AUTOSAR XML (schema 4-2-2)
package /ETAS_Project/EcucModuleConfigurationValuess
  module config MemIf: implementation-config-variant=VARIANT-PRE-COMPILE
    MemIfGeneral: MemIfDevErrorDetect=false, MemIfNumberOfDevices=1, MemIfRbFeeUsed=true, MemIfVersionInfoApi=false
  module config NvM: implementation-config-variant=VARIANT-PRE-COMPILE
    3 x NvMBlockDescriptor, all with NvMBlockCrcType=NVM_CRC16, NvMInitBlockCallback=NULL_PTR, NvMRbGenRteAdminPort=0, NvMSelectBlockForReadAll=true, NvMSelectBlockForWriteAll=true, NvMBlockJobPriority=1, NvMBlockManagementType=NVM_BLOCK_NATIVE, NvMBlockUseCrc=true, NvMBlockWriteProt=false, NvMMaxNumOfReadRetries=0, NvMMaxNumOfWriteRetries=0, NvMNvBlockNum=1, NvMNvramDeviceId=0, NvMResistantToChangedSw=false, NvMRomBlockNum=1, NvMStaticBlockIDCheck=false, NvMWriteBlockOnce=false, NvMWriteVerification=false, NvMWriteVerificationDataSize=0:
      NV_PreErasedBlock: NvMBlockUseAutoValidation=0, NvMBlockUseCRCCompMechanism=0, NvMBlockUseSyncMechanism=0, NvMCalcRamBlockCrc=0, NvMRamBlockDataAddress=Fbl_DataM_RamMirrorNV_PreErasedBlock, NvMRbFirstReadDataMigration=0, NvMRbGenRteServicePort=false, NvMRbInitBlockAtLayoutChange=0, NvMRbNoFallback=0, NvMRbRamBlockDataAddressString=NULL_PTR, NvMRbRamInitUnconditional=0, NvMRbResistantToLayoutRemoval=0, NvMRbSelectBlockForFirstInitAll=0, NvMRbSingleBlockStartCallback=NULL_PTR, NvMRbWriteCounter=0, NvMReadRamBlockFromNvCallback=NULL_PTR, NvMRomBlockDataAddress=Fbl_DataM_RomDataNV_PreErasedBlock, NvMSingleBlockCallback=Fbl_DataM_NV_PreErasedCallbackFunction, NvMWriteRamBlockToNvCallback=NULL_PTR, NvMNvBlockLength=3
      NV_ApplicationValidFlagBlock: NvMBlockUseSyncMechanism=false, NvMCalcRamBlockCrc=false, NvMNvBlockLength=4, NvMRamBlockDataAddress=Fbl_DataM_RamMirrorNV_ApplicationValidFlagBlock, NvMRomBlockDataAddress=Fbl_DataM_RomDataNV_ApplicationValidFlagBlock, NvMRbGenRteServicePort=0, NvMSingleBlockCallback=Fbl_DataM_NV_ApplicationValidFlagBlockCallbackFunction, NvMRbFirstReadDataMigration=false, NvMRbInitBlockAtLayoutChange=false, NvMRbNoFallback=false, NvMRbSelectBlockForFirstInitAll=false, NvMRbResistantToLayoutRemoval=false, NvMBlockUseAutoValidation=false
      NV_PBLValidFlagBlock: NvMBlockUseSyncMechanism=false, NvMCalcRamBlockCrc=false, NvMNvBlockLength=4, NvMRamBlockDataAddress=Fbl_DataM_RamMirrorNV_PBLValidFlagBlock, NvMRomBlockDataAddress=Fbl_DataM_RomDataNV_PBLValidFlagBlock, NvMRbGenRteServicePort=0, NvMSingleBlockCallback=Fbl_DataM_NV_PBLValidFlagBlockCallbackFunction, NvMRbFirstReadDataMigration=false, NvMRbInitBlockAtLayoutChange=false, NvMRbNoFallback=false, NvMRbSelectBlockForFirstInitAll=false, NvMRbResistantToLayoutRemoval=false, NvMBlockUseAutoValidation=false

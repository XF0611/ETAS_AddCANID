AUTOSAR XML (schema 4-2-2)
package /ETAS_Project/EcucModuleConfigurationValuess
  module config Dcm: implementation-config-variant=VARIANT-PRE-COMPILE
    DcmConfigSet
      DcmDsd
        DcmDsdServiceTable_UDS (DcmDsdServiceTable): DcmDsdSidTabId=0
      DcmDsl
      DcmDsp: DcmRbDspTransferDataMaxLenChkRequired=0
        DcmDspSecurity
        DcmDspSession
        DcmDspCA_EXTENDED_DIAGNOSTIC_SESSION (DcmDspCommonAuthorization)
        DcmDspCA_PROGRAMMING_SESSION (DcmDspCommonAuthorization)
        DcmDspDid_EcuSerialNumber (DcmDspDid):
          DcmDspDidUsePort = USE_DATA_ELEMENT_SPECIFIC_INTERFACES
          DcmRbAtomicSenderReceiverCommunication = 0
          DcmDspDidIdentifier = 61836
          DcmDspDidInfoRef = DcmDspDidInfo_EcuSerialNumber
        DcmDspData_EcuSerialNumber (DcmDspData):
          DcmRbDspDataUseAsynchronousServerCallPoint = 0
          DcmDspDataEndianness = BIG_ENDIAN
          DcmDspDataReadFnc = DID_EcuSerialNumber_0xF18C_ReadFunc
          DcmDspDataSize = 32
          DcmDspDataType = UINT8_N
          DcmDspDataUsePort = USE_DATA_ASYNCH_FNC
        DcmDspDidInfo_EcuSerialNumber (DcmDspDidInfo): DcmDspDidDynamicallyDefined=false
          DcmDspDidRead: DcmDspDidReadSessionRef=PROGRAMMING_SESSION, DcmDspDidReadSessionRef=EXTENDED_DIAGNOSTIC_SESSION, DcmDspDidReadSessionRef=DEFAULT_SESSION

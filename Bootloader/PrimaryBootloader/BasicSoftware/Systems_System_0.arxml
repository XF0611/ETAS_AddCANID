AUTOSAR XML (schema 00047)
package /Systems
  system System_0: category=SYSTEM_EXTRACT
    system mapping SystemMapping_0
      sw-mappings:
        swc to ecu mapping SwcToEcuMapping_0: component=RootSwCompositionPrototype_0.CPT_Dcm, ecu-instance=EcuInstance_0
    root-software-compositions:
      root sw composition prototype RootSwCompositionPrototype_0: software-composition=TopLevelComposition
  ecu instance EcuInstance_0

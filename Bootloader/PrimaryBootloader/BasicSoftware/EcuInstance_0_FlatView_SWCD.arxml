AUTOSAR XML (schema 00047)
package /EcuInstance_0_FlatView/SwComponentTypes
  composition sw component type EcuInstance_0_FlatView
    component CPT_Dcm: type=Dcm
    component CPT_NvM: type=NvM
    component CPT_rba_DiagLib: type=rba_DiagLib

AUTOSAR XML (schema 00047)
package /System_0_EcuExtract
  system EXTR_EcuInstance_0: category=ECU_EXTRACT, ecu-extract-version=1.0.0, system-version=1.0.0
    system mapping SYSMPG_EcuInstance_0
      sw-mappings:
        swc to ecu mapping SwcToEcuMapping_0: ecu-instance=EcuInstance_0
          component:
            CPT_EcuInstance_0_FlatView.CPT_Dcm
            CPT_EcuInstance_0_FlatView.CPT_NvM
            CPT_EcuInstance_0_FlatView.CPT_rba_DiagLib
    root-software-compositions:
      root sw composition prototype CPT_EcuInstance_0_FlatView: flat-map=EcuInstance_0_FlatMap, software-composition=EcuInstance_0_FlatView

AUTOSAR XML (schema 00047)
package /EcuInstance_0_FlatView
  flat map EcuInstance_0_FlatMap
    flat instance descriptor CPT_Dcm: upstream-reference=RootSwCompositionPrototype_0.CPT_Dcm, ecu-extract-reference=CPT_EcuInstance_0_FlatView.CPT_Dcm

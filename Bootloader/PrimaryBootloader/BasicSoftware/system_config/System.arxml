AUTOSAR XML (schema 00047)
package /System
  composition sw component type TopLevelComposition
    component CPT_rba_DiagLib: type=rba_DiagLib
    component CPT_NvM: type=NvM
    component CPT_Dcm: type=Dcm

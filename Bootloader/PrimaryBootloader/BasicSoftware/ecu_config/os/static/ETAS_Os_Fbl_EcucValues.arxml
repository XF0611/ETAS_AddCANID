AUTOSAR XML (schema 4-2-2)
package /ETAS_BIP/EcucModuleConfigurationValuess
  module config Os
    OsApp_SysCore (OsApplication):
      OsAppTaskRef = osTask_5ms
      OsAppTaskRef = osTask_1ms
      OsAppTaskRef = osTask_10ms
      OsAppTaskRef = osTask_20ms
      OsAppTaskRef = osTask_15ms
      OsAppTaskRef = osTask_StartUp
      OsAppScheduleTableRef = Fbl_ScheduleTable
    5 x OsTask, all with OsTaskActivation=1, OsTaskSchedule=FULL, OsTaskStackAllocation=1024, OsTaskAccessingApplication=OsApp_SysCore:
      osTask_10ms: OsTaskPriority=107
      osTask_StartUp: OsTaskPriority=109
        OsTaskAutostart: OsTaskAppModeRef=OSDEFAULTAPPMODE
      osTask_20ms: OsTaskPriority=108
      osTask_1ms: OsTaskPriority=105
      osTask_5ms: OsTaskPriority=106
    Fbl_ScheduleTable (OsScheduleTable): OsScheduleTableRepeating=true, OsScheduleTableDuration=22, OsScheduleTableCounterRef=Millisecond_TickCounter
      21 x OsScheduleTableExpiryPoint:
        ExpiryPoint1: OsScheduleTblExpPointOffset=1
          NewTaskAct1 (OsScheduleTableTaskActivation): OsScheduleTableActivateTaskRef=osTask_1ms
        ExpiryPoint2: OsScheduleTblExpPointOffset=2
          NewTaskAct1 (OsScheduleTableTaskActivation): OsScheduleTableActivateTaskRef=osTask_1ms
          NewTaskAct (OsScheduleTableTaskActivation): OsScheduleTableActivateTaskRef=osTask_20ms
        ExpiryPoint3: OsScheduleTblExpPointOffset=3
          NewTaskAct1 (OsScheduleTableTaskActivation): OsScheduleTableActivateTaskRef=osTask_1ms
        ExpiryPoint4: OsScheduleTblExpPointOffset=4
          NewTaskAct1 (OsScheduleTableTaskActivation): OsScheduleTableActivateTaskRef=osTask_1ms
        ExpiryPoint5: OsScheduleTblExpPointOffset=5
          NewTaskAct1 (OsScheduleTableTaskActivation): OsScheduleTableActivateTaskRef=osTask_5ms
          NewTaskAct (OsScheduleTableTaskActivation): OsScheduleTableActivateTaskRef=osTask_1ms
        ExpiryPoint6: OsScheduleTblExpPointOffset=6
          NewTaskAct1 (OsScheduleTableTaskActivation): OsScheduleTableActivateTaskRef=osTask_1ms
        ExpiryPoint7: OsScheduleTblExpPointOffset=7
          NewTaskAct1 (OsScheduleTableTaskActivation): OsScheduleTableActivateTaskRef=osTask_1ms
        ExpiryPoint8: OsScheduleTblExpPointOffset=8
          NewTaskAct1 (OsScheduleTableTaskActivation): OsScheduleTableActivateTaskRef=osTask_1ms
        ExpiryPoint9: OsScheduleTblExpPointOffset=9
          NewTaskAct1 (OsScheduleTableTaskActivation): OsScheduleTableActivateTaskRef=osTask_1ms
        ExpiryPoint10: OsScheduleTblExpPointOffset=10
          NewTaskAct1 (OsScheduleTableTaskActivation): OsScheduleTableActivateTaskRef=osTask_1ms
          NewTaskAct (OsScheduleTableTaskActivation): OsScheduleTableActivateTaskRef=osTask_5ms
        ExpiryPoint11: OsScheduleTblExpPointOffset=11
          NewTaskAct1 (OsScheduleTableTaskActivation): OsScheduleTableActivateTaskRef=osTask_1ms
          NewTaskAct (OsScheduleTableTaskActivation): OsScheduleTableActivateTaskRef=osTask_10ms
        ExpiryPoint12: OsScheduleTblExpPointOffset=12
          NewTaskAct1 (OsScheduleTableTaskActivation): OsScheduleTableActivateTaskRef=osTask_1ms
        ExpiryPoint13: OsScheduleTblExpPointOffset=13
          NewTaskAct1 (OsScheduleTableTaskActivation): OsScheduleTableActivateTaskRef=osTask_1ms
        ExpiryPoint14: OsScheduleTblExpPointOffset=14
          NewTaskAct1 (OsScheduleTableTaskActivation): OsScheduleTableActivateTaskRef=osTask_1ms
        ExpiryPoint15: OsScheduleTblExpPointOffset=15
          NewTaskAct1 (OsScheduleTableTaskActivation): OsScheduleTableActivateTaskRef=osTask_1ms
          NewTaskAct (OsScheduleTableTaskActivation): OsScheduleTableActivateTaskRef=osTask_5ms
        ExpiryPoint16: OsScheduleTblExpPointOffset=16
          NewTaskAct1 (OsScheduleTableTaskActivation): OsScheduleTableActivateTaskRef=osTask_1ms
          NewTaskAct (OsScheduleTableTaskActivation): OsScheduleTableActivateTaskRef=osTask_15ms
        ExpiryPoint17: OsScheduleTblExpPointOffset=17
          NewTaskAct1 (OsScheduleTableTaskActivation): OsScheduleTableActivateTaskRef=osTask_1ms
        ExpiryPoint18: OsScheduleTblExpPointOffset=18
          NewTaskAct1 (OsScheduleTableTaskActivation): OsScheduleTableActivateTaskRef=osTask_1ms
        ExpiryPoint19: OsScheduleTblExpPointOffset=19
          NewTaskAct1 (OsScheduleTableTaskActivation): OsScheduleTableActivateTaskRef=osTask_1ms
        ExpiryPoint20: OsScheduleTblExpPointOffset=20
          NewTaskAct1 (OsScheduleTableTaskActivation): OsScheduleTableActivateTaskRef=osTask_1ms
          NewTaskAct (OsScheduleTableTaskActivation): OsScheduleTableActivateTaskRef=osTask_5ms
        ExpiryPoint21: OsScheduleTblExpPointOffset=21
          NewTaskAct1 (OsScheduleTableTaskActivation): OsScheduleTableActivateTaskRef=osTask_1ms
          NewTaskAct (OsScheduleTableTaskActivation): OsScheduleTableActivateTaskRef=osTask_10ms
      OsScheduleTableSync: OsScheduleTblSyncStrategy=NONE
    osTask_15ms (OsTask): OsTaskActivation=1, OsTaskPriority=110, OsTaskSchedule=FULL, OsTaskStackAllocation=1024, OsTaskAccessingApplication=OsApp_SysCore

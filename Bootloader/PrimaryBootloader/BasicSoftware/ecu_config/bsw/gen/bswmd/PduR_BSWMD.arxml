AUTOSAR XML (schema 4-2-2)
package /AUTOSAR_PduR/BswModuleEntrys
  bsw module entry PduR_Init: is-reentrant=false, is-synchronous=true, call-type=REGULAR, execution-context=UNSPECIFIED, sw-service-impl-policy=STANDARD
  bsw module entry PduR_GetVersionInfo: is-reentrant=false, is-synchronous=true, call-type=CALLBACK, execution-context=UNSPECIFIED, sw-service-impl-policy=STANDARD
  bsw module entry PduR_DsmReInitMainFunction: is-reentrant=false, is-synchronous=true, call-type=SCHEDULED, execution-context=TASK, sw-service-impl-policy=STANDARD

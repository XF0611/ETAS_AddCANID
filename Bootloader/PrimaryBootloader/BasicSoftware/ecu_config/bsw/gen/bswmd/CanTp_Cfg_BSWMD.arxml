AUTOSAR XML (schema 4-2-2)
package /AUTOSAR_CanTp/BswModuleDescriptions
  bsw module description CanTp
    bsw internal behavior BswInternalBehavior
      bsw timing event TE_CanTpNormalOperatingMode: starts-on-event=CanTp_MainFunction, period=0.001

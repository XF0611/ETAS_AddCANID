AUTOSAR XML (schema 4-2-2)
package /RB/RBA/rba_MemLib/BswModuleDescriptions
  bsw module description rba_MemLib: category=BSW_MODULE, module-id=255  # Memstack internal support function
package /RB/RBA/rba_MemLib/DataConstrs
  range Mem_u8: phys 0..255 Mem_NoUnit
  range Mem_u16: phys 0..65535 Mem_NoUnit
  range Mem_u24: phys 0..16777215 Mem_NoUnit
  range Mem_u32: phys 0..4294967295 Mem_NoUnit
package /RB/RBA/rba_MemLib/Units
  unit Mem_NoUnit: display-name=Mem_NoUnit, factor-si-to-unit=1.0, offset-si-to-unit=0.0, physical-dimension=Mem_NoPhysDim  # Mem No Unit / 1:1 / Identical
package /RB/RBA/rba_MemLib/PhysicalDimensions
  physical dimension Mem_NoPhysDim: length-exp=0
package /RB/RBA/rba_MemLib/CompuMethods
  compu method Mem_Identical: identical; unit Mem_NoUnit  # The internal value and the physical one are identical. No physical unit available

AUTOSAR XML (schema 00047)
package /ETAS_Project/EcucModuleConfigurationValuess
  module config CanIf
    CanIfInitCfg
      UDS_Tx_Phys_Id_0x7B7_CANNODE_0 (CanIfTxPduCfg): CanIfTxPduId=0
      UDS_Rx_Phys_Id_0x737_CANNODE_0 (CanIfRxPduCfg): CanIfRxPduId=0
      UDS_Rx_Func_Id_0x7DF_CANNODE_0 (CanIfRxPduCfg): CanIfRxPduId=1
    CanIfCtrlDrvCfg
      CANNODE_0 (CanIfCtrlCfg): CanIfCtrlId=0
  module config CanSM
    CanSMConfiguration
      CanSMManagerNetwork_Can_Network (CanSMManagerNetwork): CanSMNetworkIndex=0
  module config CanTp
    CanTpConfig_0 (CanTpConfig)
      CanTpChannel_UDS (CanTpChannel)
        UdsOnCan_Rx_Func_0x7DF (CanTpRxNSdu): CanTpRxNSduId=0
          Func_CanIf2CanTP (CanTpRxNPdu): CanTpRxNPduId=0
        UdsOnCan_Rx_Phys_0x737 (CanTpRxNSdu): CanTpRxNSduId=1
          Phys_CanIf2CanTp (CanTpRxNPdu): CanTpRxNPduId=1
          Phys_CanTp2CanIf (CanTpTxFcNPdu): CanTpTxFcNPduConfirmationPduId=0
        UdsOnCan_Tx_Phy_0x7B7 (CanTpTxNSdu): CanTpTxNSduId=0
          Phys_CanIf2CanTp (CanTpRxFcNPdu): CanTpRxFcNPduId=1
          Phys_CanTp2CanIf (CanTpTxNPdu): CanTpTxNPduConfirmationPduId=0
    CanTpGeneral: CanTpRbValidationDone=true
  module config rba_MemLib
    rba_MemLibPublished:
      rba_MemLibPublishedEnablePrototype = false
      rba_MemLibPublishedEnableRte = false
      rba_MemLibPublishedEnableVecu = false
      rba_MemLibPublishedSwMajorVersion = 17
      rba_MemLibPublishedSwMinorVersion = 0
      rba_MemLibPublishedSwPatchVersion = 0
      rba_MemLibPublishedARMajorVersion = 4
      rba_MemLibPublishedARMinorVersion = 2
      rba_MemLibPublishedARRevisionVersion = 2
  module config Dcm
    DcmConfigSet
      DcmDsl
        DcmDslProtocol
          DcmDslProtocolRow_UDS (DcmDslProtocolRow)
            DcmDslConnection_CAN (DcmDslConnection)
              DcmDslMainConnection
                UDS_Rx_Func_Id_0x7DF_CANNODE_0_Func_PduR2Dcm (DcmDslProtocolRx): DcmDslProtocolRxPduId=1
                UDS_Rx_Phys_Id_0x737_CANNODE_0_Phys_PduR2Dcm (DcmDslProtocolRx): DcmDslProtocolRxPduId=0
                UDS_Tx_Phys_Id_0x7B7_CANNODE_0_Phys_Dcm2PduR (DcmDslProtocolTx): DcmDslTxConfirmationPduId=0
      DcmDsd
        DcmDsdServiceTable_UDS (DcmDsdServiceTable): DcmDsdSidTabId=0
  module config MemIf
    MemIfGeneral:
      MemIfMainFunctionCycleTime = 0.01
      MemIfNumberOfDevices = 1
      MemIfRbFeeUsed = true
      MemIfRbMainFunctionScheduling = MEMIF_RB_MAINFUNC_SCHEDULING_RTE_TIMED
      MemIfRbNumberOfEADevices = 0
  module config Fee
    FeeGeneral: FeePollingMode=true
    7 x FeeBlockConfiguration, all with FeeImmediateData=false, FeeNumberOfWriteCycles=1, FeeRbBlockSizeString=, FeeRbCallbackEnd=NULL_PTR, FeeRbCallbackError=NULL_PTR, FeeRbDeviceIndex=0, FeeRbFirstReadDataMigration=false, FeeRbNoFallback=false, FeeRbOrigin=NVM, FeeRbSecLevel=1, FeeRbSurvival=false, FeeRbVarBlockLength=false:
      NV_ApplicationDataFingerprintBlock: FeeBlockSize=27, FeeRbBlockPersistentId=27326
      NV_ApplicationSoftwareFingerprintBlock: FeeBlockSize=27, FeeRbBlockPersistentId=29884
      NV_ApplicationValidFlagBlock: FeeBlockSize=4, FeeRbBlockPersistentId=16561
      NV_BootSoftwareFingerprintBlock: FeeBlockSize=27, FeeRbBlockPersistentId=3260
      NV_ExternalReprogrammingRequestFlagBlock: FeeBlockSize=4, FeeRbBlockPersistentId=32699
      NV_PBLValidFlagBlock: FeeBlockSize=4, FeeRbBlockPersistentId=4628
      NV_PreErasedBlock: FeeBlockSize=3, FeeRbBlockPersistentId=30213
  module config PduR
    PduRRoutingTables
      PduRRoutingTable
        3 x PduRRoutingPath:
          CanTp2Dcm_0x737
            Src_CanTp2Dcm_0x737 (PduRSrcPdu): PduRSourcePduHandleId=0
            Dest_CanTp2Dcm_0x737 (PduRDestPdu): PduRDestPduHandleId=0
          CanTp2Dcm_0x7DF
            Src_CanTp2Dcm_0x7DF (PduRSrcPdu): PduRSourcePduHandleId=1
            Dest_CanTp2Dcm_0x7DF (PduRDestPdu): PduRDestPduHandleId=1
          Dcm2CanTp_0x7B7
            Dst_Dcm2CanTp_0x7B7 (PduRDestPdu): PduRDestPduHandleId=0
            Src_Dcm2CanTp_0x7B7 (PduRSrcPdu): PduRSourcePduHandleId=0
package /RB/UBK/Project/EcucModuleConfigurationValuess
  module config rba_ArxmlGen
    3 x rba_ArxmlGen_Comp:
      CanIf
        CanIf_ControllerState_Astruct_impl (rba_ArxmlGen_ImplDataType): rba_ArxmlGen_ImplDataTypeCategory=Array, rba_ArxmlGen_ImplDataTypeLongName=Implementation datatype for array of struct
          CanIf_struct_impl (rba_ArxmlGen_ImplDataTypeSub): rba_ArxmlGen_ImplDataTypeSubOwnRef=CanIf_ControllerStateType_struct_impl
        CanIf_ControllerState_Astruct_app (rba_ArxmlGen_ApplDataType):
          rba_ArxmlGen_ApplDataTypeCategory = Array
          rba_ArxmlGen_ApplDataTypeLongName = Structure datatype in CanIf
          rba_ArxmlGen_ApplDataTypeImplOwnRef = CanIf/CanIf_ControllerState_Astruct_impl
          CanIf_ControllerStateType (rba_ArxmlGen_ApplDataTypeSub): rba_ArxmlGen_ApplDataTypeSubOwnRef=CanIf_ControllerStateType_struct_app
        CanIf_ControllerState_Astruct_app (rba_ArxmlGen_ApplDataType): rba_ArxmlGen_ApplDataTypeNumElements=1
        CanIf_ControllerState_Astruct_impl (rba_ArxmlGen_ImplDataType): rba_ArxmlGen_ImplDataTypeNumElements=1
        CanIf_Prv_ControllerState_ast (rba_ArxmlGen_Measurement):
          rba_ArxmlGen_MeasCategory = Array
          rba_ArxmlGen_MeasDispFormat = %5.0f
          rba_ArxmlGen_MeasLongName = Can Interface controller State
          rba_ArxmlGen_MeasAddrMethodRef = INTERNAL_VAR_CLEARED
          rba_ArxmlGen_MeasApplDataTypeOwnRef = CanIf/CanIf_ControllerState_Astruct_app
        CanIf_NotifStatusType_Aenum_impl (rba_ArxmlGen_ImplDataType): rba_ArxmlGen_ImplDataTypeCategory=Array, rba_ArxmlGen_ImplDataTypeLongName=implementation data type for array of enum
          CanIf_Enum_impl (rba_ArxmlGen_ImplDataTypeSub): rba_ArxmlGen_ImplDataTypeSubOwnRef=CanIf_NotifStatusType_Enum_impl
        CanIf_NotifStatusType_Aenum_app (rba_ArxmlGen_ApplDataType):
          rba_ArxmlGen_ApplDataTypeCategory = Array
          rba_ArxmlGen_ApplDataTypeLongName = application data type for array of enum
          rba_ArxmlGen_ApplDataTypeImplOwnRef = CanIf/CanIf_NotifStatusType_Aenum_impl
          CanIf_NotifStatusType (rba_ArxmlGen_ApplDataTypeSub): rba_ArxmlGen_ApplDataTypeSubOwnRef=CanIf_NotifStatusType_Enum_app
        CanIf_NotifStatusType_Aenum_app (rba_ArxmlGen_ApplDataType): rba_ArxmlGen_ApplDataTypeNumElements=1
        CanIf_NotifStatusType_Aenum_impl (rba_ArxmlGen_ImplDataType): rba_ArxmlGen_ImplDataTypeNumElements=1
        CanIf_Prv_TxNotification_aen (rba_ArxmlGen_Measurement):
          rba_ArxmlGen_MeasCategory = Array
          rba_ArxmlGen_MeasDispFormat = %5.0f
          rba_ArxmlGen_MeasLongName = Can Interface Transmit Notification
          rba_ArxmlGen_MeasAddrMethodRef = INTERNAL_VAR_CLEARED
          rba_ArxmlGen_MeasApplDataTypeOwnRef = CanIf/CanIf_NotifStatusType_Aenum_app
      CanSM
        CanSM_Au8_app (rba_ArxmlGen_ApplDataType): rba_ArxmlGen_ApplDataTypeNumElements=1
        CanSM_Au8_impl (rba_ArxmlGen_ImplDataType): rba_ArxmlGen_ImplDataTypeNumElements=1
        CanSM_Aboolean_app (rba_ArxmlGen_ApplDataType): rba_ArxmlGen_ApplDataTypeNumElements=1
        CanSM_Aboolean_impl (rba_ArxmlGen_ImplDataType): rba_ArxmlGen_ImplDataTypeNumElements=1
        CanSM_currBOR_State_a_Aenum_app (rba_ArxmlGen_ApplDataType): rba_ArxmlGen_ApplDataTypeNumElements=1
        CanSM_currBOR_State_a_Aenum_impl (rba_ArxmlGen_ImplDataType): rba_ArxmlGen_ImplDataTypeNumElements=1
        CanSM_currComM_Mode_a_Aenum_app (rba_ArxmlGen_ApplDataType): rba_ArxmlGen_ApplDataTypeNumElements=1
        CanSM_currComM_Mode_a_Aenum_impl (rba_ArxmlGen_ImplDataType): rba_ArxmlGen_ImplDataTypeNumElements=1
        CanSM_TimerConfig_ast_Astruct_app (rba_ArxmlGen_ApplDataType): rba_ArxmlGen_ApplDataTypeNumElements=1
        CanSM_TimerConfig_ast_Astruct_impl (rba_ArxmlGen_ImplDataType): rba_ArxmlGen_ImplDataTypeNumElements=1
        SE_MainFunction (rba_ArxmlGen_ExecEntity): rba_ArxmlGen_ExecEntityPeriod=0.01
      NvM: rba_ArxmlGen_CompCategory=BswModule, rba_ArxmlGen_CompId=20, rba_ArxmlGen_CompIsConfigurable=true, rba_ArxmlGen_CompIsStandalone=false, rba_ArxmlGen_CompIsStandardized=true, rba_ArxmlGen_CompLongName=NVRAM Manager, rba_ArxmlGen_CompVersionSw=17.0.0, rba_ArxmlGen_CompSwcBswMappingRef=NvM
        4 x rba_ArxmlGen_CompuMethod, all with rba_ArxmlGen_CompuMethodCategory=TextTable:
          NvM_Rb_StatusType: rba_ArxmlGen_CompuMethodLongName=Computation method for the type of the current overall status of the NVRAM manager.
            3 x rba_ArxmlGen_CompuMethodTextEntry, all with rba_ArxmlGen_CompuMethodTENumVals=1:
              NVM_RB_STATUS_UNINIT: rba_ArxmlGen_CompuMethodTEIntVal=0, rba_ArxmlGen_CompuMethodTEText=NVM_RB_STATUS_UNINIT
              NVM_RB_STATUS_IDLE: rba_ArxmlGen_CompuMethodTEIntVal=1, rba_ArxmlGen_CompuMethodTEText=NVM_RB_STATUS_IDLE
              NVM_RB_STATUS_BUSY: rba_ArxmlGen_CompuMethodTEIntVal=2, rba_ArxmlGen_CompuMethodTEText=NVM_RB_STATUS_BUSY
          NvM_RequestResultType: rba_ArxmlGen_CompuMethodLongName=Computation method for the type of the block request result.
            9 x rba_ArxmlGen_CompuMethodTextEntry, all with rba_ArxmlGen_CompuMethodTENumVals=1:
              NVM_REQ_OK: rba_ArxmlGen_CompuMethodTEIntVal=0, rba_ArxmlGen_CompuMethodTEText=NVM_REQ_OK
              NVM_REQ_NOT_OK: rba_ArxmlGen_CompuMethodTEIntVal=1, rba_ArxmlGen_CompuMethodTEText=NVM_REQ_NOT_OK
              NVM_REQ_PENDING: rba_ArxmlGen_CompuMethodTEIntVal=2, rba_ArxmlGen_CompuMethodTEText=NVM_REQ_PENDING
              NVM_REQ_INTEGRITY_FAILED: rba_ArxmlGen_CompuMethodTEIntVal=3, rba_ArxmlGen_CompuMethodTEText=NVM_REQ_INTEGRITY_FAILED
              NVM_REQ_BLOCK_SKIPPED: rba_ArxmlGen_CompuMethodTEIntVal=4, rba_ArxmlGen_CompuMethodTEText=NVM_REQ_BLOCK_SKIPPED
              NVM_REQ_NV_INVALIDATED: rba_ArxmlGen_CompuMethodTEIntVal=5, rba_ArxmlGen_CompuMethodTEText=NVM_REQ_NV_INVALIDATED
              NVM_REQ_CANCELED: rba_ArxmlGen_CompuMethodTEIntVal=6, rba_ArxmlGen_CompuMethodTEText=NVM_REQ_CANCELED
              NVM_REQ_REDUNDANCY_FAILED: rba_ArxmlGen_CompuMethodTEIntVal=7, rba_ArxmlGen_CompuMethodTEText=NVM_REQ_REDUNDANCY_FAILED
              NVM_REQ_RESTORED_FROM_ROM: rba_ArxmlGen_CompuMethodTEIntVal=8, rba_ArxmlGen_CompuMethodTEText=NVM_REQ_RESTORED_FROM_ROM
          NvM_Rb_MigrationResult_ten: rba_ArxmlGen_CompuMethodLongName=Computation method for the type of the the migration result.
            6 x rba_ArxmlGen_CompuMethodTextEntry, all with rba_ArxmlGen_CompuMethodTENumVals=1:
              NVM_RB_MIGRATION_RESULT_INIT_E: rba_ArxmlGen_CompuMethodTEIntVal=0, rba_ArxmlGen_CompuMethodTEText=NVM_RB_MIGRATION_RESULT_INIT_E
              NVM_RB_MIGRATION_RESULT_NOT_NECESSARY_E: rba_ArxmlGen_CompuMethodTEIntVal=1, rba_ArxmlGen_CompuMethodTEText=NVM_RB_MIGRATION_RESULT_NOT_NECESSARY_E
              NVM_RB_MIGRATION_RESULT_TO_SMALLER_SIZE_E: rba_ArxmlGen_CompuMethodTEIntVal=2, rba_ArxmlGen_CompuMethodTEText=NVM_RB_MIGRATION_RESULT_TO_SMALLER_SIZE_E
              NVM_RB_MIGRATION_RESULT_TO_BIGGER_SIZE_E: rba_ArxmlGen_CompuMethodTEIntVal=3, rba_ArxmlGen_CompuMethodTEText=NVM_RB_MIGRATION_RESULT_TO_BIGGER_SIZE_E
              NVM_RB_MIGRATION_RESULT_NOT_DONE_E: rba_ArxmlGen_CompuMethodTEIntVal=4, rba_ArxmlGen_CompuMethodTEText=NVM_RB_MIGRATION_RESULT_NOT_DONE_E
              NVM_RB_MIGRATION_RESULT_DEACTIVATED_E: rba_ArxmlGen_CompuMethodTEIntVal=5, rba_ArxmlGen_CompuMethodTEText=NVM_RB_MIGRATION_RESULT_DEACTIVATED_E
          NvM_Rb_RequestType_ten: rba_ArxmlGen_CompuMethodLongName=Computation method for the type of the currently active user block request.
            3 x rba_ArxmlGen_CompuMethodTextEntry, all with rba_ArxmlGen_CompuMethodTENumVals=1:
              NvM_Rb_RequestType_NA_e: rba_ArxmlGen_CompuMethodTEIntVal=0, rba_ArxmlGen_CompuMethodTEText=NvM_Rb_RequestType_NA_e
              NvM_Rb_RequestType_Multi_e: rba_ArxmlGen_CompuMethodTEIntVal=1, rba_ArxmlGen_CompuMethodTEText=NvM_Rb_RequestType_Multi_e
              NvM_Rb_RequestType_Single_e: rba_ArxmlGen_CompuMethodTEIntVal=2, rba_ArxmlGen_CompuMethodTEText=NvM_Rb_RequestType_Single_e
        3 x rba_ArxmlGen_DataConstraint, all with rba_ArxmlGen_DataConstraintCategory=Physical, rba_ArxmlGen_DataConstraintLower=0, rba_ArxmlGen_DataConstraintUnitRef=Mem_NoUnit:
          NvM_Constr_NoUnit_u32: rba_ArxmlGen_DataConstraintUpper=4294967295
          NvM_Constr_NoUnit_u16: rba_ArxmlGen_DataConstraintUpper=65535
          NvM_Constr_NoUnit_u8: rba_ArxmlGen_DataConstraintUpper=255
        30 x rba_ArxmlGen_ExecEntity:
          CE_CancelWriteAll: rba_ArxmlGen_ExecEntityCategory=Called, rba_ArxmlGen_ExecEntityImplEntryRef=NvM_CancelWriteAll
          CE_EraseNvBlock: rba_ArxmlGen_ExecEntityCategory=Called, rba_ArxmlGen_ExecEntityImplEntryRef=NvM_EraseNvBlock
          CE_GetDataIndex: rba_ArxmlGen_ExecEntityCategory=Called, rba_ArxmlGen_ExecEntityImplEntryRef=NvM_GetDataIndex
          CE_GetErrorStatus: rba_ArxmlGen_ExecEntityCategory=Called, rba_ArxmlGen_ExecEntityImplEntryRef=NvM_GetErrorStatus
          CE_Init: rba_ArxmlGen_ExecEntityCategory=Called, rba_ArxmlGen_ExecEntityImplEntryRef=NvM_Init
          CE_InvalidateNvBlock: rba_ArxmlGen_ExecEntityCategory=Called, rba_ArxmlGen_ExecEntityImplEntryRef=NvM_InvalidateNvBlock
          SE_MainFunction: rba_ArxmlGen_ExecEntityCategory=Schedulable, rba_ArxmlGen_ExecEntityPeriod=0.01, rba_ArxmlGen_ExecEntityImplEntryRef=NvM_MainFunction
          CE_Rb_ClrWriteMonCntrs: rba_ArxmlGen_ExecEntityCategory=Called, rba_ArxmlGen_ExecEntityImplEntryRef=NvM_Rb_ClrWriteMonCntrs
          CE_Rb_FirstInitAll: rba_ArxmlGen_ExecEntityCategory=Called, rba_ArxmlGen_ExecEntityImplEntryRef=NvM_Rb_FirstInitAll
          CE_Rb_GetActiveService: rba_ArxmlGen_ExecEntityCategory=Called, rba_ArxmlGen_ExecEntityImplEntryRef=NvM_Rb_GetActiveService
          CE_Rb_GetBlockId: rba_ArxmlGen_ExecEntityCategory=Called, rba_ArxmlGen_ExecEntityImplEntryRef=NvM_Rb_GetBlockId
          CE_Rb_GetMigrationResult: rba_ArxmlGen_ExecEntityCategory=Called, rba_ArxmlGen_ExecEntityImplEntryRef=NvM_Rb_GetMigrationResult
          CE_Rb_GetNvBlockLength: rba_ArxmlGen_ExecEntityCategory=Called, rba_ArxmlGen_ExecEntityImplEntryRef=NvM_Rb_GetNvBlockLength
          CE_Rb_GetRequestType: rba_ArxmlGen_ExecEntityCategory=Called, rba_ArxmlGen_ExecEntityImplEntryRef=NvM_Rb_GetRequestType
          CE_Rb_GetStatus: rba_ArxmlGen_ExecEntityCategory=Called, rba_ArxmlGen_ExecEntityImplEntryRef=NvM_Rb_GetStatus
          CE_Rb_GetWriteCounter: rba_ArxmlGen_ExecEntityCategory=Called, rba_ArxmlGen_ExecEntityImplEntryRef=NvM_Rb_GetWriteCounter
          CE_ReadAll: rba_ArxmlGen_ExecEntityCategory=Called, rba_ArxmlGen_ExecEntityImplEntryRef=NvM_ReadAll
          CE_ReadBlock: rba_ArxmlGen_ExecEntityCategory=Called, rba_ArxmlGen_ExecEntityImplEntryRef=NvM_ReadBlock
          CE_ReadPRAMBlock: rba_ArxmlGen_ExecEntityCategory=Called, rba_ArxmlGen_ExecEntityImplEntryRef=NvM_ReadPRAMBlock
          CE_RestoreBlockDefaults: rba_ArxmlGen_ExecEntityCategory=Called, rba_ArxmlGen_ExecEntityImplEntryRef=NvM_RestoreBlockDefaults
          CE_RestorePRAMBlockDefaults: rba_ArxmlGen_ExecEntityCategory=Called, rba_ArxmlGen_ExecEntityImplEntryRef=NvM_RestorePRAMBlockDefaults
          CE_SetBlockLockStatus: rba_ArxmlGen_ExecEntityCategory=Called, rba_ArxmlGen_ExecEntityImplEntryRef=NvM_SetBlockLockStatus
          CE_SetBlockProtection: rba_ArxmlGen_ExecEntityCategory=Called, rba_ArxmlGen_ExecEntityImplEntryRef=NvM_SetBlockProtection
          CE_SetDataIndex: rba_ArxmlGen_ExecEntityCategory=Called, rba_ArxmlGen_ExecEntityImplEntryRef=NvM_SetDataIndex
          CE_SetRamBlockStatus: rba_ArxmlGen_ExecEntityCategory=Called, rba_ArxmlGen_ExecEntityImplEntryRef=NvM_SetRamBlockStatus
          CE_SetWriteAllTrigger: rba_ArxmlGen_ExecEntityCategory=Called, rba_ArxmlGen_ExecEntityImplEntryRef=NvM_Rb_SetWriteAllTrigger
          CE_ValidateAll: rba_ArxmlGen_ExecEntityCategory=Called, rba_ArxmlGen_ExecEntityImplEntryRef=NvM_ValidateAll
          CE_WriteAll: rba_ArxmlGen_ExecEntityCategory=Called, rba_ArxmlGen_ExecEntityImplEntryRef=NvM_WriteAll
          CE_WriteBlock: rba_ArxmlGen_ExecEntityCategory=Called, rba_ArxmlGen_ExecEntityImplEntryRef=NvM_WriteBlock
          CE_WritePRAMBlock: rba_ArxmlGen_ExecEntityCategory=Called, rba_ArxmlGen_ExecEntityImplEntryRef=NvM_WritePRAMBlock

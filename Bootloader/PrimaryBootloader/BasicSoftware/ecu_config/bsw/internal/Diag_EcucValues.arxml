AUTOSAR XML (schema 00047)
package /ETAS_Project
  module config Crc
    CrcGeneral:
      Crc8H2F = 0
      Crc8H2FMode = CRC_8H2F_TABLE
      Crc8 = 0
      Crc8Mode = CRC_8_TABLE
      Crc16 = 1
      Crc16Mode = CRC_16_TABLE
      Crc32 = 1
      Crc32Mode = CRC_32_TABLE
      Crc64 = 0
      Crc64Mode = CRC_64_TABLE
      CrcVersionInfoApi = 1
      Crc32P4 = false
    CrcRbRevision: CrcRbRev=Revision_2
package /ETAS_Project/EcucModuleConfigurationValuess
  module config CanTp: implementation-config-variant=VARIANT-PRE-COMPILE
    CanTpConfig_0 (CanTpConfig): CanTpMainFunctionPeriod=0.001
      CanTpChannel_UDS (CanTpChannel): CanTpChannelMode=CANTP_MODE_FULL_DUPLEX
        UdsOnCan_Rx_Func_0x7DF (CanTpRxNSdu):
          CanTpBs = 0
          CanTpNar = 0.025
          CanTpNbr = 0
          CanTpNcr = 0.15
          CanTpRxAddressingFormat = CANTP_STANDARD
          CanTpRxPaddingActivation = CANTP_ON
          CanTpRxTaType = CANTP_FUNCTIONAL
          CanTpSTmin = 0.0
          CanTpRbRxFcDisabled = false
          CanTpRxNSduRef = UDS_Rx_Func_Id_0x7DF_CANNODE_0_CanTp2PduR
          Func_CanIf2CanTP (CanTpRxNPdu): CanTpRxNPduRef=UDS_Rx_Func_Id_0x7DF_CANNODE_0_CanIf2CanTp
        UdsOnCan_Rx_Phys_0x737 (CanTpRxNSdu):
          CanTpBs = 0
          CanTpNar = 0.07
          CanTpNbr = 0
          CanTpNcr = 0.15
          CanTpRxAddressingFormat = CANTP_STANDARD
          CanTpRxPaddingActivation = CANTP_ON
          CanTpRxTaType = CANTP_PHYSICAL
          CanTpSTmin = 0.0
          CanTpRbRxFcDisabled = false
          CanTpRxNSduRef = UDS_Rx_Phys_Id_0x737_CANNODE_0_CanTp2PduR
          Phys_CanIf2CanTp (CanTpRxNPdu): CanTpRxNPduRef=UDS_Rx_Phys_Id_0x737_CANNODE_0_CanIf2CanTp
          Phys_CanTp2CanIf (CanTpTxFcNPdu): CanTpTxFcNPduConfirmationPduId=0, CanTpTxFcNPduRef=UDS_Tx_Phys_Id_0x7B7_CANNODE_0_Phys_CanTp2CanIf
        UdsOnCan_Tx_Phy_0x7B7 (CanTpTxNSdu):
          CanTpNas = 0.07
          CanTpNbs = 0.15
          CanTpNcs = 0.0
          CanTpTc = 1
          CanTpTxAddressingFormat = CANTP_STANDARD
          CanTpTxNSduId = 0
          CanTpTxPaddingActivation = CANTP_ON
          CanTpTxTaType = CANTP_PHYSICAL
          CanTpRbTxFcDisabled = false
          CanTpTxNSduRef = UDS_Tx_Phys_Id_0x7B7_CANNODE_0_Phys_PduR2CanTp
          Phys_CanIf2CanTp (CanTpRxFcNPdu): CanTpRxFcNPduRef=UDS_Rx_Phys_Id_0x737_CANNODE_0_CanIf2CanTp
          Phys_CanTp2CanIf (CanTpTxNPdu): CanTpTxNPduConfirmationPduId=0, CanTpTxNPduRef=UDS_Tx_Phys_Id_0x7B7_CANNODE_0_Phys_CanTp2CanIf
    CanTpGeneral:
      CanTpChangeParameterApi = false
      CanTpDevErrorDetect = true
      CanTpPaddingByte = 255
      CanTpRbValidationDone = true
      CanTpReadParameterApi = 0
      CanTpVersionInfoApi = true
      CanTpRbLiteSupport = false
      CanTpRbBurstQsize = 8
      CanTpRbDynamicFlowControlSupport = false
      CanTpRbExternalCounterSecondsPerTick = 1.25E-8
      CanTpRbPageConfirmation = false
      CanTpRbStrictDlcCheck = false
      CanTpRbLegacySharedFcEnabled = false
  module config Dcm: implementation-config-variant=VARIANT-PRE-COMPILE
    DcmConfigSet
      DcmDsd: DcmDsdRequestManufacturerNotificationEnabled=false, DcmDsdRequestSupplierNotificationEnabled=false
        DcmDsdServiceTable_UDS (DcmDsdServiceTable): DcmDsdSidTabId=0, DcmRbNRCForService=127
          12 x DcmDsdService:
            TesterPresent: DcmDsdSidTabFnc=Dcm_DcmTesterPresent, DcmDsdSidTabServiceId=62, DcmDsdSidTabSubfuncAvail=true, DcmRbDsdSidTabSidInitFunction=NULL_PTR, DcmDsdSidTabSessionLevelRef=DcmDspSession/DEFAULT_SESSION, DcmDsdSidTabSessionLevelRef=DcmDspSession/PROGRAMMING_SESSION, DcmDsdSidTabSessionLevelRef=DcmDspSession/EXTENDED_DIAGNOSTIC_SESSION
              zeroSubFunction (DcmDsdSubService):
                DcmDsdSubServiceId = 0
                DcmDsdSubServiceSessionLevelRef = DcmDspSession/DEFAULT_SESSION
                DcmDsdSubServiceSessionLevelRef = DcmDspSession/EXTENDED_DIAGNOSTIC_SESSION
                DcmDsdSubServiceSessionLevelRef = DcmDspSession/PROGRAMMING_SESSION
            DiagnosticSessionControl: DcmDsdSidTabFnc=Dcm_DcmDiagnosticSessionControl, DcmDsdSidTabServiceId=16, DcmDsdSidTabSubfuncAvail=true, DcmRbDsdSidTabSidInitFunction=Dcm_Dsp_DscIni, DcmDsdSidTabSessionLevelRef=DcmDspSession/DEFAULT_SESSION, DcmDsdSidTabSessionLevelRef=DcmDspSession/EXTENDED_DIAGNOSTIC_SESSION, DcmDsdSidTabSessionLevelRef=DcmDspSession/PROGRAMMING_SESSION
              3 x DcmDsdSubService, all with DcmDsdSubServiceSessionLevelRef=DcmDspSession/EXTENDED_DIAGNOSTIC_SESSION, DcmDsdSubServiceSessionLevelRef=DcmDspSession/DEFAULT_SESSION:
                DEFAULT_SESSION: DcmDsdSubServiceId=1, DcmDsdSubServiceSessionLevelRef=DcmDspSession/PROGRAMMING_SESSION
                PROGRAMMING_SESSION: DcmDsdSubServiceId=2, DcmDsdSubServiceSessionLevelRef=DcmDspSession/PROGRAMMING_SESSION
                EXTENDED_DIAGNOSTIC_SESSION: DcmDsdSubServiceId=3
            SecurityAccess: DcmDsdSidTabFnc=Dcm_DcmSecurityAccess, DcmDsdSidTabServiceId=39, DcmDsdSidTabSubfuncAvail=true, DcmRbDsdSidTabSidInitFunction=Dcm_Dsp_SecaIni, DcmDsdSidTabSessionLevelRef=DcmDspSession/EXTENDED_DIAGNOSTIC_SESSION, DcmDsdSidTabSessionLevelRef=DcmDspSession/PROGRAMMING_SESSION
              DcmDsdSubService_requestSeed_FBL (DcmDsdSubService):
                DcmDsdSubServiceId = 17
                DcmDsdSubServiceSessionLevelRef = DcmDspSession/PROGRAMMING_SESSION
                DcmDsdSubServiceSessionLevelRef = DcmDspSession/EXTENDED_DIAGNOSTIC_SESSION
              DcmDsdSubService_sendKey_FBL (DcmDsdSubService):
                DcmDsdSubServiceId = 18
                DcmDsdSubServiceSessionLevelRef = DcmDspSession/PROGRAMMING_SESSION
                DcmDsdSubServiceSessionLevelRef = DcmDspSession/EXTENDED_DIAGNOSTIC_SESSION
            WriteDataByIdentifier: DcmDsdSidTabFnc=Dcm_DcmWriteDataByIdentifier, DcmDsdSidTabServiceId=46, DcmDsdSidTabSubfuncAvail=false, DcmRbDsdSidTabSidInitFunction=Dcm_Dcm_WDBIInit, DcmDsdSidTabSessionLevelRef=DcmDspSession/PROGRAMMING_SESSION, DcmDsdSidTabSecurityLevelRef=DSP_SEC_FBL, DcmDsdSidTabSessionLevelRef=DcmDspSession/EXTENDED_DIAGNOSTIC_SESSION
            ReadDataByIdentifier: DcmDsdSidTabFnc=Dcm_DcmReadDataByIdentifier, DcmDsdSidTabServiceId=34, DcmDsdSidTabSubfuncAvail=false, DcmRbDsdSidTabSidInitFunction=Dcm_Dsp_RdbiIni, DcmDsdSidTabSessionLevelRef=DcmDspSession/DEFAULT_SESSION, DcmDsdSidTabSessionLevelRef=DcmDspSession/EXTENDED_DIAGNOSTIC_SESSION, DcmDsdSidTabSessionLevelRef=DcmDspSession/PROGRAMMING_SESSION
            Ecu_Reset: DcmDsdSidTabFnc=Dcm_DcmEcuReset, DcmDsdSidTabServiceId=17, DcmDsdSidTabSubfuncAvail=1, DcmRbDsdSidTabSidInitFunction=Dcm_Dsp_EcuReset_Ini, DcmDsdSidTabSessionLevelRef=DcmDspSession/PROGRAMMING_SESSION, DcmDsdSidTabSessionLevelRef=DcmDspSession/DEFAULT_SESSION, DcmDsdSidTabSessionLevelRef=DcmDspSession/EXTENDED_DIAGNOSTIC_SESSION
              HARD (DcmDsdSubService):
                DcmDsdSubServiceId = 1
                DcmDsdSubServiceSessionLevelRef = DcmDspSession/PROGRAMMING_SESSION
                DcmDsdSubServiceSessionLevelRef = DcmDspSession/EXTENDED_DIAGNOSTIC_SESSION
                DcmDsdSubServiceSessionLevelRef = DcmDspSession/DEFAULT_SESSION
            RoutineControl: DcmDsdSidTabFnc=Dcm_DcmRoutineControl, DcmDsdSidTabServiceId=49, DcmDsdSidTabSubfuncAvail=true, DcmRbDsdSidTabSidInitFunction=Dcm_Dsp_RC_Ini, DcmDsdSidTabSessionLevelRef=DcmDspSession/PROGRAMMING_SESSION, DcmDsdSidTabSessionLevelRef=DcmDspSession/EXTENDED_DIAGNOSTIC_SESSION, DcmDsdSidTabSessionLevelRef=DcmDspSession/DEFAULT_SESSION
              DcmDsdSubStartRoutineControl (DcmDsdSubService):
                DcmDsdSubServiceId = 1
                DcmDsdSubServiceSessionLevelRef = DcmDspSession/PROGRAMMING_SESSION
                DcmDsdSubServiceSessionLevelRef = DcmDspSession/EXTENDED_DIAGNOSTIC_SESSION
            RequestDownload: DcmRbDsdSidTabSidInitFunction=Dcm_Dsp_RequestDownload_Ini, DcmDsdSidTabServiceId=52, DcmDsdSidTabSubfuncAvail=0, DcmDsdSidTabFnc=Dcm_DcmRequestDownload, DcmDsdSidTabSessionLevelRef=DcmDspSession/PROGRAMMING_SESSION, DcmDsdSidTabSecurityLevelRef=DSP_SEC_FBL
            TransferData: DcmDsdSidTabFnc=Dcm_DcmTransferData, DcmDsdSidTabServiceId=54, DcmDsdSidTabSubfuncAvail=0, DcmRbDsdSidTabSidInitFunction=Dcm_Dsp_TransferDataIni, DcmDsdSidTabSessionLevelRef=DcmDspSession/PROGRAMMING_SESSION, DcmDsdSidTabSecurityLevelRef=DSP_SEC_FBL
            RequestTransferExit: DcmRbDsdSidTabSidInitFunction=Dcm_Dsp_RequestTransferExit_Ini, DcmDsdSidTabServiceId=55, DcmDsdSidTabFnc=Dcm_DcmRequestTransferExit, DcmDsdSidTabSubfuncAvail=0, DcmDsdSidTabSessionLevelRef=DcmDspSession/PROGRAMMING_SESSION, DcmDsdSidTabSecurityLevelRef=DSP_SEC_FBL
            ControlDtcSettings: DcmDsdSidTabFnc=Dcm_DcmControlDTCSetting, DcmRbDsdSidTabSidInitFunction=Dcm_Dsp_CDTCSIni, DcmDsdSidTabServiceId=133, DcmDsdSidTabSubfuncAvail=1, DcmDsdSidTabSessionLevelRef=DcmDspSession/EXTENDED_DIAGNOSTIC_SESSION
              Off (DcmDsdSubService):
                DcmDsdSubServiceId = 2
                DcmRbDsdSubFuncServHandler = 
                DcmRbDsdSubServiceUserModeRuleFnc = Fbl_ProgM_DisableDtc
                DcmDsdSubServiceSessionLevelRef = DcmDspSession/EXTENDED_DIAGNOSTIC_SESSION
              On (DcmDsdSubService):
                DcmRbDsdSubServiceUserModeRuleFnc = Fbl_ProgM_EnableDtc
                DcmDsdSubServiceId = 1
                DcmDsdSubServiceSessionLevelRef = DcmDspSession/EXTENDED_DIAGNOSTIC_SESSION
            CommunicationControl: DcmDsdSidTabFnc=Dcm_DcmCommunicationControl, DcmDsdSidTabServiceId=40, DcmDsdSidTabSubfuncAvail=1, DcmRbDsdSidTabSidInitFunction=Dcm_Dsp_CCIni, DcmDsdSidTabSessionLevelRef=DcmDspSession/EXTENDED_DIAGNOSTIC_SESSION
              disableRxAndTx (DcmDsdSubService):
                DcmDsdSubServiceId = 3
                DcmRbDsdSubServiceUserModeRuleFnc = Fbl_ProgM_DisableRxAndTx
                DcmDsdSubServiceSessionLevelRef = DcmDspSession/EXTENDED_DIAGNOSTIC_SESSION
              enableRxAndTx (DcmDsdSubService):
                DcmDsdSubServiceId = 0
                DcmRbDsdSubServiceUserModeRuleFnc = Fbl_ProgM_EnableRxAndTx
                DcmDsdSubServiceSessionLevelRef = DcmDspSession/EXTENDED_DIAGNOSTIC_SESSION
      DcmDsl
        DcmDslBuffer_UDS_Tx (DcmDslBuffer): DcmDslBufferSize=1026
        DcmDslBuffer_UDS_Rx (DcmDslBuffer): DcmDslBufferSize=2050
        DcmDslDiagResp: DcmDslDiagRespMaxNumRespPend=30
        DcmDslProtocol
          DcmDslProtocolRow_UDS (DcmDslProtocolRow):
            DcmDslProtocolID = DCM_UDS_ON_CAN
            DcmDslProtocolMaximumResponseSize = 4095
            DcmDslProtocolPriority = 0
            DcmRbDslProtocolNRC21OnPriorityAssessmentReject = false
            DcmSendRespPendOnTransToBoot = false
            DcmTimStrP2ServerAdjust = 0.01
            DcmTimStrP2StarServerAdjust = 0.01
            DcmDslProtocolRxBufferRef = DcmDslBuffer_UDS_Rx
            DcmDslProtocolSIDTable = DcmDsdServiceTable_UDS
            DcmDslProtocolTxBufferRef = DcmDslBuffer_UDS_Tx
            DcmDslConnection_CAN (DcmDslConnection)
              DcmDslMainConnection: DcmDslProtocolRxTesterSourceAddr=0, DcmDslProtocolComMChannelRef=ComMChannel_Can_Network_Channel
                UDS_Rx_Func_Id_0x7DF_CANNODE_0_Func_PduR2Dcm (DcmDslProtocolRx): DcmDslProtocolRxAddrType=DCM_FUNCTIONAL_TYPE, DcmDslProtocolRxPduRef=UDS_Rx_Func_Id_0x7DF_CANNODE_0_PduR2Dcm
                UDS_Tx_Phys_Id_0x7B7_CANNODE_0_Phys_Dcm2PduR (DcmDslProtocolTx): DcmDslTxConfirmationPduId=0, DcmDslProtocolTxPduRef=UDS_Tx_Phys_Id_0x7B7_CANNODE_0_Phys_Dcm2PduR
                UDS_Rx_Phys_Id_0x737_CANNODE_0_Phys_PduR2Dcm (DcmDslProtocolRx): DcmDslProtocolRxAddrType=DCM_PHYSICAL_TYPE, DcmDslProtocolRxPduRef=UDS_Rx_Phys_Id_0x737_CANNODE_0_PduR2Dcm
      DcmDsp:
        DcmDspDataDefaultEndianness = BIG_ENDIAN
        DcmDspMaxDidToRead = 4
        DcmDspMaxPeriodicDidToRead = 1
        DcmRbDspSesSecUsedInProtocol = UDS
        DcmRbDspTransferDataMaxLenChkRequired = 0
        DcmDspSecurity:
          DcmRbDspSecurityDelayTimerMonitor = REQUEST_SEED
          DcmRbDspSecurityNRCExceedNoOfAttempt = NumAttDelayAndNumAttLock
          DcmRbDspSecurityStoreSeed = false
          DcmDspSecurityMaxAttemptCounterReadoutTime = 1.0
          DSP_SEC_FBL (DcmDspSecurityRow):
            DcmDspSecurityAttemptCounterEnabled = false
            DcmDspSecurityDelayTime = 0.0
            DcmDspSecurityDelayTimeOnBoot = 0.0
            DcmDspSecurityKeySize = 4
            DcmDspSecurityLevel = 9
            DcmDspSecurityNumAttDelay = 3
            DcmDspSecuritySeedSize = 4
            DcmDspSecurityUsePort = USE_ASYNCH_FNC
            DcmRbDspSecurityNumAttLock = 0
            DcmDspSecurityGetSeedFnc = DcmGetSeedDSP_Fbl_ProgM_GetSeedCallback
            DcmDspSecurityCompareKeyFnc = DcmCompareKeyDSP_Fbl_ProgM_CompareKeyCallback
            DcmDspSecuritySetAttemptCounterFnc = 
        DcmDspSession: DcmRbDspSessionParamRecordEnabled=true
          3 x DcmDspSessionRow, all with DcmDspSessionForBoot=DCM_NO_BOOT, DcmDspSessionP2ServerMax=0.05, DcmDspSessionP2StarServerMax=2.0:
            DEFAULT_SESSION: DcmDspSessionLevel=1
            PROGRAMMING_SESSION: DcmDspSessionLevel=2
            EXTENDED_DIAGNOSTIC_SESSION: DcmDspSessionLevel=3
        DcmDspReadDTC (DcmRbDspReadDTC): DcmRbDspReadDTCMaxNumDTCRead=1, DcmRbDspReadDTCMaxNumRecordRead=1
        DcmDspControlDTCSetting: DcmSupportDTCSettingControlOptionRecord=false
        DcmDspComControl
          DcmDspComControlAllChannel: DcmDspAllComMChannelRef=ComMChannel_Can_Network_Channel
          DcmDspComControlAllChannel_Eth (DcmDspComControlAllChannel): DcmDspAllComMChannelRef=ComMChannel_Eth_Network_Channel
        DcmDspCA_EXTENDED_DIAGNOSTIC_SESSION (DcmDspCommonAuthorization): DcmDspCommonAuthorizationSessionRef=DcmDspSession/EXTENDED_DIAGNOSTIC_SESSION
        DcmDspCA_PROGRAMMING_SESSION (DcmDspCommonAuthorization): DcmDspCommonAuthorizationSessionRef=DcmDspSession/PROGRAMMING_SESSION, DcmDspCommonAuthorizationSecurityLevelRef=DSP_SEC_FBL
        DcmDspMemory_0 (DcmDspMemory)
          DcmDspMemoryIdInfo_all (DcmDspMemoryIdInfo)
            DcmRbDspDownloadMemoryRangeInfo: DcmRbDspDownloadMemoryRangeLow=0, DcmRbDspDownloadMemoryRangeHigh=4294967294
        3 x DcmDspDidInfo, all with DcmDspDidDynamicallyDefined=false:
          DcmDspDidInfo_BootSoftwareFingerprintDataIdentifier
            DcmDspDidWrite: DcmDspDidWriteSessionRef=DcmDspSession/PROGRAMMING_SESSION, DcmDspDidWriteSessionRef=DcmDspSession/EXTENDED_DIAGNOSTIC_SESSION
            DcmDspDidRead:
              DcmDspDidReadSessionRef = DcmDspSession/PROGRAMMING_SESSION
              DcmDspDidReadSessionRef = DcmDspSession/EXTENDED_DIAGNOSTIC_SESSION
              DcmDspDidReadSessionRef = DcmDspSession/DEFAULT_SESSION
          DcmDspDidInfo_ApplicationSoftwareFingerprintDataIdentifier
            DcmDspDidRead:
              DcmDspDidReadSessionRef = DcmDspSession/PROGRAMMING_SESSION
              DcmDspDidReadSessionRef = DcmDspSession/EXTENDED_DIAGNOSTIC_SESSION
              DcmDspDidReadSessionRef = DcmDspSession/DEFAULT_SESSION
            DcmDspDidWrite: DcmDspDidWriteSessionRef=DcmDspSession/PROGRAMMING_SESSION, DcmDspDidWriteSessionRef=DcmDspSession/EXTENDED_DIAGNOSTIC_SESSION
          DcmDspDidInfo_ApplicationDataFingerprintDataIdentifier
            DcmDspDidRead:
              DcmDspDidReadSessionRef = DcmDspSession/PROGRAMMING_SESSION
              DcmDspDidReadSessionRef = DcmDspSession/EXTENDED_DIAGNOSTIC_SESSION
              DcmDspDidReadSessionRef = DcmDspSession/DEFAULT_SESSION
            DcmDspDidWrite: DcmDspDidWriteSessionRef=DcmDspSession/PROGRAMMING_SESSION, DcmDspDidWriteSessionRef=DcmDspSession/EXTENDED_DIAGNOSTIC_SESSION
        3 x DcmDspDid, all with DcmRbAtomicSenderReceiverCommunication=false, DcmDspDidUsePort=USE_DATA_ELEMENT_SPECIFIC_INTERFACES:
          DcmDspDid_BootSoftwareFingerprintDataIdentifier: DcmDspDidIdentifier=61827, DcmDspDidInfoRef=DcmDspDidInfo_BootSoftwareFingerprintDataIdentifier
            DcmDspDidSignal: DcmDspDidDataPos=0, DcmDspDidDataRef=DcmDspData_BootSoftwareFingerprintDataIdentifier
          DcmDspDid_ApplicationSoftwareFingerprintDataIdentifier: DcmDspDidIdentifier=61828, DcmDspDidInfoRef=DcmDspDidInfo_ApplicationSoftwareFingerprintDataIdentifier
            DcmDspDidSignal: DcmDspDidDataPos=0, DcmDspDidDataRef=DcmDspData_ApplicationSoftwareFingerprintDataIdentifier
          DcmDspDid_ApplicationDataFingerprintDataIdentifier: DcmDspDidIdentifier=61829, DcmDspDidInfoRef=DcmDspDidInfo_ApplicationDataFingerprintDataIdentifier
            DcmDspDidSignal: DcmDspDidDataPos=0, DcmDspDidDataRef=DcmDspData_ApplicationDataFingerprintDataIdentifier
        3 x DcmDspData, all with DcmDspDataEndianness=BIG_ENDIAN, DcmDspDataType=UINT8_N, DcmDspDataUsePort=USE_DATA_ASYNCH_FNC, DcmRbDspDataUseAsynchronousServerCallPoint=false, DcmDspDataSize=72:
          DcmDspData_BootSoftwareFingerprintDataIdentifier: DcmDspDataReadFnc=DID_BootSoftwareFingerprintDataIdentifier_0xF183_ReadFunc, DcmDspDataWriteFnc=DID_BootSoftwareFingerprintDataIdentifier_0xF183_WriteFunc
          DcmDspData_ApplicationSoftwareFingerprintDataIdentifier: DcmDspDataReadFnc=DID_ApplicationSoftwareFingerprintDataIdentifier_0xF184_ReadFunc, DcmDspDataWriteFnc=DID_ApplicationSoftwareFingerprintDataIdentifier_0xF184_WriteFunc
          DcmDspData_ApplicationDataFingerprintDataIdentifier: DcmDspDataReadFnc=DID_ApplicationDataFingerprintDataIdentifier_0xF185_ReadFunc, DcmDspDataWriteFnc=DID_ApplicationDataFingerprintDataIdentifier_0xF185_WriteFunc
        DcmDspClearDTC: DcmDspClearDTCModeRuleRef=DcmModeRule_0
        3 x DcmDspRoutine:
          DcmDspRoutine_StartCheckRoutine: DcmDspRoutineIdentifier=514, DcmRbDspRoutineUseAsynchronousServerCallPoint=false, DcmRbDspStopRoutineOnSessionChange=false, DcmRbDspReqSequenceErrorEnabled=true, DcmDspRoutineUsePort=false
            DcmDspStartRoutine_StartCheckRoutine (DcmDspStartRoutine): DcmDspStartRoutineFnc=Fbl_ProgM_StartCheckRoutineCallback, DcmDspStartRoutineCommonAuthorizationRef=DcmDspCA_PROGRAMMING_SESSION
              DcmDspStartRoutineIn
                DcmDspStartRoutineInSignal_CrcTest (DcmDspStartRoutineInSignal): DcmDspRoutineSignalEndianness=BIG_ENDIAN, DcmDspRoutineSignalPos=0, DcmDspRoutineSignalType=UINT32
              DcmDspStartRoutineOut
                DcmDspStartRoutineOutSignal_StatusRecord (DcmDspStartRoutineOutSignal): DcmDspRoutineSignalEndianness=BIG_ENDIAN, DcmDspRoutineSignalPos=0, DcmDspRoutineSignalType=UINT8
          DcmDspRoutine_StartEraseMemory
            DcmDspStartRoutine
              DcmDspStartRoutineIn_0 (DcmDspStartRoutineIn)
                AddressAndLengthFormatIdentifier (DcmDspStartRoutineInSignal): DcmDspRoutineSignalEndianness=BIG_ENDIAN, DcmDspRoutineSignalType=UINT8, DcmDspRoutineSignalPos=0
          DcmDspRoutine_CheckProgrammingDependencies
            DcmDspStartRoutine_CheckProgrammingDependencies (DcmDspStartRoutine)
              DcmDspStartRoutineOut_0 (DcmDspStartRoutineOut)
        DcmDspData_VIN (DcmDspData):
          DcmDspDataEndianness = BIG_ENDIAN
          DcmDspDataReadFnc = DcmDspData_VIN_ReadFunc
          DcmDspDataSize = 136
          DcmDspDataType = UINT8_N
          DcmDspDataUsePort = USE_DATA_ASYNCH_FNC
        DcmDspDidInfo_VIN (DcmDspDidInfo): DcmDspDidDynamicallyDefined=false
          DcmDspDidRead: DcmDspDidReadSessionRef=DcmDspSession/DEFAULT_SESSION
        DcmDspDid_VIN (DcmDspDid):
          DcmDspDidIdentifier = 61840
          DcmDspDidUsePort = USE_DATA_ELEMENT_SPECIFIC_INTERFACES
          DcmRbAtomicSenderReceiverCommunication = false
          DcmDspDidInfoRef = DcmDspDidInfo_VIN
          DcmDspDidSignal: DcmDspDidDataPos=0, DcmDspDidDataRef=DcmDspData_VIN
      DcmPageBufferCfg: DcmPagedBufferEnabled=false
      DcmProcessingConditions
        DcmModeCondition_0 (DcmModeCondition): DcmConditionType=DCM_EQUALS, DcmSwcModeRef=Mode1
        DcmModeRule_0 (DcmModeRule): DcmLogicalOperator=DCM_AND, DcmModeRuleNrcValue=1, DcmArgumentRef=DcmModeCondition_0
    DcmGeneral: DcmDevErrorDetect=false, DcmRespondAllRequest=false, DcmTaskTime=0.005, DcmVersionInfoApi=true, DcmVinRef=DcmDspDid_VIN
      DcmRbGeneral:
        DcmRbApplCallRequiredOnReqReception = true
        DcmRbApplTxConfirmationRequiredAlways = false
        DcmRbConfirmForDSDGeneratedNegRes = false
        DcmRbDiagAdaptSupport = false
        DcmRbOSTimerUse = ProjectSpecific
        DcmRbRestoringEnabled = true
        DcmRbRTEsupport = 0
        DcmRbSignalDefaultValue = 0
        DcmRbStoringEnabled = true
        DcmRbOSCounterMacro = OS_GET_SYSTEM_COUNTER_US
        DcmRbOSCounterId = 1
        DcmRbRTEsupportsPRportFunctionality = false

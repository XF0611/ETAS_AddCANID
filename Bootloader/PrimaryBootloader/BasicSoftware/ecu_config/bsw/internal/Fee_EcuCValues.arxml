AUTOSAR XML (schema 00047)
package /ETAS_Project/EcucModuleConfigurationValuess
  module config Fee
    FeeGeneral:
      FeeDevErrorDetect = 0
      FeeIndex = 0
      FeeNvmJobErrorNotification = NvM_JobErrorNotification
      FeeRbMachineType = MCU_RB_MANUAL_CFG
      FeeVirtualPageSize = 8
      FeeSetModeSupported = 0
      FeeVersionInfoApi = 1
      FeeRbConfirmSingleStorageBlockloss = true
      FeeRbActUnknownBlockReorg = true
      FeeRbSectorTable: FeeRbFastCacheInitActive=1, FeeRbHeaderRecheckActive=0, FlsRbPageSize=8, FlsRbErasedValue=255
        FeeRbSector_0 (FeeRbSector): FlsRbSectorSize=32768
        FeeRbSector_1 (FeeRbSector): FlsRbSectorSize=32768
    FeePublishedInformation

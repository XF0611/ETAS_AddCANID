AUTOSAR XML (schema 00047)
package /RB/UBK/Project/EcucModuleConfigurationValuess
  module config rba_ArxmlGen

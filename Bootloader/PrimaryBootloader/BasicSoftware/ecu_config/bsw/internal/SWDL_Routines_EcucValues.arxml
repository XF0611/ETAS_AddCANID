AUTOSAR XML (schema 4-2-2)
package /ETAS_Project/EcucModuleConfigurationValuess
  module config Dcm: implementation-config-variant=VARIANT-PRE-COMPILE
    DcmConfigSet
      DcmDsp: DcmRbDspTransferDataMaxLenChkRequired=0
        DcmDspSecurity
        DcmDspSession
        3 x DcmDspRoutine, all with DcmRbDspRoutineUseAsynchronousServerCallPoint=0, DcmRbDspReqSequenceErrorEnabled=1, DcmRbDspStopRoutineOnSessionChange=0, DcmDspRoutineUsePort=false:
          DcmDspRoutine_CheckProgrammingPreconditions: DcmDspRoutineIdentifier=533
            DcmDspStartRoutine_CheckProgrammingPreconditions (DcmDspStartRoutine): DcmDspStartRoutineFnc=SWDL_CheckProgrammingPreconditionsCallback_0x0215
              DcmDspStartRoutineOut
                DcmDspStartRoutineOutSignal_StatusRecord (DcmDspStartRoutineOutSignal): DcmDspRoutineSignalType=UINT8, DcmDspRoutineSignalEndianness=BIG_ENDIAN, DcmDspRoutineSignalPos=0, DcmDspRoutineSignalLength=8
          DcmDspRoutine_CheckProgrammingDependencies: DcmDspRoutineIdentifier=65281
            DcmDspStartRoutine_CheckProgrammingDependencies (DcmDspStartRoutine): DcmDspStartRoutineFnc=SWDL_CheckProgrammingDependenciesCallback_0xFF01, DcmDspStartRoutineCommonAuthorizationRef=DcmDspCA_PROGRAMMING_SESSION
              DcmDspStartRoutineOut_0 (DcmDspStartRoutineOut)
                DcmDspStartRoutineOutSignal_StatusRecord (DcmDspStartRoutineOutSignal): DcmDspRoutineSignalEndianness=BIG_ENDIAN, DcmDspRoutineSignalType=UINT8, DcmDspRoutineSignalPos=0
          DcmDspRoutine_StartEraseMemory: DcmDspRoutineIdentifier=65280
            DcmDspStartRoutine: DcmDspStartRoutineFnc=SWDL_StartEraseMemoryCallback_0xFF00, DcmDspStartRoutineCommonAuthorizationRef=DcmDspCA_PROGRAMMING_SESSION
              DcmDspStartRoutineIn_0 (DcmDspStartRoutineIn)
                StartAddress (DcmDspStartRoutineInSignal): DcmDspRoutineSignalType=UINT32, DcmDspRoutineSignalPos=8, DcmDspRoutineSignalEndianness=BIG_ENDIAN
                Length (DcmDspStartRoutineInSignal): DcmDspRoutineSignalEndianness=BIG_ENDIAN, DcmDspRoutineSignalType=UINT32, DcmDspRoutineSignalPos=40
              DcmDspStartRoutineOut_0 (DcmDspStartRoutineOut)
                DcmDspStartRoutineOutSignal_StatusRecord (DcmDspStartRoutineOutSignal): DcmDspRoutineSignalEndianness=BIG_ENDIAN, DcmDspRoutineSignalType=UINT8, DcmDspRoutineSignalPos=0
        DcmDspDid_EcuSerialNumber (DcmDspDid)
          DcmDspDidSignal_EcuSerialNumber (DcmDspDidSignal): DcmDspDidDataPos=0, DcmDspDidDataRef=DcmDspData_EcuSerialNumber
        DcmDspDidInfo_EcuSerialNumber (DcmDspDidInfo)
          DcmDspDidRead: DcmDspDidReadSessionRef=PROGRAMMING_SESSION, DcmDspDidReadSessionRef=EXTENDED_DIAGNOSTIC_SESSION, DcmDspDidReadSessionRef=DEFAULT_SESSION

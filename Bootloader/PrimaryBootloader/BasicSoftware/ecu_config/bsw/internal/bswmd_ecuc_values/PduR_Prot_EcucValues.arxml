AUTOSAR XML (schema 4-2-2)
package /RB/UBK/Project/EcucModuleConfigurationValuess
  module config rba_ArxmlGen
    PduR (rba_ArxmlGen_Comp):
      rba_ArxmlGen_CompCategory = BswModule
      rba_ArxmlGen_CompId = 51
      rba_ArxmlGen_CompIsConfigurable = true
      rba_ArxmlGen_CompIsStandalone = false
      rba_ArxmlGen_CompIsStandardized = true
      rba_ArxmlGen_CompLongName = PDURouter
      rba_ArxmlGen_CompVersionAr = 4.2.2
      rba_ArxmlGen_CompVersionSw = 8.0.0
      PduR_uint8 (rba_ArxmlGen_ApplDataType):
        rba_ArxmlGen_ApplDataTypeCategory = Simple
        rba_ArxmlGen_ApplDataTypeDispFormat = %5.0f
        rba_ArxmlGen_ApplDataTypeLongName = uint8
        rba_ArxmlGen_ApplDataTypeCompuMethodRef = Identical
        rba_ArxmlGen_ApplDataTypeDataConstrOwnRef = PduR_DataConstraint_u8
        rba_ArxmlGen_ApplDataTypeImplOwnRef = PduR_uint8_impl
      PduR_DataConstraint_u8 (rba_ArxmlGen_DataConstraint):
        rba_ArxmlGen_DataConstraintCategory = Physical
        rba_ArxmlGen_DataConstraintLower = 0
        rba_ArxmlGen_DataConstraintUpper = 255
        rba_ArxmlGen_DataConstraintUnitRef = NoUnit
      CE_Init (rba_ArxmlGen_ExecEntity): rba_ArxmlGen_ExecEntityCategory=Called, rba_ArxmlGen_ExecEntityImplEntryRef=PduR_Init
      PduR_uint8_impl (rba_ArxmlGen_ImplDataType):
        rba_ArxmlGen_ImplDataTypeCategory = Simple
        rba_ArxmlGen_ImplDataTypeLongName = implementation data type for application data type uint8
        rba_ArxmlGen_ImplDataTypeBaseRef = uint8
      PduR_State (rba_ArxmlGen_Measurement):
        rba_ArxmlGen_MeasCategory = Simple
        rba_ArxmlGen_MeasDispFormat = %5.0f
        rba_ArxmlGen_MeasLongName = State information of Pdur module
        rba_ArxmlGen_MeasAddrMethodRef = INTERNAL_VAR_CLEARED
        rba_ArxmlGen_MeasApplDataTypeOwnRef = PduR_uint8
      5 x rba_ArxmlGen_Memsection:
        CONFIG_DATA: rba_ArxmlGen_MemsectionDatatype_08=true, rba_ArxmlGen_MemsectionDatatype_UNSPECIFIED=true, rba_ArxmlGen_MemsectionAddrMethodRef=CONFIG_DATA
        CODE: rba_ArxmlGen_MemsectionAddrMethodRef=CODE
        VAR_INIT: rba_ArxmlGen_MemsectionDatatype_UNSPECIFIED=true, rba_ArxmlGen_MemsectionAddrMethodRef=VAR_INIT
        CONST: rba_ArxmlGen_MemsectionDatatype_08=true, rba_ArxmlGen_MemsectionDatatype_UNSPECIFIED=true, rba_ArxmlGen_MemsectionAddrMethodRef=CONST
        VAR_CLEARED: rba_ArxmlGen_MemsectionDatatype_08=true, rba_ArxmlGen_MemsectionDatatype_UNSPECIFIED=true, rba_ArxmlGen_MemsectionAddrMethodRef=VAR_CLEARED

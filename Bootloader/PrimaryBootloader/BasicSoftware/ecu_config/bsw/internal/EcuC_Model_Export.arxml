AUTOSAR XML (schema 4-2-2)
package /ETAS_Project/EcucModuleConfigurationValuess
  module config EcuC
    EcucConfigSet
      PduCollection (EcucPduCollection): PduIdTypeEnum=uint16, PduLengthTypeEnum=uint16
        19 x Pdu:
          UDS_Rx_Phys_Id_0x737_CANNODE_0_CanIf2CanTp: PduLength=8
          UDS_Rx_Phys_Id_0x737_CANNODE_0_CanTp2PduR: PduLength=8
          UDS_Rx_Phys_Id_0x737_CANNODE_0_PduR2Dcm: PduLength=8
          UDS_Rx_Func_Id_0x7DF_CANNODE_0_CanIf2CanTp: PduLength=8
          UDS_Rx_Func_Id_0x7DF_CANNODE_0_CanTp2PduR: PduLength=8
          UDS_Rx_Func_Id_0x7DF_CANNODE_0_PduR2Dcm: PduLength=8
          UDS_Tx_Phys_Id_0x7B7_CANNODE_0_Phys_Dcm2PduR: PduLength=8
          UDS_Tx_Phys_Id_0x7B7_CANNODE_0_Phys_PduR2CanTp: PduLength=8
          UDS_Tx_Phys_Id_0x7B7_CANNODE_0_Phys_CanTp2CanIf: PduLength=8
          RXFrame_EthernetUDP_SoAd2DoIP: PduLength=1024
          TXFrame_EthernetUDP_DoIP2SoAd: PduLength=1024
          RXFrame_EthernetUDP_Discovery: PduLength=1024
          TXFrame_EthernetUDP_Discovery: PduLength=256
          RXFrame_EthernetTCP_SoAd2DoIP: PduLength=3072
          TXFrame_EthernetTCP_DoIP2SoAd: PduLength=1024
          RXFrame_Ethernet_DoIP2PduR: PduLength=1024
          TXFrame_Ethernet_PduR2DoIP: PduLength=1024
          TXFrame_Ethernet_Dcm2PduR: PduLength=1024
          RXFrame_Ethernet_PduR2Dcm: PduLength=1024

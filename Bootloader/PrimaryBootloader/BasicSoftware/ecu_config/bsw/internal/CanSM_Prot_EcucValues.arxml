AUTOSAR XML (schema 4-2-2)
package /RB/UBK/Project/EcucModuleConfigurationValuess
  module config rba_ArxmlGen
    CanSM (rba_ArxmlGen_Comp):
      rba_ArxmlGen_CompCategory = BswModule
      rba_ArxmlGen_CompId = 140
      rba_ArxmlGen_CompIsConfigurable = true
      rba_ArxmlGen_CompIsStandalone = true
      rba_ArxmlGen_CompIsStandardized = true
      rba_ArxmlGen_CompLongName = CanStateManager
      rba_ArxmlGen_CompVersionAr = 4.2.2
      rba_ArxmlGen_CompVersionSw = 5.0.0
      12 x rba_ArxmlGen_ApplDataType:
        CanSM_Au8_app: rba_ArxmlGen_ApplDataTypeCategory=Array, rba_ArxmlGen_ApplDataTypeLongName=Array of the type Uint8, rba_ArxmlGen_ApplDataTypeImplOwnRef=CanSM_Au8_impl
          CanSM_uint8 (rba_ArxmlGen_ApplDataTypeSub): rba_ArxmlGen_ApplDataTypeSubOwnRef=CanSM_u8_app
        CanSM_currBOR_State_a_Aenum_app: rba_ArxmlGen_ApplDataTypeCategory=Array, rba_ArxmlGen_ApplDataTypeLongName=Array of enum, rba_ArxmlGen_ApplDataTypeImplOwnRef=CanSM_currBOR_State_a_Aenum_impl
          CanSM_BusOffRecoveryStateType (rba_ArxmlGen_ApplDataTypeSub): rba_ArxmlGen_ApplDataTypeSubOwnRef=CanSM_BusOffRecoveryStateType_Enum_app
        CanSM_currComM_Mode_a_Aenum_app: rba_ArxmlGen_ApplDataTypeCategory=Array, rba_ArxmlGen_ApplDataTypeLongName=Array of enum, rba_ArxmlGen_ApplDataTypeImplOwnRef=CanSM_currComM_Mode_a_Aenum_impl
          CanSM_enum_CanSM_currComM_Mode_a_app (rba_ArxmlGen_ApplDataTypeSub): rba_ArxmlGen_ApplDataTypeSubOwnRef=CanSM_NetworkModeStateType_Enum_app
        CanSM_TimerConfig_ast_Astruct_app: rba_ArxmlGen_ApplDataTypeCategory=Array, rba_ArxmlGen_ApplDataTypeLongName=Array of structure, rba_ArxmlGen_ApplDataTypeImplOwnRef=CanSM_TimerConfig_ast_Astruct_impl
          CanSM_TimerConfig_tst (rba_ArxmlGen_ApplDataTypeSub): rba_ArxmlGen_ApplDataTypeSubOwnRef=CanSM_TimerConfig_tst_struct_app
        CanSM_Aboolean_app: rba_ArxmlGen_ApplDataTypeCategory=Array, rba_ArxmlGen_ApplDataTypeLongName=Array of the type Boolean, rba_ArxmlGen_ApplDataTypeImplOwnRef=CanSM_Aboolean_impl
          CanSM_boolean (rba_ArxmlGen_ApplDataTypeSub): rba_ArxmlGen_ApplDataTypeSubOwnRef=CanSM_boolean_app
        CanSM_u8_app: rba_ArxmlGen_ApplDataTypeCategory=Simple, rba_ArxmlGen_ApplDataTypeDispFormat=%5.0f, rba_ArxmlGen_ApplDataTypeLongName=uint8 application datatype in CanSM, rba_ArxmlGen_ApplDataTypeCompuMethodRef=Identical, rba_ArxmlGen_ApplDataTypeDataConstrOwnRef=CanSM_DataConstraint_u8, rba_ArxmlGen_ApplDataTypeImplOwnRef=CanSM_u8_Impl
        CanSM_u16_app: rba_ArxmlGen_ApplDataTypeCategory=Simple, rba_ArxmlGen_ApplDataTypeDispFormat=%5.0f, rba_ArxmlGen_ApplDataTypeLongName=uint16 application datatype in CanSM, rba_ArxmlGen_ApplDataTypeCompuMethodRef=Identical, rba_ArxmlGen_ApplDataTypeDataConstrOwnRef=CanSM_DataConstraint_u16, rba_ArxmlGen_ApplDataTypeImplOwnRef=CanSM_u16_Impl
        CanSM_BusOffRecoveryStateType_Enum_app: rba_ArxmlGen_ApplDataTypeCategory=Simple, rba_ArxmlGen_ApplDataTypeDispFormat=%5.0f, rba_ArxmlGen_ApplDataTypeLongName=enum application datatype in CanSM, rba_ArxmlGen_ApplDataTypeCompuMethodOwnRef=CanSM_BusOffRecoveryStateType_Enum_comp, rba_ArxmlGen_ApplDataTypeDataConstrOwnRef=CanSM_DataConstraint_u8, rba_ArxmlGen_ApplDataTypeImplRef=uint8
        CanSM_NetworkModeStateType_Enum_app: rba_ArxmlGen_ApplDataTypeCategory=Simple, rba_ArxmlGen_ApplDataTypeDispFormat=%5.0f, rba_ArxmlGen_ApplDataTypeLongName=enum application datatype in CanSM, rba_ArxmlGen_ApplDataTypeCompuMethodOwnRef=CanSM_NetworkModeStateType_Enum_comp, rba_ArxmlGen_ApplDataTypeDataConstrOwnRef=CanSM_DataConstraint_u8, rba_ArxmlGen_ApplDataTypeImplRef=uint8
        CanSM_TimerStateType_Enum_app: rba_ArxmlGen_ApplDataTypeCategory=Simple, rba_ArxmlGen_ApplDataTypeDispFormat=%5.0f, rba_ArxmlGen_ApplDataTypeLongName=enum application datatype in CanSM, rba_ArxmlGen_ApplDataTypeCompuMethodOwnRef=CanSM_TimerStateType_Enum_comp, rba_ArxmlGen_ApplDataTypeDataConstrOwnRef=CanSM_DataConstraint_u8, rba_ArxmlGen_ApplDataTypeImplRef=uint8
        CanSM_TimerConfig_tst_struct_app: rba_ArxmlGen_ApplDataTypeCategory=Struct, rba_ArxmlGen_ApplDataTypeLongName=structure datatype in CanSM, rba_ArxmlGen_ApplDataTypeImplOwnRef=CanSM_TimerConfig_tst_struct_impl
          cntTick_u16 (rba_ArxmlGen_ApplDataTypeSub): rba_ArxmlGen_ApplDataTypeSubOwnRef=CanSM_u16_app
          stTimer (rba_ArxmlGen_ApplDataTypeSub): rba_ArxmlGen_ApplDataTypeSubOwnRef=CanSM_TimerStateType_Enum_app
        CanSM_boolean_app: rba_ArxmlGen_ApplDataTypeCategory=Simple, rba_ArxmlGen_ApplDataTypeDispFormat=%5.0f, rba_ArxmlGen_ApplDataTypeLongName=boolean application datatype in CanSM, rba_ArxmlGen_ApplDataTypeCompuMethodRef=Identical, rba_ArxmlGen_ApplDataTypeDataConstrOwnRef=CanSM_DataConstraint_u8, rba_ArxmlGen_ApplDataTypeImplOwnRef=CanSM/CanSM_boolean_Impl
      3 x rba_ArxmlGen_CompuMethod, all with rba_ArxmlGen_CompuMethodCategory=TextTable:
        CanSM_BusOffRecoveryStateType_Enum_comp: rba_ArxmlGen_CompuMethodLongName=Computation method for the enum CanSM_BusOffRecoveryStateType
          6 x rba_ArxmlGen_CompuMethodTextEntry, all with rba_ArxmlGen_CompuMethodTENumVals=1:
            CANSM_BOR_IDLE: rba_ArxmlGen_CompuMethodTEIntVal=1, rba_ArxmlGen_CompuMethodTEText=CANSM_BOR_IDLE
            CANSM_S_BUS_OFF_CHECK: rba_ArxmlGen_CompuMethodTEIntVal=2, rba_ArxmlGen_CompuMethodTEText=CANSM_S_BUS_OFF_CHECK
            CANSM_S_NO_BUS_OFF: rba_ArxmlGen_CompuMethodTEIntVal=3, rba_ArxmlGen_CompuMethodTEText=CANSM_S_NO_BUS_OFF
            CANSM_S_TX_OFF: rba_ArxmlGen_CompuMethodTEIntVal=4, rba_ArxmlGen_CompuMethodTEText=CANSM_S_TX_OFF
            CANSM_S_RESTART_CC: rba_ArxmlGen_CompuMethodTEIntVal=5, rba_ArxmlGen_CompuMethodTEText=CANSM_S_RESTART_CC
            CANSM_S_RESTART_CC_WAIT: rba_ArxmlGen_CompuMethodTEIntVal=6, rba_ArxmlGen_CompuMethodTEText=CANSM_S_RESTART_CC_WAIT
        CanSM_NetworkModeStateType_Enum_comp: rba_ArxmlGen_CompuMethodLongName=Computation method for the enum CanSM_NetworkModeStateType
          10 x rba_ArxmlGen_CompuMethodTextEntry, all with rba_ArxmlGen_CompuMethodTENumVals=1:
            CANSM_BSM_S_NOCOM: rba_ArxmlGen_CompuMethodTEIntVal=0, rba_ArxmlGen_CompuMethodTEText=CANSM_BSM_S_NOCOM
            CANSM_BSM_S_SILENTCOM: rba_ArxmlGen_CompuMethodTEIntVal=1, rba_ArxmlGen_CompuMethodTEText=CANSM_BSM_S_SILENTCOM
            CANSM_BSM_S_FULLCOM: rba_ArxmlGen_CompuMethodTEIntVal=2, rba_ArxmlGen_CompuMethodTEText=CANSM_BSM_S_FULLCOM
            CANSM_BSM_S_NOT_INITIALIZED: rba_ArxmlGen_CompuMethodTEIntVal=3, rba_ArxmlGen_CompuMethodTEText=CANSM_BSM_S_NOT_INITIALIZED
            CANSM_BSM_S_PRE_NOCOM: rba_ArxmlGen_CompuMethodTEIntVal=4, rba_ArxmlGen_CompuMethodTEText=CANSM_BSM_S_PRE_NOCOM
            CANSM_BSM_WUVALIDATION: rba_ArxmlGen_CompuMethodTEIntVal=5, rba_ArxmlGen_CompuMethodTEText=CANSM_BSM_WUVALIDATION
            CANSM_BSM_S_PRE_FULLCOM: rba_ArxmlGen_CompuMethodTEIntVal=6, rba_ArxmlGen_CompuMethodTEText=CANSM_BSM_S_PRE_FULLCOM
            CANSM_BSM_S_SET_BAUDRATE: rba_ArxmlGen_CompuMethodTEIntVal=7, rba_ArxmlGen_CompuMethodTEText=CANSM_BSM_S_SET_BAUDRATE
            CANSM_BSM_S_SILENTCOM_BOR: rba_ArxmlGen_CompuMethodTEIntVal=8, rba_ArxmlGen_CompuMethodTEText=CANSM_BSM_S_SILENTCOM_BOR
            CANSM_BSM_S_TX_TIMEOUT_EXCEPTION: rba_ArxmlGen_CompuMethodTEIntVal=9, rba_ArxmlGen_CompuMethodTEText=CANSM_BSM_S_TX_TIMEOUT_EXCEPTION
        CanSM_TimerStateType_Enum_comp: rba_ArxmlGen_CompuMethodLongName=Computation method for the enum CanSM_TimerStateType
          4 x rba_ArxmlGen_CompuMethodTextEntry, all with rba_ArxmlGen_CompuMethodTENumVals=1:
            CANSM_TIMER_INIT: rba_ArxmlGen_CompuMethodTEIntVal=1, rba_ArxmlGen_CompuMethodTEText=CANSM_TIMER_INIT
            CANSM_TIMER_RUNNING: rba_ArxmlGen_CompuMethodTEIntVal=2, rba_ArxmlGen_CompuMethodTEText=CANSM_TIMER_RUNNING
            CANSM_TIMER_ELAPSED: rba_ArxmlGen_CompuMethodTEIntVal=3, rba_ArxmlGen_CompuMethodTEText=CANSM_TIMER_ELAPSED
            CANSM_TIMER_CANCELLED: rba_ArxmlGen_CompuMethodTEIntVal=4, rba_ArxmlGen_CompuMethodTEText=CANSM_TIMER_CANCELLED
      CanSM_DataConstraint_u8 (rba_ArxmlGen_DataConstraint):
        rba_ArxmlGen_DataConstraintCategory = Physical
        rba_ArxmlGen_DataConstraintLower = 0
        rba_ArxmlGen_DataConstraintUpper = 255
        rba_ArxmlGen_DataConstraintUnitRef = NoUnit
      CanSM_DataConstraint_u16 (rba_ArxmlGen_DataConstraint):
        rba_ArxmlGen_DataConstraintCategory = Physical
        rba_ArxmlGen_DataConstraintLower = 0
        rba_ArxmlGen_DataConstraintUpper = 65535
        rba_ArxmlGen_DataConstraintUnitRef = NoUnit
      SE_MainFunction (rba_ArxmlGen_ExecEntity): rba_ArxmlGen_ExecEntityCategory=Schedulable, rba_ArxmlGen_ExecEntityImplEntryRef=CanSM_MainFunction
      CE_Init (rba_ArxmlGen_ExecEntity): rba_ArxmlGen_ExecEntityCategory=Called, rba_ArxmlGen_ExecEntityImplEntryRef=CanSM_Init
      12 x rba_ArxmlGen_ImplDataType:
        CanSM_Au8_impl: rba_ArxmlGen_ImplDataTypeCategory=Array, rba_ArxmlGen_ImplDataTypeLongName=array of elements of the type Uint8
          CanSM_uint8_Impl (rba_ArxmlGen_ImplDataTypeSub): rba_ArxmlGen_ImplDataTypeSubOwnRef=CanSM_u8_Impl
        CanSM_currComM_Mode_a_Aenum_impl: rba_ArxmlGen_ImplDataTypeCategory=Array, rba_ArxmlGen_ImplDataTypeLongName=Array of enum for implementation data type
          CanSM_enum_CanSM_currComM_Mode_a_Impl (rba_ArxmlGen_ImplDataTypeSub): rba_ArxmlGen_ImplDataTypeSubOwnRef=CanSM_NetworkModeStateType_Enum_impl
        CanSM_currBOR_State_a_Aenum_impl: rba_ArxmlGen_ImplDataTypeCategory=Array, rba_ArxmlGen_ImplDataTypeLongName=Array of enum for implementation data type
          CanSM_enum_CanSM_currBOR_State_a_Impl (rba_ArxmlGen_ImplDataTypeSub): rba_ArxmlGen_ImplDataTypeSubOwnRef=CanSM_BusOffRecoveryStateType_Enum_impl
        CanSM_Aboolean_impl: rba_ArxmlGen_ImplDataTypeCategory=Array, rba_ArxmlGen_ImplDataTypeLongName=array of elements of the type Boolean
          CanSM_boolean_Impl (rba_ArxmlGen_ImplDataTypeSub): rba_ArxmlGen_ImplDataTypeSubOwnRef=CanSM/CanSM_boolean_Impl
        CanSM_u8_Impl: rba_ArxmlGen_ImplDataTypeCategory=Simple, rba_ArxmlGen_ImplDataTypeLongName=uint8 implementation data type in CanSM, rba_ArxmlGen_ImplDataTypeBaseRef=uint8
        CanSM_u16_Impl: rba_ArxmlGen_ImplDataTypeCategory=Simple, rba_ArxmlGen_ImplDataTypeLongName=uint16 implementation data type in CanSM, rba_ArxmlGen_ImplDataTypeBaseRef=uint16
        CanSM_boolean_Impl: rba_ArxmlGen_ImplDataTypeCategory=Simple, rba_ArxmlGen_ImplDataTypeLongName=Boolean implementation data type in CanSM, rba_ArxmlGen_ImplDataTypeBaseRef=uint8
        CanSM_BusOffRecoveryStateType_Enum_impl: rba_ArxmlGen_ImplDataTypeCategory=Simple, rba_ArxmlGen_ImplDataTypeLongName=enum implementation data type in CanSM, rba_ArxmlGen_ImplDataTypeBaseRef=uint8
        CanSM_NetworkModeStateType_Enum_impl: rba_ArxmlGen_ImplDataTypeCategory=Simple, rba_ArxmlGen_ImplDataTypeLongName=enum implementation data type in CanSM, rba_ArxmlGen_ImplDataTypeBaseRef=uint8
        CanSM_TimerStateType_Enum_impl: rba_ArxmlGen_ImplDataTypeCategory=Simple, rba_ArxmlGen_ImplDataTypeLongName=enum implementation data type in CanSM, rba_ArxmlGen_ImplDataTypeBaseRef=uint8
        CanSM_TimerConfig_ast_Astruct_impl: rba_ArxmlGen_ImplDataTypeCategory=Array, rba_ArxmlGen_ImplDataTypeLongName=Array of structure
          CanSM_TimerConfig_tst (rba_ArxmlGen_ImplDataTypeSub): rba_ArxmlGen_ImplDataTypeSubOwnRef=CanSM_TimerConfig_tst_struct_impl
        CanSM_TimerConfig_tst_struct_impl: rba_ArxmlGen_ImplDataTypeCategory=Struct, rba_ArxmlGen_ImplDataTypeLongName=structure
          cntTick_u16 (rba_ArxmlGen_ImplDataTypeSub): rba_ArxmlGen_ImplDataTypeSubOwnRef=CanSM_u16_Impl
          stTimer (rba_ArxmlGen_ImplDataTypeSub): rba_ArxmlGen_ImplDataTypeSubOwnRef=CanSM_TimerStateType_Enum_impl
      9 x rba_ArxmlGen_Measurement, all with rba_ArxmlGen_MeasCategory=Array, rba_ArxmlGen_MeasDispFormat=%5.0f, rba_ArxmlGen_MeasAddrMethodRef=INTERNAL_VAR_CLEARED:
        CanSM_BusOff_Cntr_au8: rba_ArxmlGen_MeasLongName=Bus-Off counter for CanSM, rba_ArxmlGen_MeasApplDataTypeOwnRef=CanSM_Au8_app
        CanSM_currBOR_State_en: rba_ArxmlGen_MeasLongName=Current Bus-Off recovery state for CanSM, rba_ArxmlGen_MeasApplDataTypeOwnRef=CanSM_currBOR_State_a_Aenum_app
        CanSM_ReqComM_Mode_en: rba_ArxmlGen_MeasLongName=stores the requested communication mode, rba_ArxmlGen_MeasApplDataTypeOwnRef=CanSM_Au8_app
        CanSM_BORMode_au8: rba_ArxmlGen_MeasLongName=Variable to SET/RESET the BOR mode, rba_ArxmlGen_MeasApplDataTypeOwnRef=CanSM_Au8_app
        CanSM_BusOffISRPend_ab: rba_ArxmlGen_MeasLongName=To Set the BOR ISR Pending Request to True or False, rba_ArxmlGen_MeasApplDataTypeOwnRef=CanSM_Aboolean_app
        CanSM_Network_Init_ab: rba_ArxmlGen_MeasLongName=Setting this leads to initialisation of the network, rba_ArxmlGen_MeasApplDataTypeOwnRef=CanSM_Aboolean_app
        CanSM_MutexMode_au8: rba_ArxmlGen_MeasLongName=Used to set, rba_ArxmlGen_MeasApplDataTypeOwnRef=CanSM_Au8_app
        CanSM_CurrNw_Mode_en: rba_ArxmlGen_MeasLongName=current ComM mode, rba_ArxmlGen_MeasApplDataTypeOwnRef=CanSM_currComM_Mode_a_Aenum_app
        CanSM_TimerConfig_ast: rba_ArxmlGen_MeasLongName=CanSM timer configuration, rba_ArxmlGen_MeasApplDataTypeOwnRef=CanSM_TimerConfig_ast_Astruct_app
      5 x rba_ArxmlGen_Memsection:
        CONFIG_DATA_POSTBUILD: rba_ArxmlGen_MemsectionDatatype_08=true, rba_ArxmlGen_MemsectionDatatype_16=true, rba_ArxmlGen_MemsectionDatatype_32=true, rba_ArxmlGen_MemsectionDatatype_UNSPECIFIED=true, rba_ArxmlGen_MemsectionAddrMethodRef=CONFIG_DATA_POSTBUILD
        CONST: rba_ArxmlGen_MemsectionDatatype_08=true, rba_ArxmlGen_MemsectionDatatype_16=true, rba_ArxmlGen_MemsectionDatatype_32=true, rba_ArxmlGen_MemsectionDatatype_UNSPECIFIED=true, rba_ArxmlGen_MemsectionAddrMethodRef=CONST
        VAR_CLEARED: rba_ArxmlGen_MemsectionDatatype_08=true, rba_ArxmlGen_MemsectionDatatype_16=true, rba_ArxmlGen_MemsectionDatatype_32=true, rba_ArxmlGen_MemsectionDatatype_UNSPECIFIED=true, rba_ArxmlGen_MemsectionAddrMethodRef=VAR_CLEARED
        VAR_INIT: rba_ArxmlGen_MemsectionDatatype_UNSPECIFIED=true, rba_ArxmlGen_MemsectionAddrMethodRef=VAR_INIT
        CODE: rba_ArxmlGen_MemsectionAddrMethodRef=CODE

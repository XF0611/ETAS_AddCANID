AUTOSAR XML (schema 4-2-2)
package /ETAS_Project/EcucModuleConfigurationValuess
  module config MemIf: implementation-config-variant=VARIANT-PRE-COMPILE
    MemIfGeneral: MemIfDevErrorDetect=false, MemIfNumberOfDevices=1, MemIfRbFeeUsed=true, MemIfVersionInfoApi=false
  module config NvM: implementation-config-variant=VARIANT-PRE-COMPILE
    NvMCommon:
      NvMRbSetWriteAllTriggerApi = true
      NvMApiConfigClass = NVM_API_CONFIG_CLASS_3
      NvMBswMMultiBlockJobStatusInformation = false
      NvMCompiledConfigId = 0
      NvMCrcNumOfBytes = 1
      NvMDevErrorDetect = false
      NvMDrvModeSwitch = false
      NvMDynamicConfiguration = false
      NvMJobPrioritization = false
      NvMMultiBlockCallback = Fbl_DataM_MultiBlockJobEndNotification
      NvMPollingMode = true
      NvMSetRamBlockStatusApi = true
      NvMSizeStandardJobQueue = 1
      NvMVersionInfoApi = false
      NvMMainFunctionPeriod = 0.01
    8 x NvMBlockDescriptor, all with NvMBlockJobPriority=1, NvMBlockWriteProt=false, NvMWriteBlockOnce=false, NvMWriteVerification=false, NvMResistantToChangedSw=false, NvMBlockCrcType=NVM_CRC16, NvMBlockManagementType=NVM_BLOCK_NATIVE, NvMBlockUseCrc=true, NvMBlockUseSyncMechanism=false, NvMMaxNumOfReadRetries=0, NvMMaxNumOfWriteRetries=0, NvMNvBlockNum=1, NvMNvramDeviceId=0, NvMStaticBlockIDCheck=false, NvMWriteVerificationDataSize=0, NvMInitBlockCallback=NULL_PTR:
      NvM_MultiBlock: NvMNvBlockLength=1, NvMRomBlockNum=0, NvMCalcRamBlockCrc=false
      NvM_ConfigId: NvMNvBlockLength=2, NvMRamBlockDataAddress=NvM_Prv_idConfigStored_u16, NvMSelectBlockForReadAll=true, NvMSelectBlockForWriteAll=true, NvMRomBlockNum=0, NvMCalcRamBlockCrc=false
      NV_ExternalReprogrammingRequestFlagBlock: NvMRomBlockNum=1, NvMCalcRamBlockCrc=false, NvMNvBlockLength=4, NvMRamBlockDataAddress=Fbl_DataM_RamMirrorNV_ReprogrammingRequestFlagBlock, NvMRomBlockDataAddress=Fbl_DataM_RomDataNV_ReprogrammingRequestFlagBlock, NvMRbGenRteAdminPort=0, NvMRbGenRteServicePort=0, NvMSingleBlockCallback=Fbl_DataM_NV_ReprogrammingRequestFlagBlockCallbackFunction, NvMSelectBlockForWriteAll=true, NvMSelectBlockForReadAll=true, NvMRbFirstReadDataMigration=false, NvMRbInitBlockAtLayoutChange=false, NvMRbNoFallback=false, NvMRbSelectBlockForFirstInitAll=false, NvMRbResistantToLayoutRemoval=false, NvMBlockUseAutoValidation=false
      NV_BootSoftwareFingerprintBlock: NvMNvBlockLength=27, NvMNvramBlockIdentifier=2, NvMRamBlockDataAddress=Fbl_DataM_RamMirrorNV_BootSoftwareFingerprintBlock, NvMRbFirstReadDataMigration=false, NvMRbGenRteAdminPort=false, NvMRbGenRteServicePort=false, NvMRbInitBlockAtLayoutChange=false, NvMRbNoFallback=false, NvMRbResistantToLayoutRemoval=false, NvMRbSelectBlockForFirstInitAll=false, NvMRomBlockDataAddress=Fbl_DataM_RomDataNV_BootSoftwareFingerprintBlock, NvMRomBlockNum=1, NvMSelectBlockForReadAll=true, NvMSelectBlockForWriteAll=true, NvMSingleBlockCallback=Fbl_DataM_NV_BootSoftwareFingerprintBlockCallbackFunction
      NV_ApplicationSoftwareFingerprintBlock: NvMNvBlockLength=27, NvMNvramBlockIdentifier=3, NvMRamBlockDataAddress=Fbl_DataM_RamMirrorNV_ApplicationSoftwareFingerprintBlock, NvMRbFirstReadDataMigration=false, NvMRbGenRteAdminPort=false, NvMRbGenRteServicePort=false, NvMRbInitBlockAtLayoutChange=false, NvMRbNoFallback=false, NvMRbResistantToLayoutRemoval=false, NvMRbSelectBlockForFirstInitAll=false, NvMRomBlockDataAddress=Fbl_DataM_RomDataNV_ApplicationSoftwareFingerprintBlock, NvMRomBlockNum=1, NvMSelectBlockForReadAll=true, NvMSelectBlockForWriteAll=true, NvMSingleBlockCallback=Fbl_DataM_NV_ApplicationSoftwareFingerprintCallbackFunction
      NV_ApplicationDataFingerprintBlock: NvMNvBlockLength=27, NvMNvramBlockIdentifier=4, NvMRamBlockDataAddress=Fbl_DataM_RamMirrorNV_ApplicationDataFingerprintBlock, NvMRbFirstReadDataMigration=false, NvMRbGenRteAdminPort=false, NvMRbGenRteServicePort=false, NvMRbInitBlockAtLayoutChange=false, NvMRbNoFallback=false, NvMRbResistantToLayoutRemoval=false, NvMRbSelectBlockForFirstInitAll=false, NvMRomBlockDataAddress=Fbl_DataM_RomDataNV_ApplicationDataFingerprintBlock, NvMRomBlockNum=1, NvMSelectBlockForReadAll=true, NvMSelectBlockForWriteAll=true, NvMSingleBlockCallback=Fbl_DataM_NV_ApplicationDataFingerprintBlockCallbackFunction
      NV_PBLValidFlagBlock: NvMNvBlockLength=4, NvMNvramBlockIdentifier=5, NvMRamBlockDataAddress=Fbl_DataM_RamMirrorNV_PBLValidFlagBlock, NvMRbFirstReadDataMigration=false, NvMRbGenRteAdminPort=false, NvMRbGenRteServicePort=false, NvMRbInitBlockAtLayoutChange=false, NvMRbNoFallback=false, NvMRbResistantToLayoutRemoval=false, NvMRbSelectBlockForFirstInitAll=false, NvMRomBlockDataAddress=Fbl_DataM_RomDataNV_PBLValidFlagBlock, NvMRomBlockNum=1, NvMSelectBlockForReadAll=true, NvMSelectBlockForWriteAll=true
      NV_ApplicationValidFlagBlock: NvMNvBlockLength=4, NvMNvramBlockIdentifier=6, NvMRamBlockDataAddress=Fbl_DataM_RamMirrorNV_ApplicationValidFlagBlock, NvMRbFirstReadDataMigration=false, NvMRbGenRteAdminPort=false, NvMRbGenRteServicePort=false, NvMRbInitBlockAtLayoutChange=false, NvMRbNoFallback=false, NvMRbResistantToLayoutRemoval=false, NvMRbSelectBlockForFirstInitAll=false, NvMRomBlockDataAddress=Fbl_DataM_RomDataNV_ApplicationValidFlagBlock, NvMRomBlockNum=1, NvMSelectBlockForReadAll=true, NvMSelectBlockForWriteAll=true

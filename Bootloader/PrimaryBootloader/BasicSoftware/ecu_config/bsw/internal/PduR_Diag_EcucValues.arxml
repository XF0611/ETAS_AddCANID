AUTOSAR XML (schema 00047)
package /ETAS_Project/EcucModuleConfigurationValuess
  module config PduR: implementation-config-variant=VARIANT-PRE-COMPILE
    Dcm (PduRBswModules):
      PduRCancelTransmit = 1
      PduRTransportProtocol = 1
      PduRTxConfirmation = 1
      PduRUpperModule = 1
      PduRCancelReceive = 0
      PduRChangeParameterApi = 0
      PduRCommunicationInterface = 0
      PduRLowerModule = 0
      PduRRetransmission = 0
      PduRTriggertransmit = 0
      PduRUseTag = 0
      PduRBswModuleRef = Dcm
    CanTp (PduRBswModules):
      PduRCancelTransmit = 1
      PduRLowerModule = 1
      PduRTransportProtocol = 1
      PduRTxConfirmation = 1
      PduRCancelReceive = 0
      PduRChangeParameterApi = 0
      PduRCommunicationInterface = 0
      PduRRetransmission = 0
      PduRTriggertransmit = 0
      PduRUpperModule = 0
      PduRUseTag = 0
      PduRBswModuleRef = CanTp
      PduRInvalidHandlers: PduRIHCancelReceive=0, PduRIHCancelTransmit=0
    PduRRoutingTables: PduRConfigurationId=0
      PduRRoutingTable
        3 x PduRRoutingPath:
          CanTp2Dcm_0x7DF
            Dest_CanTp2Dcm_0x7DF (PduRDestPdu): PduRDestPduRef=UDS_Rx_Func_Id_0x7DF_CANNODE_0_PduR2Dcm
            Src_CanTp2Dcm_0x7DF (PduRSrcPdu): PduRSrcPduUpTxConf=1, PduRSrcPduRef=UDS_Rx_Func_Id_0x7DF_CANNODE_0_CanTp2PduR
          CanTp2Dcm_0x737
            Dest_CanTp2Dcm_0x737 (PduRDestPdu): PduRDestPduRef=UDS_Rx_Phys_Id_0x737_CANNODE_0_PduR2Dcm
            Src_CanTp2Dcm_0x737 (PduRSrcPdu): PduRSrcPduUpTxConf=1, PduRSrcPduRef=UDS_Rx_Phys_Id_0x737_CANNODE_0_CanTp2PduR
          Dcm2CanTp_0x7B7
            Dst_Dcm2CanTp_0x7B7 (PduRDestPdu): PduRDestPduRef=UDS_Tx_Phys_Id_0x7B7_CANNODE_0_Phys_PduR2CanTp
            Src_Dcm2CanTp_0x7B7 (PduRSrcPdu): PduRSrcPduUpTxConf=1, PduRSrcPduRef=UDS_Tx_Phys_Id_0x7B7_CANNODE_0_Phys_Dcm2PduR
    PduRGeneral:
      PduRDevErrorDetect = 0
      PduRVersionInfoApi = 0
      PduRZeroCostOperation = 0
      PduRIFGatewayOperation = 0
      PduRTPGatewayOperation = 0
      PduRQueueingSupport = 0
      PduRMulticastToTpSupport = 0
      PduRMulticastToIfSupport = 0
      PduRMulticastFromTpSupport = 0
      PduRGwTpWithLimitedBuffer = false

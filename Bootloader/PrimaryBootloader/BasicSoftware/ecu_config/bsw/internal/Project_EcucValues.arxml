AUTOSAR XML (schema 00047)
package /ETAS_Project/EcucModuleConfigurationValuess
  module config ComM: implementation-config-variant=VARIANT-PRE-COMPILE
    ComMGeneral:
      ComMEcuGroupClassification = 0
      ComMModeLimitationEnabled = false
      ComMTMinFullComModeDuration = 0.01
      ComMVersionInfoApi = false
      ComMWakeupInhibitionEnabled = false
      ComMPncGatewayEnabled = false
      ComMPncSupport = false
      ComMResetAfterForcingNoComm = false
      ComMSynchronousWakeUp = false
      ComMRteEnabled = false
      ComMDevErrorDetect = false
    ComMConfigSet
      ComMUser_Can_Network_Channel (ComMUser): ComMUserIdentifier=0
      ComMChannel_Can_Network_Channel (ComMChannel):
        ComMMainFunctionPeriod = 0.01
        ComMFullCommRequestNotificationEnabled = false
        ComMNoCom = true
        ComMNoWakeUpInhibitionNvmStorage = false
        ComMNoWakeup = true
        ComMChannelId = 0
        ComMBusType = COMM_BUS_TYPE_CAN
        ComMNetworkManagement: ComMNmLightTimeout=10, ComMNmVariant=NONE, ComMPncNmRequest=false
        ComMUserPerChannel_Can_Network_Channel (ComMUserPerChannel): ComMUserChannel=ComMUser_Can_Network_Channel
      ComMChannel_Eth_Network_Channel (ComMChannel):
        ComMBusType = COMM_BUS_TYPE_ETH
        ComMChannelId = 1
        ComMFullCommRequestNotificationEnabled = false
        ComMMainFunctionPeriod = 0.001
        ComMNoCom = false
        ComMNoWakeUpInhibitionNvmStorage = false
        ComMNoWakeup = false
        ComMNetworkManagement: ComMNmLightTimeout=10.0, ComMNmVariant=NONE, ComMPncNmRequest=false
        ComMUserPerChannel: ComMUserChannel=ComMUser_Eth_Network_Channel
      ComMUser_Eth_Network_Channel (ComMUser): ComMUserIdentifier=2
  module config CanIf: implementation-config-variant=VARIANT-PRE-COMPILE
    CanIfInitCfg: CanIfInitCfgSet=0
      CanIfInitHohCfg
        CANNODE_0_Rx_Std_MailBox_1 (CanIfHrhCfg): CanIfHrhIdSymRef=CANNODE_0_Rx_Std_MailBox_1, CanIfHrhCanCtrlIdRef=CANNODE_0
        CANNODE_0_Rx_Std_MailBox_2 (CanIfHrhCfg): CanIfHrhIdSymRef=CANNODE_0_Rx_Std_MailBox_2, CanIfHrhCanCtrlIdRef=CANNODE_0
        CANNODE_0_Tx_Std_MailBox_1 (CanIfHthCfg): CanIfHthIdSymRef=CANNODE_0_Tx_Std_MailBox_1, CanIfHthCanCtrlIdRef=CANNODE_0
      UDS_Rx_Phys_Id_0x737_CANNODE_0 (CanIfRxPduCfg):
        CanIfRxPduReadData = false
        CanIfRxPduReadNotifyStatus = true
        CanIfRxPduCanId = 1856
        CanIfRxPduCanIdType = STANDARD_CAN
        CanIfRxPduDlc = 1
        CanIfRxPduId = 0
        CanIfRxPduUserRxIndicationUL = CAN_TP
        CanIfRxPduHrhIdRef = CANNODE_0_Rx_Std_MailBox_1
        CanIfRxPduRef = UDS_Rx_Phys_Id_0x737_CANNODE_0_CanIf2CanTp
      UDS_Rx_Func_Id_0x7DF_CANNODE_0 (CanIfRxPduCfg):
        CanIfRxPduReadData = false
        CanIfRxPduReadNotifyStatus = true
        CanIfRxPduCanId = 2015
        CanIfRxPduCanIdType = STANDARD_CAN
        CanIfRxPduDlc = 1
        CanIfRxPduId = 1
        CanIfRxPduUserRxIndicationUL = CAN_TP
        CanIfRxPduHrhIdRef = CANNODE_0_Rx_Std_MailBox_2
        CanIfRxPduRef = UDS_Rx_Func_Id_0x7DF_CANNODE_0_CanIf2CanTp
      Buffer_CANNODE_0_Tx_Std_MailBox_1 (CanIfBufferCfg): CanIfBufferSize=0, CanIfBufferHthRef=CANNODE_0_Tx_Std_MailBox_1
      UDS_Tx_Phys_Id_0x7B7_CANNODE_0 (CanIfTxPduCfg):
        CanIfTxPduReadNotifyStatus = false
        CanIfTxPduType = STATIC
        CanIfTxPduCanIdType = STANDARD_CAN
        CanIfTxPduCanId = 1864
        CanIfTxPduUserTxConfirmationUL = CAN_TP
        CanIfTxPduTruncation = true
        CanIfTxPduBufferRef = Buffer_CANNODE_0_Tx_Std_MailBox_1
        CanIfTxPduRef = UDS_Tx_Phys_Id_0x7B7_CANNODE_0_Phys_CanTp2CanIf
    CanIfCtrlDrvCfg: CanIfRbCtrlDrvPrefix=CanConf_CanHardwareObject, CanIfCtrlDrvNameRef=CanGeneral, CanIfCtrlDrvInitHohConfigRef=CanIfInitHohCfg
      CANNODE_0 (CanIfCtrlCfg): CanIfCtrlId=0, CanIfCtrlWakeupSupport=false, CanIfCtrlCanCtrlRef=ETAS_CAN
    CanIfDispatchCfg:
      CanIfDispatchUserCtrlBusOffUL = CAN_SM
      CanIfDispatchUserCtrlModeIndicationUL = CAN_SM
      CanIfDispatchUserTrcvModeIndicationName = CAN_SM
      CanIfDispatchUserTrcvModeIndicationUL = CAN_SM
      CanIfDispatchUserCtrlBusOffName = CanSM_ControllerBusOff
    CanIfPrivateCfg: CanIfPrivateDlcCheck=false
    CanIfPublicCfg:
      CanIfPublicReadRxPduDataApi = false
      CanIfPublicReadRxPduNotifyStatusApi = true
      CanIfPublicReadTxPduNotifyStatusApi = true
      CanIfPublicSetDynamicTxIdApi = false
      CanIfPublicTxBuffering = false
      CanIfPublicTxConfirmPollingSupport = false
      CanIfPublicVersionInfoApi = false
      CanIfPublicCancelTransmitSupport = false
      CanIfPublicErrorPassiveSupport = false
      CanIfPublicCanIfLiteConfiguration = false
      CanIfPublicUserTpTxInOfflineMode = false
      CanIfPublicWakeupCheckValidSupport = false
      CanIfPublicPnSupport = false
      CanIfPublicHandleTypeEnum = UINT16
      CanIfPublicBusoffRecoveryfromRxIndication = false
      CanIfPublicDevErrorDetect = false
      CanIfTriggerTransmitSupport = false
      CanIfTxOfflineActiveSupport = false
      CanIfWakeupSupport = false
      CanIfReadMsgIdApi = true
      CanIfPublicMultipleDrvSupport = false
  module config CanSM: implementation-config-variant=VARIANT-PRE-COMPILE
    CanSMConfiguration: CanSMModeRequestRepetitionMax=5, CanSMModeRequestRepetitionTime=0.07
      CanSMManagerNetwork_Can_Network (CanSMManagerNetwork):
        CanSMBorTxConfirmationPolling = false
        CanSMBorCounterL1ToL2 = 0
        CanSMBorTimeL1 = 0.04
        CanSMBorTimeL2 = 0.1
        CanSMBorTimeTxEnsured = 0.02
        CanSMNetworkIndex = 0
        CanSMComMNetworkHandleRef = ComMChannel_Can_Network_Channel
        CanSMDemEventParameterRefs: CanSMRbDynCreate_CANSM_E_BUS_OFF=Standard
        CanSMController_CANNODE_0 (CanSMController): CanSMControllerId=CANNODE_0
    CanSMGeneral: CanSMMainFunctionTimePeriod=0.01, CanSMVersionInfoApi=false, CanSMDevErrorDetect=false, CanSMPncSupport=false
  module config EcuC: implementation-config-variant=VARIANT-PRE-COMPILE
    EcucConfigSet
      PduCollection (EcucPduCollection): PduIdTypeEnum=uint16, PduLengthTypeEnum=uint16
        9 x Pdu, all with PduLength=8:
          UDS_Rx_Phys_Id_0x737_CANNODE_0_CanIf2CanTp
          UDS_Rx_Phys_Id_0x737_CANNODE_0_CanTp2PduR
          UDS_Rx_Phys_Id_0x737_CANNODE_0_PduR2Dcm
          UDS_Rx_Func_Id_0x7DF_CANNODE_0_CanIf2CanTp
          UDS_Rx_Func_Id_0x7DF_CANNODE_0_CanTp2PduR
          UDS_Rx_Func_Id_0x7DF_CANNODE_0_PduR2Dcm
          UDS_Tx_Phys_Id_0x7B7_CANNODE_0_Phys_Dcm2PduR
          UDS_Tx_Phys_Id_0x7B7_CANNODE_0_Phys_PduR2CanTp
          UDS_Tx_Phys_Id_0x7B7_CANNODE_0_Phys_CanTp2CanIf
    EcuCRbSettings: EcuCRbArRelease=AR42_Rev2, EcuCRbRteInUse=false

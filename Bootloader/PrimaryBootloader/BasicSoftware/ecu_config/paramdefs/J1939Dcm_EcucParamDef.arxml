AUTOSAR XML (schema 4-2-2)
package /AUTOSAR_J1939Dcm/EcucModuleDefs
  module definition J1939Dcm [0..1]: category=VENDOR_SPECIFIC_MODULE_DEFINITION, refined-module-def=J1939Dcm, variants pre-compile  # J1939 Diagnostic Communication Manager | Configuration of J1939Dcm (J1939 Diagnostic Communications Manager) module.
    container J1939DcmConfigSet  # This container contains the configuration parameters and sub containers of the AUTOSAR J1939Dcm module.
      container J1939DcmChannel [1..*]  # Contains the J1939DcmChannel parameters.
        enumeration J1939DcmBusType: {J1939DCM_ISO9141, J1939DCM_J1587, J1939DCM_J1850, J1939DCM_J1922, J1939DCM_J1939_NETWORK_1, J1939DCM_J1939_NETWORK_2, J1939DCM_J1939_NETWORK_3, J1939DCM_OTHER}, set at pre-compile  # Identifies the communication port
        symbolic name reference J1939DcmComMChannelRef: scope=ECU, set at link in variant link-time / post-build in variant post-build / pre-compile in variant pre-compile, destination=ComMChannel  # Reference to the ComMChannel.
      container J1939DcmNode [1..*]  # Contains the parameters for the support of a logical J1939 node.
        integer J1939DcmSPNsInDataStream [0..*]: 0..524287, multiplicity set at pre-compile, set at pre-compile  # Defines the SPNs available in data stream for use in DM24.
        symbolic name reference J1939DcmNmNodeRef: set at link in variant link-time+post-build / pre-compile in variant pre-compile, destination=J1939NmNode  # Reference to the corresponding J1939Nm node.
        symbolic name reference J1939DcmNodeRmUserRef: set at link in variant link-time / post-build in variant post-build / pre-compile in variant pre-compile, destination=J1939RmUser  # Reference to the J1939RmUser used by J1939Dcm.
        container J1939DcmDiagnosticMessageSupport [1..*]  # Contains parameters to configure the diagnostic message support
          enumeration J1939DcmDmxSupport: {J1939DCM_DM01_SUPPORT, J1939DCM_DM02_SUPPORT, J1939DCM_DM03_SUPPORT, J1939DCM_DM04_SUPPORT, J1939DCM_DM05_SUPPORT, J1939DCM_DM06_SUPPORT, J1939DCM_DM07_SUPPORT, J1939DCM_DM08_SUPPORT, J1939DCM_DM09_SUPPORT, J1939DCM_DM10_SUPPORT, J1939DCM_DM11_SUPPORT, J1939DCM_DM12_SUPPORT, J1939DCM_DM13_SUPPORT, J1939DCM_DM14_SUPPORT, J1939DCM_DM15_SUPPORT, J1939DCM_DM16_SUPPORT, J1939DCM_DM17_SUPPORT, J1939DCM_DM18_SUPPORT, J1939DCM_DM19_SUPPORT, J1939DCM_DM20_SUPPORT, J1939DCM_DM21_SUPPORT, J1939DCM_DM22_SUPPORT, J1939DCM_DM23_SUPPORT, J1939DCM_DM24_SUPPORT, J1939DCM_DM25_SUPPORT, J1939DCM_DM26_SUPPORT, J1939DCM_DM27_SUPPORT, J1939DCM_DM28_SUPPORT, J1939DCM_DM29_SUPPORT, J1939DCM_DM30_SUPPORT, J1939DCM_DM31_SUPPORT, J1939DCM_DM32_SUPPORT, J1939DCM_DM33_SUPPORT, J1939DCM_DM34_SUPPORT, J1939DCM_DM35_SUPPORT, J1939DCM_DM36_SUPPORT, J1939DCM_DM37_SUPPORT, J1939DCM_DM38_SUPPORT, J1939DCM_DM39_SUPPORT, J1939DCM_DM40_SUPPORT, J1939DCM_DM41_SUPPORT, J1939DCM_DM42_SUPPORT, J1939DCM_DM43_SUPPORT, J1939DCM_DM44_SUPPORT, J1939DCM_DM45_SUPPORT, J1939DCM_DM46_SUPPORT, J1939DCM_DM47_SUPPORT, J1939DCM_DM48_SUPPORT, J1939DCM_DM49_SUPPORT, J1939DCM_DM50_SUPPORT, J1939DCM_DM51_SUPPORT, J1939DCM_DM52_SUPPORT, J1939DCM_DM53_SUPPORT, J1939DCM_DM54_SUPPORT, J1939DCM_DM55_SUPPORT, J1939DCM_DM56_SUPPORT, J1939DCM_DM57_SUPPORT}, set at pre-compile  # This parameter is used to identify the actual DMx message.
          reference J1939DcmDiagnosticMessageSupportChannelRef: set at link in variant link-time+post-build / pre-compile in variant pre-compile, destination=J1939DcmChannel  # Reference to J1939DcmChannel for which this diagnostic message is supported.
          container J1939DcmRxPdu [0..1]  # Contains parameters to configure the J1939DcmRxPdu.
            integer J1939DcmRxPduId: 0..65535, scope=ECU, set at pre-compile, symbolic-name-value=true, with-auto=true  # The I-PDU identifier used for communication with PduR.
            reference J1939DcmRxPduRef: set at link in variant link-time / post-build in variant post-build / pre-compile in variant pre-compile, destination=Pdu  # Reference to the global Pdu element in the Ecuc module.
          container J1939DcmTxPdu [0..1]  # Contains parameters to configure the J1939DcmTxPdu.
            integer J1939DcmTxPduId: 0..65535, scope=ECU, set at pre-compile, symbolic-name-value=true, with-auto=true  # The I-PDU identifier used to identify the Tx message.
            reference J1939DcmTxPduRef: set at link in variant link-time / post-build in variant post-build / pre-compile in variant pre-compile, destination=Pdu  # Reference to the global Pdu element in the Ecuc module.
    container J1939DcmGeneral  # Contains the general configuration parameters of the module.
      integer J1939DcmCommonBufferSize: 1..65535, set at pre-compile  # Size of common buffer (in Bytes). The buffer size should be as large as the longest command or response message.
      integer J1939DcmDM01BufferSize [0..1]: 1..65535, multiplicity set at pre-compile, set at pre-compile  # Size of DM01 buffer (in Bytes). The buffer size should be as large as the longest DM01 response message.
      integer J1939DcmDM01MaxDTCs [0..1]: 1..255, multiplicity set at pre-compile, set at pre-compile, default-value=20  # Configuration value of limitation of maximum DTCs to be reported in the DM01 message. This parameter is applicable only for DEM triggered and Cyclically triggered DM01 message. For Tester triggered DM01 messages this limitation is not applicable
      boolean J1939DcmDevErrorDetect: set at pre-compile  # Switches the Default Error Tracer (Det) detection and notification ON or OFF. | * true: enabled (ON). * false: disabled (OFF).
      float J1939DcmMainFunctionPeriod: 0.001..0.255, scope=ECU, set at link in variant link-time+post-build / pre-compile in variant pre-compile  # Call cycle in seconds of J1939Dcm_MainFunction.
      integer J1939DcmMaxDTCsPerMainFunction [0..1]: 1..255, multiplicity set at pre-compile, set at pre-compile  # Maximum threshold of DTCs filtered in a single MainFunction cycle.
      integer J1939DcmMaxFreezeFramesPerMainFunction [0..1]: 1..255, multiplicity set at pre-compile, set at pre-compile  # Maximum threshold of FreezeFrames filtered in a single MainFunction cycle.
      integer J1939DcmMaxRatiosPerMainFunction [0..1]: 1..255, multiplicity set at pre-compile, set at pre-compile  # Maximum threshold of Ratios filtered in a single MainFunction cycle.
      boolean J1939DcmRbAllowApplToStopDM1PeriodicMsg [0..1]: origin=RB:AR42.5.0.0:2019-01-25, set at pre-compile, default-value=false  # If enabled, this feature provides the Application an API to allow/stop DM01 Periodic messages for the current cycle. Application API 'J1939DcmAppl_AllowDM1PeriodicMsg' would be invoked from J1939Dcm_DM1Scheduler and J1939Dcm_DemTriggerOnDTCStatus. The Application can return E_OK to allow the transmission of DM01 Periodic messages, or return E_NOT_OK if DM01 periodic transmission is to be stopped for the current cycle. | * True : Enabled (ON); * False : Disabled (OFF)
      boolean J1939DcmRbGetPermToAcceptReq [0..1]: origin=RB:AR42.6.0.0:2019-07-26, set at pre-compile, default-value=false  # If enabled, this feature provides the Application an API to accept/reject DM Request messages received. Application API 'J1939DcmAppl_GetPermToAcceptReq' would be invoked from J1939Dcm_StartOfReception, J1939Dcm_RequestIndication and J1939Dcm_RxIndication APIs. The Application can return E_OK to accept the request message, or return E_NOT_OK if the request is to be rejected. If this feature is enabled, an Application callback 'J1939DcmAppl_RequestCompleted' will be given after the TxConfirmation to inform the Application that the request was serviced completely
      integer J1939DcmRbMemMaxNumberOfRetryForTransmit [0..1]: 0..255, multiplicity set at pre-compile, origin=RB:AR42.3.0.0:2018-01-25, set at pre-compile  # Maximum number of times the Device should retry to Transmit the Response for Memory Access Services when Status Request is being Transmitted and vice-versa.( configure this value as multiple of J1939Dcm Main Function Period)
      float J1939DcmRbMemTimeOutForData [0..1]: 0..1, origin=RB:AR42.3.0.0:2018-01-25, set at link in variant link-time+post-build / pre-compile in variant pre-compile  # Time-out period while waiting for data for requested operation(write).( configure this value as multiple of J1939Dcm Main Function Period)
      float J1939DcmRbMemTimeOutForOperationComplete [0..1]: 0..1, origin=RB:AR42.3.0.0:2018-01-25, set at link in variant link-time+post-build / pre-compile in variant pre-compile  # Time-out period while waiting to receive Operation Complete Message from Tool.( configure this value as multiple of J1939Dcm Main Function Period)
      float J1939DcmRbMemTimeOutForOperationExecution [0..1]: 0..1, origin=RB:AR42.3.0.0:2018-01-25, set at link in variant link-time+post-build / pre-compile in variant pre-compile  # Time-out period while waiting for requested operation(read, write, erase) to be completed from application side.( configure this value as multiple of J1939Dcm Main Function Period)
      float J1939DcmRbMemTimeOutForReceivingKey [0..1]: 0..1, origin=RB:AR42.3.0.0:2018-01-25, set at link in variant link-time+post-build / pre-compile in variant pre-compile  # Time-out period while waiting to receive Key from Tool.( configure this value as multiple of J1939Dcm Main Function Period)
      boolean J1939DcmVersionInfoApi: set at pre-compile  # Pre-processor switch for enabling version info API support.

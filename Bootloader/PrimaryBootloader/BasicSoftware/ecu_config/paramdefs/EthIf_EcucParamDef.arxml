AUTOSAR XML (schema 4-2-2)
package /AUTOSAR_EthIf/EcucModuleDefs
  module definition EthIf [0..1]: category=VENDOR_SPECIFIC_MODULE_DEFINITION, refined-module-def=EthIf, variants pre-compile  # Configuration of the EthIf (Ethernet Interface) module.
    container EthIfConfigSet  # Collecting container for all parameters with post-build configuration classes.
      container EthIfController [1..*]  # This container contains the configuration of EthIfController. | An EthIfController is used to abstract the access to VLANs from the underlying communication system composed of physical Ethernet controller and Ethernet Transceiver (optional) or Ethernet Switch (optional) or Ethernet Switch Port Group (optional).
        integer EthIfCtrlIdx: 0..255, scope=ECU, set at pre-compile, symbolic-name-value=true, with-auto=true  # EthIfCtrlIdx (automatically generated) | This parameter provides a zero-based consecutive index of the Ethernet Communication Controllers. Upper layer BSW modules and the EthIf itself use this index to identify an Ethernet Communication Controller.
        integer EthIfCtrlMtu: 64..9000, scope=ECU, post-build-variant-value=true, set at link in variant link-time / post-build in variant post-build / pre-compile in variant pre-compile  # Specifies the maximum transmission unit (MTU) of the EthIfCtrl in [bytes]. | Note: In case a VLAN tag is used for the EthIfCtrl, the frame length of the Ethernet frame will increase by 4 bytes.
        integer EthIfMaxTxBufsTotal [0..0]: 1..4294967295, set at pre-compile  # EthIfMaxTxBufsTotal (currently unused) | Limits the total number of transmit buffers.
        integer EthIfVlanId [0..1]: 0..4095, scope=ECU, multiplicity set at link in variant link-time / post-build in variant post-build / pre-compile in variant pre-compile, post-build-variant-multiplicity=true, post-build-variant-value=true, set at link in variant link-time / post-build in variant post-build / pre-compile in variant pre-compile  # A virtual-LAN is identified by this attribute according to IEEE 802.1Q.
        symbolic name reference EthIfEthTrcvRef [0..1]: scope=ECU, multiplicity set at link in variant link-time / post-build in variant post-build / pre-compile in variant pre-compile, post-build-variant-multiplicity=true, post-build-variant-value=true, set at link in variant link-time / post-build in variant post-build / pre-compile in variant pre-compile, destination=EthIfTransceiver  # Reference to an Ethernet transceiver, which is handled by the Ethernet Interface.
        symbolic name reference EthIfPhysControllerRef: scope=ECU, post-build-variant-value=true, set at link in variant link-time / post-build in variant post-build / pre-compile in variant pre-compile, destination=EthIfPhysController  # Reference to a physical Ethernet controller, which is handled by the Ethernet Interface.
        choice reference EthIfSwitchRefOrPortGroupRef [0..1]: multiplicity set at link in variant link-time / post-build in variant post-build / pre-compile in variant pre-compile, post-build-variant-multiplicity=true, post-build-variant-value=true, set at link in variant link-time / post-build in variant post-build / pre-compile in variant pre-compile, destination=[EthIfSwitch, EthIfSwitchPortGroup]  # The choice reference allows to configure either the EthIfController references an EthIfSwitch or an EthIfSwitchPortGroup. | Reference to a EthIfSwitchPortGroup. In case port groups are controlled by PNC EthIfSwitchPortGroupRefSemantics shall have the value ETHIF_SWITCH_PORT_GROUP_LINK_INFO. In case port groups are controlled by the EhtIfController EthIfSwitchPortGroupRefSemantics shall have the value ETHIF_SWITCH_PORT_GROUP_CONTROL.
      container EthIfFrameOwnerConfig [1..*]  # Configuration of Ethernet frame owner | The EthIfFrameOwnerConfig container is used to map Ethernet frames with a particular EtherType to an UpperLayer.
        integer EthIfFrameType: 0..65535, post-build-variant-value=true, set at link in variant link-time / post-build in variant post-build / pre-compile in variant pre-compile  # Selects the Ethernet frame type. | A list of EtherTypes specified for IETF protocols can be found in RFC7042, Appendix B.
        integer EthIfOwner [0..0]: 0..255, post-build-variant-value=true, set at link in variant link-time / post-build in variant post-build / pre-compile in variant pre-compile  # EthIfOwner (unused) | Selects the owner of an Ethernet frame type. The owner is a zero based index into the callback function configuration 'EthIfRxIndicationConfig'. I.e. an Ethernet frame of type IPv4 (0x800) at index 0 will call the first callback function configured in 'EthIfRxIndicationConfig'.
        boolean EthIfRbRxBypass [0..1]: origin=RB:AR42.9.0.0:2020-06-30, set at link in variant link-time / post-build in variant post-build / pre-compile in variant pre-compile  # RB (Vendor06) specific parameter: Enables / Disables RxIndication bypass for the FrameOwner. | When the bypass is enabled, EthIf_RxIndication() will forward to UL_RxIndication() all the received Ethernet frames without identifying EthIfCtrl and without checking EthIfCtrl state. This bypass is intended to be used for RMU EtherType only (Marvell Switch control frames over Ethernet).
        symbolic name reference EthIfRxIndicationRef: origin=RB:AR41.19.0.0:2015-09-10, post-build-variant-value=true, set at link in variant link-time / post-build in variant post-build / pre-compile in variant pre-compile, destination=EthIfRxIndicationConfig  # RB (Vendor06) specific parameter: Reference to EthIfRxIndicationConfig container where the RxIndication callback function is configured.
        symbolic name reference EthIfTxConfirmationRef [0..1]: origin=RB:AR41.19.0.0:2015-09-10, post-build-variant-value=true, set at link in variant link-time / post-build in variant post-build / pre-compile in variant pre-compile, destination=EthIfTxConfirmationConfig  # RB (Vendor06) specific parameter: Reference to EthIfTxConfirmationConfig container where the TxConfirmation callback function is configured.
        symbolic name reference EthIfZeroCopyTxConfirmationRef [0..1]: origin=RB:AR42.8.0.0:2019-12-31, post-build-variant-value=true, set at link in variant link-time / post-build in variant post-build / pre-compile in variant pre-compile, destination=EthIfZeroCopyTxConfirmationConfig  # RB (Vendor06) specific parameter: Reference to EthIfZeroCopyTxConfirmationConfig container where the ZeroCopyTxConfirmation callback function is configured.
      container EthIfPhysController [1..*]  # This container contains the configuration of EthIfPhysController. | The usage of EthIfEthCtrlRef and EthIfWEthCtrlRef is exclusive OR.
        string EthIfEthDriverPrefix [0..1]: scope=ECU, multiplicity set at pre-compile, origin=RB:AR42.8.0.0:2019-12-31, set at pre-compile, max-length=32, min-length=3  # EthIfEthDriverPrefix (automatically generated for RTA_BSW driver) | RB (Vendor06) specific parameter: Defines the related Eth Driver API prefix. In case EthIfEthCtrlRef refers to a RTA_BSW driver, the parameter EthIfEthDriverPrefix is automatically forwarded and do not need to be configured by integrator. | The prefix need to be constructed in the following way: "vi_ai" where vi is the vendorId (06 for RTA_BSW) and ai is the vendorApiInfix. For example, if the prefix is defined as "06_SynopsisGmacAhb", then the transmission API called by EthIf will be Eth_06_SynopsisGmacAhb_Transmit(). The EthIfEthDriverPrefix is optional. If it is disabled then no prefix will be used in API names (for example transmission API called by EthIf will be Eth_Transmit()). EthIfEthDriverPrefix is also used to determine the name of the Eth Driver header file to be included. Range of characters is 3..32.
        integer EthIfPhysControllerIdx: 0..255, scope=ECU, set at pre-compile, symbolic-name-value=true, with-auto=true  # EthIfPhysControllerIdx (automatically generated) | This parameter provides a zero-based consecutive index of the physical Ethernet controllers. Upper layer BSW modules and the Ethernet Interface itself use this index to identify a physical Ethernet controller.
        symbolic name reference EthIfEthCtrlRef: scope=ECU, post-build-variant-value=true, set at link in variant link-time / post-build in variant post-build / pre-compile in variant pre-compile, destination=EthCtrlConfig  # Reference to a physical Ethernet controller, which is handled by a specific Ethernet controller driver.
        symbolic name reference EthIfWEthCtrlRef [0..0]: scope=ECU, post-build-variant-value=true, set at link in variant link-time / post-build in variant post-build / pre-compile in variant pre-compile, destination=WEthCtrlConfig  # EthIfWEthCtrlRef (currently unused) | Reference to a physical Wireless Ethernet controller, which is handled by a specific Wireless Ethernet controller driver.
        container EthIfPhysCtrlRxMainFunctionPriorityProcessing [0..*]: multiplicity set at pre-compile  # Configuration of ingress FIFO based main function processing. | An EthIf_MainFunctionRx_{PriorityProcessing ShortName} API is generated for each EthIfPhysCtrlRxMainFunctionPriorityProcessing container based on the short name of this container. In case Rx interrupt is enabled, this container shall not be configured. In polling mode, EthIfPhysCtrlRxMainFunctionPriorityProcessing shall be configured at least one time.
          integer EthIfPhysCtrlRxIndicationIterations [0..1]: 1..65535, set at pre-compile  # Max number of Ethernet frames polled per main function invocation. | When the parameter is unconfigured, the polling of Eth_Receive will be done indefinitely until there is no more frame to receive.
          float EthIfPhysCtrlRxMainFunctionPeriod: 0..Inf, set at pre-compile  # Specifies the period of main function in seconds.
          float EthIfPhysCtrlRxMainFunctionRuntimeLimit [0..1]: 0..Inf, origin=RB:AR42.4.4.0:2018-04-30, set at pre-compile  # RB (Vendor06) specific parameter: Specifies the runtime limit of the EthIfPhysCtrlRxMainFunction in seconds.
          symbolic name reference EthIfPhysCtrlRxIngressFifoRef: set at pre-compile, destination=EthCtrlConfigIngressFifo  # Reference to the reception FIFO. | The reception FIFO is part of the related Physical Ethernet Controller.
      container EthIfRxIndicationConfig [1..*]  # Configuration of receive callback functions.
        function name EthIfRxIndicationFunction: post-build-variant-value=true, set at link in variant link-time / post-build in variant post-build / pre-compile in variant pre-compile  # Specifies receive indication callback function. | The receive callback function (RxIndication) is called by EthIf to inform the Upper Layer about the reception of a new Ethernet frame.
      container EthIfSwitch [0..*]  # This container contains the configuration of EthIfSwitches.
        boolean EthIfSwitchEnableLinkStateInterrupt [0..1]: origin=RB:AR42.4.5.0:2018-05-31, set at pre-compile  # RB (Vendor06) specific parameter: Enables / Disables link state change interrupt. | When link state change interrupt is enabled, EthIf expects that the switch calls EthIf_SwitchLinkUpIndication and EthIf_SwitchLinkDownIndication to inform about link state change for a particular port. When link state change interrupt is disabled, EthIf will poll the link state by calling directly the EthSwt_GetLinkState API from EthIf_MainFunctionState. When EthIfSwitchEnableLinkStateInterrupt is not configured, the default Autosar functionning is used : link state change is polled via EthSwt_GetLinkState API from EthIf_MainFunctionState.
        integer EthIfSwitchIdx: 0..255, scope=ECU, set at pre-compile, symbolic-name-value=true, with-auto=true  # EthIfSwitchIdx (Automatically generated) | This parameter provides a zero-based consecutive index of the Ethernet Interface Switches. Upper layer BSW modules and the EthIf itself use this index to identify a Ethernet Switch.
        symbolic name reference EthIfSwitchRef: scope=ECU, post-build-variant-value=true, set at link in variant link-time / post-build in variant post-build / pre-compile in variant pre-compile, destination=EthSwtConfig  # Reference to a Ethernet Switch, which is handled by a specific Ethernet Switch driver.
      container EthIfSwitchMgmtInfoIndicationConfig [0..0]: multiplicity set at pre-compile  # EthIfSwitchMgmtInfoIndicationConfig (currently unused) | Configuration of Switch Management callback function.
        function name EthIfSwitchMgmtInfoIndicationFunction [0..0]: post-build-variant-value=true, set at link in variant link-time / post-build in variant post-build / pre-compile in variant pre-compile  # EthIfSwitchMgmtInfoIndicationFunction (currently unused) | Enables/Disables the ingress Switch management info indication redirected call to upper layers who registered for the call.
      container EthIfSwitchPortGroup [0..*]  # This container contains the configuration of EthIfSwitchPortGroups. | If EthIfSwitchPortGroups are controlled by PNC one EthIfSwitchPortGroup per PNC shall exist. The host port shall be part of all EthIfSwitchPortGroups. The up link port of a master switch and the up link port of the slave switch shall be part of all EthIfSwitchPortGroups that contain EthSwtPorts belonging to the slave switch.
        integer EthIfSwitchPortGroupIdx: 0..255, scope=ECU, set at pre-compile, symbolic-name-value=true, with-auto=true  # EthIfSwitchPortGroupIdx (automatically generated) | This parameter provides a zero-based consecutive index of the Ethernet Switch Port Groups. Upper layer BSW modules and the EthIf itself use this index to identify an Ethernet Switch Port Group.
        enumeration EthIfSwitchPortGroupRefSemantics [0..1]: {ETHIF_SWITCH_PORT_GROUP_CONTROL, ETHIF_SWITCH_PORT_GROUP_LINK_INFO}, post-build-variant-value=true, set at link in variant link-time / post-build in variant post-build / pre-compile in variant pre-compile  # Defines how the EthIfSwitchRefOrPortGroupRef refering to a EthIfSwitchPortGroup shall be interpreted. If port group is not referenced by any EthIfCtrl (stand-alone), it is controlled by BswM. So that this optional parameter should not be configured. | * ETHIF_SWITCH_PORT_GROUP_CONTROL : Used in case all ports in this group are controlled by the EthIf Controller (Used, if no PNC configured for this channel). * ETHIF_SWITCH_PORT_GROUP_LINK_INFO : Used in case all ports in this group are controlled by EthIf_SwitchPortGroupRequestMode (Port Group configured as link-info itself is not controlled by BswM, but all ports of this group are controlled by BswM using other stand-alone Port Group(s) mapped to the PNC configured for the same channel).
        symbolic name reference EthIfPortRef [1..*]: post-build-variant-value=true, set at link in variant link-time / post-build in variant post-build / pre-compile in variant pre-compile, destination=EthSwtPort  # Reference to an Ethernet Switch Port.
      container EthIfSwitchTimeStampIndicationConfig [0..0]: multiplicity set at pre-compile  # EthIfSwitchTimeStampIndicationConfig (currently unused) | Configuration of Switch timestamp indications.
        function name EthIfSwitchEgressTimeStampIndicationFunction [0..0]: post-build-variant-value=true, set at link in variant link-time / post-build in variant post-build / pre-compile in variant pre-compile  # EthIfSwitchEgressTimeStampIndicationFunction (currently unused) | Enables/Disables to upper layers an egress timestamp indication function.
        function name EthIfSwitchIngressTimeStampIndicationFunction [0..0]: post-build-variant-value=true, set at link in variant link-time / post-build in variant post-build / pre-compile in variant pre-compile  # EthIfSwitchIngressTimeStampIndicationFunction (currently unused) | Enables/Disables to upper layers an ingress timestamp indication function.
      container EthIfTransceiver [0..*]  # This container contains the configuration of EthIfTransceiver. | The usage of EthIfEthTrcvRef and EthIfWEthTrcvRefis exclusive OR.
        integer EthIfTransceiverIdx: 0..255, scope=ECU, set at pre-compile, symbolic-name-value=true, with-auto=true  # EthIfTransceiverIdx (Automatically generated) | This parameter provides a zero-based consecutive index of the Ethernet transceivers. Upper layer BSW modules and the Ethernet Interface itself use this index to identify an Ethernet tranceiver.
        symbolic name reference EthIfEthTrcvRef: scope=ECU, post-build-variant-value=true, set at link in variant link-time / post-build in variant post-build / pre-compile in variant pre-compile, destination=EthTrcvConfig  # Reference to an Ethernet transceiver, which is handled by a specific Ethernet transceiver driver.
        symbolic name reference EthIfWEthTrcvRef [0..0]: scope=ECU, post-build-variant-value=true, set at link in variant link-time / post-build in variant post-build / pre-compile in variant pre-compile, destination=WEthTrcvConfig  # EthIfWEthTrcvRef (currently unused) | Reference to an Wireless Ethernet transceiver, which is handled by a specific Wireless Ethernet transceiver driver.
      container EthIfTrcvLinkStateChgConfig [0..0]  # EthIfTrcvLinkStateChgConfig (currently unused). | Specifies link state change callback function
        function name EthIfTrcvLinkStateChgFunction [0..0]: post-build-variant-value=true, set at link in variant link-time / post-build in variant post-build / pre-compile in variant pre-compile  # EthIfTrcvLinkStateChgFunction (currently unused). | Specifies link state change callback function
      container EthIfTxConfirmationConfig [0..*]  # Configuration of transmit indication callback functions.
        function name EthIfTxConfirmationFunction: post-build-variant-value=true, set at link in variant link-time / post-build in variant post-build / pre-compile in variant pre-compile  # Specifies transmit indication callback function | The transmit callback function (TxConfirmation) is called by EthIf to confirm to the Upper Layer the transmission of an Ethernet frame. The TxConfirmation callback is not required for TcpIp communication as the Upper Layers of EthIf in TcpIp component (IPv4, IPv6 or ARP) do not need this information. For other Upper Layers of EthIf (CDD), the TxConfirmation callback may be configured (for example, the TxConfirmation callback should be configured for EthTSyn).
      container EthIfZeroCopyTxConfirmationConfig [0..*]  # RB (Vendor06) specific container: Configuration of ZeroCopy transmit indication callback functions.
        function name EthIfZeroCopyTxConfirmationFunction: origin=RB:AR42.8.0.0:2019-12-31, post-build-variant-value=true, set at link in variant link-time / post-build in variant post-build / pre-compile in variant pre-compile  # RB (Vendor06) specific parameter: Specifies ZeroCopy transmit indication callback function | The transmit callback function (ZeroCopyTxConfirmation) is called by EthIf to confirm to the Upper Layer the transmission of an ZeroCopy Ethernet frame.
    container EthIfGeneral  # This container contains the general configuration parameters of the Ethernet Interface.
      boolean EthIfDevErrorDetect: set at pre-compile, default-value=false  # Switches the Default Error Tracer (Det) notification ON or OFF. | * true: detection and notification is enabled. * false: notification is disabled (detection remains active).
      boolean EthIfEnableRxInterrupt [0..0]: set at pre-compile  # EthIfEnableRxInterrupt (currently unused) | Enables / Disables receive interrupt. | When receive interrupt is disabled, the reception of new Ethernet frames is polled by each EthIf_MainFunctionRx_{PriorityProcessing ShortName} at EthIfPhysCtrlRxMainFunctionPeriod cycle time
      boolean EthIfEnableSignalQualityApi: set at pre-compile  # Enable/disable the APIs to read and clear the signal quality for Trcv and switch.
      boolean EthIfEnableTxInterrupt [0..0]: set at pre-compile  # EthIfEnableTxInterrupt (currently unused) | Enables / Disables the transmit interrupt. | When transmit interrupt is disabled, the confimation for transmitted Ethernet frames is polled by EthIf_MainFunctionTx at EthIfMainFunctionPeriod cycle time
      boolean EthIfEnableWEthApi [0..0]: multiplicity set at pre-compile, set at pre-compile, default-value=false  # EthIfEnableWEthApi (currently unused) | Enables / Disables API's for WEth / WEthTrcv
      boolean EthIfGetAndResetMeasurementDataApi: set at pre-compile, default-value=false  # Enables / Disables the Get and Reset Measurement Data API
      boolean EthIfGetBaudRate [0..0]: set at pre-compile  # EthIfGetBaudRate (currently unused) | Enables / Disables GetBaudRate API.
      boolean EthIfGetCounterState [0..0]: set at pre-compile  # EthIfGetCounterState (currently unused) | Enables / Disables GetCounterState API.
      boolean EthIfGetCtrlIdxList [0..0]: set at pre-compile, default-value=false  # EthIfGetCtrlIdxList (currently unused) | Enables / Disables GetCtrlIdxList API.
      boolean EthIfGetTransceiverWakeupModeApi [0..0]: multiplicity set at pre-compile, set at pre-compile, default-value=false  # EthIfGetTransceiverWakeupModeApi (currently unused) | Enables / Disables EthIf_GetTransceiverWakeupMode API
      boolean EthIfGetVlanIdSupport: set at pre-compile, default-value=false  # Enables / Disables GetVlanId API.
      boolean EthIfGlobalTimeSupport: set at pre-compile  # Enables/Disables the Global Time APIs used amongst others by Global Time Synchronization over Ethernet. | The following APIs are enabled / disabled by this configuration parameter : EthIf_GetCurrentTime, EthIf_EnableEgressTimeStamp, EthIf_GetEgressTimeStamp and EthIf_GetIngressTimeStamp.
      float EthIfMainFunctionPeriod: 0..Inf, set at pre-compile  # Specifies the period of main function EthIf_MainFunctionTx in seconds. Ethernet Interface does not require this information but the BSW scheduler.
      float EthIfMainFunctionStatePeriod: 0..Inf, multiplicity set at pre-compile, set at pre-compile  # Specifies the period of main function EthIf_MainFunctionState in seconds. Ethernet Interface does not require this information but the BSW scheduler.
      integer EthIfMaxTrcvsTotal [0..0]: 1..255, set at pre-compile  # EthIfMaxTrcvsTotal (currently unused) | Limits the total number of transceivers.
      boolean EthIfOverrideSrcMACSupport [0..1]: origin=RB:42.5.1.0:2018-07-18, set at pre-compile  # RB (Vendor06) specific parameter: Functionality provided to upper layer of EthIf to override the source MAC address. | Enables/Disables the API EthIf_OverrideTxBufSrcAddr based on the configuration.
      float EthIfPortStartupActiveTime [0..1]: 0.001..65.535, multiplicity set at link in variant link-time / post-build in variant post-build / pre-compile in variant pre-compile, post-build-variant-multiplicity=true, post-build-variant-value=true, set at link in variant link-time+post-build / pre-compile in variant pre-compile  # Denote the time delay in seconds after the mode "ETHTRCV_MODE_ACTIVE" of all EthIfSwitchPorts are requested via EthIf_StartAllPorts. | This is only used for ports in EthIfSwtPortGroups which are not referenced by a EthIfController.
      string EthIfPublicCddHeaderFile [0..*]: scope=ECU, multiplicity set at pre-compile, set at pre-compile, max-length=32, min-length=1  # Defines header files for callback functions which shall be included in case of CDDs. Range of characters is 1.. 32.
      integer EthIfRxIndicationIterations [0..0]: 0..65535, set at pre-compile  # EthIfRxIndicationIterations (currently unused) | Maximum number of Ethernet frames per Ethernet controller polled from the Ethernet driver within EthIf_MainFunctionRx. | EthIf_MainFunctionRx is unused. The checking for newly received frames in polling mode is done only by the EthIf_MainFunctionRx_{PriorityProcessing ShortName} API. The EthIfGeneral/EthIfRxIndicationIterations configuration parameter is therefore not required. Only the EthIfPhysCtrlRxIndicationIterations for each PriorityProcessing container shall be configured.
      boolean EthIfSetForwardingModeApi [0..0]: set at pre-compile, default-value=false  # EthIfSetForwardingModeApi (currently unused) | Enables /disables EthIf_SetForwardingMode API.
      float EthIfSignalQualityCheckPeriod [0..1]: 0..Inf, set at pre-compile  # Specifies the period in seconds in which the signal quality will be polled in the context of EthIf_MainfunctionState. The value shall be an integral multiple of EthIfMainFunctionStatePeriod. Dependency: If this parameter is defined, the parameter EthIfEnableSignalQualityApi shall be set to TRUE.
      boolean EthIfStartAutoNegotiation [0..0]: set at pre-compile  # EthIfStartAutoNegotiation (currently unused) | Enables / Disables StartAutoNegotiation API.
      boolean EthIfSwitchGlobalTimeSupport [0..1]: origin=RB:42.4.5.0:2018-05-31, set at pre-compile  # RB (Vendor06) specific parameter: Enables/Disables the Global Time APIs related to switch used amongst others by Global Time Synchronization over Ethernet. | The following APIs are enabled / disabled by this configuration parameter : EthIf_GetTxMgmtObject and EthIf_GetRxMgmtObject.
      boolean EthIfSwitchManagementSupport [0..0]: set at pre-compile  # EthIfSwitchManagementSupport (currently unused) | Enables/Disables the Switch management APIs to support a Switch-port specific communication attribute access.
      float EthIfSwitchOffPortTimeDelay [0..1]: 0.001..65.535, multiplicity set at link in variant link-time / post-build in variant post-build / pre-compile in variant pre-compile, post-build-variant-multiplicity=true, post-build-variant-value=true, set at link in variant link-time+post-build / pre-compile in variant pre-compile  # Denote the time delay in seconds after the mode "ETHTRCV_MODE_DOWN" of a EthIfSwitchPortGroup will be executed. | This is only used for EthIfSwtPortGroups which not referenced by a EthIfController. The time delay shall be greater than the UdpNm timings, because UdpNm shall finish its shutdown handling. (Repeat Message State, Prepare Bus-Sleep state, Bus-Sleep state).
      integer EthIfTrcvLinkStateChgMainReload: 1..255, set at pre-compile  # Specifies the frequency of transceiver link state change checks in each period of main function EthIf_MainFunctionState.
      boolean EthIfVerifyConfigApi [0..0]: set at pre-compile, default-value=false  # EthIfVerifyConfigApi (currently unused) | Enables /disables EthIf_VerifyConfig API.
      boolean EthIfVersionInfoApi: set at pre-compile, default-value=false  # Enables / Disables version info API
      boolean EthIfVersionInfoApiMacro [0..0]: set at pre-compile, default-value=false  # EthIfVersionInfoApiMacro (currently unused) | Enables / Disables version info API macro implementation.
      integer EthIfVirtualAddressFilterSize [0..1]: 1..255, origin=RB:42.3.5.0:2017-11-20, set at pre-compile  # RB (Vendor06) specific parameter: Specifies the size of virtual address filter over all configured EthCtrls. It should be set to the overall number of simultaneously used multicast IP addresses and the size MUST NOT be greater than the summed capacity of physical address filters of all configured EthCtrls. Dependency: This parameter is only valid if Eth.EthGeneral.EthUpdatePhysAddrFilter is enabled. If multicast communication is not used, then Eth.EthGeneral.EthUpdatePhysAddrFilter should be disabled in Eth and EthIfVirtualAddressFilterSize should not be configured.
      boolean EthIfWakeUpSupport [0..0]: set at pre-compile, default-value=false  # EthIfWakeUpSupport (currently unused) | Configures if wakeup is supported or not.
      boolean EthIfZeroCopyTxSupport [0..1]: origin=RB:AR42.8.0.0:2019-12-31, set at pre-compile, default-value=false  # RB (Vendor06) specific parameter: Enables/Disables the ZeroCopy transmission APIs. | The following APIs are enabled / disabled by this configuration parameter : EthIf_ZeroCopyFillHeader and EthIf_ZeroCopyTransmit.

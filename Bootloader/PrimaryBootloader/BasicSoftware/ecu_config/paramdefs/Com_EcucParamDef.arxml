AUTOSAR XML (schema 4-2-2)
package /AUTOSAR_Com/EcucModuleDefs
  module definition Com [0..1]: category=VENDOR_SPECIFIC_MODULE_DEFINITION, post-build-variant-support=true, refined-module-def=Com, variants pre-compile  # Communication Module | Configuration of the AUTOSAR COM module(with vendor specific enhancements of RB).
    container ComConfig  # This container contains the configuration parameters and sub containers of the AUTOSAR COM module.
      integer ComDataMemSize [0..1]: 0..18446744073709551615, multiplicity set at pre-compile, set at pre-compile  # Size of internal Com data in units of bytes (static memory allocation) - memory required by post-build configuration must be smaller than this constant. This parameter is needed only in case of post-build loadable implementation using static memory allocation.
      integer ComMaxIPduCnt [0..1]: 0..18446744073709551615, multiplicity set at pre-compile, set at pre-compile  # Maximum number of IPdus. This parameter is needed only in case of post-build loadable implementation using static memory allocation.
      container ComGwMapping [0..*]: multiplicity set at pre-compile, post-build-variant-multiplicity=true  # Each instance of this container defines one mapping of the integrated Signal Gateway.
        choice container ComGwDestination [1..*]: multiplicity set at pre-compile, post-build-variant-multiplicity=true  # Each instance of this choice container allows to define one routing destination either by reference to an already configured COM signal / signal group or by a destination description container.
          container ComGwDestinationDescription [0..1]  # Description of a gateway destination. This container allows defining a gateway destination without the configuration of a complete COM signal. This allows adding / changing gateway relations post build without the configuration of new signals.
            integer ComBitPosition: 0..4294967295, set at pre-compile  # Starting position within the I-PDU. This parameter refers to the position in the I-PDU and not in the shadow buffer. If the endianness conversion is configured to Opaque the parameter ComBitPosition shall define the bit0 of the first byte like in little endian byte order.
            enumeration ComSignalEndianness: {BIG_ENDIAN, LITTLE_ENDIAN, OPAQUE}, set at pre-compile  # Defines the endianness of the signal's network representation.
            float ComSignalInitValue [0..1]: multiplicity set at pre-compile, set at pre-compile, default-value=-2147483649  # Initial value for this signal.
            enumeration ComTransferProperty [0..1]: {PENDING, TRIGGERED, TRIGGERED_ON_CHANGE, TRIGGERED_ON_CHANGE_WITHOUT_REPETITION, TRIGGERED_WITHOUT_REPETITION}, multiplicity set at pre-compile, set at pre-compile  # Defines if a write access to this signal can trigger the transmission of the corresponding I-PDU. If the I-PDU is triggered, depends also on the transmission mode of the corresponding I-PDU.
            integer ComUpdateBitPosition [0..1]: -1..4294967295, multiplicity set at pre-compile, set at pre-compile, default-value=-1  # Bit position of update-bit inside I-PDU. | If this attribute is omitted then there is no update-bit. This setting must be consistently on sender and on receiver side. Range: 0..63 for CAN and LIN, 0..511 for CAN FD, 0..2031 for FlexRay, 0..4294967295 for TP. Default value of -1 implies that this parameter is not configured.
            reference ComGwIPduRef: set at pre-compile, destination=ComIPdu  # Reference to an I-PDU of a Signal Gateway source or destination description.
            container ComFilter [0..1]  # This container contains the configuration parameters of the AUTOSAR COM module's Filters. | Note: On sender side the container is used to specify the transmission mode conditions.
              enumeration ComFilterAlgorithm: {ALWAYS, MASKED_NEW_DIFFERS_MASKED_OLD, MASKED_NEW_DIFFERS_X, MASKED_NEW_EQUALS_X, NEVER, NEW_IS_OUTSIDE, NEW_IS_WITHIN, ONE_EVERY_N}, set at pre-compile  # This attribute is used for Tx/Rx Filtering. Please configure this attribute to select a filter algorithm for ComSignal/ComGroupSignal.
              integer ComFilterMask [0..1]: -2147483649..4294967295, multiplicity set at pre-compile, set at pre-compile, default-value=-2147483649  # This attribute is used for Tx/Rx Filtering. Please configure this attribute for ComFilterAlgorithm's like MASKED_NEW_EQUALS_X, MASKED_NEW_DIFFERS_X and MASKED_NEW_DIFFERS_MASKED_OLD. Default value of -2147483649 implies that this parameter is not configured.
              integer ComFilterMax [0..1]: -2147483649..4294967295, multiplicity set at pre-compile, set at pre-compile, default-value=-2147483649  # This attribute is used for Tx/Rx Filtering. Please configure this attribute for ComFilterAlgorithm's like NEW_IS_WITHIN and NEW_IS_OUTSIDE. Default value of -2147483649 implies that this parameter is not configured.
              integer ComFilterMin [0..1]: -2147483649..4294967295, multiplicity set at pre-compile, set at pre-compile, default-value=-2147483649  # This attribute is used for Tx/Rx Filtering. Please configure this attribute for ComFilterAlgorithm's like NEW_IS_WITHIN and NEW_IS_OUTSIDE. Default value of -2147483649 implies that this parameter is not configured.
              integer ComFilterOffset [0..1]: -1..4294967294, multiplicity set at pre-compile, set at pre-compile, default-value=-1  # This attribute is used for Tx/Rx Filtering. Please configure this attribute for ComFilterAlgorithm ONE_EVERY_N. | Range = 0..(ComFilterPeriod-1). Default value of -1 implies that this parameter is not configured.
              integer ComFilterPeriod [0..1]: 1..4294967295, multiplicity set at pre-compile, set at pre-compile, default-value=1  # This parameter defines the period of the ComFilterAlgorithm ONE_EVERY_N. Default value of +1 implies that this parameter is not configured.
              integer ComFilterX [0..1]: -2147483649..4294967295, multiplicity set at pre-compile, set at pre-compile, default-value=-2147483649  # This attribute is used for Tx/Rx Filtering. Please configure this attribute for ComFilterAlgorithm's like MASKED_NEW_EQUALS_X and MASKED_NEW_DIFFERS_X. Default value of -2147483649 implies that this parameter is not configured.
          container ComGwSignal [0..1]  # This container allows specifying a gateway source or destination respectively with a reference to a ComSignal, a ComGroupSignal or a ComSignalGroup.
            choice reference ComGwSignalRef: post-build-variant-value=true, set at pre-compile, destination=[ComGroupSignal, ComSignal, ComSignalGroup]  # Reference to an object of a gateway relation. Either to a ComSignal, ComGroupSignal or to a SignalGroup.
        choice container ComGwSource  # This choice container allows the definition of the gateway source signal either by reference to an already configured COM signal / signal group or by a source description container.
          container ComGwSignal [0..1]  # This container allows specifying a gateway source or destination respectively with a reference to a ComSignal, a ComGroupSignal or a ComSignalGroup.
            choice reference ComGwSignalRef: post-build-variant-value=true, set at pre-compile, destination=[ComGroupSignal, ComSignal, ComSignalGroup]  # Reference to an object of a gateway relation. Either to a ComSignal, ComGroupSignal or to a ComSignalGroup.
          container ComGwSourceDescription [0..1]  # Description of a gateway source. This container allows defining a gateway source without the configuration of a complete COM signal. This allows adding / changing gateway relations post build without the configuration of new signals.
            integer ComBitPosition: 0..4294967295, set at pre-compile  # Starting position within the I-PDU. This parameter refers to the position in the I-PDU and not in the shadow buffer. If the endianness conversion is configured to Opaque the parameter ComBitPosition shall define the bit0 of the first byte like in little endian byte order.
            integer ComBitSize [0..1]: 0..64, multiplicity set at pre-compile, set at pre-compile  # Size in bits, for integer signal types. For ComSignalType UINT8_N and UINT8_DYN | the size shall be configured by ComSignalLength. For ComSignalTypes FLOAT32 and FLOAT64 the size is already defined by the signal type and therefore may be omitted.
            enumeration ComSignalEndianness: {BIG_ENDIAN, LITTLE_ENDIAN, OPAQUE}, set at pre-compile  # Defines the endianness of the signal's network representation.
            integer ComSignalLength [0..1]: 0..4294967295, multiplicity set at pre-compile, set at pre-compile  # Description: | For ComSignalType UINT8_N this parameter specifies the length n in bytes. For ComSignalType UINT8_DYN it specifies the maximum length in bytes. For all other types this parameter shall be ignored. Range: 0..8 for normal CAN/ LIN I-PDUs, 0..64 for CAN FD I-PDUs, 0..254 for normal FlexRay I-PDUs (all of ComIPduType NORMAL), 0..4294967295 for I-PDUs with ComIPduType TP.
            enumeration ComSignalType: {BOOLEAN, FLOAT32, FLOAT64, SINT16, SINT32, SINT64, SINT8, UINT16, UINT32, UINT64, UINT8, UINT8_DYN, UINT8_N}, set at pre-compile  # The AUTOSAR type of the signal. Whether or not the signal is signed or unsigned can be found by examining the value of this attribute. | This type could also be used to reserved appropriate storage in AUTOSAR COM.
            integer ComUpdateBitPosition [0..1]: -1..4294967295, multiplicity set at pre-compile, set at pre-compile, default-value=-1  # Bit position of update-bit inside I-PDU. | If this attribute is omitted then there is no update-bit. This setting must be consistently on sender and on receiver side. Range: 0..63 for CAN and LIN, 0..511 for CAN FD, 0..2031 for FlexRay, 0..4294967295 for TP. Default value of -1 implies that this parameter is not configured.
            reference ComGwIPduRef: set at pre-compile, destination=ComIPdu  # Reference to an I-PDU of a Signal Gateway source or destination description.
      container ComIPdu [0..*]: multiplicity set at pre-compile, post-build-variant-multiplicity=true  # Contains the configuration parameters of the AUTOSAR COM module's I-PDUs.
        string ComCalibrationNameForIpduControl [0..1]: multiplicity set at pre-compile, origin=RB:20.0.0:2016-01-04, set at pre-compile  # User is provided with this option for each IPDU(To Control IPDU through Calibration) to give an desired calibration name instead of Com_st"PduShortName"PduCtrl_C name. Calibration name provided here will be generated in Com_Flatmap.arxml file and henceforth will be used to access the calibration value to Control IPDU communication. Otherwise, if this parameter is left blank, default calibration name will be generated as Com_st"PduShortName"PduCtrl_C. Note: ComIPduControlViaCalibration parameter should be enabled in ComGeneral for the this parameter field to be used. No validation will be checked on the string provided here, calibration name will be generated as it is.
        string ComCalibrationNameForNumberOfRepetitionOfTxPdu [0..1]: multiplicity set at pre-compile, origin=RB:4.3.0:2018-03-09, set at pre-compile  # User is provided with this option (For Tx IPDUs configured with number of repetition value) to give a desired calibration name instead of Com_nrOfRepn"ComIpduShortName"_C name. Calibration name provided here will be generated in Com_Flatmap.arxml file and henceforth will be used to access the calibration value to calibrate the number of repetition of Tx IPDUs. Otherwise, if this parameter is left blank, default calibration name will be generated as Com_nrOfRepn"ComIpduShortName"_C. Note: ComTxIpduNumberOfRepetition parameter should be enabled in ComGeneral for this parameter field to be used. No validation will be checked on the string provided here, calibration name will be generated as it is.
        string ComCalibrationNameForRxIpduTimeout [0..1]: multiplicity set at pre-compile, origin=RB:20.0.0:2016-01-04, set at pre-compile  # User is provided with this option (For Receive IPDUs configured with Timeout value) to give an desired calibration name instead of Com_ti"PduShortName"RxTout_C name. Calibration name provided here will be generated in Com_Flatmap.arxml file and henceforth will be used to access the calibration value to calibrate the timeout of receive IPDUs. Otherwise, if this parameter is left blank, default calibration name will be generated as Com_ti"PduShortName"RxTout_C. Note: ComRxIpduTimeoutCalibration parameter should be enabled in ComGeneral for the this parameter field to be used. No validation will be checked on the string provided here, calibration name will be generated as it is.
        string ComCalibrationNameForTxModeCyclePeriod [0..1]: multiplicity set at pre-compile, origin=RB:20.0.0:2016-01-04, set at pre-compile  # User is provided with this option (For Transmit IPDUs configured with PERIODIC/MIXED mode) to give an desired calibration name instead of Com_ti"PduShortName"TxPerd_C name. Calibration name provided here will be generated in Com_Flatmap.arxml file and henceforth will be used to access the calibration value to change the peridiocity of transmit IPDUs(configured with PERIODIC/MIXED mode). Otherwise, if this parameter is left blank, default calibration name will be generated as Com_ti"PduShortName"TxPerd_C. Note: ComTxModeCyclePeriodCalibration parameter should be enabled in ComGeneral for the this parameter field to be used. No validation will be checked on the string provided here, calibration name will be generated as it is.
        string ComCalibrationNameForTxPduTimeOffset [0..1]: multiplicity set at pre-compile, origin=RB:1.0.0:2018-01-10, set at pre-compile  # User is provided with this option (For Cyclic Tx IPDUs configured with ComTxModeTimeOffset value) to give a desired calibration name instead of Com_ti"PduShortName"TxTOffset_C name. Calibration name provided here will be generated in Com_Flatmap.arxml file and henceforth will be used to access the calibration value to calibrate the TxTimeOffset of cyclic Tx IPDUs. Otherwise, if this parameter is left blank, default calibration name will be generated as Com_ti"PduShortName"TxTOffset_C. Note: ComTxModeTimeOffsetCalibration parameter should be enabled in ComGeneral for this parameter field to be used. No validation will be checked on the string provided here, calibration name will be generated as it is.
        float ComFirstTimeout [0..1]: 0..3600, multiplicity set at pre-compile, origin=RB:1.0.0:2016-09-29, post-build-variant-multiplicity=true, post-build-variant-value=true, set at pre-compile  # Defines the length of the first deadline monitoring timeout period in seconds. This timeout is used immediately after start (or restart) of the deadline monitoring service. The timeout period of the successive periods is configured by ComTimeout.
        function name ComIPduCallout [0..1]: multiplicity set at pre-compile, set at pre-compile  # This parameter defines the existence and the name of a callout function for the corresponding I-PDU. If this parameter is omitted no I-PDU callout shall take place for the corresponding I-PDU.
        boolean ComIPduCancellationSupport [0..1]: scope=ECU, multiplicity set at pre-compile, post-build-variant-multiplicity=true, post-build-variant-value=true, set at pre-compile, default-value=false  # Defines for I-PDUs with ComIPduType NORMAL: If the underlying IF-modul supports cancellation of transmit requests. | Defines for I-PDUs with ComIPduType TP: If the underlying TP-module supports RX and TX cancellation of ongoing requests.
        enumeration ComIPduDirection: {RECEIVE, SEND}, set at pre-compile  # The direction defines if this I-PDU, and therefore the contributing signals and signal groups, shall be sent or received.
        function name ComIPduErrorNotification [0..1]: multiplicity set at pre-compile, origin=RB:1.0.0:2016-09-29, set at pre-compile  # Name of the callback to provide a Tx/Rx timeout notification on Ipdu level to runtime environment
        integer ComIPduHandleId [0..1]: 0..65535, scope=ECU, multiplicity set at pre-compile, set at pre-compile, symbolic-name-value=true, with-auto=true  # The numerical value used as the ID of this I-PDU. The ComIPduHandleId is required by the API calls Com_RxIndication, Com_TpRxIndication, Com_StartOfReception and Com_CopyRxData to receive I-PDUs from the PduR (ComIPduDirection: Receive), as well as the PduId passed to an Rx-I-PDU-callout. For Tx-I-PDUs (ComIPduDirection: Send), this handle Id is used for the APIs calls Com_TxConfirmation, Com_TriggerTransmit, Com_TriggerIPDUSend or Com_TriggerIPDUSendWithMetaData, Com_CopyTxData and Com_TpTxConfirmation to transmit respectively confirm transmissions of I-PDUs, as well as the PduId passed to the Tx-I-PDU-callout configured with ComIPduCallout and/or ComIPduTriggerTransmitCallout.
        enumeration ComIPduSignalProcessing: {DEFERRED, IMMEDIATE}, post-build-variant-value=true, set at pre-compile  # For the definition of the two modes Immediate and Deferred.
        function name ComIPduTriggerTransmitCallout [0..1]: multiplicity set at pre-compile, set at pre-compile  # If there is a trigger transmit callout defined for this I-PDU this parameter contains the name of the callout function.
        enumeration ComIPduType: {NORMAL, TP}, post-build-variant-value=true, set at pre-compile  # Defines if this I-PDU is a normal I-PDU that can be sent unfragmented or if this is a large I-PDU that shall be sent via the Transport Protocol of the underlying bus.
        function name ComIpduNotificationCallback [0..1]: multiplicity set at pre-compile, origin=RB:1.0.0:2016-09-29, set at pre-compile  # Notification callback function for TX IPDU.This function is called after the transmit confirmation is reeived for the IPdu, from the lower layer.
        float ComTimeout [0..1]: 0..3600, multiplicity set at pre-compile, origin=RB:1.0.0:2016-09-29, post-build-variant-multiplicity=true, post-build-variant-value=true, set at pre-compile  # Defines the length of the deadline monitoring timeout period in seconds. The period for the first timeout period can be configured separately by ComFirstTimeout.
        reference ComIPduGroupRef [0..*]: multiplicity set at pre-compile, post-build-variant-multiplicity=true, post-build-variant-value=true, set at pre-compile, destination=ComIPduGroup  # Reference to the I-PDU groups this I-PDU belongs to.
        reference ComIPduMainFunctionRef [0..1]: origin=RB:4.3.0:2018-03-02, set at pre-compile, destination=ComMainFunction  # Reference to the ComMainFunction. Direction of this ComIPdu and referred ComMainFunction must be same. Based on the direction, if reference is configured, then main-function processing for this ComIPdu will be done in the generated Com_MainFunction(Tx/Rx)_"ComMainFunction-ComMainFunctionSuffix". If this reference is not configured, main-function processing for this ComIPdu will be done in Com_MainFunction(Rx/Tx).
        reference ComIPduSignalGroupRef [0..*]: multiplicity set at pre-compile, post-build-variant-multiplicity=true, post-build-variant-value=true, set at pre-compile, destination=ComSignalGroup  # References to all signal groups contained in this I-Pdu
        reference ComIPduSignalRef [0..*]: multiplicity set at pre-compile, post-build-variant-multiplicity=true, post-build-variant-value=true, set at pre-compile, destination=ComSignal  # References to all signals contained in this I-PDU.
        reference ComPduIdRef: set at pre-compile, destination=Pdu  # Reference to the "global" Pdu structure to allow harmonization of handle IDs in the COM-Stack.
        container ComIPduCounter [0..1]  # This optional container contains the configuration parameters of PDU Counter.
          function name ComIPduCounterErrorNotification [0..1]: multiplicity set at pre-compile, set at pre-compile  # Name of Com_CbkCounterErr callback function to be called. If this | parameter is omitted no I-PDU counter mismatch notification shall take place.
          integer ComIPduCounterSize: 1..8, set at pre-compile  # Size of PDU Counter expressed in bits.
          integer ComIPduCounterStartPosition: 0..4294967295, set at pre-compile  # Position of PDU counter expressed in bits from start position of data content. | of I-PDU (SDU). Note that PDU counter is not allowed to cross a byte border. The parameter ComIPduCounterStartPosition shall define the bit0 of the first byte like in little endian byte order.
          integer ComIPduCounterThreshold [0..1]: 0..255, multiplicity set at pre-compile, set at pre-compile, default-value=0  # Threshold value of I-PDU counter algorithm.
        container ComIPduReplication [0..1]  # This optional container contains the information needed for each I-PDU replicated.
          integer ComIPduReplicationQuorum [0..0]: 1..3, set at pre-compile  # The number of identical I-PDUs needed for successful voting. NOTE:The multiplicity of this paramter is 0..0 and hence cannot be configured, because this feature is not yet supported.
          reference ComIPduReplicaRef [0..0]: scope=ECU, multiplicity set at pre-compile, set at pre-compile, destination=Pdu  # Reference to replicas PduR PDUs of this IPDU. NOTE:The multiplicity of this paramter is 0..0 and hence cannot be configured, because this feature is not yet supported.
        container ComTxIPdu [0..1]  # This container contains additional transmission related configuration parameters of the AUTOSAR COM module's I-PDUs.
          string ComMetaDataDefault [0..1]: multiplicity set at pre-compile, set at pre-compile  # In case an I-PDU has a globally configured MetaDataLength distinct from 0 and no explicit meta data is given for a send request (e.g. by using Com_TriggerIPDUSendWithMetaData ), The AUTOSAR COM module uses this configured default meta data for sending. | The configured string shall be interpreted as a decimal representation of the characters separated by blanks, e.g. "97 98 100" means a string "abd", where the char "a" is in byte 0(lowest address), "b" is in byte 1, and "d" is in byte 2 and (highest address).
          float ComMinimumDelayTime [0..1]: 0..3600, multiplicity set at pre-compile, origin=AUTOSAR_ECUC V3.0, post-build-variant-multiplicity=true, post-build-variant-value=true, set at pre-compile  # Defines the Minimum Delay Time (MDT) between successive transmissions of this I-PDU in seconds. The MDT is independent of the possible different transmission modes. There is only one minimum delay time parameter for one I-PDU. The minimum delay timer is not reset by changing the transmission mode. Hence, it is not allowed to violate the minimum delay time by transmission mode changes. It is not possible to monitor the minimum delay time for I-PDUs that are requested using the Com_TriggerTransmit API.
          enumeration ComTxIPduClearUpdateBit [0..1]: {Confirmation, Transmit, TriggerTransmit}, multiplicity set at pre-compile, post-build-variant-multiplicity=true, post-build-variant-value=true, set at pre-compile  # Defines when the update-bits of signals or signal groups, contained in this I-PDU, will be cleared.
          integer ComTxIPduUnusedAreasDefault: 0..255, set at pre-compile  # The AUTOSAR COM module fills not used areas of an I-PDU with this byte pattern. This attribute is mandatory to avoid undefined behaviour. This byte-pattern will be repeated throughout the I-PDU before any init-values or update-bits were set.
          container ComTxModeFalse [0..1]  # This container contains the configuration parameters of the AUTOSAR COM module's transmission modes in the case the ComFilter evaluates to false.
            container ComTxMode  # This container contains the configuration parameters of the AUTOSAR COM module's transmission modes.
              enumeration ComTxModeMode: {DIRECT, MIXED, NONE, PERIODIC, MIXED_PHASE_SHIFT}, post-build-variant-value=true, set at pre-compile  # The available transmission modes are Mixed, Periodic, Direct, None. | The transmission mode None shall not have any further sub-attributes in the ComTxMode object.
              integer ComTxModeNumberOfRepetitions [0..1]: 0..255, multiplicity set at pre-compile, post-build-variant-multiplicity=true, post-build-variant-value=true, set at pre-compile  # Defines the number of repetitions for the transmission mode DIRECT and the event driven part of transmission mode MIXED.
              float ComTxModeRepetitionPeriod [0..1]: 0..3600, multiplicity set at pre-compile, post-build-variant-multiplicity=true, post-build-variant-value=true, set at pre-compile  # Defines the repetition period in seconds of the multiple transmissions in case ComTxModeNumberOfRepetitions is configured greater than or equal to 1 and ComTxModeMode is configured to DIRECT or MIXED. In case of the mixed transmission mode only the event driven part is affected.
              float ComTxModeTimeOffset [0..1]: 0..3600, multiplicity set at pre-compile, post-build-variant-multiplicity=true, post-build-variant-value=true, set at pre-compile  # Defines the period in seconds between the start of the I-PDU by Com_IpduGroupControl and the first transmission request in case ComTxModeMode is configured to PERIODIC or MIXED. In case of the mixed transmission mode only the periodic part is affected. | In case ComTxModeTimeOffset is omitted or configured to 0, the first periodic transmission shall be transmitted within the next invocation of Com_MainFunctionTx.
              float ComTxModeTimePeriod [0..1]: 0..3600, multiplicity set at pre-compile, post-build-variant-multiplicity=true, post-build-variant-value=true, set at pre-compile  # Defines the repetition period in seconds of the periodic transmission requests in case ComTxModeMode is configured to PERIODIC or MIXED. In case of the mixed transmission mode only the periodic part is affected.
          container ComTxModeTrue [0..1]  # This container contains the configuration parameters of the AUTOSAR COM module's transmission modes in the case the ComFilter evaluates to true.
            container ComTxMode  # This container contains the configuration parameters of the AUTOSAR COM module's transmission modes.
              enumeration ComTxModeMode: {DIRECT, MIXED, NONE, PERIODIC, MIXED_PHASE_SHIFT}, post-build-variant-value=true, set at pre-compile  # The available transmission modes are Mixed, Periodic, Direct, None | The transmission mode None shall not have any further sub-attributes in the ComTxMode object.
              integer ComTxModeNumberOfRepetitions [0..1]: 0..255, multiplicity set at pre-compile, post-build-variant-multiplicity=true, post-build-variant-value=true, set at pre-compile  # Defines the number of repetitions for the transmission mode DIRECT and the event driven part of transmission mode MIXED.
              float ComTxModeRepetitionPeriod [0..1]: 0..3600, multiplicity set at pre-compile, post-build-variant-multiplicity=true, post-build-variant-value=true, set at pre-compile  # Defines the repetition period in seconds of the multiple transmissions in case ComTxModeNumberOfRepetitions is configured greater than or equal to 1 and ComTxModeMode is configured to DIRECT or MIXED. In case of the mixed transmission mode only the event driven part is affected.
              float ComTxModeTimeOffset [0..1]: 0..3600, multiplicity set at pre-compile, post-build-variant-multiplicity=true, post-build-variant-value=true, set at pre-compile  # Defines the period in seconds between the start of the I-PDU by Com_IpduGroupControl and the first transmission request in case ComTxModeMode is configured to PERIODIC or MIXED. In case of the mixed transmission mode only the periodic part is affected. | In case ComTxModeTimeOffset is omitted or configured to 0, the first periodic transmission shall be transmitted within the next invocation of Com_MainFunctionTx.
              float ComTxModeTimePeriod [0..1]: 0..3600, multiplicity set at pre-compile, post-build-variant-multiplicity=true, post-build-variant-value=true, set at pre-compile  # Defines the repetition period in seconds of the periodic transmission requests in case ComTxModeMode is configured to PERIODIC or MIXED. In case of the mixed transmission mode only the periodic part is affected.
      container ComIPduGroup [0..*]: multiplicity set at pre-compile, post-build-variant-multiplicity=true  # Contains the configuration parameters of the AUTOSAR COM module's I-PDU groups.
        integer ComIPduGroupHandleId: 0..65535, scope=ECU, set at pre-compile, symbolic-name-value=true, with-auto=true  # The numerical value used as the ID of this I-PDU Group . | The ComIPduGroupHandleId is required by the API calls to start and stop I-PDU Groups. Range: 0 .. (ComSupportedIPduGroups-1)
        reference ComIPduGroupGroupRef [0..*]: multiplicity set at pre-compile, post-build-variant-multiplicity=true, post-build-variant-value=true, set at pre-compile, destination=ComIPduGroup  # References to all I-PDU groups that includes this I-PDU group. If this reference is omitted this I-PDU group does not belong to another I-PDU group.
      container ComSignal [0..*]: multiplicity set at pre-compile, post-build-variant-multiplicity=true  # Contains the configuration parameters of the AUTOSAR COM module's signals.
        integer ComBitPosition: 0..4294967295, post-build-variant-value=true, set at pre-compile  # Starting position within the I-PDU. This parameter refers to the position in the I-PDU and not in the shadow buffer. If the endianness conversion is configured to Opaque the parameter ComBitPosition shall define the bit0 of the first byte like in little endian byte order.
        integer ComBitSize [0..1]: 0..64, multiplicity set at pre-compile, post-build-variant-value=true, set at pre-compile  # Size in bits, for integer signal types. For ComSignalType UINT8_N and UINT8_DYN | the size shall be configured by ComSignalLength. For ComSignalTypes FLOAT32 and FLOAT64 the size is already defined by the signal type and therefore may be omitted.
        enumeration ComDataInvalidAction [0..1]: {NOTIFY, REPLACE}, multiplicity set at pre-compile, set at pre-compile  # This parameter defines the action performed upon reception of an invalid signal. | Relating to signal groups the action in case if one of the included signals is an invalid signal. If Replace is used the ComSignalInitValue will be used for the replacement.
        function name ComErrorNotification [0..1]: multiplicity set at pre-compile, set at pre-compile  # Only valid on sender side: Name of Com_CbkTxErr callback function to be called. | If this parameter is omitted no error notification shall take place.
        float ComFirstTimeout [0..1]: 0..3600, multiplicity set at pre-compile, post-build-variant-multiplicity=true, post-build-variant-value=true, set at pre-compile  # Defines the length of the first deadline monitoring timeout period in seconds. This timeout is used immediately after start (or restart) of the deadline monitoring service. The timeout period of the successive periods is configured by ComTimeout.
        integer ComHandleId [0..1]: 0..65535, scope=ECU, multiplicity set at pre-compile, set at pre-compile, symbolic-name-value=true, with-auto=true  # The numerical value used as the ID. | For signals it is required by the API calls Com_UpdateShadowSignal, Com_ReceiveShadowSignal and Com_InvalidateShadowSignal. For signals groups it is required by the Com_SendSignalGroup and Com_ReceiveSignalGroup calls.
        boolean ComInitialValueOnly [0..1]: multiplicity set at pre-compile, set at pre-compile, default-value=false  # This parameter defines that the respective signal's initial value shall be put into the respective PDU but there will not be any update of the value through the RTE. Thus the Com implementation does not need to expect any API calls for this signal (group).
        function name ComInvalidNotification [0..1]: multiplicity set at pre-compile, set at pre-compile  # Only valid on receiver side: Name of Com_CbkInv callback function to be called. Name of the function which notifies the RTE about the reception of an invalidated signal/ signal group. Only applicable if ComDataInvalidAction is configured to NOTIFY.
        function name ComNotification [0..1]: multiplicity set at pre-compile, set at pre-compile  # On sender side: Name of Com_CbkTxAck callback function to be called. | On receiver side: Name of Com_CbkRxAck callback function to be called. If this parameter is omitted no notification shall take place.
        enumeration ComRxDataTimeoutAction [0..1]: {NONE, REPLACE}, multiplicity set at pre-compile, set at pre-compile  # This parameter defines the action performed upon expiration of the reception deadline monitoring timer.
        float ComSignalDataInvalidValue [0..1]: -2147483649..4294967295, multiplicity set at pre-compile, set at pre-compile, default-value=-2147483649.0  # Defines the data invalid value of the signal.
        enumeration ComSignalEndianness: {BIG_ENDIAN, LITTLE_ENDIAN, OPAQUE}, post-build-variant-value=true, set at pre-compile  # Defines the endianness of the signal's network representation.
        float ComSignalInitValue [0..1]: multiplicity set at pre-compile, post-build-variant-multiplicity=true, post-build-variant-value=true, set at pre-compile, default-value=-2147483649  # Initial value for this signal. The default value is 0.
        integer ComSignalLength [0..1]: 0..4294967295, multiplicity set at pre-compile, set at pre-compile  # Description: | For ComSignalType UINT8_N this parameter specifies the length n in bytes. For ComSignalType UINT8_DYN it specifies the maximum length in bytes. For all other types this parameter shall be ignored. Range: 0..8 for normal CAN/ LIN I-PDUs, 0..64 for CAN FD I-PDUs, 0..254 for normal FlexRay I-PDUs (all of ComIPduType NORMAL), 0..4294967295 for I-PDUs with ComIPduType TP.
        enumeration ComSignalType: {BOOLEAN, FLOAT32, FLOAT64, SINT16, SINT32, SINT64, SINT8, UINT16, UINT32, UINT64, UINT8, UINT8_DYN, UINT8_N}, set at pre-compile  # The AUTOSAR type of the signal. Whether or not the signal is signed or unsigned can be found by examining the value of this attribute. | This type could also be used to reserved appropriate storage in AUTOSAR COM.
        float ComTimeout [0..1]: 0..3600, multiplicity set at pre-compile, post-build-variant-multiplicity=true, post-build-variant-value=true, set at pre-compile  # Defines the length of the deadline monitoring timeout period in seconds. The period for the first timeout period can be configured separately by ComFirstTimeout.
        function name ComTimeoutNotification [0..1]: multiplicity set at pre-compile, set at pre-compile  # On sender side: Name of Com_CbkTxTOut callback function to be called. | On receiver side: Name of Com_CbkRxTOut callback function to be called.
        enumeration ComTransferProperty [0..1]: {PENDING, TRIGGERED, TRIGGERED_ON_CHANGE, TRIGGERED_ON_CHANGE_WITHOUT_REPETITION, TRIGGERED_WITHOUT_REPETITION}, multiplicity set at pre-compile, post-build-variant-multiplicity=true, post-build-variant-value=true, set at pre-compile  # Defines if a write access to this signal can trigger the transmission of the corresponding I-PDU. If the I-PDU is triggered, depends also on the transmission mode of the corresponding I-PDU.
        integer ComUpdateBitPosition [0..1]: -1..4294967295, multiplicity set at pre-compile, post-build-variant-multiplicity=true, post-build-variant-value=true, set at pre-compile, default-value=-1  # Bit position of update-bit inside I-PDU. | If this attribute is omitted then there is no update-bit. This setting must be consistently on sender and on receiver side. Range: 0..63 for CAN and LIN, 0..511 for CAN FD, 0..2031 for FlexRay, 0..4294967295 for TP. Default value of -1 implies that this parameter is not configured.
        foreign reference ComSystemTemplateSystemSignalRef [0..1]: scope=ECU, multiplicity set at pre-compile, post-build-variant-multiplicity=true, post-build-variant-value=true, set at pre-compile, destination-type=I-SIGNAL-TO-I-PDU-MAPPING  # Reference to the ISignalToIPduMapping that contains a reference to the ISignal (System Template) which this ComSignal (or ComGroupSignal) represents.
        container ComFilter [0..1]  # This container contains the configuration parameters of the AUTOSAR COM module's Filters. | Note: On sender side the container is used to specify the transmission mode conditions.
          enumeration ComFilterAlgorithm: {ALWAYS, MASKED_NEW_DIFFERS_MASKED_OLD, MASKED_NEW_DIFFERS_X, MASKED_NEW_EQUALS_X, NEVER, NEW_IS_OUTSIDE, NEW_IS_WITHIN, ONE_EVERY_N}, set at pre-compile  # This attribute is used for Tx/Rx Filtering. Please configure this attribute to select a filter algorithm for ComSignal/ComGroupSignal.
          integer ComFilterMask [0..1]: -2147483649..4294967295, multiplicity set at pre-compile, set at pre-compile, default-value=-2147483649  # This attribute is used for Tx/Rx Filtering. Please configure this attribute for ComFilterAlgorithms like MASKED_NEW_EQUALS_X, MASKED_NEW_DIFFERS_X and MASKED_NEW_DIFFERS_MASKED_OLD. Default value of -2147483649 implies that this parameter is not configured.
          integer ComFilterMax [0..1]: -2147483649..4294967295, multiplicity set at pre-compile, set at pre-compile, default-value=-2147483649  # This attribute is used for Tx/Rx Filtering. Please configure this attribute for ComFilterAlgorithm's like NEW_IS_WITHIN and NEW_IS_OUTSIDE. Default value of -2147483649 implies that this parameter is not configured.
          integer ComFilterMin [0..1]: -2147483649..4294967295, multiplicity set at pre-compile, set at pre-compile, default-value=-2147483649  # This attribute is used for Tx/Rx Filtering. Please configure this attribute for ComFilterAlgorithm's like NEW_IS_WITHIN and NEW_IS_OUTSIDE. Default value of -2147483649 implies that this parameter is not configured.
          integer ComFilterOffset [0..1]: -1..4294967294, multiplicity set at pre-compile, set at pre-compile, default-value=-1  # This attribute is used for Tx/Rx Filtering. Please configure this attribute for ComFilterAlgorithm ONE_EVERY_N. | Range = 0..(ComFilterPeriod-1). Default value of -1 implies that this parameter is not configured.
          integer ComFilterPeriod [0..1]: 1..4294967295, multiplicity set at pre-compile, post-build-variant-value=true, set at pre-compile, default-value=1  # This parameter defines the period of the ComFilterAlgorithm ONE_EVERY_N. Default value of +1 implies that this parameter is not configured.
          integer ComFilterX [0..1]: -2147483649..4294967295, multiplicity set at pre-compile, set at pre-compile, default-value=-2147483649  # This attribute is used for Tx/Rx Filtering. Please configure this attribute for ComFilterAlgorithm's like MASKED_NEW_EQUALS_X and MASKED_NEW_DIFFERS_X. Default value of -2147483649 implies that this parameter is not configured.
      container ComSignalGroup [0..*]: multiplicity set at pre-compile, post-build-variant-multiplicity=true  # Contains the configuration parameters of the AUTOSAR COM module's signal groups.
        enumeration ComDataInvalidAction [0..1]: {NOTIFY, REPLACE}, multiplicity set at pre-compile, set at pre-compile  # This parameter defines the action performed upon reception of an invalid signal. | Relating to signal groups the action in case if one of the included signals is an invalid signal. If Replace is used the ComSignalInitValue will be used for the replacement.
        function name ComErrorNotification [0..1]: multiplicity set at pre-compile, set at pre-compile  # Only valid on sender side: Name of Com_CbkTxErr callback function to be called. | If this parameter is omitted no error notification shall take place.
        float ComFirstTimeout [0..1]: 0..3600, multiplicity set at pre-compile, post-build-variant-multiplicity=true, post-build-variant-value=true, set at pre-compile  # Defines the length of the first deadline monitoring timeout period in seconds. This timeout is used immediately after start (or restart) of the deadline monitoring service. The timeout period of the successive periods is configured by ComTimeout.
        integer ComHandleId [0..1]: 0..65535, scope=ECU, multiplicity set at pre-compile, set at pre-compile, symbolic-name-value=true, with-auto=true  # The numerical value used as the ID. | For signals it is required by the API calls Com_UpdateShadowSignal, Com_ReceiveShadowSignal and Com_InvalidateShadowSignal. For signals groups it is required by the Com_SendSignalGroup and Com_ReceiveSignalGroup calls.
        boolean ComInitialValueOnly [0..1]: multiplicity set at pre-compile, set at pre-compile, default-value=false  # This parameter defines that the respective signal's initial value shall be put into the respective PDU but there will not be any update of the value through the RTE. Thus the Com implementation does not need to expect any API calls for this signal (group).
        function name ComInvalidNotification [0..1]: multiplicity set at pre-compile, set at pre-compile  # Only valid on receiver side: Name of Com_CbkInv callback function to be called. Name of the function which notifies the RTE about the reception of an invalidated signal/ signal group. Only applicable if ComDataInvalidAction is configured to NOTIFY.
        function name ComNotification [0..1]: multiplicity set at pre-compile, set at pre-compile  # On sender side: Name of Com_CbkTxAck callback function to be called. | On receiver side: Name of Com_CbkRxAck callback function to be called. If this parameter is omitted no notification shall take place.
        enumeration ComRxDataTimeoutAction [0..1]: {NONE, REPLACE}, multiplicity set at pre-compile, set at pre-compile  # This parameter defines the action performed upon expiration of the reception deadline monitoring timer.
        boolean ComSignalGroupArrayAccess [0..1]: multiplicity set at pre-compile, set at pre-compile  # Defines whether the uint8-array based access shall be used for this ComSignalGroup.
        float ComTimeout [0..1]: 0..3600, multiplicity set at pre-compile, post-build-variant-multiplicity=true, post-build-variant-value=true, set at pre-compile  # Defines the length of the deadline monitoring timeout period in seconds. The period for the first timeout period can be configured separately by ComFirstTimeout.
        function name ComTimeoutNotification [0..1]: multiplicity set at pre-compile, set at pre-compile  # On sender side: Name of Com_CbkTxTOut callback function to be called. | On receiver side: Name of Com_CbkRxTOut callback function to be called.
        enumeration ComTransferProperty [0..1]: {PENDING, TRIGGERED, TRIGGERED_ON_CHANGE, TRIGGERED_ON_CHANGE_WITHOUT_REPETITION, TRIGGERED_WITHOUT_REPETITION}, multiplicity set at pre-compile, post-build-variant-multiplicity=true, post-build-variant-value=true, set at pre-compile  # Defines if a write access to this signal can trigger the transmission of the corresponding I-PDU. If the I-PDU is triggered, depends also on the transmission mode of the corresponding I-PDU.
        integer ComUpdateBitPosition [0..1]: -1..4294967295, multiplicity set at pre-compile, post-build-variant-multiplicity=true, post-build-variant-value=true, set at pre-compile, default-value=-1  # Bit position of update-bit inside I-PDU. | If this attribute is omitted then there is no update-bit. This setting must be consistently on sender and on receiver side. Range: 0..63 for CAN and LIN, 0..511 for CAN FD, 0..2031 for FlexRay, 0..4294967295 for TP. Default value of -1 implies that this parameter is not configured.
        foreign reference ComSystemTemplateSignalGroupRef [0..1]: scope=ECU, multiplicity set at pre-compile, post-build-variant-multiplicity=true, post-build-variant-value=true, set at pre-compile, destination-type=I-SIGNAL-TO-I-PDU-MAPPING  # Reference to the ISignalToIPduMapping that contains a reference to the ISignalGroup (SystemTemplate) which this ComSignalGroup represents.
        container ComGroupSignal [0..*]: multiplicity set at pre-compile, post-build-variant-multiplicity=true  # This container contains the configuration parameters of group signals. I.e. signals that are included within a signal group.
          integer ComBitPosition: 0..4294967295, post-build-variant-value=true, set at pre-compile  # Starting position within the I-PDU. This parameter refers to the position in the I-PDU and not in the shadow buffer. If the endianness conversion is configured to Opaque the parameter ComBitPosition shall define the bit0 of the first byte like in little endian byte order
          integer ComBitSize [0..1]: 0..64, multiplicity set at pre-compile, post-build-variant-value=true, set at pre-compile  # Size in bits, for integer signal types. For ComSignalType UINT8_N and UINT8_DYN | the size shall be configured by ComSignalLength. For ComSignalTypes FLOAT32 and FLOAT64 the size is already defined by the signal type and therefore may be omitted.
          integer ComHandleId [0..1]: 0..65535, scope=ECU, multiplicity set at pre-compile, set at pre-compile, symbolic-name-value=true, with-auto=true  # The numerical value used as the ID. | For signals it is required by the API calls Com_UpdateShadowSignal, Com_ReceiveShadowSignal and Com_InvalidateShadowSignal. For signals groups it is required by the Com_SendSignalGroup and Com_ReceiveSignalGroup calls.
          float ComSignalDataInvalidValue [0..1]: -2147483649..4294967295, multiplicity set at pre-compile, set at pre-compile, default-value=-2147483649.0  # Defines the data invalid value of the signal.
          enumeration ComSignalEndianness: {BIG_ENDIAN, LITTLE_ENDIAN, OPAQUE}, post-build-variant-value=true, set at pre-compile  # Defines the endianness of the signal's network representation.
          float ComSignalInitValue [0..1]: multiplicity set at pre-compile, post-build-variant-multiplicity=true, post-build-variant-value=true, set at pre-compile, default-value=-2147483649  # Initial value for this signal. The default value is 0.
          integer ComSignalLength [0..1]: 0..4294967295, multiplicity set at pre-compile, set at pre-compile  # Description: | For ComSignalType UINT8_N this parameter specifies the length n in bytes. For ComSignalType UINT8_DYN it specifies the maximum length in bytes. For all other types this parameter shall be ignored. Range: 0..8 for normal CAN/ LIN I-PDUs, 0..64 for CAN FD I-PDUs, 0..254 for normal FlexRay I-PDUs (all of ComIPduType NORMAL), 0..4294967295 for I-PDUs with ComIPduType TP.
          enumeration ComSignalType: {BOOLEAN, FLOAT32, FLOAT64, SINT16, SINT32, SINT64, SINT8, UINT16, UINT32, UINT64, UINT8, UINT8_DYN, UINT8_N}, set at pre-compile  # The AUTOSAR type of the signal. Whether or not the signal is signed or unsigned can be found by examining the value of this attribute. | This type could also be used to reserved appropriate storage in AUTOSAR COM.
          enumeration ComTransferProperty [0..1]: {PENDING, TRIGGERED_ON_CHANGE}, multiplicity set at pre-compile, post-build-variant-multiplicity=true, post-build-variant-value=true, set at pre-compile  # Optionally defines whether this group signal shall contribute to the TRIGGERED_ON_CHANGE transfer property of the signal group. If at least one group signal of a signal group has the "ComTransferProperty" configured all other group signals of that signal group shall have the attribute configured as well.
          foreign reference ComSystemTemplateSystemSignalRef [0..1]: scope=ECU, multiplicity set at pre-compile, post-build-variant-multiplicity=true, post-build-variant-value=true, set at pre-compile, destination-type=I-SIGNAL-TO-I-PDU-MAPPING  # Reference to the ISignalToIPduMapping that contains a reference to the ISignal (System Template) which this ComSignal (or ComGroupSignal) represents.
          container ComFilter [0..1]  # This container contains the configuration parameters of the AUTOSAR COM module's Filters. | Note: On sender side the container is used to specify the transmission mode conditions.
            enumeration ComFilterAlgorithm: {ALWAYS, MASKED_NEW_DIFFERS_MASKED_OLD, MASKED_NEW_DIFFERS_X, MASKED_NEW_EQUALS_X, NEVER, NEW_IS_OUTSIDE, NEW_IS_WITHIN, ONE_EVERY_N}, set at pre-compile  # This attribute is used for Tx/Rx Filtering. Please configure this attribute to select a filter algorithm for ComSignal/ComGroupSignal.
            integer ComFilterMask [0..1]: -2147483649..4294967295, multiplicity set at pre-compile, set at pre-compile, default-value=-2147483649  # This attribute is used for Tx/Rx Filtering. Please configure this attribute for ComFilterAlgorithm's like MASKED_NEW_EQUALS_X, MASKED_NEW_DIFFERS_X and MASKED_NEW_DIFFERS_MASKED_OLD. Default value of -2147483649 implies that this parameter is not configured.
            integer ComFilterMax [0..1]: -2147483649..4294967295, multiplicity set at pre-compile, set at pre-compile, default-value=-2147483649  # This attribute is used for Tx/Rx Filtering. Please configure this attribute for ComFilterAlgorithm's like NEW_IS_WITHIN and NEW_IS_OUTSIDE. Default value of -2147483649 implies that this parameter is not configured.
            integer ComFilterMin [0..1]: -2147483649..4294967295, multiplicity set at pre-compile, set at pre-compile, default-value=-2147483649  # This attribute is used for Tx/Rx Filtering. Please configure this attribute for ComFilterAlgorithm's like NEW_IS_WITHIN and NEW_IS_OUTSIDE. Default value of -2147483649 implies that this parameter is not configured.
            integer ComFilterOffset [0..1]: -1..4294967294, multiplicity set at pre-compile, set at pre-compile, default-value=-1  # This attribute is used for Tx/Rx Filtering. Please configure this attribute for ComFilterAlgorithm ONE_EVERY_N. | Range = 0..(ComFilterPeriod-1). Default value of -1 implies that this parameter is not configured.
            integer ComFilterPeriod [0..1]: 1..4294967295, multiplicity set at pre-compile, post-build-variant-value=true, set at pre-compile, default-value=1  # This parameter defines the period of the ComFilterAlgorithm ONE_EVERY_N. Default value of +1 implies that this parameter is not configured.
            integer ComFilterX [0..1]: -2147483648..4294967295, multiplicity set at pre-compile, set at pre-compile  # This attribute is used for Tx/Rx Filtering. Please configure this attribute for ComFilterAlgorithm's like MASKED_NEW_EQUALS_X and MASKED_NEW_DIFFERS_X. Default value of -2147483649 implies that this parameter is not configured.
      container ComTimeBase  # Contains the timebase parameters for Tx, Rx and routing.
        float ComGwTimeBase [0..1]: 0..3600, scope=ECU, multiplicity set at pre-compile, set at pre-compile  # The period between successive calls to Com_MainFunctionRouteSignals in seconds. This parameter may be used by the COM generator to transform the values of the signal gateway related timing configuration parameters of the COM module to internal implementation specific counter or tick values. The COM module's internal timing handling is implementation specific. | The COM module (generator) might rely on the fact that Com_MainFunctionRouteSignals is scheduled according to the value configured here.
        float ComRxTimeBase [0..1]: 0..3600, scope=ECU, multiplicity set at pre-compile, set at pre-compile  # The period between successive calls to Com_MainFunctionRx in seconds. This parameter may be used by the COM generator to transform the values of the reception related timing configuration parameters of the COM module to internal implementation specific counter or tick values. The COM module's internal timing handling is implementation specific. | The COM module (generator) may rely on the fact that Com_MainFunctionRx is scheduled according to the value configured here.
        float ComTxTimeBase [0..1]: 0..3600, scope=ECU, multiplicity set at pre-compile, set at pre-compile  # The period between successive calls to Com_MainFunctionTx in seconds. This parameter may be used by the COM generator to transform the values of the transmission related timing configuration parameters of the COM module to internal implementation specific counter or tick values. The COM module's internal timing handling is implementation specific. | The COM module (generator) may rely on the fact that Com_MainFunctionTx is scheduled according to the value configured here.
        container ComMainFunction [0..*]  # Generates multiple Com_MainFunction's to process the referred ComIPdu's.
          enumeration ComMainFunctionDirection: {RECEIVE, SEND}, origin=RB:4.3.0:2018-03-02, set at pre-compile  # Direction of ComMainFunction. Direction of this ComMainFunction and the referred ComIPdu direction shall be same.
          string ComMainFunctionSuffix: origin=RB:4.3.0:2018-03-21, set at pre-compile  # This parameter shall be used as suffix to generate MainFunction name. For example, if "Core1_10ms" is configured here, then a separate mainFunction is generated as Com_MainFunctionRx_Core1_10ms() or as Com_MainFunctionTx_Core1_10ms() for Rx- or Tx-MainFunction respectively.
          float ComMainFunctionTimeBase [0..1]: 0..3600, scope=ECU, multiplicity set at pre-compile, origin=RB:4.3.0:2018-03-02, set at pre-compile  # The period between successive calls to Com_MainFunctionRx_"ComMainFunctionSuffix" or Com_MainFunctionTx_"ComMainFunctionSuffix" in seconds for Rx- or Tx-ComMainFunction respectively. This parameter may be used by the COM generator to transform the values of the reception related timing configuration parameters of the COM module to internal implementation specific counter or tick values. The COM module's internal timing handling is implementation specific. Note: If this parameter is unconfigured, ComRxTimeBase or ComTxTimeBase value shall be used.
          reference ComMainPartitionRef [0..1]: origin=RB:8.4.0:2020-03-31, set at pre-compile, destination=EcucPartition  # Reference to EcucPartition, where the according Com_MainFunction instance is assigned to.
    container ComGeneral  # Contains the general configuration parameters of the module.
      boolean ComCancellationSupport [0..1]: multiplicity set at pre-compile, set at pre-compile, default-value=true  # This parameter enables/disables the cancellation feature: | true: enabled false: disabled. Note: This parameter default value is true, if ComCancellationSupport feature is not required then user has to explicitly disable this parameter.
      boolean ComCommonIPduTxPeriodFeature: origin=RB:1.0.0:2016-09-29, set at pre-compile  # Feature to reduce busload during flashing of other ECUs.This can be activated by calling function Com_ReduceBusload(CycleTime), CycleTime represents new cycle time in ticks(multiples of ComTxTimeBase).If this functionality is activated by calling function Com_ReduceBusload(), period of all TX IPDUs (periodic mode IPDUs and periodic part of mixed mode IPDUs) will be changed to new period
      boolean ComConfigurationUseDet [0..1]: multiplicity set at pre-compile, set at pre-compile  # The error hook shall contain code to call the Det. | If this parameter is configured COM_DEV_ERROR_DETECT shall be set to ON as output of the configuration tool. (as input for the source code).
      boolean ComEnablePeriodicFramesSync [0..1]: multiplicity set at pre-compile, origin=RB:9.0.0:2020-06-18, set at pre-compile, default-value=false  # If enabled, Com support the periodic ComTxIPdu frames synchronization. If disabled, Com will not support periodic ComTxIPdu frames synchronization.
      boolean ComEnableBufferForSignalProcessingImmediate [0..1]: multiplicity set at pre-compile, origin=RB:2019-09-06, set at pre-compile, default-value=false  # If enabled, local buffer will be allocated to store the received I-PDU for ComIPduSignalProcessing configured as IMMEDIATE. If disabled, local buffer will not be allocated to store the received I-PDU for ComIPduSignalProcessing configured as IMMEDIATE.
      boolean ComEnableJitterFilter: origin=RB:1.0.0:2016-09-29, set at pre-compile  # If ComEnableJitterFilter is enabled, then ComRxTimeBase is added with the configured time out for the Rx IPDU, after the IPDU is received successfully. The feature is valid in the reception deadline monitoring for the signals and signal groups with update bit and also for the Rx IPDU
      boolean ComEnableMDTForCyclicTransmission [0..1]: multiplicity set at pre-compile, set at pre-compile, default-value=true  # Enables globally for the whole Com module the minimum delay time monitoring for cyclic and repeated transmissions (ComTxModeMode=PERIODIC or ComTxModeMode=MIXED for the cyclic transmissions, ComTxModeNumberOfRepetitions > 0 for repeated transmissions).
      boolean ComEnablePduBasedLocks [0..1]: multiplicity set at pre-compile, origin=RB:2019-03-29, set at pre-compile, default-value=false  # If enabled, Pdu based locks shall be enabled in below API's Com_MainFunctionRouteSignals, Com_InternalMainFunctionRx, Com_RxIndication, Com_Prv_SendIpdu which avoid multiple short locks. Purpose: To optimise runtime consumption by many short locks. If disabled, existing locks shall still be present in the code which can be further enabled/disabled through Com_Cfg_SchM.h_tpl file
      boolean ComEnableSignalGroupArrayApi: set at pre-compile, default-value=false  # Activate/Deactivate the signal group array access APIs (Com_SendSignalGroupArray, Com_ReceiveSignalGroupArray) | true: signal group array access APIs activated false: signal group array access APIs deactivated
      boolean ComInitvalOptimization [0..1]: multiplicity set at pre-compile, origin=RB:9.4.0:2020-08-04, set at pre-compile, default-value=false  # If set to TRUE the optimization of the InitialValues of ComSignals and ComGroupSignals will be enabled.
      boolean ComInvalidationForDiscardedTpRxIpdus [0..1]: multiplicity set at pre-compile, origin=RB:8.4.0:2020-03-23, set at pre-compile, default-value=true  # Configurable(Backward compatible) switch to select whether the AUTOSAR COM module shall treat all signals of the received large I-PDU exactly like invalidated signals, whenever it is incorrectly received due to any of below scenarios: In case Com_TpRxIndication is called with value E_NOT_OK for the parameter result, When the I-PDU callout in context of Com_TpRxIndication returns false, When the large data(I-PDU) ComIPduCounter mismatch occurs.
      boolean ComIPduControlViaCalibration [0..1]: multiplicity set at pre-compile, origin=RB:2011-07-18, set at pre-compile, default-value=false  # If switch is enabled, a calibration variable is generated for each IPdu, with the help of which, it is possible to control operation of that IPdu. If the value of the calibration varaible is configured to 0, then the IPdu is disabled from communication activity( transmission / reception ). In case the value of the calibration varaible for an Ipdu is configured greater than 0 OR if ComIPduControlViaCalibration swicth is disabled, then the software behaves normally and a call to Com_IPduGroupControl will result in normal operation of the API.
      boolean ComIPduControlViaRbaNdsEcuVariant [0..1]: multiplicity set at pre-compile, origin=RB:2017-05-24, set at pre-compile, default-value=false  # If switch is enabled, a vector is generated for all Tx and Rx IPdu's, with the help of which, it is possible to control operation of any IPdu. If the bit for the corresponding Ipdu is 0, then the IPdu is disabled from communication activity( transmission / reception ). In case the bit is set to 1 for an Ipdu or if ComIPduControlViaRbaNdsEcuVariant switch is disabled, then the software behaves normally and a call to Com_IPduGroupControl will result in normal operation of the API.
      boolean ComMetaDataSupport [0..1]: multiplicity set at pre-compile, set at pre-compile, default-value=false  # This parameter enables/disables the support of meta-data feature including the API Com_TriggerIPDUSendWithMetaData. | true: enabled false: disabled
      boolean ComMultiCoreSwitch [0..1]: multiplicity set at pre-compile, origin=RB:2013-12-10, set at pre-compile, default-value=false  # If enabled, then some multicore related locks will be activated
      boolean ComProvideIpduStatusAPI [0..1]: multiplicity set at pre-compile, origin=RB:2011-07-18, set at pre-compile, default-value=false  # If enabled, it is possible to check the IPdu status with APIs, each for Tx and Rx Ipdus COM_ProvideRxIpduStatus : Returns boolean value of the Rx Ipdu started/Stopped status; Started :True, Stopped :False COM_ProvideTxIpduStatus : Returns boolean value of the Tx Ipdu started/Stopped status; Started :True, Stopped :False The parameter for each of this API is Rx/Tx Ipdu handle Id repectively
      boolean ComRTESpecificSymbolicNames [0..1]: multiplicity set at pre-compile, origin=RB:2013-10-18, set at pre-compile, default-value=false  # If enabled, RTE specific symbolic names will be generated for Com Signals, SignalGroups and GroupSignals along with AUTOSAR specific symbolic names otherwise only AUTOSAR specific symbolic names will be generated
      boolean ComReadRxIPduLength [0..1]: multiplicity set at pre-compile, origin=RB:1.0.0:2016-09-29, set at pre-compile, default-value=false  # If enabled then it is possible to read the length of the received IPdu by a call to the API Com_ReadRxIPduLength The API returns COM_SERVICE_NOT_AVAILABLE in case the ComRxPduId is not in range or the corresponding IPdu Group is not started and updates the RxIPdu length with zero In normal case it returns E_OK by updating the RxIPdu length.
      boolean ComRxDualCycleSupport [0..1]: multiplicity set at pre-compile, origin=RB:9.0.0:2020-06-03, set at pre-compile, default-value=false  # This parameter enables/disables to update new IPDU based reception deadline value via Com_SetRxIPduTimeoutTicks service: true: enabled, false: disabled.
      boolean ComTxIPduSortByCanId [0..1]: multiplicity set at pre-compile, origin=RB:9.0.0:2020-06-22, set at pre-compile, default-value=false  # If enabled, order of transmission of ComTxIPdu with same periodicity will be decided on the configured CanIfTxPduCanId, lower the value higher the priority. Otherwise it is ignored.
      boolean ComRetryFailedTransmitRequests [0..1]: multiplicity set at pre-compile, set at pre-compile, default-value=false  # If this Parameter is set to true, retry of failed transmission requests is enabled. If this Parameter is not present, the default value is assumed.
      boolean ComRxIpduTimeoutCalibration [0..1]: multiplicity set at pre-compile, origin=RB:2015-09-10, set at pre-compile, default-value=false  # If enabled, a calibration variable Com_ti"PduShortName"RxTout_C is generated for each reception IPDU with ComTimeOut configured. The value of ComTimeOut can be calibrated and this will be considered as the Rx deadline monitoring parameter for the corresponding IPdu instead of the configured ComTimeout. If disabled, Rx deadline monitoring will be performed based on the value of IPDU ComTimeout configured.
      integer ComSupportedIPduGroups: 0..65535, set at pre-compile  # Defines the maximum number of supported I-PDU groups. Example: In Pre-Compile, if there are twenty ComIPduGroups are present in the configuration. Then value of 20 will be automatically filled in ComSupportedIPduGroups. In Post-Build, if ComSupportedIPduGroups is configured as 100, then user can configure a maximum of 100 ComIPduGroups.
      boolean ComTxIPduDeferredProcessing [0..1]: multiplicity set at pre-compile, origin=RB:2015-05-29, set at pre-compile, default-value=true  # If enabled, all the event pdu's will be consolidated and transmitted through Com_MainFunctionTx
      boolean ComTxIpduNumberOfRepetitionCalibration [0..1]: multiplicity set at pre-compile, origin=RB:4.3.0:2018-03-09, set at pre-compile, default-value=false  # If enabled, a calibration variable Com_nrOfRepn"ComIPduShortName"_C is generated for each transmission IPdu with default repetition value. The value of repetition can be calibrated and this will be considered as the number of repetition for IPdu. If disabled, repetition will be performed based on the value of IPDU repetition configured. Please Note: This is applicable only for the Tx Ipdus with Direct/Mixed transmission mode E.g. Calibration to 0 -> Message is transmitted one time after a request Calibration to 5 -> message is transmitted 5 + 1 = 6 times after request
      boolean ComTxModeCyclePeriodCalibration [0..1]: multiplicity set at pre-compile, origin=RB:2015-01-08, set at pre-compile, default-value=false  # If enabled, a calibration variable is generated for each Transmission IPDU with name Com_ti"PduShortName"TxPerd_C. The value in this variable will be considered as the transmission period factor for the corresponding IPdu instead of the the configured ComTxModeTimePeriod. If disabled, then the Tx PDU transmission period behavior will be normal. Please Note: 1. This is applicable only for the Tx Ipdus with Periodic/Mixed transmission mode 2. The value assigned to this should be a multiple of ComTxTimeBase
      boolean ComTxModeTimeOffsetCalibration [0..1]: multiplicity set at pre-compile, origin=RB:1.0.0:2018-01-10, set at pre-compile, default-value=false  # If enabled, a calibration variable Com_ti"PduShortName"TxTOffset_C is generated for each Cyclic Tx IPDU's with ComTxModeTimeOffset configured. The value of ComTxModeTimeOffset can be calibrated and this will be considered as the Offset for the cyclic type Pdu's(PERIODIC or MIXED) for the corresponding IPdu instead of the configured ComTxModeTimeOffset. If disabled, Offset for the cyclic type Pdu's will be performed based on the value of IPDU ComTxModeTimeOffset configured.
      boolean ComTxScheduledInDiffTimebase [0..1]: multiplicity set at pre-compile, origin=RB:2013-09-17, set at pre-compile, default-value=false  # If enabled, then Com_IsTxScheduled(PduIdType ComTxPduId, uint16 ComCallerTaskCycle) function can be called in different task cycle as Com_MainfunctionTx. If disabled, then Com_IsTxScheduled has to be called in same task cycle as Com_MainfunctionTx When this feature is enabled, the Com_IsTxScheduled API shall use "ComCallerTaskCycle" parameter Where ComCallerTaskCycle is in milli-seconds, i.e., for 1ms,ComCallerTaskCycle has to be passed as 1
      string ComUserCbkHeaderFile [0..*]: multiplicity set at pre-compile, set at pre-compile, max-length=32, min-length=1  # Defines the header files for callback functions which shall be included by the COM module.
      string ComUserFlatmapRefPath [0..1]: multiplicity set at pre-compile, origin=RB:7.4.0:2019-09-25, set at pre-compile  # Project specific FlatMap reference path. By default FlatMap reference path is considered as Com_FlatView/Com_FlatMap, where Com_FlatView is ARPackage name and Com_FlatMap is FlatMap name. Reference path shall provide minimum of one ARPackage(or many) and one FlatMap name seperated with forward-slash(/) in the same order. Eg. ARPackage1/ARPackage2/FlatMapInstance
      boolean ComVersionInfoApi: set at pre-compile  # Activate/Deactivate the version information API (Com_GetVersionInfo). | True: version information API activated False: version information API deactivated

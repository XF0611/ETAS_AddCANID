AUTOSAR XML (schema 4-2-2)
# The material contained in this specification is protected by copyright and
# other types of Intellectual Property Rights. The commercial exploitation of the
# material contained in this specification requires a license to such
# Intellectual Property Rights.
# This specification may be utilized or reproduced without any modification, in
# any form or by any means, for informational purposes only. For any other
# purpose, no part of the specification may be utilized or reproduced, in any
# form or by any means, without permission in writing from the publisher.
# licensed under the same rules as applicable to the AUTOSAR Standard.
package /AUTOSAR_FrSM/EcucModuleDefs
  module definition FrSM [0..1]: category=VENDOR_SPECIFIC_MODULE_DEFINITION, post-build-variant-support=true, refined-module-def=FrSM, variants link-time/post-build/pre-compile  # Configuration of the FlexRay State Manager
    container FrSMConfig  # This container comprises the cluster specific configuration of the FlexRay State Manager.
      container FrSMCluster [1..*]  # This container specifies a FlexRay cluster and all related data. A FlexRay cluster may consist of more than one controller per ECU.
        enumeration FrSMChannel: {FRSM_CHANNEL_A, FRSM_CHANNEL_B}, origin=BOSCH, post-build-variant-value=true, set at post-build in variant post-build / pre-compile in variant pre-compile, default-value=FRSM_CHANNEL_B  # This parameter refers the FlexRay Transceiver channel.
        boolean FrSMCheckWakeupReason: post-build-variant-value=true, set at link in variant link-time / post-build in variant post-build / pre-compile in variant pre-compile  # If FrSMCheckWakeupReason is true, the FrSM will check the wakeup reason in order to skip the wakeup in case of wakeup by bus. If FrSMCheckWakeupReason is false, the FrSM will always try to perform a wakeup.
        boolean FrSMDelayStartupWithoutWakeup: post-build-variant-value=true, set at link in variant link-time / post-build in variant post-build / pre-compile in variant pre-compile  # If true, timer t1 shall be started instead of immediately calling FrIf_AllowColdstart in case of a startup without wakeup.
        float FrSMDurationT1: 0..Inf, post-build-variant-value=true, set at link in variant link-time / post-build in variant post-build / pre-compile in variant pre-compile  # The duration of timer t1 in seconds. A value of 0 shall imply that the timer is not used. | A value of 0 shall imply that the timer is not used.
        float FrSMDurationT2: 0..Inf, post-build-variant-value=true, set at link in variant link-time / post-build in variant post-build / pre-compile in variant pre-compile  # The duration of timer t2 in seconds. A value of 0 shall imply that the timer is not used. The value of this parameter shall be larger than the value of FrSMDurationT1 parameter. | A value of 0 shall imply that the timer is not used. The value of this parameter shall be larger than the value of FrSMDurationT1 parameter.
        float FrSMDurationT3: 0..Inf, post-build-variant-value=true, set at link in variant link-time / post-build in variant post-build / pre-compile in variant pre-compile  # The duration of timer t3 in seconds. The value of this parameter shall be larger than the value of FrSMDurationT1 parameter. A value of 0 shall imply that the timer is not used. It shall only be possible to configure a value 0 if no FrNm is used. | A value of 0 shall imply that the timer is not used. It shall only be possible to configure a value 0 if no FrNm is used.
        float FrSMDurationT4: 0..Inf, post-build-variant-value=true, set at link in variant link-time / post-build in variant post-build / pre-compile in variant pre-compile  # The timer t4 ensures that a dual channel node will eventually clear its coldstart inhibit bit and become a leading coldstarter.
        boolean FrSMIsColdstartEcu: post-build-variant-value=true, set at link in variant link-time / post-build in variant post-build / pre-compile in variant pre-compile  # True: The ECU is a coldstart node for this FlexRay cluster. False: The ECU is no coldstart node for this FlexRay cluster. | False: The ECU is no coldstart node for this FlexRay cluster.
        boolean FrSMIsDualChannelNode: origin=BOSCH, set at pre-compile, default-value=false  # True: The ECU is having 2 channels. False: The ECU is having 1 channels.
        boolean FrSMIsWakeupEcu: post-build-variant-value=true, set at link in variant link-time / post-build in variant post-build / pre-compile in variant pre-compile  # True: FrSM shall perform a wakeup for this cluster. False: FrSM shall never perform a wakeup for this FlexRay cluster. | False: FrSM shall never perform a wakeup for this FlexRay cluster.
        float FrSMMainFunctionCycleTime: 0..Inf, set at link in variant link-time+post-build / pre-compile in variant pre-compile  # This parameter defines the cycle time in seconds of the periodic calling of FrSM main function.
        integer FrSMMinNumberOfColdstarter [0..0]: 0..255, multiplicity set at link in variant link-time / post-build in variant post-build / pre-compile in variant pre-compile, post-build-variant-multiplicity=true, post-build-variant-value=true, set at link in variant link-time / post-build in variant post-build / pre-compile in variant pre-compile  # This parameter defines the number of coldstarter that should not be underrun. If this parameter is not configured the mainfunction shall not check the number of startup frames.
        integer FrSMNumWakeupPatterns: 0..65535, post-build-variant-value=true, set at link in variant link-time / post-build in variant post-build / pre-compile in variant pre-compile  # Maximum number of Wakeup Patterns the node may send before going to FRSM_STARTUP.
        integer FrSMStartupRepetitions [0..1]: 0..65535, multiplicity set at link in variant link-time / post-build in variant post-build / pre-compile in variant pre-compile, post-build-variant-multiplicity=true, post-build-variant-value=true, set at link in variant link-time / post-build in variant post-build / pre-compile in variant pre-compile  # The number of times an ECU may repeat the startup procedure for a FlexRay cluster.
        integer FrSMStartupRepetitionsWithWakeup [0..1]: 0..65535, multiplicity set at link in variant link-time / post-build in variant post-build / pre-compile in variant pre-compile, post-build-variant-multiplicity=true, post-build-variant-value=true, set at link in variant link-time / post-build in variant post-build / pre-compile in variant pre-compile  # The number of times an ECU may repeat the startup procedure including a wakeup for a FlexRay cluster.
        float FrSMTrcvStdbyDelay [0..1]: 0..Inf, multiplicity set at link in variant link-time / post-build in variant post-build / pre-compile in variant pre-compile, post-build-variant-multiplicity=true, post-build-variant-value=true, set at link in variant link-time / post-build in variant post-build / pre-compile in variant pre-compile  # The duration of timer t_TrcvStdbyDelay in seconds. The granularity of this parameter shall be restricted to full FlexRay cycles (FrIfGdCycle). This parameter will be used as replacement for the Timer t4 used in AR402. This parameter will be configured in seconds. A value of 0 shall imply that the timer is not used. | A value of 0 shall imply that the timer is not used.
        symbolic name reference FrSMComMNetworkHandleRef: set at link in variant link-time+post-build / pre-compile in variant pre-compile, destination=ComMChannel  # Reference to the unique handle to identify one certain FlexRay network correspond to one of the network handles of the ComM configuration.
        symbolic name reference FrSMFrIfClusterRef: post-build-variant-value=true, set at link in variant link-time / post-build in variant post-build / pre-compile in variant pre-compile, destination=FrIfCluster  # References the cluster configuration in the FlexRay Interface configuration. Note that the assigned controllers and transceivers are defined in the FrIf configuration and can be accessed via this reference. | Note that the assigned controllers and transceivers are defined in the FrIf configuration and can be accessed via this reference.
        container FrSMClusterDemEventParameterRefs [0..1]  # Container for the references to DemEventParameter elements which shall be invoked using the API Dem_ReportErrorStatus in case the corresponding error occurs. The EventId is taken from the referenced DemEventParameter's DemEventId value. The standardized errors are provided in this container and can be extended by vendor specific error references. | The standardized errors are provided in this container and can be extended by vendor specific error references.
          enumeration FrSMRbDynCreate_FRSM_E_CLUSTER_STARTUP: {Disabled, Standard}, origin=BOSCH, set at pre-compile, default-value=Disabled  # Selects the way how the FrSM DemEvents are created. If not set or set to "Disabled", no such DemEvent is automatically created. If the dynamic creation of this DemEvent is enabled, the reference to this DemEvent (in parameter FRSM_E_CLUSTER_STARTUP) is also automatically created and shall therefore not be set manually.
          enumeration FrSMRbDynCreate_FRSM_E_CLUSTER_SYNC_LOSS: {Disabled, Standard}, origin=BOSCH, set at pre-compile, default-value=Disabled  # Selects the way how the FrSM DemEvents are created. If not set or set to "Disabled", no such DemEvent is automatically created. If the dynamic creation of this DemEvent is enabled, the reference to this DemEvent (in parameter FRSM_E_CLUSTER_SYNC_LOSS) is also automatically created and shall therefore not be set manually.
          symbolic name reference FRSM_E_CLUSTER_STARTUP: set at link in variant link-time+post-build / pre-compile in variant pre-compile, destination=DemEventParameter  # Reference to the DemEventParameter which shall be issued when the error "FRSM_E_CLUSTER_STARTUP" has occurred. If the reference is not configured the error shall be reported as DET error. Autosar 422 specifies this parameter as mandatory but as it was optional in 402, it is retained as optional parameter for this release.
          symbolic name reference FRSM_E_CLUSTER_SYNC_LOSS: set at link in variant link-time+post-build / pre-compile in variant pre-compile, destination=DemEventParameter  # Reference to the DemEventParameter which shall be issued when the error "FRSM_E_CLUSTER_SYNC_LOSS" has occurred. If the reference is not configured the error shall be reported as DET error.
    container FrSMGeneral  # This container contains the general configuration parameters of the FlexRay State Manager.
      boolean FrSMAllSlotsSupport [0..1]: multiplicity set at pre-compile, set at pre-compile  # Configuration parameter to enable/disable FrSM support to enable/disable the switching from key-slot/single-slot mode to all-slot mode.
      string FrSMCddHeaderFile [0..1]: multiplicity set at pre-compile, set at pre-compile  # This parameter defines header files for callback functions which are implemented by CDD, e.g. <Cdd>_SyncLossErrorIndication.
      boolean FrSMDSMReInit: origin=BOSCH, set at pre-compile, default-value=false  # Enables or disables the reporting of DEM event after DSM Re-initialisation
      boolean FrSMDevErrorDetect: set at pre-compile, default-value=false  # Switches the Default Error Tracer (Det) detection and notification ON or OFF. true: enabled (ON). false: disabled (OFF). | * true: enabled (ON). * false: disabled (OFF).
      boolean FrSMInitCallBack: origin=BOSCH, set at pre-compile, default-value=false  # Enables and disables the call of the init callback function
      function name FrSMSyncLossErrorIndicationName [0..1]: multiplicity set at link in variant link-time+post-build / pre-compile in variant pre-compile, set at link in variant link-time+post-build / pre-compile in variant pre-compile  # Name of <Cdd>_SyncLossErrorIndication function that shall be called on loss of synchronization. If this parameter is omitted no indication shall take place.
      boolean FrSMSystemTimerUsed: origin=BOSCH, set at pre-compile, default-value=false  # Enables and disables the use of system timer in the project. When it is enabled, the system timer will be used for the FrSM timers T1, T2, T3 and T4 and when disabled, the OS timer will be used for the same.
      boolean FrSMVersionInfoApi: set at pre-compile, default-value=false  # Enables and disables the version info API

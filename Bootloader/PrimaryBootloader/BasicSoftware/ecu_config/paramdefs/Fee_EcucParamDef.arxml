AUTOSAR XML (schema 4-2-2)
package /AUTOSAR_Fee/EcucModuleDefs
  module definition Fee [0..254]: category=VENDOR_SPECIFIC_MODULE_DEFINITION, refined-module-def=Fee, variants pre-compile  # Memory: Flash EEPROM Emulation | Configuration of the Fee (Flash eeprom emulation) module.
    container FeeBlockConfiguration [1..65535]: multiplicity set at pre-compile  # FeeBlockConfiguration. | Configuration of block specific parameters for the Flash EEPROM Emulation module.
      integer FeeBlockNumber [0..1]: 1..65534, multiplicity set at pre-compile, set at pre-compile, symbolic-name-value=true  # Block identifier. | This tag has currently no effect, the FeeRbBlockPersistentId has to be configured instead. The FeeBlockNumber will be calculated by the Fee automatically. This can be used as a parameter in the user interfaces in order to identify the relevant block. | 0x0000 and 0xFFFF shall not be used for block numbers (see FEE006). Range: min = 2^NVM_DATASET_SELECTION_BITS max = 0xFFFF - 2^NVM_DATASET_SELECTION_BITS Note: Depending on the number of bits set aside for dataset selection several other block numbers shall also be left out to ease implementation.
      integer FeeBlockSize: 1..65535, multiplicity set at pre-compile, set at pre-compile  # Data size of the block. | Size of a logical block in bytes.
      string FeeRbBlockSizeString [0..1]: multiplicity set at pre-compile, origin=RB:1.0.0:2011-09-09, set at link in variant link-time / pre-compile in variant pre-compile, default-value=NULL_PTR  # Block size in String. | Size of a Fee Block defined as a string. | This parameter allow user define Fee block Length with a C operation. Note: the operation must be calculated in compile time
      boolean FeeImmediateData: multiplicity set at pre-compile, set at pre-compile  # Marker for high priority data. | If the Fee's queue contains more than one order, high priority data will be favored. | true: Block contains immediate data. false: Block does not contain immediate data.
      integer FeeNumberOfWriteCycles: 0..4294967295, multiplicity set at pre-compile, set at pre-compile  # Number of block write cycles over ECU lifetime. | Number of write cycles (app.) required for this block (during the complete ECU lifetime). This tag is used for calculating the reachable driving cycles in some product lines (e.g. CC-AS).
      integer FeeRbBlockPersistentId: 1..65534, multiplicity set at pre-compile, set at pre-compile  # Permanent block ID. | Permanent block ID which is stored in the medium ("UUID"). | Permanent block id which is used for storage in medium ("UUID").
      string FeeRbCallbackEnd [0..1]: multiplicity set at pre-compile, origin=RB:1.0.0:2011-09-09, set at link in variant link-time / pre-compile in variant pre-compile, default-value=NULL_PTR  # Callback function for successful jobs. | Name of callback function which is called after successful finished orders. This should be used for any adapter blocks/jobs because the module's job result is only changed for NvM job types. | Possible values are: Name of the Callback function or NULL_PTR if no Callback function is available.
      string FeeRbCallbackError [0..1]: multiplicity set at pre-compile, origin=RB:1.0.0:2011-09-09, set at link in variant link-time / pre-compile in variant pre-compile, default-value=NULL_PTR  # Callback function for failed jobs. | Name of callback function which is called if order couldn't be finished successfully. This should be used for any adapter blocks/jobs because the module's job result is only changed for NvM job types. | Possible values are: Name of the Callback function or NULL_PTR if no Callback function is available.
      enumeration FeeRbDataFilterType [0..1]: multiplicity set at pre-compile, origin=RB:1.0.0:2011-09-09, set at pre-compile, default-value=DYNAMIC  # Data Filter Type (data classification). | Defines the data classification for certain actions (e.g. during migration, start up, erase services). This tag has currently no effect.
        DYNAMIC  # Dynamic (standard, anybody can erase this block (e.g. during migration)
        STATIC  # Static (only certain users can erase this block, e.g. repair shops)
        PERMANENT  # Permanent (only very certain users can erase this block, e.g. OEM)
        SUPER_PERMANENT  # Super Permanent (block can never be erased)
      integer FeeRbDeviceIndex [0..1]: 0..254, multiplicity set at pre-compile, origin=RB:1.0.0:2011-09-09, set at pre-compile, default-value=0  # Rb special device index in integer. This information is needed by the NVRAM manager respectively the Memory Abstraction Interface to address a certain logical block. | Rb special device index | Range: 0 .. 254 (0xFF reserved for broadcast call to GetStatus function). This tag has currently no effect.
      boolean FeeRbFirstReadDataMigration [0..1]: multiplicity set at pre-compile, origin=RB:1.0.0:2011-09-09, set at pre-compile, default-value=false  # First Read Data Migration | This tag activates or deactivates the First Read Data Migration feature. | false: First Read Data Migration is disabled (default). true: First Read Data Migration is enabled.
      boolean FeeRbNoFallback [0..1]: multiplicity set at pre-compile, origin=RB:1.0.0:2011-09-09, set at pre-compile, default-value=false  # NoFallback attribute | This tag activates or deactivates a fall back mechanism to older copies of the same block in case the latest block is corrupted. By default a fall back to old copies is possible. The NoFallback feature is available only for Renesas R1x / P1x as well as TI controllers. It is activated only when at least one block is configured as NoFallback. The API Fee_Rb_BlockMaintenance() needs to be activated and called during shutdown when this feature is used. This is necessary to repair double storage NoFallback blocks which are corrupted due to write interruptions. | false: If the latest copy is corrupted an older valid copy of the same block is read (default). true: If the latest copy is corrupted all available older copies of the same block are ignored. Behavior during layout change: Parameter gets activated in the new layout (true): Old copies are still readable since the evaluation is done on the block properties from the data flash. New copies are written with an activated NoFallback setting. Parameter gets deactivated in the new layout (false) but the feature itself is still activated: Only the last valid copy which was also readable with an activated NoFallback setting is readable. New copies are written with a deactivated NoFallback setting. Parameter gets deactivated in the new layout (false) and the feature itself is deactivated: All old copies are readable.
      enumeration FeeRbOrigin: multiplicity set at pre-compile, origin=RB:1.0.0:2011-09-09, set at pre-compile  # Responsible module for this configuration. | NVM / Adapter / Fee internal block type
        NVM  # NvM block type
        ADAPTER  # Adapter block type (Eep_Adapter / PDM_Adapter)
        FEE  # Fee Internal
      boolean FeeRbRobustness [0..1]: multiplicity set at pre-compile, origin=RB:1.0.0:2011-09-09, set at pre-compile, default-value=false  # Block robustness attribute. | This tag improves the robustness against a data modification during write executions by adding an additional checksum to the block data which is calculated over an internal buffer that is used for writing the block data step by step. | true: Feature enabled (block will be increased by 4 bytes). false: Feature disabled.Note: Behavior for rba_FeeFs1 during layout change: 1. Parameter gets activated in the new layout (true): Old copies are still readable since the evaluation is done on the block properties from the data flash. New copies are written with an activated Robustness setting. 2. Parameter gets deactivated in the new layout (false): Only the last valid copy which was also readable with an activated Robustness setting is readable. New copies are written with a deactivated Robustness setting.
      integer FeeRbSecLevel: 1..2, multiplicity set at pre-compile, origin=RB:1.0.0:2011-09-09, set at pre-compile  # Redundant data storage. | Security Level of the block | Range: 1 = Block has one copy in flash, 2 = Block has two identical copies in flash
      boolean FeeRbSurvival [0..1]: multiplicity set at pre-compile, origin=RB:1.0.0:2011-09-09, set at pre-compile, default-value=false  # Block survival attribute. | This tag changes the reorganization behaviour for this block in case it is not within the layout. | true: Sector reorganization will not delete this block, even if it is not part of the layout. false: Sector reorganization will delete this block if it is not part of the layout.
      boolean FeeRbVarBlockLength [0..1]: multiplicity set at pre-compile, origin=RB:1.0.0:2011-09-09, set at pre-compile, default-value=false  # Variable Block Length | This tag marks that the block length is variable and calculated on runtime. | false: Block length is numeric literal and calculated at compile time (default). true: Block length is variable and calculated on runtime.
      symbolic name reference FeeDeviceIndex [0..0]: multiplicity set at pre-compile, set at pre-compile, destination=FlsGeneral  # Block Device index. | This information is defined but not used. | This tag has currently no effect.
    container FeeGeneral: multiplicity set at pre-compile  # Container for general parameters. These parameters are not specific to a block.
      boolean FeeDevErrorDetect: multiplicity set at pre-compile, set at pre-compile  # Development Error Detection setting. | Pre-processor switch to enable and disable development error detection. | true: Development error detection enabled. false: Development error detection disabled.
      integer FeeIndex: 0..254, multiplicity set at pre-compile, set at pre-compile  # Instance ID (obselete and not used) | This paramdef is not used and is obselete. The paramdef is still kept to be comptabile with AR4.0 version
      function name FeeNvmJobEndNotification [0..1]: multiplicity set at pre-compile, set at pre-compile, default-value=NULL_PTR  # Job End notification function. | Mapped to the job end notification routine provided by the upper layer module (NvM_JobEndNotification). This tag has currently no effect. Job end and job error notifications must be configured block wise if necessary.
      function name FeeNvmJobErrorNotification [0..1]: multiplicity set at pre-compile, set at pre-compile, default-value=NULL_PTR  # Job Error notification function. | Mapped to the job error notification routine provided by the upper layer module (NvM_JobErrorNotification). This tag has currently no effect. Job end and job error notifications must be configured block wise if necessary.
      boolean FeePollingMode: multiplicity set at pre-compile, set at pre-compile  # Polling mode setting. | Pre-processor switch to enable and disable the polling mode for this module (usage of the job result functionality). | true: Polling mode enabled, callback functions (provided to FLS module) disabled. false: Polling mode disabled, callback functions (provided to FLS module) enabled.
      boolean FeeRbActEraseSuspension [0..1]: multiplicity set at pre-compile, origin=RB:1.0.0:2011-09-09, set at pre-compile, default-value=false  # Erase suspension active (only for Ti devices). | This tag improves the possibility to activate a suspension during erasing of flash. If it's active, the erase order can be suspended by other Fee orders and if all Fee orders are finished, erase order should be resumed. This feature is only for Ti device active. | true: Feature enabled. false: Feature disabled.
      boolean FeeRbActSafetyChecks [0..1]: multiplicity set at pre-compile, origin=RB:1.0.0:2011-09-09, set at pre-compile, default-value=true  # Internal Safety Check setting. | Pre-processor switch to enable or disable additional internal checks of the module concerning layout and block sizes. | true: Feature enabled. false: Feature disabled. default: true.
      boolean FeeRbActSurvivalEval [0..1]: multiplicity set at pre-compile, origin=RB:1.0.0:2011-09-09, set at pre-compile, default-value=false  # Activation of the "partial afterburner". | Pre-processor switch to enable or disable an additional block specific reorganization for unknown blocks with an active survival setting ("FeeRbSurvival") in the medium. | true: Feature enabled ("block specific afterburner" on for blocks with active survival setting). false: Feature disabled ("block specific afterburner" off for blocks with active survival setting). default: false Hint: If activated, this block will be overtaken independent from the "FeeRbActUnknownBlockReorg" setting ("general afterburner").
      boolean FeeRbActUnknownBlockReorg [0..1]: multiplicity set at pre-compile, origin=RB:1.0.0:2011-09-09, set at pre-compile, default-value=false  # Activation of the "global afterburner". | Pre-processor switch to enable or disable an additional reorganization for any unknown block in the medium. Only the CB (Customer Block) is allowed to enable this feature, because this is affecting the thresholds of the sector reorganization to a special safety level. It must be deactivated (default) for the ASW! | true: Feature enabled ("general afterburner" on for all unknown blocks). false: Feature disabled ("general afterburner" off for all unknown blocks). default: false. Hints: If activated, all unknown blocks will be overtaken independent from the "FeeRbActSurvivalEval" setting ("block specific afterburner"). If deactivated and with active survival evaluation ("FeeRbActSurvivalEval" == TRUE), only blocks with an active survival setting ("FeeRbSurvival" == TRUE) will be overtaken.# Only the CB (Customer Block) is allowed to enable this feature, because this is affecting the thresholds of the sector reorganization to a special safety level. It must be deactivated (default) for the ASW!
      integer FeeRbActUnknownBlockReorgCacheSize [0..1]: 0..393210, multiplicity set at pre-compile, origin=RB:6.0.0:2015-07-31, set at pre-compile, default-value=1800  # Available cache size for faster sector reorganisation for "global afterburner" feature. | Pre-processor switch to enable or disable an additional optimisation in reorganization for any unknown block in the medium. Only the CB (Customer Block) and with global afterburner feature (FeeRbActUnknownBlockReorg = TRUE) is allowed to enable this feature. It must be deactivated (default) for the ASW! | Numeric value. Default: 1800. Hints: This feature fastens the sector reorganisation for unknown blocks by scanning the sector and building up a cache for unknown block. Required size of an unknown cache block entry: FS1: 6 bytes, FS1x: 10 bytes For best performance project must allocate enough cache size to store information of all unknown blocks (one more then actual number of unknown blocks). Example: Project has 250 unknown blocks in CB then at least 251*6 = 1506bytes to be allocated (FS1 only). For FS1x: 251*10 = 2510bytes Default value is for 299 (FS1) or 179 (FS1x) unknown blocks, which is 300*6=1800bytes (FS1) or 180*10= 1800bytes.
      boolean FeeRbAddonsCCAS [0..1]: multiplicity set at pre-compile, origin=RB:1.0.0:2011-09-09, set at pre-compile, default-value=false  # Activation of the CC-AS specific add-ons. | Pre-processor switch to enable or disable add-ons for CC-AS ("Forced Read", "Stop Mode", "Write address based"). Hint: for the usage of the rba_FeeAddOnAS_ForcedRead functionality, the Fee configuration tag "FeeRbReadForce" needs to be activated as well. | true: Add-ons for CC-AS enabled. false: Add-ons for CC-AS disabled. default: false.
      enumeration FeeRbBlockTableLocation [0..1]: multiplicity set at pre-compile, origin=RB:15.0.2:2020-02-17, set at pre-compile, default-value=RAM  # Selected Location for Block Properties Table | Select Fee Block Properties Location - Keep default setting "RAM" to optimize the runtime of the code. Use "ROM" setting in case of reduction of RAM consumption only. | RAM: RAM Location of Fee Block Properties ROM: ROM Location of Fee Block Properties default: RAM
        RAM  # Use RAM location for Fee Blockproperties Table
        ROM  # Use ROM location for Fee Blockproperties Table
      boolean FeeRbConfirmSingleStorageBlockloss [0..1]: multiplicity set at pre-compile, set at pre-compile, default-value=false  # Confirmation: Weakness Single Storage Blockloss | If FS1 or FS2 is selected as filesystem: Blocks configured with single storage have a very low probability to get lost even during regular operation. Background: In case an abort (reset or power loss) happens during physically charging the cells of the last page of a block then the data can be left weakly programmed and be lost during later operation. Because of this reason it is recommented that critical data is configured as double storage. For more information please check the rba_FeeFs1 and/or rba_FeeFs2 documentation chapter 10 &quot;Miscellaneous&quot;. By setting this tag to true you confirm that the weakness is considered in the block configuration. If this is not done the build will abort. This is done due to a quality measure to ensure the knowledge about this information is spread in the organization. | true: FS1 and FS2 reset weakness for single storage blocks is considered in the block configuration false: FS1 and FS2 reset weakness for single storage blocks is not considered in the block configuration
      boolean FeeRbEnterStopModeApi [0..1]: multiplicity set at pre-compile, set at pre-compile, default-value=false  # API activation for Fee_Rb_EnterStopMode() | Compiler switch to enable/disable the stop mode functionality of the FEE module. If the stop mode API is called, the Fee is finishing the current job and afterwards locking itself. As soon as the Fee is locked, no further Fls requests are given until the Fee is initialized again. (The stop mode cannot be left) | true: Stop mode feature supported. false: Stop mode feature not supported.
      enumeration FeeRbFsSelect [0..1]: multiplicity set at pre-compile, origin=RB:7.0.0:2015-11-13, set at pre-compile, default-value=FS1  # Selected Filesystem. | Specifies the actual layout of the data on the flash.
        FS1  # Fee 1.0 layout - round robin, management and user data one next to the other
        FS1X  # Fee1x driver (compatible to Fee1.0 layout)- round robin, management and user data one next to the other
        FS2  # Fee 2.0 layout - seperate sectors for management and user data.
        FS3  # PCM Memory Management Layout - Memory separated into two halfs
      integer FeeRbGeneralDeviceIndex [0..1]: 0..254, multiplicity set at pre-compile, set at pre-compile  # Device id when multi instance of Fee is used | Specifies the InstanceId of this module instance. If only one instance is present it shall have the Id 0.
      boolean FeeRbGetFreeSpaceApi [0..1]: multiplicity set at pre-compile, set at pre-compile, default-value=false  # API activation to get number of free bytes in DFlash | Pre-processor switch to enable / disable the API to return amount of free bytes in the DFLASH area | true: Free space API enabled. false: Free space API disabled.
      boolean FeeRbGetNrFreeBytesAndFatEntriesApi [0..1]: multiplicity set at pre-compile, origin=RB:16.0.0:2020-06-25, set at pre-compile, default-value=false  # API activation to get number of free bytes and FAT entries in Dflash | Pre-processor switch to enable / disable the API to return the amount of free bytes and FAT entries in the DFLASH area until a hard reorganization or an erase operation starts. This API applies only to FeeFs2. | true: Number free bytes and FAT entries API enabled. false: Number free bytes FAT entries API disabled.
      enumeration FeeRbMachineType [0..1]: multiplicity set at pre-compile, origin=RB:1.0.0:2011-09-09, set at pre-compile  # Machine Type | Controller type to be configured in case no MCU module is present.
        FEE_RB_IFX_UC1_TC23X  # IFX TC23X/Dev1 Production
        MCU_RB_IFX_UC1_DEV2_B  # IFX Dev2 Production Device B silicon
        MCU_RB_IFX_UC1_DEV3_C  # IFX Dev3 Production Device C silicon
        MCU_RB_IFX_UC1_DEV3_D  # IFX Dev3 Production Device D silicon
        MCU_RB_IFX_UC1_DEV4_B  # IFX Dev4 Production Device B silicon
        FEE_RB_IFX_TC33X_40NM_CMPL  # IFX Dev S (TC33x) 40nm Production Device A silicon Complementary
        FEE_RB_IFX_TC33X_40NM_SE  # IFX Dev S (TC33x) 40nm Production Device A silicon Single Ended
        MCU_RB_IFX_TC35X_A  # IFX Dev M (TC35x) 40nm Production Device A silicon Complementary
        FEE_RB_IFX_TC35X_40NM_SE  # IFX Dev M (TC35x) 40nm Production Device A silicon Single Ended
        MCU_RB_IFX_UC1_DEV3_40NM_A  # IFX Dev3 (TC37x) 40nm Production Device A silicon Complementary
        FEE_RB_IFX_TC37X_40NM_SE  # IFX Dev3 (TC37x) 40nm Production Device A silicon Single Ended
        MCU_RB_IFX_UC1_DEV4_40NM_A  # IFX Dev4 (TC38x) 40nm Production Device A silicon Complementary
        FEE_RB_IFX_TC38X_40NM_SE  # IFX Dev4 (TC38x) 40nm Production Device A silicon Single Ended
        MCU_RB_IFX_UC1_DEV5_40NM_A  # IFX Dev5 (TC39x) 40nm Production Device A silicon Complementary
        MCU_RB_IFX_UC1_DEV5_40NM_B  # IFX Dev5 (TC39x) 40nm Production Device B silicon Complementary
        FEE_RB_IFX_TC39X_40NM_SE  # IFX Dev5 (TC39x) 40nm Production Device B silicon Single Ended
        FEE_RB_IFX_TC3EX_40NM_CMPL  # IFX Dev4 Evo (TC3Ex) 40nm Production Device A silicon Complementary
        FEE_RB_IFX_TC3EX_40NM_SE  # IFX Dev4 Evo (TC3Ex) 40nm Production Device A silicon Single Ended
        FEE_RB_IFX_40NM_SE_HSM  # IFX Aurix2 (TC33x,TC35x,TC37x,TC38x,TC39x,TC3Ex) 40nm Production Device Single Ended HSM
        FEE_RB_IFX_40NM_CMPL_HSM  # IFX Aurix2 (TC33x,TC35x,TC37x,TC38x,TC39x,TC3Ex) 40nm Production Device Complementary HSM
        MCU_RB_JDP_UC1_DEV1  # JDP Dev1 Production Device
        MCU_RB_JDP_UC1_DEV{2..4}_C2  # JDP Dev{2..4} Cut 2.0 Production Device
        MCU_RB_ST_UC1_DEV3PLUS_C1  # ST Dev3 Plus
        MCU_RB_ST_UC1_DEV3_40NM_C3  # ST Dev3 40NM Cut3
        MCU_RB_ST_UC1_DEV3_40NM_C3_2  # ST Dev3 40NM Cut3.2
        FLS_RB_ST_STELLAR_16M_C1  # ST Centauri Cut1
        FLS_RB_ST_STELLAR_16M_C1_HSM  # ST Centauri Cut1 HSM
        FLS_RB_ST_UCU_DEV5_SR6P6_C1  # ST SR6P6 Cut1 (Centauri Cut2)
        FLS_RB_ST_UCU_DEV5_SR6P6_C1_HSM  # ST SR6P6 Cut1 (Centauri Cut2) HSM
        FEE_RB_ST_CHORUS_1M_DF64K  # ST Chorus 1M 64K DFLASH (SPC582Bx)
        FEE_RB_ST_CHORUS_2M_DF64K  # ST Chorus 2M 64K DFLASH (SPC584Bx)
        FEE_RB_ST_CHORUS_4M_DF128K  # ST Chorus 4M 128K DFLASH (SPC584Cx/SPC58ECx)
        FEE_RB_ST_CHORUS_6M_DF256K  # ST Chorus 6M 256K DFLASH (SPC58xGx)
        FEE_RB_ST_CHORUS_10M_DF256K  # ST Chorus 10M 256K DFLASH (SPC58xHx)
        FEE_RB_ST_CHORUS_4M_HSM_DF32K  # ST Chorus 4M HSM 32K DFLASH (SPC584Cx/SPC58ECx)
        FEE_RB_ST_CHORUS_6M_HSM_DF32K  # ST Chorus 6M HSM 32K DFLASH (SPC58xGx)
        FEE_RB_ST_CHORUS_10M_HSM_DF32K  # ST Chorus 10M HSM 32K DFLASH (SPC58xHx)
        FEE_RB_MPC5746C  # NXP MPC5746C 128K DFLASH for Host
        FEE_RB_MPC5746C_HSM  # NXP MPC5746C 32K DFLASH for HSM
        MCU_RB_ST_CHORUS_4M_HSM  # ST SPC584Cx/SPC58ECx Chorus 4M HSM
        MCU_RB_V850R1X_512K  # Renesas V850 R1x Device (512kB PFlash / 32kB DFlash)
        MCU_RB_V850R1X_512K_REDUCED  # Renesas V850 R1x Device (512kB PFlash / 32kB DFlash) reduced by Crash data size
        MCU_RB_V850R1X_1M  # Renesas V850 R1x Device (1MB PFlash / 32kB DFlash)
        MCU_RB_V850R1X_1M_REDUCED  # Renesas V850 R1x Device (1MB PFlash / 32kB DFlash) reduced by Crash data size
        FEE_RB_RH850_F1KM_S1_DF64K  # Renesas RH850 F1KM Device (1MB PFlash / 64kB DFlash)
        FEE_RB_RH850_F1KM_S1_DF62_2K_REDUCED  # Renesas RH850 F1KM Device (1MB PFlash / 62kB DFlash) Reduced by Crash data size (2kB)
        FEE_RB_RH850_F1KM_S1_DF60_4K_REDUCED  # Renesas RH850 F1KM Device (1MB PFlash / 60kB DFlash) Reduced by Crash data size (4kB)
        FEE_RB_RH850_F1KM_S4_104K_Host  # Renesas RH850 F1KM-S4 Device Host (104,25kB DFlash for Host)
        FEE_RB_RH850_F1KM_S4_23K_HSM  # Renesas RH850 F1KM-S4 Device HSM (23,75kB DFlash for HSM)
        FEE_RB_CYT2B7  # Cypress Traveo2 B7 (96kB DFlash) 72kB reserved for host
        FEE_RB_CYT2B7_HSM  # Cypress Traveo2 B7 (96kB DFlash) 24kB reserved for HSM
        FEE_RB_CYT2B9  # Cypress Traveo2 B9 (128kB DFlash) 96kB reserved for host
        FEE_RB_CYT2B9_HSM  # Cypress Traveo2 B9 (128kB DFlash) 32kB reserved for HSM
        MCU_RB_RH850_F1M_CF3M_DF64K  # Renesas RH850 F1M Device (3MB PFlash / 64kB DFlash)
        MCU_RB_RH850_F1M_CF3M_DF62_2K_REDUCED  # Renesas RH850 F1M Device (3MB PFlash / 62kB DFlash) Reduced by Crash data size (2kB)
        MCU_RB_RH850_F1M_CF3M_DF60_4K_REDUCED  # Renesas RH850 F1M Device (3MB PFlash / 60kB DFlash) Reduced by Crash data size (4kB)
        FEE_RB_RCAR_S25FS256  # External Quad SPI Flash for Renesas R-Car controller with external flash S25FS256 (32MB) from Cypress
        FEE_RB_RCAR_S25FS512  # External Quad SPI Flash for Renesas R-Car controller with external flash S25FS512 (64MB) from Cypress
        FEE_RB_RCAR_S70FS01GS  # External Quad SPI Flash for Renesas R-Car controller with external flash S70FS01GS (128MB) from Cypress
        FEE_RB_RCAR_S70FS01GS_HSM  # External Quad SPI Flash for Renesas R-Car controller HSM core with external flash S70FS01GS (128MB) from Cypress
        FEE_RB_ZYNQ_W25Q128JV  # External Quad SPI Flash for ZYNQ Ultrascale+ controller with external flash W25Q128JV (16MB) from Winbond
        FEE_RB_ZYNQ_W25Q256JV  # External Quad SPI Flash for ZYNQ Ultrascale+ controller with external flash W25Q256JV (32MB) from Winbond
        FEE_RB_ZYNQ_S70FS01GS  # External Quad SPI Flash for ZYNQ Ultrascale+ controller with external flash S70FS01GS (128MB) from Cypress
        FEE_RB_ZYNQ_S25FS512S  # External Quad SPI Flash for ZYNQ Ultrascale+ controller with external flash S25FS512S (64MB) from Cypress
        FEE_RB_ZYNQ_MT25QU01G  # External Quad SPI Flash for ZYNQ Ultrascale+ controller with external flash MT25QU01G (128MB) from Micron
        FEE_RB_ZYNQ_MT25QU02G  # External Quad SPI Flash for ZYNQ Ultrascale+ controller with external flash MT25QU02G (256MB) from Micron
        FEE_RB_ZYNQ_MX66U1G  # External Quad SPI Flash for ZYNQ Ultrascale+ controller with external flash MX66U1G (128MB) from Macronix
        FEE_RB_ZYNQ_MX66U2G  # External Quad SPI Flash for ZYNQ Ultrascale+ controller with external flash MX66U2G (256MB) from Macronix
        FEE_RB_RH850U2A16  # Renesas RH850U2A16 (512KB)
        FEE_RB_RH850U2A16_4S_16KBM  # Renesas RH850U2A16, with 4 Sector Emulation and first 16KBytes reserved for Boot Manager
        FEE_RB_RH850U2A16_4S_240KBDF_16KBM  # Renesas RH850U2A16 4 Sector Emulation with only 256kB DFLASH area is usable (same as U2A8) + 16KBytes reserved for Boot Manager
        FEE_RB_RH850U2A16_HSM  # Renesas RH850U2A16 HSM DFLASH (64KB)
        FEE_RB_RH850U2A8_4S_16KBM  # Renesas RH850U2A8, with 4 Sector Emulation and first 16KBytes reserved for Boot Manager
        FEE_RB_RH850U2A8_HSM  # Renesas RH850U2A8 HSM DFLASH (64KB)
        MCU_RB_REN_RH850_P1LC_D1  # CC CUBE Dev1 Flash
        MCU_RB_REN_RH850_P1LC_D2  # CC CUBE Dev2 Flash
        FLS_RB_RH850P1M_1MB  # Renesas RH850 P1M 1MB
        MCU_RB_RH850P1XC_DEV3  # CC CUBE Dev3 Flash
        MCU_RB_RH850P1XC_DEV3_6S  # CC CUBE Dev3 Flash with 6 sectors
        MCU_RB_RH850P1XC_DEV3_REDUCED  # CC CUBE Dev3 Flash reduced by Crash data size
        MCU_RB_RH850P1XC_DEV3_REDUCED_6S  # CC CUBE Dev3 Flash reduced by Crash data size and with 6 sectors
        FLS_RB_RH850P1XC_DEV3_9K4S_24KC  # CC CUBE Dev3 Flash (24kB Crash data and 4 sectors - 9kB each)
        MCU_RB_RH850P1XC_DEV3_HSM  # CC CUBE Dev3 HSM Flash
        MCU_RB_RH850P1XC_DEV4  # CC CUBE Dev4 Flash
        MCU_RB_RH850P1XC_DEV4_REDUCED  # CC CUBE Dev4 Flash reduced by Crash data size
        MCU_RB_RH850P1XC_DEV4_HSM  # CC CUBE Dev4 HSM Flash
        MCU_RB_RH850P1XC_DEV5  # CC CUBE Dev5 Flash
        MCU_RB_RH850P1XC_DEV5_REDUCED  # CC CUBE Dev5 Flash reduced by Crash data size
        MCU_RB_RH850P1XC_DEV5_HSM  # CC CUBE Dev5 HSM Flash
        FEE_RB_RH850P1XC_MX25L32  # External SPI Flash for RH850P1xC controller with external flash MX25L32 (4MB) from Macronix
        MCU_RB_PC  # PC-based simulation environment 8 byte physical page 6 sectors each 64kB
        MCU_RB_PC_16B  # PC-based simulation environment 16 byte physical page 6 sectors each 64kB
        MCU_RB_PC_2SEC  # PC-based simulation environment 8 byte physical page 2 sectors each 64kB
        FEE_RB_PC_4SEC_24KB  # PC-based simulation environment 4 sectors each 24kB
        MCU_RB_PC_4SEC_64KB  # PC-based simulation environment 4 sectors each 64kB
        MCU_RB_PC_4SEC_256KB  # PC-based simulation environment 4 sectors each 256kB
        MCU_RB_PC_6SEC_128KB  # PC-based simulation environment 6 sectors each 128kB
        MCU_RB_PC_8SEC_8KB  # PC-based simulation environment 8 sectors each 8kB
        MCU_RB_PC_8SEC_16KB  # PC-based simulation environment 8 sectors each 16kB
        MCU_RB_PC_8SEC_32KB  # PC-based simulation environment 8 sectors each 32kB
        MCU_RB_PC_8SEC_64KB  # PC-based simulation environment 8 sectors each 64kB and 8B pages
        RBA_FLS_PC_8SEC_64KB_16B  # PC-based simulation environment 8 sectors each 64kB and 16B pages
        FEE_RB_FULL_MANUAL_CFG  # Full manual configuration for first prototyping
        MCU_RB_EVE_AUTOSAR  # EVE AUTOSAR simulation environment
        MCU_RB_MANUAL_CFG  # This option is used to support other targets which are not supported in the list. The information of target must be configured manually in FeeGeneral/FeeRbSectorTable
      boolean FeeRbMaintainRedundantBlocks [0..1]: multiplicity set at pre-compile, set at pre-compile, default-value=false  # API activation for Fee_Rb_BlockMaintenance(). | Pre-processor switch to enable / disable the API to maintain the redundant blocks. Hint: If NvM is used this switch must be set to "TRUE"! | true: Maintain API enabled. false: Maintain API disabled.
      integer FeeRbPageBufferSize [0..1]: 256.., multiplicity set at pre-compile, origin=RB:7.1.0:2016-04-09, set at pre-compile, default-value=1024  # Size of internal page buffer. | Size of buffer for communication between flash driver and Fee. If there is no configuration value for this parameter, the default (1024) will be automatically used. | The value has to be a multiple of virtual page size for writing into flash and a multiple of cache line size for reading from an external flash.
      boolean FeeRbReadForce [0..1]: multiplicity set at pre-compile, set at pre-compile, default-value=false  # Forced read setting. | Pre-processor switch to enable and disable force read function. | true: Forced read enabled. false: Forced read disabled. default: false.
      string FeeRbSchedTriggerFeeRbEndInit [0..1]: multiplicity set at pre-compile, set at pre-compile, default-value=empty  # ETO for Fee_Rb_EndInit | In case the function Fee_Rb_EndInit shall be scheduled using AUTOSAR the function Fee_Rb_EndInit will be generated as External Trigger Occured function. The name the external trigger can be configured here. If left empty then Fee_Rb_EndInit will not be mentioned in BSWMD. In this case manual scheduling of Fee_Rb_EndInit has to be done. This feature is supported only in case of exactly one Fee instance (no multi instance) which must not be configured for FS1 in FeeRbFsSelect. | 1. Create extern trigger outside of the Mem stack 2. Select trigger name here
      function name FeeRbSyncFlsMainLoopHook [0..1]: multiplicity set at pre-compile, set at pre-compile, default-value=(void)0  # Hook into synchronous Fls_MainFunction loop | A hook function can be configured, which will be called in the synchronous Fls_MainFunction loop used for all flash access operations during Fee initialization. This can be useful especially for projects, where the flash is accessed concurrently by different cores at initialization time. HW limitations due to shared logic can block one user until the job of the other user finishes. This impacts the runtime of the loop and consequently extends the runtime of the entire Fee initialization. No other task can be scheduled in between, which may cause a Watchdog reset or impacts the system behaviour in a different way. The user can use the hook function to take all necessary actions to keep the system stable. | 1. Integrate the function into your build environment 2. Write the function name of your hook function to the configuration parameter 3. Build the software 4. Run the software, the hook function will be called once per loop cycle
      boolean FeeRbTriggerReorgApi [0..1]: multiplicity set at pre-compile, set at pre-compile, default-value=false  # API activation for Fee_Rb_TriggerReorg() | Compiler switch to enable/disable the "Forced reorganisation followed by a sector erase" functionality of the FEE module. | true: Forced reorganisation feature supported (one force reorg per call). false: Forced reorganisation feature not supported.
      boolean FeeSetModeSupported: multiplicity set at pre-compile, set at pre-compile  # API activation for Fee_SetMode(). | Compiler switch to enable/disable the "SetMode" functionality of the FEE module. | true: SetMode functionality supported / code present, false: SetMode functionality not supported / code not present. Note: This configuration setting has to be consistent with that of all underlying flash device drivers (configuration parameter FlsSetModeApi).
      boolean FeeVersionInfoApi: multiplicity set at pre-compile, set at pre-compile  # API activation for Fee_GetVersionInfo(). | Pre-processor switch to enable / disable the API to read out the modules version information. | true: Version info API enabled. false: Version info API disabled.
      integer FeeVirtualPageSize: 0..65535, multiplicity set at pre-compile, set at pre-compile  # Virtual page size setting. | The size in bytes to which logical blocks shall be aligned. The correct value is automatically taken internally from Fee. Hint: If 0 is configured, the Fee will search for the largest configured (HW) page size within the complete sector configuration and define it as the virtual page size automatically.
      container FeeRbSectorTable [0..1]  # This container contains the information of target which is not supported by the target list. This container must be configured when user chooses the option MCU_RB_MANUAL_CFG of FeeRbMachineType
        integer FlsRbPageSize: 1..4294967295, multiplicity set at pre-compile, set at pre-compile, symbolic-name-value=true  # Size of one page of this sector in bytes (HW/target dependant configuration)
        boolean FeeRbFastCacheInitActive: origin=RB, set at pre-compile, default-value=true  # Fast cache initialization setting | Switch to enable and disable Fast cache initialization.
        boolean FeeRbHeaderRecheckActive: origin=RB, set at pre-compile, default-value=false  # Header Recheck setting | switch to enable and disable Header Recheck, necessary to be set to true only for flash types with undefined erase pattern
        integer FlsRbErasedValue [0..1]: 0..255, multiplicity set at pre-compile, origin=RB, set at pre-compile  # This parameter defines the erase value of the Data Flash (HW/target dependant configuration)
        container FeeRbSector [1..255]  # Contains the information of sector of the specific target
          integer FlsRbSectorSize: 1..4294967295, multiplicity set at pre-compile, set at pre-compile, symbolic-name-value=true  # Size of this sector in bytes
    container FeePublishedInformation [0..1]: multiplicity set at pre-compile  # FeePublishedInformation. | Additional published parameters not covered by CommonPublishedInformation container. | Note that these parameters do not have any configuration class setting, since they are published information.
      integer FeeBlockOverhead [0..0]: 0..65535, multiplicity set at pre-compile, set at published-information  # Block overhead. | Management overhead per logical block in bytes (block header size). | Note: If the management overhead depends on the block size or block location a formula has to be provided that allows the configurator to calculate the management overhead correctly. This tag is currently ignored.
      float FeeMaximumBlockingTime [0..0]: 0..Inf, multiplicity set at pre-compile, set at published-information  # Maximum block time. | The maximum time the FEE module's API routines shall be blocked (delayed) by internal operations. This tag is currently ignored. | Note: Internal operations in that case means operations that are not explicitly invoked from the upper layer module but need to be handled for proper operation of this module or the underlying memory driver. This tag is currently ignored.
      integer FeePageOverhead [0..0]: 0..65535, multiplicity set at pre-compile, set at published-information  # Page overhead. | Management overhead per page in bytes. | Note: If the management overhead depends on the block size or block location a formula has to be provided that allows the configurator to calculate the management overhead correctly. This tag is currently ignored.
    container FeeRbDebug [0..1]: multiplicity set at pre-compile  # Fee Debugging | Container for debugging switches.
      boolean FeeRbDebugBlock: multiplicity set at pre-compile, set at pre-compile, default-value=false  # Own debugging block to keep debugging information over resets. | Enables a Fee block owned by the Fee itself. This block holds the information about timing measurements and erase counters over resets. | true: Fee debug block enabled. false: Fee debug block disabled.
      boolean FeeRbDebugCheckFatEntries: multiplicity set at pre-compile, set at pre-compile, default-value=false  # Check that FAT entries for all required blocks are present in the FAT after FAT sector change. | After each FAT sector change check whether for a list of blocks of interest FAT entries were copied. This is useful for reset tests to keep the history of the dump for better analyzing situations with block loss. | true: Checking the FAT entries after FAT sector change enabled. false: Checking the FAT entries after FAT sector change disabled.
      boolean FeeRbDebugCheckLayout: multiplicity set at pre-compile, set at pre-compile, default-value=false  # Check the layout on startup. | During Fee startup a list of specified block is checked to be present with data or invalidated in the flash. If one of those blocks is missing the Fee goes into an endless loop in the init to avoid further changes of the DFLASH. This is useful for reset tests to preserve a certain dump in order to ease finding errors. | true: Checking the layout on startup enabled. false: Checking the layout on startup disabled.
      boolean FeeRbDebugDump: multiplicity set at pre-compile, set at pre-compile, default-value=false  # Dump the DFLASH on unexpected errors. | Whenever internally an unexpected error happens the DFLASH is dumped to a text file. This feature makes only sense when the Fee is running in a simulation on the PC. | true: Dump on unexpected error enabled. false: Dump on unexpected error disabled.
      boolean FeeRbDebugEraseCounters: multiplicity set at pre-compile, set at pre-compile, default-value=false  # Enable sector erase counter measurements. | Pre-processor switch to enable and disable erase counter measurements. | true: Erase counters enabled. false: Erase counters disabled.
      integer FeeRbDebugEraseCountersHistogramSize: 1..50, multiplicity set at pre-compile, set at pre-compile, symbolic-name-value=true, default-value=1  # Size of the erase counters histogram. | Number of slots in the histogram for erase counter measurement. | When erase counter measurement is enabled a histogram for delta erase counter measurement will be maintained one for each sector. It is log(2) scaled with an offset of 0. The bigger this histogram is, the bigger are the maximum values it can hold. On the other hand more RAM is consumed and the debug block (in case it is enabled) will also grow bigger to store the histogram. Every slot consumes 4 bytes (uint32). When erase counter measurement is turned off then this value has no effect.
      boolean FeeRbDebugTime: multiplicity set at pre-compile, set at pre-compile, default-value=false  # Enable timing measurements. | Pre-processor switch to enable and disable timing measurements. | true: Timing measurements enabled. false: Timing measurements disabled. In case timing measurement is enabled the following operations are measured: Main Function duration Init Read Write Invalidate Data sector change FAT sector change
      integer FeeRbDebugTimeHistogramSize: 1..50, multiplicity set at pre-compile, set at pre-compile, symbolic-name-value=true, default-value=1  # Size of the timing measurement histogram. | Number of slots in the histogram for timing measurement. | When time measurement is enabled a histogram for timing measurement will be maintained for all measured operations. The unit in this histogram is microseconds and it is log(2) scaled where the first basket has an offset of 0. The bigger this histogram is, the bigger are the maximum values it can hold. On the other hand more RAM is consumed and the debug block (in case it is enabled) will also grow bigger to store the histogram. Every slot consumes 4 bytes (uint32). When timing measurement is turned off then this value has no effect.
      reference FeeRbDebugCheckLayoutBlock [0..65535]: multiplicity set at pre-compile, set at pre-compile, destination=FeeBlockConfiguration  # Block which presence shall be checked | Every block that is named here is checked in the init for its presence when FeeRbDebugCheckLayout is enabled.
    container FeeRbDevice [0..1]: multiplicity set at pre-compile  # Fee Device | Container for FeeFsx flash specific parameters.
      container FeeRbDeviceFs2 [0..1]: multiplicity set at pre-compile  # FeeFs2 Flash Parameter | Container for FeeFs2 flash specific parameters.
        integer FeeRbDeviceFs2EraseCycles [0..1]: multiplicity set at pre-compile, origin=RB:13.1.0:2019-04-30, set at pre-compile  # Max number of erase cycles (only valid in case of machine type set to full manual configuration) | The maximum number of program/erase cycles of each flash cell. | This number is provided in the flash device sheet.
        integer FeeRbDeviceFs2FastModeMaxRead [0..1]: multiplicity set at pre-compile, origin=RB:13.1.0:2019-04-30, set at pre-compile  # Max byte read in fast mode (only valid in case of machine type set to full manual configuration or if suitable flash device selected e.g. external flash) | The maximum number of bytes to be read or compared in one cycle of flash driver's job processing function in fast mode. | The maximum number can be restricted for certain devices.
        integer FeeRbDeviceFs2FastModeMaxWrite [0..1]: multiplicity set at pre-compile, origin=RB:13.1.0:2019-04-30, set at pre-compile  # Max byte write in fast mode (only valid in case of machine type set to full manual configuration or if suitable flash device selected e.g. external flash) | The maximum number of bytes to be written in one cycle of the flash driver's job processing function in fast mode. | The maximum number can be restricted for certain devices.
        string FeeRbDeviceFs2FlsDeviceType [0..1]: multiplicity set at pre-compile, origin=RB:13.1.0:2019-04-30, set at pre-compile  # Fls device type (only valid in case of machine type set to full manual configuration) | Device type to be used by Fls. | Each flash device is separated into sub device types which have a dedicated address range and a page width for programming (smallest programmable unit). Please refer to flash driver documentation.
        string FeeRbDeviceFs2FlsMachineType [0..1]: multiplicity set at pre-compile, origin=RB:13.1.0:2019-04-30, set at pre-compile  # Fls machine type (only valid in case of machine type set to full manual configuration) | Machine type to be used by Fls. | Controller type to be configured. Please refer to flash driver documentation.
        string FeeRbDeviceFs2FlsSectorKey [0..1]: multiplicity set at pre-compile, origin=RB:13.1.0:2019-04-30, set at pre-compile  # Fls sector key (only valid in case of machine type set to full manual configuration) | Sector key to be used by Fls. | To find the right sector key, please refer to Fee documentation.
        boolean FeeRbDeviceFs2IsPreprogm [0..1]: multiplicity set at pre-compile, origin=RB:13.1.0:2019-04-30, set at pre-compile  # Flash performs preprogramming before erase (only valid in case of machine type set to full manual configuration) | Indicates if flash hardware internally pre-programs cells first before starting the erase. | true: Flash hardware pre-programs flash cells before erase. false: Flash hardware does not pre-program flash cells before erase.
        integer FeeRbDeviceFs2MaxEraseDisturbs [0..1]: multiplicity set at pre-compile, origin=RB:13.1.0:2019-04-30, set at pre-compile  # Max erase disturbs (only valid in case of machine type set to full manual configuration) | Maximum erase distance between the flash sectors. | All sectors must be used round-robin in order to prevent the accumulation of erase disturbs in static sectors. This information may be provided in the flash device sheet.
        integer FeeRbDeviceFs2MaxWordlineDfcts [0..1]: multiplicity set at pre-compile, origin=RB:13.1.0:2019-04-30, set at pre-compile  # Max wordline defects (only valid in case of machine type set to full manual configuration) | Maximum wordline defects to be handled.
        integer FeeRbDeviceFs2NormalModeMaxRead [0..1]: multiplicity set at pre-compile, origin=RB:13.1.0:2019-04-30, set at pre-compile  # Max byte read in normal mode (only valid in case of machine type set to full manual configuration or if suitable flash device selected e.g. external flash) | The maximum number of bytes to be read or compared in one cycle of the flash driver's job processing function in normal mode. | The maximum number can be restricted for certain devices.
        integer FeeRbDeviceFs2NormalModeMaxWrite [0..1]: multiplicity set at pre-compile, origin=RB:13.1.0:2019-04-30, set at pre-compile  # Max byte write in normal mode (only valid in case of machine type set to full manual configuration or if suitable flash device selected e.g. external flash) | The maximum number of bytes to be written in one cycle of the flash driver's job processing function in normal mode. | The maximum number can be restricted for certain devices.
        integer FeeRbDeviceFs2PageSize [0..1]: multiplicity set at pre-compile, origin=RB:13.1.0:2019-04-30, set at pre-compile  # Page size (only valid in case of machine type set to full manual configuration or if suitable flash device selected e.g. external flash) | Minimum number of bytes to be written within one write operation. | This is considered as the logical page size which shall be configured as multiples of the physical page size.
        integer FeeRbDeviceFs2PatternErased [0..1]: multiplicity set at pre-compile, origin=RB:13.1.0:2019-04-30, set at pre-compile  # Erase pattern (only valid in case of machine type set to full manual configuration) | Pattern for an erased byte in the flash. | Erase pattern is provided in the flash device sheet.
        integer FeeRbDeviceFs2PatternInvalidate [0..1]: multiplicity set at pre-compile, origin=RB:13.1.0:2019-04-30, set at pre-compile  # Invalidate pattern (only valid in case of machine type set to full manual configuration) | Pattern which can be used to invalidate flash data. | Usually the inverted erase pattern.
        integer FeeRbDeviceFs2SafetySpace [0..1]: multiplicity set at pre-compile, origin=RB:13.1.0:2019-04-30, set at pre-compile  # Safety space (only valid in case of machine type set to full manual configuration) | Number of bytes to be considered as safety space when starting a data sector reorganization.
        integer FeeRbDeviceFs2SectorSize [0..1]: multiplicity set at pre-compile, origin=RB:13.1.0:2019-04-30, set at pre-compile  # Sector size (only valid in case of machine type set to full manual configuration or if suitable flash device selected e.g. external flash) | Fee logical sector size. | Shall be configured as multiples of the physical sector size.
        integer FeeRbDeviceFs2SoftSectorReorgThd [0..1]: multiplicity set at pre-compile, origin=RB:13.1.0:2019-04-30, set at pre-compile  # Soft sector reorganization threshold | Soft sector reorganization threshold. | When the threshold is reached, soft sector reorganization will be issued. Hints: The threshold shall not be greater than the available effective flash memory space for data minus the size of the data layout. The threshold shall not be lower than the effective size of one logical sector.
        container FeeRbDeviceFs2SectorList [0..1]: multiplicity set at pre-compile  # Sector list | List of logical Fee sectors.
          container FeeRbDeviceFs2SectorDesc [0..32]: multiplicity set at pre-compile  # Sector descriptor | Sector descriptor.
            integer FeeRbDeviceFs2SectorStartAddress [0..1]: multiplicity set at pre-compile, origin=RB:13.1.0:2019-04-30, set at pre-compile  # Sector start address (only valid in case of machine type set to full manual configuration or if suitable flash device selected e.g. external flash) | Start address of each logical sector.

AUTOSAR XML (schema 4-2-2)
package /AUTOSAR_NvM/EcucModuleDefs
  module definition NvM: category=VENDOR_SPECIFIC_MODULE_DEFINITION, refined-module-def=NvM, variants pre-compile  # Memory: NVRAM Manager | [NVM539_Conf] Configuration of the NvM (Non volatile RAM Manager) module.
    container NvMBlockDescriptor [2..65535]: multiplicity set at pre-compile  # Block descriptor | [NVM061_Conf] Container for all block-specific configuration parameters. For each NvM block, one instance of this container shall be specified.
      enumeration NvMBlockCrcType [0..1]: multiplicity set at pre-compile, set at pre-compile, default-value=NVM_CRC16  # CRC type | [NVM476_Conf] Defines the CRC data width for the NVRAM block. Due to Autosar this parameter shall define the CRC data width for data in NV memory and for data in permanent RAM block. Currently this parameter defines the CRC data width only for data in permanent RAM block (see parameter NvMCalcRamBlockCrc). For data in NV memory the CRC will be always calculated by lower layers independently from this parameter.
        NVM_CRC8  # 8 bit CRC
        NVM_CRC16  # 16 bit CRC
        NVM_CRC32  # 32 bit CRC
      string NvMBlockHeaderInclude [0..1]: multiplicity set at pre-compile, set at pre-compile  # Header file to include | BSW_SWS_AR4_0_R2_NVRAMManager_Ext-2997] Defines a header file that shall be included. Only the header file name without the extension has to be entered here. For example Bsw_MemMap instead of Bsw_MemMap.h. If a header file is defined the declarations of the RAM data block (NvMRamBlockDataAddress) and the ROM data block (NvMRomBlockDataAddress) have to be done within this header-file by the user. If a header-file is defined for a specific NvM block a compile time check is carried out to check if the configured NvM block (NvMNvBlockLength) length matches the size of the data given in in the RAM data block (NvMRamBlockDataAddress) and the ROM data block (NvMRomBlockDataAddress). This check is done using the sizeof-operator and causes a compile time error in case of a mismatch. Note that the compile time check just can be carried out if for the NvM block the following two conditions are fulfilled: 1. Runtime RAM block handling is not used by this block (NvMRbRamBlockDataAddressString and NvMRbNvBlockLengthString are empty) 2. The values entered in the RAM data block (NvMRamBlockDataAddress) and the ROM data block (NvMRomBlockDataAddress) are names of a linker symbol, pointers or subelements of data structures declared in the header (e.g. e.g. MyVar, MyStruct.MyMember, MyArray[3], &MyVar, ...) but are not addresses in hexadecimal notation (e.g. 0x8000A000).
      integer NvMBlockJobPriority: 0..1, set at pre-compile  # Job priority | [NVM477_Conf] Defines the job priority for a NVRAM block. The current version of NvM supports two job priorities: 0 : Immediate priority, 1 : Standard priority. Immediate priority can be enabled only if priority jobs handling is enabled via the NvMJobPrioritization configuration paramter. Immediate priority blocks shall participate neither in multi-block-read (see also NvMSelectBlockForReadAll) nor in multi-block-write (see also NvMSelectBlockForWriteAll) operations. If an immediate block is selected for ReadAll or WriteAll, then it is not possible to queue an immediate write request for this block while the multiblock operation is being executed (as the state of this block would be PENDING (NVM385)).
      enumeration NvMBlockManagementType: set at pre-compile  # Block management type | [NVM062_Conf] Defines the block management type for the NVRAM block. An NvM block can be a native, a redundant or a dataset block.
        NVM_BLOCK_NATIVE  # Native
        NVM_BLOCK_REDUNDANT  # Redundant
        NVM_BLOCK_DATASET  # Dataset
      boolean NvMBlockUseAutoValidation [0..1]: multiplicity set at pre-compile, set at pre-compile, default-value=false  # Set block to changed during ValidateAll | [ECUC_NvM_00557] Defines whether a NVRAM block shall be processed during NvM_ValidateAll or not. This configuration parameter is only allowed to be set for NVRAM blocks which are configured to have a permanent RAM block or which are configured to use explicit synchronization mechanism.
      boolean NvMBlockUseCRCCompMechanism [0..1]: multiplicity set at pre-compile, set at pre-compile, default-value=false  # CRC compare mechanism | [ECUC_NvM_00556] Defines whether the CRC of the permanent RAM Block shall be compared during a write job with the CRC which was calculated during the last successful read or write job. This parameter can be set to true only if parameter NvMCalcRamBlockCrc is also true.
      boolean NvMBlockUseCrc: set at pre-compile  # Use CRC | [NVM036_Conf] Enables/disables CRC usage for the NVRAM block in NV memory. If enabled a CRC is calculated before a write operation which is then stored in the NV memory along with the block data. During a read operation this CRC is then checked again to ensure data integrity. Independant of parameter NvMBlockUseCrc the RTA-BSW MemStack always uses CRCs to ensure data integrity, but this is done on lower software layers (not NVM level) and it is not possible to deactive it. Due to this reason the parameter NvMBlockUseCrc has to be globally enabled by setting the common parameter NvMRbNvCrcEnable to TRUE if a CRC also should be used at NVM level. Just if both parameters NvMBlockUseCrc and NvMRbNvCrcEnable are set to true the CRC will be used for this block on NVM level. Hint: For the case that the complete RTA-BSW MemStack this does not affect any CRC useage on lower layers. Hint: If not the complete RTA-BSW MemStack is used then the common parameter NvMRbNvCrcEnable should be set to TRUE to ensure that CRCs are used at NVM level.
      boolean NvMBlockUseSyncMechanism: set at pre-compile, default-value=false  # Explicit synchronization | [NVM519_Conf] Enables/disables the explicit synchronization mechanism with a RAM mirror and callback routines for transferring data to and from NvM module's RAM mirror.
      boolean NvMBlockWriteProt: set at pre-compile  # Initially write protected | [NVM033_Conf] Enables/disables an initial write protection of the NV block.
      boolean NvMCalcRamBlockCrc [0..1]: multiplicity set at pre-compile, set at pre-compile, default-value=false  # CRC (re)calculation | [NVM119_Conf] Enables/disables the CRC (re)calculation for the permanent RAM block or NVRAM blocks which are configured to use explicit synchronization mechanism.
      function name NvMInitBlockCallback [0..1]: multiplicity set at pre-compile, set at pre-compile, default-value=NULL_PTR  # Initialization callback | [NVM116_Conf] Name of the block-specific callback routine which shall be invoked if no ROM data is available for initialization of the NVRAM block. If you explicitly want to specify that no such callback routine shall be called, enter NULL_PTR here. For a user located above RTE and if NvMRbGenRteServicePort is set to TRUE, the name of this callback has to be set as: "Rte_Call_ _Init_InitBlock". The signature of the callback-function has to be: Std_ReturnType CallbackName(void). It is not allowed to call any NvM or DEM functions from within this callback function!
      integer NvMMaxNumOfReadRetries: 0..0, set at pre-compile  # Max. number of read retries | [NVM533_Conf] Defines the maximum number of read retries. The current version of NvM does not support this feature, so this parameter has always to be set to 0.
      integer NvMMaxNumOfWriteRetries: 0..0, set at pre-compile  # Max. number of write retries | [NVM499_Conf] Defines the maximum number of write retries. The current version of NvM does not support this feature, so this parameter has always to be set to 0.
      integer NvMNvBlockBaseNumber [0..0]: 1..65534, set at pre-compile  # Block base number | [NVM478_Conf] According to the NvM specification, this setting shall perform the link to the IDs used in the memory hardware abstraction. Since this NvM implementation uses a different (more efficient) identification scheme towards the memory hardware abstraction, this parameter is and remains superfluous.
      integer NvMNvBlockLength [0..1]: 1..65407, multiplicity set at pre-compile, set at pre-compile  # Block length (fixed number) | [NVM479_Conf] Defines the NV block data length in bytes. (Hint: NvM keeps an internal reserve of 128 bytes, so the maximum block length is 65535-128=65407 bytes.)
      integer NvMNvBlockNum: 1..255, set at pre-compile  # Number of NV blocks | [NVM480_Conf] Defines the number of multiple NV blocks in a contiguous area according to the given block management type. The allowed number of NV blocks is 1 for a native block, 2 for a redundant block and 1..255 for a dataset block. Additionally, the following condition has to be satisfied: NvMNvBlockNum + NvMRomBlockNum <= 255 [NVM444]
      integer NvMNvramBlockIdentifier [0..1]: 2..65534, multiplicity set at pre-compile, set at pre-compile, symbolic-name-value=true  # Block identifier | [NVM481_Conf] Identification of a NVRAM block via a unique block identifier which is used at the NvM API functions (not towards the memory hardware abstraction and also not on the media). The value 0 is reserved for multi block related operations and their results. The value 1 is reserved for the block containing the configuration ID used as part of the dynamic configuration feature. The identifiers of all blocks must be contiguous, i.e. there must not be any gaps in the sequence of block identifiers. All multi block operations operate in an ascending ID sequence, which means that blocks with lower IDs are read and written earlier than blocks with higher IDs. If you don't explicitly specify an identifier for a block, such an identifier is automatically assigned by NvM.
      integer NvMNvramDeviceId: 0..254, set at pre-compile  # Device ID | [NVM035_Conf] Identification of the device where the NVRAM block is located. In contrast to AUTOSAR's NvM specification, this is not a parameter derived from the block configuration on the Ea/Fee module configuration, but the device identifier is directly specified here (and the Ea/Fee block configuration is completely auto-generated). Additionally, device ID 0 is fixed to address Fee and device IDs 1 onwards address Eep devices.
      string NvMRamBlockDataAddress [0..1]: multiplicity set at pre-compile, set at pre-compile, default-value=NULL_PTR  # RAM block data address | [NVM482_Conf] Defines the start address of permanent RAM block data. You may either give an address in hexadecimal notation here (e.g. 0x1234ABCD) or the name of a linker symbol (e.g. MyTestRamBlock) or the address (e.g. &MyTestRamBlock). If you explicitly want to specify that no permanent RAM block shall be used for this block, enter NULL_PTR here. The NvM users shall allocate each NvM RAM block in a RAM section called "saved zone". When using AUTOSAR mechanisms for memory allocation, the memory class _SEC_VAR_SAVED_ZONE_ shall be used. Caution: Configuring the same permanent RAM for more than one NvM block is possible but highly not recommended. In fact, an owner of an NvM block sharing the same permanent RAM block with other NvM blocks has to be aware that the owners of those other blocks could also modify the content of the shared RAM block. Hence, a certain synchronization on read/write accesses, to the common RAM block, needs to be established between different NvM blocks' owners sharing a common permanent RAM block.
      integer NvMRbBlockPersistentId [0..1]: 1..65534, multiplicity set at pre-compile, origin=RB:0.2.0:2012-03-01, set at pre-compile  # Persistent ID | [BSW_SWS_AR4_0_R2_NVRAMManager_Ext-2749] Defines a unique ID for this block representing its block-specific properties. It shall be changed if and only if these block-specific properties are modified in a non-compatible way. This ID is stored on the memory media and is the basis for block identification in the memory drivers (Fee, Eep). In contrast to the IDs which are taken for block identification at the C API, this ID is (for a given block) identical in all modules of the memory stack. Its value typically remains the same even if other blocks are added to or removed from the block layout. It is not allowed that any two blocks have the same persistent ID. Additionally, the persistent IDs 0 and 65535 are reserved for internal use. If you don't explicitly specify a persistent ID for a block, such an identifier is automatically assigned by NvM based on the block name and block length.
      boolean NvMRbFirstReadDataMigration [0..1]: multiplicity set at pre-compile, origin=RB:9.0.0:2016-11-04, set at pre-compile, default-value=false  # First Read Data Migration | [BSW_SWS_AR4_0_R2_NVRAMManager_Ext-3027] Enables/disables First Read Data Migration feature for this block. When First Read Data Migration is enabled a read job is also performed when a missmatch between the configured NV block length and the block length on medium (EEPROM) occurs. In case the NV block length is smaller then the block on medium the remaining data are discarded. In case the NV block length is bigger then the block on medium the remaining data are filled with zero. If the feature is disabled and a length missmatch occurs the read job is not performed.
      boolean NvMRbGenRteAdminPort [0..1]: multiplicity set at pre-compile, origin=RB:1.4.0:2013-05-15, set at pre-compile, default-value=false  # Generate RTE admin port | Defines whether an administrative port shall be generated for this block. If enabled, an RTE P-Port of this kind is created for this NvM block which allows to invoke administrative operations such as SetBlockProtection via RTE. But since the demand for this feature is rather rare, the creation of administrative ports has to be explicitly enabled by setting this configuration parameter to true. Please note that enabling this feature is only possible if the RTE service port creation is also enabled for this block.
      boolean NvMRbGenRteServicePort [0..1]: multiplicity set at pre-compile, origin=RB:1.4.0:2013-05-15, set at pre-compile, default-value=true  # Generate RTE service port | Defines whether a service port shall be generated for this block. Per default, an RTE P-Port is created for each NvM block which allows to invoke service operations such as ReadBlock or WriteBlock via RTE. In cases where callbacks have been configured for this block, this configuration parameter also controls the creation of the corresponding R-Ports. But since not all NvM blocks are accessed via RTE, the creation of all these RTE ports for this block can be suppressed by setting this configuration parameter to false.
      boolean NvMRbInitBlockAtLayoutChange [0..1]: multiplicity set at pre-compile, origin=RB:6.0.0:2015-07-31, set at pre-compile, default-value=false  # Initialize block in case of a layout change | [BSW_SWS_AR4_0_R2_NVRAMManager_Ext-2881] Defines whether the NvM block shall be initialized if a block layout change is detected. In such case, the block is firstly read during ReadAll. If the block couldn't be retrieved from the medium, initialization data (from the ROM block or via the initialization callback) is written to the medium after the execution of ReadAll. This configuration parameter is allowed to be set to "true" under the following conditions: (1) The common configuration parameter NvMRbInitAtLayoutChange is set to "true". (2) The block is native or redundant (3) The block has a standard priority (4) The block has a ROM block or an initialization callback (5) The block has a RAM block or is configured with explicit synchronization (6) The block is configured for ReadAll (7) Additionally, if dynamic configuration is enabled, then this block has to be resistant to sw change. Hint: The block is initialized (i.e. written to the medium after ReadAll) if a configuration ID mismatch is detected. Therefore, when configuring a block with this feature, a new compiled configuration ID should be configured via the NvMCompiledConfigId parameter (otherwise the block wouldn't be initialized). In later versions, the compiled ID will be automatically generated and it wouldn't be necessary anymore to update it when adding/reconfiguring an NvM block with the "init at layout change" feature.
      boolean NvMRbNoFallback [0..1]: multiplicity set at pre-compile, origin=RB:6.1.0:2015-10-30, set at pre-compile, default-value=false  # No fallback to the old value | [BSW_SWS_AR4_0_R2_NVRAMManager_Ext-2925] This tag activates or deactivates a fallback mechanism to older copies of the same block. It is only evaluated for blocks located on Fee and ignored for blocks located on Ea. By default, this feature is set to false which is the standard behavior for Fee blocks (i.e. older values of the same block are preferred over delivering no block data at all). In Ea, older values are never available by principle and therefore blocks located on Ea will behave as if this tag had been set to true, regardless of its actual setting. If this tag is set to true and the corresponding block is located on Fee, older values will not be returned if the latest block instance is completely corrupted. In this case, inconsistent state is reported instead. Caution: When enabling this feature for the first time, already existing instances of the corresponding block on the media might not be readable anymore. Additionally, some Fee configurations might not support this feature at all. Please refer to the Fee documentation for details.
      string NvMRbNvBlockLengthString [0..1]: multiplicity set at pre-compile, origin=RB:9.0.0:2016-11-04, set at pre-compile  # Block length (C expression) | [BSW_SWS_AR4_0_R2_NVRAMManager_Ext-2996] Defines the NV block data length in bytes. All possible R-VALUES in C programming language except stand alone numerical literals are supported. A semicolon at the end of the C expression is not necessary. For numerical literals use NvMNvBlockLength or a define directive instead. For example if the block length Null shall be configured use a define directive like NV_BLOCK_LENGTH_NULL. All R-Values used here have to be declared by the user. Furthermore the user has to make it known to NvM_Cfg.c. Therefore the configuration parameter NvMBlockHeaderInclude has to be used.
      string NvMRbRamBlockDataAddressString [0..1]: multiplicity set at pre-compile, origin=RB:9.0.0:2016-11-04, set at pre-compile, default-value=NULL_PTR  # RAM block data address (C expression) | [BSW_SWS_AR4_0_R2_NVRAMManager_Ext-] Defines the RAM block data length as C expression. All possible R-VALUES in C programming language are supported. A semicolon at the end of the C expression is not necessary. All R-Values used here have to be declared by the user. Furthermore the user has to make it known to NvM_Cfg.c. Therefore the configuration parameter NvMBlockHeaderInclude has to be used.
      boolean NvMRbRamInitUnconditional [0..1]: multiplicity set at pre-compile, origin=RB:11.1.0:2018-04-31, set at pre-compile, default-value=false  # RAM init unconditional | [BSW_SWS_AR4_0_R2_NVRAMManager_Ext-3175] This parameter defines whether a permanent RAM block will be initialized unconditionally. - true: permanent RAM block will be initialized even if it has remained unchanged after last reset (common parameter NvMRbRamInitCheck = NVM_RAM_INIT_CHECK_QUICK) - false: permanent RAM block will be initialized dependent on the state of the parameter NvMRbRamInitCheck
      boolean NvMRbResistantToLayoutRemoval [0..1]: multiplicity set at pre-compile, origin=RB:2.1.0:2013-10-28, set at pre-compile, default-value=false  # Resistant to layout removal | [BSW_SWS_AR4_0_R2_NVRAMManager_Ext-2783] Defines whether the NvM block is resistant to layout removal. Once configured and written, lower layers keep this block saved on the persistent media even when this block is not part of the layout anymore (i.e. when the configuration changes and this block is removed from the layout). In this case, this block is not accessible from NvM. If the configuration changes again and this block is reconfigured, access to this block is reenabled again. If dynamic configuration is active (via NvMDynamicConfiguration), then resistant-to-layout-removal blocks must be resistant-to-changed-SW (configurable via NvMResistantToChangedSw parameter).
      boolean NvMRbSelectBlockForFirstInitAll [0..1]: multiplicity set at pre-compile, origin=RB:3.1.0:2014-04-25, set at pre-compile, default-value=false  # Initialize block during FirstInitAll | [BSW_SWS_AR4_0_R2_NVRAMManager_Ext-2828] Defines whether a NvM block shall be processed during NvM_Rb_FirstInitAll or not. This configuration parameter is allowed to be set in the following cases: (i) The NvM block (is native or redundant) and (has a ROM block or an InitblockCallback) and (has a permanent RAM block or is configured to use explicit synchronization mechanism) (ii) The NvM block (is native or redundant) and (has no ROM block and no InitBlockCallback). In this case the NvM block is simply invalidated by the NvM_Rb_FirstInitAll job. (iii) The NvM block is of type NVM_BLOCK_DATASET. In this case, all the NV blocks of the NvM block are invalidated by the NvM_Rb_FirstInitAll job.
      function name NvMRbSingleBlockStartCallback [0..1]: multiplicity set at pre-compile, origin=RB:9.0.0:2016-11-04, set at pre-compile, default-value=NULL_PTR  # Single block start callback | [BSW_SWS_AR4_0_R2_NVRAMManager_Ext_3062] Name of the block-specific callback routine which shall be invoked on start of each access to the actual memory media. If you explicitly want to specify that no such callback routine shall be called, enter NULL_PTR here. The signature of the callback-function has to be: Std_ReturnType CallbackName(uint8 ServiceId). It is not allowed to call any NvM or DEM functions from within this callback function!
      boolean NvMRbWriteCounter [0..1]: multiplicity set at pre-compile, origin=RB:17.0.0:2021-01-31, set at pre-compile, default-value=false  # Write Counter | [BSW_SWS_AR_NVRAMManager_Ext-3296] This parameter defines whether the write counter is enabled/disabled for a NVRAM block. Attention: When write counter is enabled the size of data stored in non-volatile memory changes (block-size = user-data-size + write-counter-size) with all its implications on backwards-compatibility!
      function name NvMReadRamBlockFromNvCallback [0..1]: multiplicity set at pre-compile, set at pre-compile, default-value=NULL_PTR  # Read RAM copy callback | [NVM521_Conf] Name of the block-specific callback routine which shall be invoked in order to let the application copy data from the NvM module's mirror to RAM block (see also the NvMBlockUseSyncMechanism parameter). If you explicitly want to specify that no such callback routine shall be called, enter NULL_PTR here. For a user located above RTE and if NvMRbGenRteServicePort is set to TRUE, the name of this callback has to be set as: "Rte_Call_ _Mirror_ReadRamBlockFromNvmNvM". The signature of the callback-function has to be: Std_ReturnType CallbackName(void* NvMBuffer). It is not allowed to call any NvM or DEM functions from within this callback function!
      boolean NvMResistantToChangedSw: set at pre-compile  # Resistant to changed SW | [NVM483_Conf] Defines whether a NVRAM block shall be treated as resistant to configuration changes or not (see also the NvMCompiledConfigId and NvMDynamicConfiguration parameters for a description of this mechanism).
      string NvMRomBlockDataAddress [0..1]: multiplicity set at pre-compile, set at pre-compile, default-value=NULL_PTR  # ROM block data address | [NVM484_Conf] Defines the start address of ROM block data. You may either give an address in hexadecimal notation here (e.g. 0x2345BCDE) or the name of a linker symbol (e.g. MyTestRomBlock) or the address (e.g. &MyTestRomBlock). If you explicitly want to specify that no ROM block shall be available for this block, enter NULL_PTR here. The NvM users shall allocate each NvM ROM block in the so called "saved recovery zone". When using AUTOSAR mechanisms for memory allocation, the memory class <MODULE>_SEC_CONST_SAVED_RECOVERY_ZONE_<SIZE> shall be used.
      integer NvMRomBlockNum: 0..254, set at pre-compile  # Number of ROM blocks | [NVM485_Conf] Defines the number of multiple ROM blocks in a contiguous area according to the given block management type. The allowed number of ROM blocks is 0..1 for a native or a redundant block and 0..254 for a dataset block. Additionally, the following condition has to be satisfied: NvMNvBlockNum + NvMRomBlockNum <= 255 [NVM444]
      boolean NvMSelectBlockForReadAll [0..1]: multiplicity set at pre-compile, set at pre-compile, default-value=false  # Read block during ReadAll | [NVM117_Conf] Defines whether a NVRAM block shall be processed during NvM_ReadAll or not. This configuration parameter is only allowed to be set for NVRAM blocks which are configured to have a permanent RAM block or which are configured to use explicit synchronization mechanism. Additionally, dataset blocks (configurable via NvMBlockManagementType parameter) as well as immediate priority blocks (configurable via NvMBlockJobPriority parameter) are not allowed to be selected for NvM_ReadAll.
      boolean NvMSelectBlockForWriteAll [0..1]: multiplicity set at pre-compile, set at pre-compile, default-value=false  # Write block during WriteAll | [NVM549_Conf] Defines whether a NVRAM block shall be processed during NvM_WriteAll or not. This configuration parameter is only allowed to be set for NVRAM blocks which are configured to have a permanent RAM block or which are configured to use explicit synchronization mechanism.
      function name NvMSingleBlockCallback [0..1]: multiplicity set at pre-compile, set at pre-compile, default-value=NULL_PTR  # Single block callback | [NVM506_Conf] Name of the block-specific callback routine which shall be invoked on termination of each access to the actual memory media. If you explicitly want to specify that no such callback routine shall be called, enter NULL_PTR here. For a user located above RTE and if NvMRbGenRteServicePort is set to TRUE, the name of this callback has to be set as: "Rte_Call_ _Finished_JobFinished". The signature of the callback-function has to be: Std_ReturnType CallbackName(uint8 ServiceId, NvM_RequestResultType JobResult). It is not allowed to call any NvM or DEM functions from within this callback function!
      boolean NvMStaticBlockIDCheck: set at pre-compile  # Static block ID check | [NVM532_Conf] Enables/disables the static block ID check for this block. The current version of NvM does not support this feature, so this parameter has currently always to be set to false.
      boolean NvMWriteBlockOnce: set at pre-compile  # Write block once | [NVM072_Conf] Enables/disables automatic write protection of this block once it has been successfully read from or written to the memory media. This protects the block data to be overwritten once it has been successfully written. Please note that the fact that the block data has been successfully written is lost after NvM_Init; you typically recover this information by trying to read the block via NvM_ReadAll or NvM_ReadBlock before attempting any write/invalidate/erase operation on blocks configured to be written only once. An NvM block configured with the "Write Once" is allowed to be initialized at layout change (please see NvMRbInitBlockAtLayoutChange configuration parameter). If the block is initialized (i.e. its recovery data is written to the medium after ReadAll), attempting any write/invalidate/erase operation on this block will fail.
      function name NvMWriteRamBlockToNvCallback [0..1]: multiplicity set at pre-compile, set at pre-compile, default-value=NULL_PTR  # Write RAM copy callback | [NVM520_Conf] Name of the block-specific callback routine which shall be invoked in order to let the application copy data from RAM block to the NvM module's mirror (see also the NvMBlockUseSyncMechanism parameter). If you explicitly want to specify that no such callback routine shall be called, enter NULL_PTR here. For a user located above RTE and if NvMRbGenRteServicePort is set to TRUE, the name of this callback has to be set as: "Rte_Call_ _Mirror_WriteRamBlockToNvmNvM". The signature of the callback-function has to be: Std_ReturnType CallbackName(void* NvMBuffer). It is not allowed to call any NvM or DEM functions from within this callback function!
      boolean NvMWriteVerification: set at pre-compile  # Write verification | [NVM534_Conf] Enables/disables write verification. The current version of NvM does not support this feature, so this parameter has currently always to be set to false.
      integer NvMWriteVerificationDataSize: 0..65535, set at pre-compile  # Write verification data size | [NVM538_Conf] Defines the number of bytes to compare in each step when comparing the content of a RAM Block and a block read back during write verification. This parameter is ignored if the write verification feature is disabled for this block.
      container NvMRbSecServices [0..1]: multiplicity set at pre-compile  # Configuration for cryptographic services | Description
        boolean NvMRbAddEncryption [0..1]: multiplicity set at pre-compile, origin=RB:15.0.0:2020-01-31, set at pre-compile, default-value=false  # Add block encryption | [BSW_SWS_AR4_0_R2_NVRAMManager_Ext-3249] Defines whether user data in NVRAM block shall be encrypted in NV memory.
        boolean NvMRbAddRandom [0..1]: multiplicity set at pre-compile, origin=RB:15.0.0:2020-01-31, set at pre-compile, default-value=false  # Add random number to encrypted data | [BSW_SWS_AR4_0_R2_NVRAMManager_Ext-3250] Defines whether a random number shall be used for cryptographic services.
        boolean NvMRbAddSignature [0..1]: multiplicity set at pre-compile, origin=RB:15.0.0:2020-01-31, set at pre-compile, default-value=false  # Add signature | [BSW_SWS_AR4_0_R2_NVRAMManager_Ext-3251] Defines whether user data in NVRAM block shall be signed in NV memory. If NvM signs user data then the persistent ID of the NVRAM block will be added to user data before signing.
        integer NvMRbAssociatedDataLength [0..1]: 0..65535, multiplicity set at pre-compile, origin=RB:15.0.0:2020-01-31, set at pre-compile  # Associated data length | [BSW_SWS_AR4_0_R2_NVRAMManager_Ext-3267] Defines the length of associated data in bytes used for AEAD encryption. If this parameter is defined then NvM will use Csm job for AEAD encryption.
        string NvMRbAssociatedDataPtr [0..1]: multiplicity set at pre-compile, origin=RB:15.0.0:2020-01-31, set at pre-compile, default-value=NULL_PTR  # Pointer to the associated data | [BSW_SWS_AR4_0_R2_NVRAMManager_Ext-3268] Defines the pointer to the associated data used for AEAD encryption. You may either give an address in hexadecimal notation here (e.g. 0x1234ABCD) or the name of a linker symbol (e.g. MyAssociatedData) or the address (e.g. &MyAssociatedData). It is also possible to specify no associated data by entering NULL_PTR. If this parameter is defined then NvM will use an AEAD encryption Csm job.
        integer NvMRbEncryptedDataLength [0..1]: 0..65407, multiplicity set at pre-compile, origin=RB:15.0.0:2020-01-31, set at pre-compile  # Encrypted data length | [BSW_SWS_AR4_0_R2_NVRAMManager_Ext-3252] Defines the length of encrypted user data in bytes. Note: The length depends on following criteria: - user data length (s. parameter NvMNvBlockLength) - referenced encryption algorithm (s. parameters NvMRbCsmJobEncryptRef and NvMRbCsmJobDecryptRef) - optional random number length
        integer NvMRbRandomLength [0..1]: 0..65535, multiplicity set at pre-compile, origin=RB:15.0.0:2020-01-31, set at pre-compile  # Random number length | [BSW_SWS_AR4_0_R2_NVRAMManager_Ext-3253] Defines the length of random number in bytes used for user data encryption.
        integer NvMRbSignatureLength [0..1]: 0..65535, multiplicity set at pre-compile, origin=RB:15.0.0:2020-01-31, set at pre-compile  # Signature length | [BSW_SWS_AR4_0_R2_NVRAMManager_Ext-3254] Defines the length of signature in bytes used to sign user data in NV memory.
        integer NvMRbTagLength [0..1]: 0..65535, multiplicity set at pre-compile, origin=RB:15.0.0:2020-01-31, set at pre-compile  # Tag length | [BSW_SWS_AR4_0_R2_NVRAMManager_Ext-3269] Defines the length of the tag in bytes used for AEAD encryption. If this parameter is defined then NvM will use Csm job for AEAD encryption.
        symbolic name reference NvMRbCsmJobDecryptRef [0..1]: multiplicity set at pre-compile, origin=RB:15.0.0:2020-01-31, set at pre-compile, destination=CsmJob  # Csm job for decryption | [BSW_SWS_AR4_0_R2_NVRAMManager_Ext-3255] Reference to the Csm job used for decryption of user data. If the Csm job reference uses AEAD algorithm then parameters NvMRbAssociatedDataLength, NvMRbAssociatedDataPtr and NvMRbTagLength shall be defined.
        symbolic name reference NvMRbCsmJobEncryptRef [0..1]: multiplicity set at pre-compile, origin=RB:15.0.0:2020-01-31, set at pre-compile, destination=CsmJob  # Csm job for encryption | [BSW_SWS_AR4_0_R2_NVRAMManager_Ext-3256] Reference to the Csm job used for encryption of user data. If the Csm job reference uses AEAD algorithm then parameters NvMRbAssociatedDataLength, NvMRbAssociatedDataPtr and NvMRbTagLength shall be defined.
        symbolic name reference NvMRbCsmJobRandomRef [0..1]: multiplicity set at pre-compile, origin=RB:15.0.0:2020-01-31, set at pre-compile, destination=CsmJob  # Csm job to get a random number used for encryption | [BSW_SWS_AR4_0_R2_NVRAMManager_Ext-3257] Reference to the Csm job to get a random number used for cryptographic services.
        symbolic name reference NvMRbCsmJobSignatureGenerateRef [0..1]: multiplicity set at pre-compile, origin=RB:15.0.0:2020-01-31, set at pre-compile, destination=CsmJob  # Csm job to generate a signature | [BSW_SWS_AR4_0_R2_NVRAMManager_Ext-3258] Reference to the Csm job to generate a signature for user data in NV memory.
        symbolic name reference NvMRbCsmJobSignatureVerifyRef [0..1]: multiplicity set at pre-compile, origin=RB:15.0.0:2020-01-31, set at pre-compile, destination=CsmJob  # Csm job to verify a signature | [BSW_SWS_AR4_0_R2_NVRAMManager_Ext-3259] Reference to the Csm job to verify a signature from NV memory.
      choice container NvMTargetBlockReference [0..0]  # Reference to block in media | [NVM486_Conf] According to the NvM specification, this container shall collect all references to the related block configuration in Ea resp. Fee. Since this NvM implementation entirely generates this related block configuration, this container together with its contained reference parameters is and remains superfluous.
        container NvMEaRef [0..1]: multiplicity set at pre-compile  # Reference to block in serial EEPROM | [NVM487_Conf] Container for block-specific Ea parameters/references. Not used in this NvM implementation.
          symbolic name reference NvMNameOfEaBlock [0..0]: set at pre-compile, destination=EaBlockConfiguration  # Reference to block in serial EEPROM | [NVM488_Conf] Reference to block configuration in Ea module. Not used in this NvM implementation.
        container NvMFeeRef [0..1]: multiplicity set at pre-compile  # Reference to block in flash EEPROM emulation | [NVM489_Conf] Container for block-specific Fee parameters/references. Not used in this NvM implementation.
          symbolic name reference NvMNameOfFeeBlock [0..0]: set at pre-compile, destination=FeeBlockConfiguration  # Reference to block in flash EEPROM emulation | [NVM490_Conf] Reference to block configuration in Fee module. Not used in this NvM implementation.
    container NvMCommon  # Common options | [NVM028_Conf] Container for common (i.e. not block-specific) configuration options.
      enumeration NvMApiConfigClass: set at pre-compile  # API class | [NVM491_Conf] Allows to configure the feature set supported by the NvM service. Higher API classes mean more features at the expense of higher resource usage. Lower API classes mean less features but a smaller memory footprint. Please relate to the NvM documentation for a detailed description of which API class contains which set of features.
        NVM_API_CONFIG_CLASS_3  # API Class 3
      boolean NvMBswMMultiBlockJobStatusInformation [0..1]: multiplicity set at pre-compile, set at pre-compile, default-value=false  # Inform BswM about the multiblock job status | [BSW_SWS_AR4_0_R2_NVRAMManager_Ext-2803] Enables/disables the notification of BswM about the current status of the multiblock job. The notification is made by invoking the function BswM_NvM_CurrentJobMode when multiblock operations are started, finished or canceled. If this notification is enabled, then a configured multiblock callback (configurable via NvMMultiBlockCallback) is not fired (BSW_SWS_AR4_0_R2_NVRAMManager_Ext-2804).
      integer NvMCompiledConfigId: 0..65535, set at pre-compile  # Compiled configuration ID | [NVM492_Conf] Configuration ID uniquely identifying the NV memory layout version. This ID is used for compatibility decisions during NvM_ReadAll if dynamic configuration feature of NvM is enabled (see also the NvMDynamicConfiguration parameter) or if the initialization of blocks at a layout change is enabled (see also the NvMRbInitAtLayoutChange parameter). This parameter is also used for the "initialization at layout change feature" (see also NvMRbInitBlockAtLayoutChange parameter). The configuration of the compiled ID is currently mandatory. In later versions, if this ID is not manually configured, NvM will generate it automatically from the values of the following configuration parameters of each NvM block in the layout: NvMNvBlockLength, NvMNvBlockNum, NvMBlockManagementType, NvMRbBlockPersistentId, NvMRbInitBlockAtLayoutChange.
      integer NvMCrcNumOfBytes: 1..65535, set at pre-compile  # Number of CRC bytes | [NVM493_Conf] If CRC (re-) calculation is configured for at least one permanent RAM block, this parameter defines the maximum number of bytes which shall be processed within one cycle of job processing.
      integer NvMDatasetSelectionBits [0..0]: 0..8, set at pre-compile  # Number of data selection bits | [NVM494_Conf] According to the NvM specification, this setting defines the number of least significant bits which shall be used to address a certain dataset of a NVRAM block within the interface to the memory hardware abstraction. Since this NvM implementation uses a different (more efficient) identification scheme towards the memory hardware abstraction, this parameter is and remains superfluous.
      boolean NvMDevErrorDetect: set at pre-compile  # Development error detection | [NVM495_Conf] Enables/disables the detection and notification of development errors. If this parameter is enabled, then extended error checking is performed during runtime; any errors detected by these checks are reported to the Det module. This feature should be switched off in series software.
      boolean NvMDrvModeSwitch: set at pre-compile  # Driver mode switch | [NVM496_Conf] Enables/disables switching memory drivers to fast mode during performing NvM_ReadAll and NvM_WriteAll. Fast node is not and will not be supported by layers underneath NvM. Therefore, NvM does not support this feature, so this parameter has currently always to be set to false.
      boolean NvMDynamicConfiguration: set at pre-compile  # Dynamic configuration | [NVM497_Conf] Enables/disables the dynamic configuration management feature. If enabled, the currently configured compiled configuration ID (see NvMCompiledConfigId parameter) is compared against the configuration ID stored on the memory media during NvM_ReadAll. If these ID's don't match, only the blocks marked as being resistant to SW changes (see also the NvMResistantToChangedSw parameter) are read from the memory media. If this parameter is disabled, NvM_ReadAll is processed without taking care of any possibly stored configuration ID.
      boolean NvMJobPrioritization: set at pre-compile  # Job prioritization | [NVM498_Conf] Enables/disables job prioritization handling.
      float NvMMainFunctionPeriod: 0.., set at pre-compile  # Main function period | [ECUC_NvM_00555] Defines the period between successive calls to the NvM main function in seconds. In case NvM main function is scheduled via RTE in a timed task the minimum value is 1.0e-7 [s].
      function name NvMMultiBlockCallback [0..1]: multiplicity set at pre-compile, set at pre-compile  # Multiblock callback | [NVM500_Conf] Name of the common callback routine which shall be invoked on termination of each asynchronous multi block request (NvM_Rb_FirstInitAll, NvM_ReadAll, removing of non-resistant to changed SW blocks or NvM_WriteAll). If you explicitly want to specify that no such callback routine shall be called, enter NULL_PTR here. It is not allowed to call any NvM or DEM functions from within this callback function!
      boolean NvMPollingMode: set at pre-compile  # Polling mode | [NVM501_Conf] Defines the way how NvM communicates to the memory media drivers. If set to true, the NvM_MainFunction polls the status from these drivers if some operation is ongoing. If set to false, the media drivers asynchronously report any changes in the operation status via dedicated callback functions provided by NvM. NvM does not support asynchronous notifications from the memory media drivers, so this parameter has currently always to be set to true.
      boolean NvMRbAuxInterface [0..1]: multiplicity set at pre-compile, origin=RB:7.0.0:2016-01-31, set at pre-compile, default-value=false  # Auxiliary interface | [BSW_SWS_AR4_0_R2_NVRAMManager_Ext-2945] Enables/disables the auxiliary service interface. This interface allows a special "auxiliary" user to trigger NvM single-block jobs for arbitrary blocks which do not interfere with jobs or states of "regular" users.
      boolean NvMRbCommonCalcRamBlockCrc [0..1]: multiplicity set at pre-compile, origin=RB:13.1.0:2019-03-31, set at pre-compile, default-value=false  # Common CRC (re)calculation | [BSW_SWS_AR4_0_R2_NVRAMManager_Ext-3186] Defines the default value for parameters NvMCalcRamBlockCrc and NvMBlockUseCRCCompMechanism. If this parameter is set to true then default value of parameters NvMCalcRamBlockCrc and NvMBlockUseCRCCompMechanism is true for all NVRAM blocks for which these parameters can be true. I.e. for all NVRAM blocks with permanent RAM blocks or which are configured to use explicit synchronization mechanism. For NVRAM blocks which have not configured a CRC type the NvM will use the default CRC type of 16 bit (NVM_CRC16).
      boolean NvMRbCommonWriteCounter [0..1]: multiplicity set at pre-compile, origin=RB:17.0.0:2021-01-31, set at pre-compile, default-value=false  # Common write counter | [BSW_SWS_AR_NVRAMManager_Ext-3295] Defines the default value for the block specific parameter NvMRbWriteCounter. - true: default value of the parameter NvMRbWriteCounter is true for all NVRAM blocks. I.e. the write counter is enabled for all NVRAM blocks and disabled only for NVRAM blocks where the parameter NvMRbWriteCounter is explicitely set to false. - false: default value of the parameter NvMRbWriteCounter is false for all NVRAM blocks. I.e. the write counter is disabled for all NVRAM blocks and enabled only for NVRAM blocks where the parameter NvMRbWriteCounter is explicitely set to true.
      enumeration NvMRbGenArxmlVersion [0..1]: multiplicity set at pre-compile, origin=RB:0.2.0:2012-03-01, set at pre-compile, default-value=NVM_GEN_ARXML_VERSION_402  # Version of generated ARXML | [BSW_SWS_AR4_0_R2_NVRAMManager_Ext-2746] Version of the generated ARXML file(s).
        NVM_GEN_ARXML_VERSION_402  # 4.0R2
      boolean NvMRbInitAtLayoutChange [0..1]: multiplicity set at pre-compile, origin=RB:6.0.0:2015-07-31, set at pre-compile, default-value=false  # Initialize blocks at a layout change | [BSW_SWS_AR4_0_R2_NVRAMManager_Ext-2893] Enables/disables the initialization of NvM blocks having the configuration parameter NvMRbInitBlockAtLayoutChange set to "true". This initialization is perfomed in case a layout change is detected.
      enumeration NvMRbMainFunctionScheduling [0..1]: multiplicity set at pre-compile, origin=RB:13.0.0:2019-01-31, set at pre-compile, default-value=NVM_RB_MAINFUNC_SCHEDULING_RTE_TIMED  # Scheduling for NvM_MainFunction | [BSW_SWS_AR4_0_R2_NVRAMManager_Ext-3183] Defines if NvM_MainFunction() is beeing called in the background-task via RTE, in a scheduled task via RTE or if it is not called via RTE and therefore has to be scheduled manually. In case it is scheduled manually no RTE events or entities are generated.
        NVM_RB_MAINFUNC_SCHEDULING_RTE_BACKGROUND  # RTE background task
        NVM_RB_MAINFUNC_SCHEDULING_RTE_TIMED  # RTE timed task
        NVM_RB_MAINFUNC_SCHEDULING_MANUAL  # Manual scheduling
      function name NvMRbMultiBlockStartCallback [0..1]: multiplicity set at pre-compile, origin=RB:7.1.0:2016-04-30, set at pre-compile  # Multiblock start callback | [BSW_SWS_AR4_0_R2_NVRAMManager_Ext-2762] Entry address of the common callback routine which shall be invoked whenever an asynchronous multi block request is about to start. It is not allowed to call any NvM or DEM functions from within this callback function!
      boolean NvMRbNvCrcEnable [0..1]: multiplicity set at pre-compile, origin=RB:14.0.0:2019-06-05, set at pre-compile, default-value=false  # Enable CRC useage in NV memory | Globally enables/disables CRC useage in NV memory for NVRAM blocks which have the block-specific parameter NvMBlockUseCrc set to TRUE. If NvMRbNvCrcEnable is TRUE the block-specific parameter NvMBlockUseCrc defines if a CRC on NVM level is used for the block. If NvMRbNvCrcEnable is set to FALSE no CRCs on NVM level will be used (even though the block-specific parameter NvMBlockUseCrc might be set to TRUE). Hint: For projects which do not use the complete RTA-BSW MemStack, the parameter NvMRbNvCrcEnable should be set to TRUE to enable CRC useage. For projects which use the complete RTA-BSW Memstack it is adviced to keep the Nv CRC on NvM level turned off (NvMRbNvCrcEnable=FALSE) because the lower software layers already apply CRC integrity checks. Attention: When CRC useage is activated the block-size of the NVM block changes compared to the case that CRC is deactivated (block-size = user-data-size + crc-size) with all its implications on backwards-compatibility!
      function name NvMRbObserverCallback [0..1]: multiplicity set at pre-compile, origin=RB:3.1.0:2014-04-25, set at pre-compile  # Observer callback | [BSW_SWS_AR4_0_R2_NVRAMManager_Ext-2843] Name of the callback routine which is invoked on the termination of the processing of a job for a block within an asynchronous request. Unlike multiblock callback, if configured, this callback is invoked for any configured block including the configuration ID block (when dynamic configuration is enabled) and excluding block #0. Similar to the single block request, it provides the block specific request result when the processing of the block finishes. If you explicitly want to specify that no such callback routine shall be called, enter NULL_PTR here. It is not allowed to call any NvM or DEM functions from within this callback function!
      enumeration NvMRbRamInitCheck [0..1]: multiplicity set at pre-compile, origin=RB:2.1.0:2013-10-28, set at pre-compile, default-value=NVM_RB_RAM_INIT_CHECK_NONE  # RAM init check | [BSW_SWS_AR4_0_R2_NVRAMManager_Ext-2786] This parameter allows to choose the behavior of the NvM module when a reset occurs. NVM_RB_RAM_INIT_CHECK_NONE: After a reset, NvM_ReadAll() reads all blocks suitable for ReadAll. NVM_RB_RAM_INIT_CHECK_QUICK: After a reset, it is checked whether the saved zone is lost. If not lost, only blocks whose RAM status bits are INVALID are filled with data from Nv blocks during NvM_ReadAll(). If the RAM status bit of a block is found VALID, then the block is skipped by NvM_ReadAll().
        NVM_RB_RAM_INIT_CHECK_NONE  # None
        NVM_RB_RAM_INIT_CHECK_QUICK  # Quick
      boolean NvMRbRemoveNonResistantBlocks [0..1]: multiplicity set at pre-compile, origin=RB:2.1.0:2013-10-28, set at pre-compile, default-value=false  # Remove non-resistant blocks | [BSW_SWS_AR4_0_R2_NVRAMManager_Ext-2787] Enables/disables enhanced dynamic configuration. If enabled and if the configured configuration ID is different from the configuration ID stored on the memory media, NV blocks which are configured to be non-resistant against SW changes (parameter NvMResistantToChangedSw set to false) are removed from the media directly after NvM_ReadAll has finished. Afterwards, the changed configuration ID is immediately written to the memory media before serving any other NvM request. This feature is only available if dynamic configuration is enabled (see parameter NvMDynamicConfiguration). Caution: if the enhanced dynamic configuration is enabled, all of the single block operations will be neither accepted nor executed before the ReadAll is called, if the block is as ReadAll block configured and is not resistant to changed software.
      integer NvMRbReqMonDevId [0..1]: 0..254, multiplicity set at pre-compile, origin=RB:10.0.0:2017-07-31, set at pre-compile  # Device ID for request monitoring | [BSW_SWS_AR4_0_R2_NVRAMManager_Ext-3141] This parameter defines the device where the NVRAM block for request monitoring will be located.
      enumeration NvMRbReqMonitor [0..1]: multiplicity set at pre-compile, origin=RB:10.0.0:2017-07-31, set at pre-compile, default-value=NVM_RB_REQ_MON_DISABLED  # Request monitoring | [BSW_SWS_AR4_0_R2_NVRAMManager_Ext-3124] This parameter defines the request monitoring function for the NvM. NVM_RB_REQ_MON_DISABLED [Default]: Request monitoring disabled. NVM_RB_REQ_MON_WRITE: Monitoring of write requests enabled. In this case following counters are available: - NvM_Rb_cntrWrites_u16 = Number of write requests since last power-on, - NvM_Rb_nrBytesWritten_u32 = Number of bytes written since last power-on, - NvM_Rb_idLastWrittenBlock_uo = ID of the last written block, - NvM_Rb_WriteMon_st.nrBytesWrittenMax_u32 = maximum number of bytes written since last power-on, - NvM_Rb_WriteMon_st.cntrWritesAbs_u32 = accumulated number of all write requests, - NvM_Rb_WriteMon_st.cntrWritesMax_u16 = maximum number of write requests since last power-on
        NVM_RB_REQ_MON_DISABLED  # Disabled
        NVM_RB_REQ_MON_WRITE  # Write requests
      boolean NvMRbRuntimeRamBlockConfiguration [0..1]: multiplicity set at pre-compile, origin=RB:9.0.0:2016-11-04, set at pre-compile, default-value=false  # Runtime RAM Block Configuration | [BSW_SWS_AR4_0_R2_NVRAMManager_Ext-3028] Enables/disables the runtime calculation of the NV block lengths and RAM block data addresses. When this feature is enabled the NV block length and the RAM block data address can be defined as C expression in NvMRbNvBlockLengthString and NvMRamBlockDataAddress. If this feature is enabled and explicit synchronization is used for a block the explicit synchronization buffer has to be defined by the user. Therefore the configuration parameters NvMRbRuntimeRamBufferAddressStart and NvMRbRuntimeRamBufferAddressEnd have to be used.
      string NvMRbRuntimeRamBufferAddressEnd [0..1]: multiplicity set at pre-compile, origin=RB:9.0.0:2016-11-04, set at pre-compile, default-value=NULL_PTR  # Explicit Sync RAM End Address | [BSW_SWS_AR4_0_R2_NVRAMManager_Ext-] Defines the end address of the RAM buffer used for explicit synchronisation when NV block lengths are calculated on runtime (NvMRbRuntimeRamBlockConfiguration is enabled).
      string NvMRbRuntimeRamBufferAddressStart [0..1]: multiplicity set at pre-compile, origin=RB:9.0.0:2016-11-04, set at pre-compile, default-value=NULL_PTR  # Explicit Sync RAM Start Address | [BSW_SWS_AR4_0_R2_NVRAMManager_Ext-] Defines the start address of the RAM buffer used for explicit synchronisation when NV block lengths are calculated on runtime (NvMRbRuntimeRamBlockConfiguration is enabled).
      boolean NvMRbSetWriteAllTriggerApi [0..1]: multiplicity set at pre-compile, origin=RB:8.0.0:2016-07-31, set at pre-compile, default-value=false  # SetWriteAllTrigger API | [BSW_SWS_AR4_0_R2_NVRAMManager_Ext-2982] Enables/disables NvM_Rb_SetWriteAllTrigger API. This API allows to trigger WriteAll participation independent of RAM block states or whether a block is currently busy or not. When Dem is used with NvM, Dem shall require this API. Hence, this parameter is required to set as true.
      boolean NvMRbSwcdToEcucValuesEnable [0..1]: multiplicity set at pre-compile, origin=RB:17.0.0:2020-12-04, set at pre-compile, default-value=false  # Enable SWCD to EcucValues translation | On SWCD level it is possible to configure NvBlockNeeds. For such NvBlockNeeds it is required to configure a corresponding NvM block on EcucValues side. On enabling this switch the available information in SWCD is automatically translated to EcucValues. SWCD does support only a subset of pure AUTOSAR parameters. Additional information has to be provided on EcucValues level. Currently it is not possible to automatically calculate the mandatory parameters block length and the device ID from the SWCD configuration. The 2 parameters NvMNvBlockLength and NvMNvramDeviceId have to be provided additionally on EcucValues level.
      integer NvMRepeatMirrorOperations [0..1]: 0..7, multiplicity set at pre-compile, set at pre-compile, default-value=0  # Max. number of mirror operation retries | [NVM518_Conf] Defines the number of retries to let the application copy data to or from the NvM module's mirror before postponing the current job. The lower multiplicity is set to 0 in contrast to NVM518_Conf. In fact, this parameter doesn't have to be configured if none of the blocks is configured to use explicit synchronization. See also the NvMBlockUseSyncMechanism parameter in the block configuration.
      boolean NvMSetRamBlockStatusApi: set at pre-compile  # SetRamBlockStatus API | [NVM502_Conf] Enables/disables the NvM_SetRamBlockStatus API. If enabled, NvM_WriteAll only writes blocks to memory which have been explicitly marked as changed by using this API. If disabled, this API is not available and NvM_WriteAll writes blocks to memory regardless of whether they have changed or not. The current version of NvM does not support disabling the NvM_SetRamBlockStatus API, so this parameter must always be set to true.
      integer NvMSizeImmediateJobQueue [0..1]: 1..255, multiplicity set at pre-compile, set at pre-compile, default-value=1  # Size of immediate job queue | [NVM503_Conf] Defines the number of queue entries for the immediate priority job queue. This parameter is only applicable if the NvMJobPrioritization parameter is set to true.
      integer NvMSizeStandardJobQueue: 1..255, set at pre-compile  # Size of standard job queue | [NVM504_Conf] Defines the number of queue entries for the standard job queue.
      boolean NvMVersionInfoApi: set at pre-compile  # GetVersionInfo API | [NVM505_Conf] Enables/disables the NvM_GetVersionInfo API.
      container NvMRbApiOverloading [0..1]: multiplicity set at pre-compile  # API overloading | [BSW_SWS_AR4_0_R2_NVRAMManager_Ext-2914] Container for API overloading options. The parameters within this container should only be used with extreme care after thoroughly consulting the NvM documentation. Using the API overloading feature the wrong way can corrupt the entire Mem stack's functionality.
        function name NvMRbAuxInvalidateNvBlock [0..1]: multiplicity set at pre-compile, origin=RB:15.1.0:2020-04-30, set at pre-compile  # Rb_AuxInvalidateNvBlock function name | [BSW_SWS_AR4_0_R2_NVRAMManager_Ext-2914] Name of the function to be called in the body of NvM_Rb_AuxInvalidateNvBlock instead of NvM's own implementation (which is available as NvM_Rb_AuxInvalidateNvBlockBase if this parameter is set).
        function name NvMRbAuxReadBlock [0..1]: multiplicity set at pre-compile, origin=RB:15.1.0:2020-04-30, set at pre-compile  # Rb_AuxReadBlock function name | [BSW_SWS_AR4_0_R2_NVRAMManager_Ext-2914] Name of the function to be called in the body of NvM_Rb_AuxReadBlock instead of NvM's own implementation (which is available as NvM_Rb_AuxReadBlockBase if this parameter is set).
        function name NvMRbAuxWriteBlock [0..1]: multiplicity set at pre-compile, origin=RB:15.1.0:2020-04-30, set at pre-compile  # Rb_AuxWriteBlock function name | [BSW_SWS_AR4_0_R2_NVRAMManager_Ext-2914] Name of the function to be called in the body of NvM_Rb_AuxWriteBlock instead of NvM's own implementation (which is available as NvM_Rb_AuxWriteBlockBase if this parameter is set).
        function name NvMRbCancelWriteAll [0..1]: multiplicity set at pre-compile, origin=RB:15.1.0:2020-04-30, set at pre-compile  # CancelWriteAll function name | [BSW_SWS_AR4_0_R2_NVRAMManager_Ext-2914] Name of the function to be called in the body of NvM_CancelWriteAll instead of NvM's own implementation (which is available as NvM_Rb_CancelWriteAllBase if this parameter is set).
        function name NvMRbEraseNvBlock [0..1]: multiplicity set at pre-compile, origin=RB:6.1.0:2015-10-31, set at pre-compile  # EraseNvBlock function name | [BSW_SWS_AR4_0_R2_NVRAMManager_Ext-2914] Name of the function to be called in the body of NvM_EraseNvBlock instead of NvM's own implementation (which is available as NvM_Rb_EraseNvBlockBase if this parameter is set).
        function name NvMRbFirstInitAll [0..1]: multiplicity set at pre-compile, origin=RB:15.1.0:2020-04-30, set at pre-compile  # Rb_FirstInitAll function name | [BSW_SWS_AR4_0_R2_NVRAMManager_Ext-2914] Name of the function to be called in the body of NvM_Rb_FirstInitAll instead of NvM's own implementation (which is available as NvM_Rb_FirstInitAllBase if this parameter is set).
        function name NvMRbInvalidateNvBlock [0..1]: multiplicity set at pre-compile, origin=RB:6.1.0:2015-10-31, set at pre-compile  # InvalidateNvBlock function name | [BSW_SWS_AR4_0_R2_NVRAMManager_Ext-2914] Name of the function to be called in the body of NvM_InvalidateNvBlock instead of NvM's own implementation (which is available as NvM_Rb_InvalidateNvBlockBase if this parameter is set).
        function name NvMRbReadAll [0..1]: multiplicity set at pre-compile, origin=RB:6.1.0:2015-10-31, set at pre-compile  # ReadAll function name | [BSW_SWS_AR4_0_R2_NVRAMManager_Ext-2914] Name of the function to be called in the body of NvM_ReadAll instead of NvM's own implementation (which is available as NvM_Rb_ReadAllBase if this parameter is set).
        function name NvMRbReadBlock [0..1]: multiplicity set at pre-compile, origin=RB:6.1.0:2015-10-31, set at pre-compile  # ReadBlock function name | [BSW_SWS_AR4_0_R2_NVRAMManager_Ext-2914] Name of the function to be called in the body of NvM_ReadBlock instead of NvM's own implementation (which is available as NvM_Rb_ReadBlockBase if this parameter is set).
        function name NvMRbReadPRamBlock [0..1]: multiplicity set at pre-compile, origin=RB:16.0.0:2020-07-31, set at pre-compile  # ReadPRamBlock function name | [BSW_SWS_AR4_0_R2_NVRAMManager_Ext-2914] Name of the function to be called in the body of NvM_ReadPRAMBlock instead of NvM's own implementation (which is available as NvM_Rb_ReadPRAMBlockBase if this parameter is set).
        function name NvMRbRestoreBlockDefaults [0..1]: multiplicity set at pre-compile, origin=RB:6.1.0:2015-10-31, set at pre-compile  # RestoreBlockDefaults function name | [BSW_SWS_AR4_0_R2_NVRAMManager_Ext-2914] Name of the function to be called in the body of NvM_RestoreBlockDefaults instead of NvM's own implementation (which is available as NvM_Rb_RestoreBlockDefaultsBase if this parameter is set).
        function name NvMRbRestorePRamBlockDefaults [0..1]: multiplicity set at pre-compile, origin=RB:16.0.0:2020-07-31, set at pre-compile  # RestorePRamBlockDefaults function name | [BSW_SWS_AR4_0_R2_NVRAMManager_Ext-2914] Name of the function to be called in the body of NvM_RestorePRAMBlockDefaults instead of NvM's own implementation (which is available as NvM_Rb_RestorePRAMBlockDefaultsBase if this parameter is set).
        function name NvMRbValidateAll [0..1]: multiplicity set at pre-compile, origin=RB:15.1.0:2020-04-30, set at pre-compile  # ValidateAll function name | [BSW_SWS_AR4_0_R2_NVRAMManager_Ext-2914] Name of the function to be called in the body of NvM_Rb_ValidateAll instead of NvM's own implementation (which is available as NvM_Rb_ValidateAllBase if this parameter is set).
        function name NvMRbWriteAll [0..1]: multiplicity set at pre-compile, origin=RB:6.1.0:2015-10-31, set at pre-compile  # WriteAll function name | [BSW_SWS_AR4_0_R2_NVRAMManager_Ext-2914] Name of the function to be called in the body of NvM_WriteAll instead of NvM's own implementation (which is available as NvM_Rb_WriteAllBase if this parameter is set).
        function name NvMRbWriteBlock [0..1]: multiplicity set at pre-compile, origin=RB:6.1.0:2015-10-31, set at pre-compile  # WriteBlock function name | [BSW_SWS_AR4_0_R2_NVRAMManager_Ext-2914] Name of the function to be called in the body of NvM_WriteBlock instead of NvM's own implementation (which is available as NvM_Rb_WriteBlockBase if this parameter is set).
        function name NvMRbWritePRamBlock [0..1]: multiplicity set at pre-compile, origin=RB:16.0.0:2020-07-31, set at pre-compile  # WritePRamBlock function name | [BSW_SWS_AR4_0_R2_NVRAMManager_Ext-2914] Name of the function to be called in the body of NvM_WritePRAMBlock instead of NvM's own implementation (which is available as NvM_Rb_WritePRAMBlockBase if this parameter is set).
    container NvmDemEventParameterRefs [0..0]  # Dem event parameter references | [NVM541_Conf] Container for the references to DemEventParameter elements which are invoked using the Dem_ReportErrorStatus API in case the corresponding error occurs. Dem events are not supported by NvM. So, this entire container shall not be provided.
      symbolic name reference NVM_E_INTEGRITY_FAILED [0..0]: set at pre-compile, destination=DemEventParameter  # Dem event "integrity failed" | [NVM542_Conf] Reference to the DemEventParameter which is invoked using the Dem_ReportErrorStatus API in case an inconsistent block is encountered on the memory media. Dem events are not supported by NvM. So, this reference shall not be provided.
      symbolic name reference NVM_E_LOSS_OF_REDUNDANCY [0..0]: set at pre-compile, destination=DemEventParameter  # Dem event "loss of redundancy" | [NVM546_Conf] Reference to the DemEventParameter which is invoked using the Dem_ReportErrorStatus API in case a loss of redundancy is detected. Dem events are not supported by NvM. So, this reference shall not be provided.
      symbolic name reference NVM_E_QUEUE_OVERFLOW [0..0]: set at pre-compile, destination=DemEventParameter  # Dem event "queue overflow" | [NVM547_Conf] Reference to the DemEventParameter which is invoked using the Dem_ReportErrorStatus API in case a queue overflow occurs. Dem events are not supported by NvM. So, this reference shall not be provided.
      symbolic name reference NVM_E_REQ_FAILED [0..0]: set at pre-compile, destination=DemEventParameter  # Dem event "request failed" | [NVM543_Conf] Reference to the DemEventParameter which is invoked using the Dem_ReportErrorStatus API in case a request fails. Dem events are not supported by NvM. So, this reference shall not be provided.
      symbolic name reference NVM_E_VERIFY_FAILED [0..0]: set at pre-compile, destination=DemEventParameter  # Dem event "verify failed" | [NVM545_Conf] Reference to the DemEventParameter which is invoked using the Dem_ReportErrorStatus API in case a verify operation fails. Dem events are not supported by NvM. So, this reference shall not be provided.
      symbolic name reference NVM_E_WRITE_PROTECTED [0..0]: set at pre-compile, destination=DemEventParameter  # Dem event "write protected" | [NVM548_Conf] Reference to the DemEventParameter which is invoked using the Dem_ReportErrorStatus API in case a write operation to a write protected block is encountered. Dem events are not supported by NvM. So, this reference shall not be provided.
      symbolic name reference NVM_E_WRONG_BLOCK_ID [0..0]: set at pre-compile, destination=DemEventParameter  # Dem event "wrong block ID" | [NVM544_Conf] Reference to the DemEventParameter which is invoked using the Dem_ReportErrorStatus API in case a static block ID check fails. Dem events are not supported by NvM. So, this reference shall not be provided.

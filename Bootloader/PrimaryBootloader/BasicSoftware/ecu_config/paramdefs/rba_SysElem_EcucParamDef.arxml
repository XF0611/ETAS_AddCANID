AUTOSAR XML (schema 4-2-2)
package /RB/RBA/rba_SysElem/EcucModuleDefs
  module definition rba_SysElem [0..1]: category=VENDOR_SPECIFIC_MODULE_DEFINITION, variants pre-compile  # System Elements
    container rba_SysElem_SystemModel  # System Model | This container is added to have an additional hierarchical level. This is needed due to a bug that no ChoiceContainer is support as top level Container directly under the module Container.
      container rba_SysElem_DataMappings [0..1]  # DataMappings | Container for DataMappings
        container rba_SysElem_DataMapping [0..*]  # DataMapping | Mapping of port elements (data elements and parameters) to frames and signals.
          enumeration rba_SysElem_CommunicationDirection [0..1]: set at pre-compile, origin=RB, with-auto=true  # CommunicationDirection | Describes the communication direction.
            in  # Reception (Input)
            out  # Transmission (Output)
          container rba_SysElem_ClientServerToSignalMapping [0..1]  # ClientServerToSignalMapping | This element maps the ClientServerOperation to call- and return-SystemSignals. The serialization is defined by the referenced SerializationTechnology
            reference rba_SysElem_CallSignalRef: set at pre-compile, origin=RB, destination=rba_SysElem_SystemSignal  # CallSignal Reference | Reference to the callSignal to which the IN and INOUT ArgumentDataPrototypes are mapped.
            reference rba_SysElem_ClientServerOperationRef: set at pre-compile, origin=RB, destination=rba_SysElem_ClientServerOperation  # ClientServerOperation Reference | Reference to a ClientServerOperation, which is mapped to a call SystemSignal and a return SystemSignal
            reference rba_SysElem_ReturnSignalRef [0..1]: set at pre-compile, origin=RB, destination=rba_SysElem_SystemSignal  # ReturnSignal Reference | Reference to the returnSignal to which the OUT and INOUT ArgumentDataPrototypes are mapped
          container rba_SysElem_SenderReceiverToSignalGroupMapping [0..1]  # SenderReceiverToSignalGroupMapping | Mapping of a sender receiver communication data element with a composite datatype to a signal group.
            reference rba_SysElem_SystemSignalGroupRef: set at pre-compile, origin=RB, destination=rba_SysElem_SystemSignalGroup  # SignalGroup Reference | Reference to the signal group, which contain all primitive datatypes of the composite type.
            reference rba_SysElem_TopLevelTypeMapping: set at pre-compile, origin=RB, destination=rba_SysElem_TypeMapping  # Top Level Type Mapping Reference | References the Type Mapping used by this SignalGroupMapping
            reference rba_SysElem_VariableDataPrototypeRef: set at pre-compile, origin=RB, destination=rba_SysElem_VariableDataPrototype  # VariableDataPrototype Reference | Reference to a data element with a composite datatype which is mapped to a signal group.
            container rba_SysElem_TypeMapping [1..*]  # TypeMapping | The CompositeTypeMapping maps the the ApplicationArrayElements and ApplicationRecordElements to Signals of the SignalGroup.
              container rba_SysElem_SenderRecArrayTypeMapping [0..1]  # SenderRecArrayTypeMapping | If the ApplicationCompositeDataType is an Array, the "ArrayTypeMapping" will be used.
                container rba_SysElem_ArrayElementMapping [1..*]  # ArrayElementMapping | Each ApplicationArrayElement must be mapped on a SystemSignal.
                  integer rba_SysElem_Index [0..1]: 0.., set at pre-compile, origin=RB, with-auto=true  # Index | This index can be used to ensure the correct order of the ArrayElementMapping. This is more a fallback in case a file split and merge would swap the order
                  reference rba_SysElem_SystemSignalRef [0..1]: set at pre-compile, origin=RB, destination=rba_SysElem_SystemSignal  # System Signal Reference | Reference to the system signal used to carry the primitive ApplicationArrayElement.
                  reference rba_SysElem_TypeMappingRef [0..1]: set at pre-compile, origin=RB, destination=rba_SysElem_TypeMapping  # Type Mapping Reference | References to Type Mapping that is a child of this ArrayElementMapping
              container rba_SysElem_SenderRecRecordTypeMapping [0..1]  # SenderRecRecordTypeMapping | If the ApplicationCompositeDataType is a Record, the "RecordTypeMapping" will be used.
                container rba_SysElem_RecordElementMapping [0..*]  # RecordElementMapping | Each ApplicationRecordElement must be mapped on a SystemSignal.
                  reference rba_SysElem_ImplementationRecordElementRef [0..1]: set at pre-compile, origin=RB, destination=rba_SysElem_RecordImplDataType/rba_SysElem_SubElement  # Implementation Record Element Reference | Reference to the SubElement the Record
                  reference rba_SysElem_SystemSignalRef [0..1]: set at pre-compile, origin=RB, destination=rba_SysElem_SystemSignal  # System Signal Reference | Reference to the system signal used to carry the primitive ApplicationRecordElement.
                  reference rba_SysElem_TypeMappingRef [0..1]: set at pre-compile, origin=RB, destination=rba_SysElem_TypeMapping  # Type Mapping Reference | References to Type Mapping that is a child of this RecordElementMapping
          container rba_SysElem_SenderReceiverToSignalMapping [0..1]  # SenderReceiverToSignalMapping | Mapping of a sender receiver communication data element with a primitive datatype to a signal.
            reference rba_SysElem_SystemSignalRef: set at pre-compile, origin=RB, destination=rba_SysElem_SystemSignal  # SystemSignal Reference | Reference to the system signal used to carry the data element.
            reference rba_SysElem_VariableDataPrototypeRef: set at pre-compile, origin=RB, destination=rba_SysElem_VariableDataPrototype  # VariableDataPrototype Reference | Reference to the data element, which ought to be sent over the Communication bus.
      container rba_SysElem_DataTransformations [0..1]  # DataTransformations | Conainer for DataTransformations
        container rba_SysElem_DataTransformation [0..*]  # DataTransformation | A DataTransformation represents a transformer chain. It is an ordered list of transformers.
          enumeration rba_SysElem_Direction: {in, out}, set at pre-compile, origin=RB, with-auto=true  # Direction | Specifies, how the DataTransformation is used in the ECU, for sending or receiving data.
          boolean rba_SysElem_ExecuteDespiteDataUnavailability: set at pre-compile, origin=RB, with-auto=true  # ExecuteDespiteDataUnavailability | Specifies whether the transformer is executed even if no input data are available.
          container rba_SysElem_TransformationTechnology [1..255]  # TransformationTechnology | A TransformationTechnology is a transformer inside a transformer chain.
            integer rba_SysElem_Index: 0.., set at pre-compile, origin=RB, with-auto=true  # Index | This index is used to ensure the correct order of the TransformationTechnologies inside a DataTransformation independent of the used tools in the workflow.
            reference rba_SysElem_TransformationTechnologyRef: set at pre-compile, origin=RB, destination=rba_SysElem_TransformationTechnologies/rba_SysElem_TransformationTechnology  # TransformationTechnology Reference | Reference to the TransformationTechnology Configuration Container.
      container rba_SysElem_IPdus [0..1]  # IPdus | Container for IPdus
        choice container rba_SysElem_IPdu [0..*]  # IPdu | The IPdu (Interaction Layer Protocol Data Unit) element is used to sum up all Pdus that are routed by the PduR.
          container rba_SysElem_ISignalIPdu [0..1]  # ISignalIPdu | Represents the IPdus handled by Com. The ISignalIPdu assembled and disassembled in AUTOSAR COM consists of one or more signals. In case no multiplexing is performed this IPdu is routed to/from the Interface Layer. A maximum of one dynamic length signal per IPdu is allowed.
            integer rba_SysElem_Length [0..1]: set at pre-compile, origin=RB, with-auto=true  # Length | Pdu length in bytes. In case of dynamic length IPdus (containing a dynamical length signal), this value indicates the maximum data length. It should be noted that in former AUTOSAR releases (Rel 2.1, Rel 3.0, Rel 3.1, Rel 4.0 Rev. 1) this parameter was defined in bits. The Pdu length of zero bytes is allowed.
            integer rba_SysElem_MetaDataLength [0..1]: 0.., set at pre-compile, origin=RB, with-auto=true  # MetaDataLength | Number of additional bytes of MetaData in the PDU data field. The MetaData contains auxiliary information for the PDU, e.g. the CAN ID.
            integer rba_SysElem_UnusedBitPattern: set at pre-compile, origin=RB, with-auto=true  # UnusedBitPattern | AUTOSAR COM and AUTOSAR IPDUM are filling not used areas of an IPDU with this bit-pattern. This attribute is mandatory to avoid undefined behavior. This byte-pattern will be repeated throughout the IPdu.
            boolean rba_SysElem_UseLdCom [0..1]: set at pre-compile, origin=RB, with-auto=true  # UseLdCom | This parameter specifies, if the constraints are fulfilled to transfer this ISignal with LdCom. Following constraints shall be checked: TPS_SYST_02015 to TPS_SYST_02028, TPS_SYST_03001 If LdCom is integrated in the ECU shall not be checked.
            container rba_SysElem_ISignalToPduMapping [0..*]  # ISignalToPduMapping | Definition of SignalToIPduMappings included in the SignalIPdu.
              enumeration rba_SysElem_PackingByteOrder [0..1]: {mostSignificantByteFirst, mostSignificantByteLast, opaque}, set at pre-compile, origin=RB, with-auto=true  # PackingByteOrder | This parameter defines the order of the bytes of the signal and the packing into the SignalIPdu. The byte ordering "Little Endian" (MostSignificantByteLast), "Big Endian" (MostSignificantByteFirst) and "Opaque" can be selected. For opaque data endianness conversion shall be configured to Opaque. The value of this attribute impacts the absolute position of the signal into the SignalIPdu (see the startPosition attribute description). For an ISignalGroup the packingByteOrder is irrelevant and shall be ignored.
              integer rba_SysElem_StartPosition [0..1]: set at pre-compile, origin=RB, with-auto=true  # StartPosition | This parameter is necessary to describe the bitposition of a signal within an SignalIPdu. It denotes the least significant bit for "Little Endian" and the most significant bit for "Big Endian" packed signals within the IPdu (see the description of the packingByteOrder attribute). In AUTOSAR the bit counting is always set to "sawtooth" and the bit order is set to "Decreasing". The bit counting in byte 0 starts with bit 0 (least significant bit). The most significant bit in byte 0 is bit 7. Please note that the way the bytes will be actually sent on the bus does not impact this representation: they will always be seen by the software as a byte array. If a mapping for the ISignalGroup is defined, this attribute is irrelevant and shall be ignored.
              reference rba_SysElem_ISignalGroupRef [0..1]: set at pre-compile, origin=RB, destination=rba_SysElem_ISignalGroup  # ISignalGroup Reference | Reference to an ISignalGroup that is mapped into the ISignalIPdu. If an ISignalToIPduMapping for an ISignalGroup is defined, only the UpdateIndicationBitPosition and the transferProperty is relevant. The startPosition and the packingByteOrder shall be ignored. Each ISignal contained in the ISignalGroup shall be mapped into an IPdu by an own ISignalToIPduMapping. The references to the ISignal and to the ISignalGroup in an ISignalToIPduMapping are mutually exclusive.
              reference rba_SysElem_ISignalRef [0..1]: set at pre-compile, origin=RB, destination=rba_SysElem_ISignal  # ISignal Reference | Reference to a ISignal that is mapped into the ISignalIPdu. Each ISignal contained in the ISignalGroup shall be mapped into an IPdu by an own ISignalToIPduMapping. The references to the ISignal and to the ISignalGroup in an ISignalToIPduMapping are mutually exclusive.
              foreign reference rba_SysElem_ISignalToPduMappingForeignRef: set at pre-compile, origin=RB, destination-type=I-SIGNAL-TO-I-PDU-MAPPING  # ISignalToPduMapping Foreign Reference | Reference to the ISignalToIPduMapping in the SystemExtract.
      container rba_SysElem_ISignalGroups [0..1]  # ISignalGroups | Container for ISignalGroups
        container rba_SysElem_ISignalGroup [0..*]  # ISignalGroup | SignalGroup of the Interaction Layer. The RTE supports a "signal fan-out" where the same System Signal Group is sent in different SignalIPdus to multiple receivers. An ISignalGroup refers to a set of ISignals that shall always be kept together. A ISignalGroup represents a COM Signal Group.
          reference rba_SysElem_ComBasedSignalGroupTransformationRef [0..1]: set at pre-compile, origin=RB, destination=rba_SysElem_DataTransformation  # ComBasedSignalGroupTransformation Reference | Optional reference to a DataTransformation which represents the transformer chain that is used to transform the data that shall be placed inside this ISignalGroup based on the COMBasedTransformer approach.
          foreign reference rba_SysElem_ISignalGroupForeignRef: set at pre-compile, origin=RB, destination-type=I-SIGNAL-GROUP  # ISignalGroup Foreign Reference | Reference to this ISignalGroup in the SystemExtract.
          reference rba_SysElem_ISignalRef [0..*]: set at pre-compile, origin=RB, destination=rba_SysElem_ISignal  # ISignal Reference | Reference to a set of ISignals that shall always be kept together.
          reference rba_SysElem_SystemSignalGroupRef: set at pre-compile, origin=RB, destination=rba_SysElem_SystemSignalGroup  # System Signal Group Reference | Reference to the SystemSignalGroup that is defined on VFB level and that is supposed to be transmitted in the ISignalGroup.
          container rba_SysElem_TransformationComSpecProps [0..1]  # TransformationComSpecProps | Specifies port specific configuration properties for transformer attributes
            container rba_SysElem_EndToEndTransformationComSpecProps [0..1]  # EndToEndTransformationComSpecProps | Specifies port specific configuration properties for EndToEnd transformer attributes
              boolean rba_SysElem_DisableEndToEndCheck: set at pre-compile, origin=RB, with-auto=true  # DisableEndToEndCheck | Disables/Enables the E2E check. The E2Eheader is removed from the payload independent from the setting of this attribute
              integer rba_SysElem_MaxDeltaCounter [0..1]: 0.., set at pre-compile, origin=RB, with-auto=true  # MaxDeltaCounter | Maximum allowed gap between two counter values of two consecutive checks
              integer rba_SysElem_MaxErrorStateInit [0..1]: 0.., set at pre-compile, origin=RB, with-auto=true  # MaxErrorStateInit | Maximal number of checks in which ProfileStatus equal to E2E_P_ERROR was determined, within the last WindowSize checks, for the state E2E_SM_INIT. The minimum value is 0
              integer rba_SysElem_MaxErrorStateInvalid [0..1]: 0.., set at pre-compile, origin=RB, with-auto=true  # MaxErrorStateInvalid | Maximal number of checks in which ProfileStatus equal to E2E_P_ERROR was determined, within the last WindowSize checks, for the state E2E_SM_INVALID. The minimum value is 0
              integer rba_SysElem_MaxErrorStateValid: 0.., set at pre-compile, origin=RB, with-auto=true  # MaxErrorStateValid | Maximal number of checks in which ProfileStatus equal to E2E_P_ERROR was determined, within the last WindowSize checks, for the state E2E_SM_VALID. The minimum value is 0
              integer rba_SysElem_MaxNoNewOrRepeatedData [0..1]: 0.., set at pre-compile, origin=RB, with-auto=true  # MaxNoNewOrRepeatedData | The maximum amount of missing or repeated Data which the receiver does not expect to exceed under normal communication conditions.
              integer rba_SysElem_MinOkStateInit [0..1]: 1.., set at pre-compile, origin=RB, with-auto=true  # MinOkStateInit | Minimal number of checks in which ProfileStatus equal to E2E_P_OK was determined, within the last WindowSize checks, for the state E2E_SM_INIT. The minimum value is 1
              integer rba_SysElem_MinOkStateInvalid [0..1]: 1.., set at pre-compile, origin=RB, with-auto=true  # MinOkStateInvalid | Minimal number of checks in which ProfileStatus equal to E2E_P_OK was determined, within the last WindowSize checks, for the state E2E_SM_INVALID. The minimum value is 1
              integer rba_SysElem_MinOkStateValid [0..1]: 1.., set at pre-compile, origin=RB, with-auto=true  # MinOkStateValid | Minimal number of checks in which ProfileStatus equal to E2E_P_OK was determined, within the last WindowSize checks, for the state E2E_SM_VALID. The minimum value is 1
              integer rba_SysElem_SyncCounterInit [0..1]: 0.., set at pre-compile, origin=RB, with-auto=true  # SyncCounterInit | Number of Data required for validating the consistency of the counter that must be received with a valid counter (i.e. counter within the allowed lock-in range) after the detection of an unexpected behavior of a received counter.
              integer rba_SysElem_WindowSize [0..1]: 0.., set at pre-compile, origin=RB, with-auto=true  # WindowSize | Size of the monitoring window for the E2E state machine
          choice container rba_SysElem_TransformationISignalProps [0..*]  # TransformationISignalProps | TransformationISignalProps holds all the attributes for the different TransformationTechnologies that are ISignal specific.
            container rba_SysElem_EndToEndTransformationISignalProps [0..1]  # EndToEndTransformationISignalProps | The container EndToEndTransformationISignalProps specifies ISignalGroup specific configuration properties for E2E transformer attributes.
              enumeration rba_SysElem_CSErrorReaction [0..1]: set at pre-compile, origin=RB, with-auto=true  # CsErrorReaction | Defines whether the transformer chain of client/server communication coordinates an autonomous error reaction together with the RTE or whether any error reaction is the responsibility of the application.
                applicationOnly  # The application is responsible for any error reaction. No autonomous error reaction of RTE and transformer
                autonomous  # RTE and Transformer coordinate an autonomous error reaction on their own
              integer rba_SysElem_DataID [0..*]: 0.., set at pre-compile, origin=RB, with-auto=true  # DataId | This represents a unique numerical identifier. Note: ID is used for protection against masquerading. The details concerning the maximum number of values (this information is specific for each E2E profile) applicable for this attribute are controlled by a semantic constraint that depends on the category of the EndToEndProtection.
              integer rba_SysElem_DataLength [0..1]: 0.., set at pre-compile, origin=RB, with-auto=true  # DataLength | Length of Data in bits.
              integer rba_SysElem_MaxDataLength [0..1]: 0.., set at pre-compile, origin=RB, with-auto=true  # MaxDataLength | Maximum length of Data in bits.
              integer rba_SysElem_MinDataLength [0..1]: 0.., set at pre-compile, origin=RB, with-auto=true  # MinDataLength | Minimum length of Data in bits.
              reference rba_SysElem_TransformationTechnologyRef: set at pre-compile, origin=RB, destination=rba_SysElem_TransformationTechnologies/rba_SysElem_TransformationTechnology  # TransformationTechnology Reference | Reference to the TransformationTechnology description that contains transformer specific and ISignal independent configuration properties.
            container rba_SysElem_SOMEIPTransformationISignalProps [0..1]  # SOMEIPTransformationISignalProps | The container SOMEIPTransformationISignalProps specifies ISignalGroup specific configuration properties for SOME/IP transformer attributes.
              enumeration rba_SysElem_CSErrorReaction [0..1]: set at pre-compile, origin=RB, with-auto=true  # CsErrorReaction | Defines whether the transformer chain of client/server communication coordinates an autonomous error reaction together with the RTE or whether any error reaction is the responsibility of the application.
                applicationOnly  # The application is responsible for any error reaction. No autonomous error reaction of RTE and transformer
                autonomous  # RTE and Transformer coordinate an autonomous error reaction on their own
              integer rba_SysElem_InterfaceVersion [0..1]: 0.., set at pre-compile, origin=RB, with-auto=true  # InterfaceVersion | The interface version the SOME/IP transformer shall use.
              enumeration rba_SysElem_MessageType [0..1]: {request, requestNoReturn, notification, response, error}, set at pre-compile, origin=RB, with-auto=true  # MessageType | The Message Type which shall be placed into the SOME/IP header.
              enumeration rba_SysElem_SessionHandlingSR [0..1]: {sessionHandlingActive, sessionHandlingInactive}, set at pre-compile, origin=RB, with-auto=true  # SessionHandlingSR | Defines whether the SOME/IP transformer shall use session handling for Sender/Receiver communication.
              integer rba_SysElem_SizeOfArrayLengthFields [0..1]: 0.., set at pre-compile, origin=RB, with-auto=true  # SizeOfArrayLengthFields | The size of all length fields (in Bytes) of fixed-size arrays in the SOME/IP message. The data type of the length field for an array is determined by the value of this parameter: - uint8 if the value equals 1 - uint16 if the value equals 2 - uint32 if the value equals 4 - no length field if the parameter is not configured
              integer rba_SysElem_SizeOfStructLengthFields [0..1]: 0.., set at pre-compile, origin=RB, with-auto=true  # SizeOfStructLengthFields | The size of all length fields (in Bytes) of structs in the SOME/IP message. The data type of the length field for a struct is determined by the value of this parameter: - uint8 if the value equals 1 - uint16 if the value equals 2 - uint32 if the value equals 4 - no length field if the parameter is not configured
              integer rba_SysElem_SizeOfUnionLengthFields [0..1]: 0.., set at pre-compile, origin=RB, with-auto=true  # SizeOfUnionLengthFields | The size of all length fields (in Bytes) of unions in the SOME/IP message. The data type of the length field for an union is determined by the value of this parameter: - uint8 if the value equals 1 - uint16 if the value equals 2 - uint32 if the value equals 4 - no length field if the parameter is not configured
              reference rba_SysElem_TransformationTechnologyRef: set at pre-compile, origin=RB, destination=rba_SysElem_TransformationTechnologies/rba_SysElem_TransformationTechnology  # TransformationTechnology Reference | Reference to the TransformationTechnology description that contains transformer specific and ISignal independent configuration properties.
            container rba_SysElem_UserDefinedTransformationISignalProps [0..1]  # UserDefinedTransformationISignalProps | The UserDefinedTransformationISignalProps is used to specify ISignalGroup specific configuration properties for custom transformers.
              enumeration rba_SysElem_CSErrorReaction [0..1]: set at pre-compile, origin=RB, with-auto=true  # CsErrorReaction | Defines whether the transformer chain of client/server communication coordinates an autonomous error reaction together with the RTE or whether any error reaction is the responsibility of the application.
                applicationOnly  # The application is responsible for any error reaction. No autonomous error reaction of RTE and transformer
                autonomous  # RTE and Transformer coordinate an autonomous error reaction on their own
              reference rba_SysElem_TransformationTechnologyRef: set at pre-compile, origin=RB, destination=rba_SysElem_TransformationTechnologies/rba_SysElem_TransformationTechnology  # TransformationTechnology Reference | Reference to the TransformationTechnology description that contains transformer specific and ISignal independent configuration properties.
      container rba_SysElem_ISignals [0..1]  # ISignals | Container for ISignals
        container rba_SysElem_ISignal [0..*]  # ISignal | Signal of the Interaction Layer. The RTE supports a "signal fan-out" where the same System Signal is sent in different SignalIPdus to multiple receivers. To support the RTE "signal fan-out" each SignalIPdu contains ISignals. If the same System Signal is to be mapped into several SignalIPdus there is one ISignal needed for each ISignalToIPduMapping. ISignals describe the Interface between the Precompile configured RTE and the potentially Postbuild configured Com Stack (see ECUC Parameter Mapping). In case of the SystemSignalGroup an ISignal must be created for each SystemSignal contained in the SystemSignalGroup.
          enumeration rba_SysElem_DataTypePolicy: {legacy, networkRepresentationFromComSpec, override, transformingISignal}, set at pre-compile, origin=RB, with-auto=true  # DataTypePolicy | With the aggregation of SwDataDefProps an ISignal specifies how it is represented on the network. This representation follows a particular policy. Note that this causes some redundancy which is intended and can be used to support flexible development methodology as well as subsequent integrity checks. If the policy "networkRepresentationFromComSpec" is chosen the network representation from the ComSpec that is aggregated by the PortPrototype shall be used. If the "override" policy is chosen the requirements specified in the PortInterface and in the ComSpec are not fulfilled by the networkRepresentationProps. In case the System Description doesn't use a complete Software Component Description (VFB View) the "legacy" policy can be chosen.
          integer rba_SysElem_Length: set at pre-compile, origin=RB, with-auto=true  # Length | Size of the signal in bits. The size needs to be derived from the mapped VariableDataPrototype according to the mapping of primitive DataTypes to BaseTypes as used in the RTE. Indicates maximum size for dynamic length signals. The ISignal length of zero bits is allowed.
          reference rba_SysElem_DataTransformationRef [0..1]: set at pre-compile, origin=RB, destination=rba_SysElem_DataTransformation  # DataTransformation Reference | Optional reference to a DataTransformation which represents the transformer chain that is used to transform the data that shall be placed inside this ISignal.
          foreign reference rba_SysElem_ISignalForeignRef: set at pre-compile, origin=RB, destination-type=I-SIGNAL  # ISignal Foreign Reference | Reference to this ISignal in the SystemExtract.
          reference rba_SysElem_SystemSignalRef: set at pre-compile, origin=RB, destination=rba_SysElem_SystemSignal  # SystemSignal Reference | Reference to the System Signal that is supposed to be transmitted in the ISignal.
          choice container rba_SysElem_InitValue [0..1]  # InitValue | Optional definition of a ISignal's initValue in case the System Description doesn't use a complete Software Component Description (VFB View). This supports the inclusion of legacy system signals.
            container rba_SysElem_ArrayValueSpecification [0..1]  # ArrayValueSpecification | Specifies the values for an array
              container rba_SysElem_NumericalValueSpecification [1..*]  # NumericalValueSpecification | A numerical ValueSpecification which is intended to be assigned to a Primitive data element. Note that the numerical value is a variant, it can be computed by a formula.
                float rba_SysElem_NumericalValue: set at pre-compile, origin=RB, with-auto=true  # Value | This is the value itself.
            container rba_SysElem_NumericalValueSpecification [0..1]  # NumericalValueSpecification | A numerical ValueSpecification which is intended to be assigned to a Primitive data element. Note that the numerical value is a variant, it can be computed by a formula.
              float rba_SysElem_NumericalValue: set at pre-compile, origin=RB, with-auto=true  # Value | This is the value itself.
            container rba_SysElem_TextValueSpecification [0..1]  # TextValueSpecification | The purpose of TextValueSpecification is to define the labels that correspond to enumeration values.
              string rba_SysElem_TextValue: set at pre-compile, origin=RB, with-auto=true  # Value | This is the value itself. Note that vt uses the | operator to separate the values for the different bitfield masks in case that the semantics of the related DataPrototype is described by means of a BITFIELD_TEXTTABLE in the associated CompuMethod.
          container rba_SysElem_TransformationComSpecProps [0..1]  # TransformationComSpecProps | Specifies port specific configuration properties for transformer attributes
            container rba_SysElem_EndToEndTransformationComSpecProps [0..1]  # EndToEndTransformationComSpecProps | Specifies port specific configuration properties for EndToEnd transformer attributes
              boolean rba_SysElem_DisableEndToEndCheck: set at pre-compile, origin=RB, with-auto=true  # DisableEndToEndCheck | Disables/Enables the E2E check. The E2Eheader is removed from the payload independent from the setting of this attribute
              integer rba_SysElem_MaxDeltaCounter [0..1]: 0.., set at pre-compile, origin=RB, with-auto=true  # MaxDeltaCounter | Maximum allowed gap between two counter values of two consecutive checks
              integer rba_SysElem_MaxErrorStateInit [0..1]: 0.., set at pre-compile, origin=RB, with-auto=true  # MaxErrorStateInit | Maximal number of checks in which ProfileStatus equal to E2E_P_ERROR was determined, within the last WindowSize checks, for the state E2E_SM_INIT. The minimum value is 0
              integer rba_SysElem_MaxErrorStateInvalid [0..1]: 0.., set at pre-compile, origin=RB, with-auto=true  # MaxErrorStateInvalid | Maximal number of checks in which ProfileStatus equal to E2E_P_ERROR was determined, within the last WindowSize checks, for the state E2E_SM_INVALID. The minimum value is 0
              integer rba_SysElem_MaxErrorStateValid: 0.., set at pre-compile, origin=RB, with-auto=true  # MaxErrorStateValid | Maximal number of checks in which ProfileStatus equal to E2E_P_ERROR was determined, within the last WindowSize checks, for the state E2E_SM_VALID. The minimum value is 0
              integer rba_SysElem_MaxNoNewOrRepeatedData [0..1]: 0.., set at pre-compile, origin=RB, with-auto=true  # MaxNoNewOrRepeatedData | The maximum amount of missing or repeated Data which the receiver does not expect to exceed under normal communication conditions.
              integer rba_SysElem_MinOkStateInit [0..1]: 1.., set at pre-compile, origin=RB, with-auto=true  # MinOkStateInit | Minimal number of checks in which ProfileStatus equal to E2E_P_OK was determined, within the last WindowSize checks, for the state E2E_SM_INIT. The minimum value is 1
              integer rba_SysElem_MinOkStateInvalid [0..1]: 1.., set at pre-compile, origin=RB, with-auto=true  # MinOkStateInvalid | Minimal number of checks in which ProfileStatus equal to E2E_P_OK was determined, within the last WindowSize checks, for the state E2E_SM_INVALID. The minimum value is 1
              integer rba_SysElem_MinOkStateValid [0..1]: 1.., set at pre-compile, origin=RB, with-auto=true  # MinOkStateValid | Minimal number of checks in which ProfileStatus equal to E2E_P_OK was determined, within the last WindowSize checks, for the state E2E_SM_VALID. The minimum value is 1
              integer rba_SysElem_SyncCounterInit [0..1]: 0.., set at pre-compile, origin=RB, with-auto=true  # SyncCounterInit | Number of Data required for validating the consistency of the counter that must be received with a valid counter (i.e. counter within the allowed lock-in range) after the detection of an unexpected behavior of a received counter.
              integer rba_SysElem_WindowSize [0..1]: 0.., set at pre-compile, origin=RB, with-auto=true  # WindowSize | Size of the monitoring window for the E2E state machine
          choice container rba_SysElem_TransformationISignalProps [0..*]  # TransformationISignalProps | TransformationISignalProps holds all the attributes for the different TransformationTechnologies that are ISignal specific.
            container rba_SysElem_EndToEndTransformationISignalProps [0..1]  # EndToEndTransformationISignalProps | The container EndToEndTransformationISignalProps specifies ISignal specific configuration properties for E2E transformer attributes.
              enumeration rba_SysElem_CSErrorReaction [0..1]: set at pre-compile, origin=RB, with-auto=true  # CsErrorReaction | Defines whether the transformer chain of client/server communication coordinates an autonomous error reaction together with the RTE or whether any error reaction is the responsibility of the application.
                applicationOnly  # The application is responsible for any error reaction. No autonomous error reaction of RTE and transformer
                autonomous  # RTE and Transformer coordinate an autonomous error reaction on their own
              integer rba_SysElem_DataID [0..*]: 0.., set at pre-compile, origin=RB, with-auto=true  # DataId | This represents a unique numerical identifier. Note: ID is used for protection against masquerading. The details concerning the maximum number of values (this information is specific for each E2E profile) applicable for this attribute are controlled by a semantic constraint that depends on the category of the EndToEndProtection.
              integer rba_SysElem_DataLength [0..1]: 0.., set at pre-compile, origin=RB, with-auto=true  # DataLength | Length of Data in bits.
              integer rba_SysElem_MaxDataLength [0..1]: 0.., set at pre-compile, origin=RB, with-auto=true  # MaxDataLength | Maximum length of Data in bits.
              integer rba_SysElem_MinDataLength [0..1]: 0.., set at pre-compile, origin=RB, with-auto=true  # MinDataLength | Minimum length of Data in bits.
              reference rba_SysElem_TransformationTechnologyRef: set at pre-compile, origin=RB, destination=rba_SysElem_TransformationTechnologies/rba_SysElem_TransformationTechnology  # TransformationTechnology Reference | Reference to the TransformationTechnology description that contains transformer specific and ISignal independent configuration properties.
            container rba_SysElem_SOMEIPTransformationISignalProps [0..1]  # SOMEIPTransformationISignalProps | The container SOMEIPTransformationISignalProps specifies ISignal specific configuration properties for SOME/IP transformer attributes.
              enumeration rba_SysElem_CSErrorReaction [0..1]: set at pre-compile, origin=RB, with-auto=true  # CsErrorReaction | Defines whether the transformer chain of client/server communication coordinates an autonomous error reaction together with the RTE or whether any error reaction is the responsibility of the application.
                applicationOnly  # The application is responsible for any error reaction. No autonomous error reaction of RTE and transformer
                autonomous  # RTE and Transformer coordinate an autonomous error reaction on their own
              integer rba_SysElem_InterfaceVersion [0..1]: 0.., set at pre-compile, origin=RB, with-auto=true  # InterfaceVersion | The interface version the SOME/IP transformer shall use.
              boolean rba_SysElem_IsDynamicLengthFieldSize [0..1]: set at pre-compile, origin=RB, with-auto=true  # IsDynamicLengthFieldSize | This attribute shall be used to determine the wire type in the context of using the TLV encoding
              enumeration rba_SysElem_MessageType [0..1]: {request, requestNoReturn, notification, response, error}, set at pre-compile, origin=RB, with-auto=true  # MessageType | The Message Type which shall be placed into the SOME/IP header.
              enumeration rba_SysElem_SessionHandlingSR [0..1]: {sessionHandlingActive, sessionHandlingInactive}, set at pre-compile, origin=RB, with-auto=true  # SessionHandlingSR | Defines whether the SOME/IP transformer shall use session handling for Sender/Receiver communication.
              integer rba_SysElem_SizeOfArrayLengthFields [0..1]: 0.., set at pre-compile, origin=RB, with-auto=true  # SizeOfArrayLengthFields | The size of all length fields (in Bytes) of fixed-size arrays in the SOME/IP message. The data type of the length field for an array is determined by the value of this parameter: - uint8 if the value equals 1 - uint16 if the value equals 2 - uint32 if the value equals 4 - no length field if the parameter is not configured
              integer rba_SysElem_SizeOfStructLengthFields [0..1]: 0.., set at pre-compile, origin=RB, with-auto=true  # SizeOfStructLengthFields | The size of all length fields (in Bytes) of structs in the SOME/IP message. The data type of the length field for a struct is determined by the value of this parameter: - uint8 if the value equals 1 - uint16 if the value equals 2 - uint32 if the value equals 4 - no length field if the parameter is not configured
              integer rba_SysElem_SizeOfUnionLengthFields [0..1]: 0.., set at pre-compile, origin=RB, with-auto=true  # SizeOfUnionLengthFields | The size of all length fields (in Bytes) of unions in the SOME/IP message. The data type of the length field for an union is determined by the value of this parameter: - uint8 if the value equals 1 - uint16 if the value equals 2 - uint32 if the value equals 4 - no length field if the parameter is not configured
              reference rba_SysElem_TransformationTechnologyRef: set at pre-compile, origin=RB, destination=rba_SysElem_TransformationTechnologies/rba_SysElem_TransformationTechnology  # TransformationTechnology Reference | Reference to the TransformationTechnology description that contains transformer specific and ISignal independent configuration properties.
              container rba_SysElem_TlvIdDefinition [0..*]  # TlvIdDefinition | The container represents the ability to define the tlvDataId
                integer rba_SysElem_TLVDataId: 0.., set at pre-compile, origin=RB, with-auto=true  # TLV DataId | This attribute represents the definition of the value of the TlvDataId
                reference rba_SysElem_TlvArgumentRef [0..1]: set at pre-compile, origin=RB, destination=rba_SysElem_ArgumentDataPrototype  # TlvArgument Reference | This reference assigns a tlvDataId to a given argument of a ClientServerOperation. \ClientServerOperation\ArgumentDataPrototype.
                reference rba_SysElem_TlvImplementationDataTypeElementRef [0..1]: set at pre-compile, origin=RB, destination=rba_SysElem_RecordImplDataType/rba_SysElem_SubElement  # TlvImplementationDataTypeElement Reference | This reference associates the definition of a TLV data id with a given ImplementationDataTypeElement. \ImplementationDataTypeElement.
            container rba_SysElem_UserDefinedTransformationISignalProps [0..1]  # UserDefinedTransformationISignalProps | The UserDefinedTransformationISignalProps is used to specify ISignal specific configuration properties for custom transformers.
              enumeration rba_SysElem_CSErrorReaction [0..1]: set at pre-compile, origin=RB, with-auto=true  # CsErrorReaction | Defines whether the transformer chain of client/server communication coordinates an autonomous error reaction together with the RTE or whether any error reaction is the responsibility of the application.
                applicationOnly  # The application is responsible for any error reaction. No autonomous error reaction of RTE and transformer
                autonomous  # RTE and Transformer coordinate an autonomous error reaction on their own
              reference rba_SysElem_TransformationTechnologyRef: set at pre-compile, origin=RB, destination=rba_SysElem_TransformationTechnologies/rba_SysElem_TransformationTechnology  # TransformationTechnology Reference | Reference to the TransformationTechnology description that contains transformer specific and ISignal independent configuration properties.
      container rba_SysElem_ImplementationDataTypes [0..1]  # Implementation Data Types | Container for Implementation Data Types
        choice container rba_SysElem_ImplementationDataType [0..*]  # Implementation Data Type | Describes a reusable data type on the implementation level. This will typically correspond to a typedef in C-code.
          container rba_SysElem_ArrayImplDataType [0..1]  # Array Implementation Data Type | Implementation Data Type of Category: Array
            enumeration rba_SysElem_Category: {VALUE, TYPE_REFERENCE, DATA_REFERENCE, FUNCTION_REFERENCE, STRUCTURE, UNION, ARRAY}, set at pre-compile, origin=RB, with-auto=true  # Category | Categories of the Implementation Data Types.
            boolean rba_SysElem_DynArrayLength [0..1]: set at pre-compile, origin=RB, with-auto=true  # Dynamic array length | Specifies if the Array is dynamical or not.
            string rba_SysElem_DynArraySizeProfile [0..1]: set at pre-compile, origin=RB, with-auto=true  # Dynamic Array Size Profile | Specifies the profile which the array will follow in case this data type is a variable size array.
            integer rba_SysElem_NumArrayElem: set at pre-compile, origin=RB, with-auto=true  # Number of array elements | Number of Elements in the Array.
            enumeration rba_SysElem_arraySizeSemantics [0..1]: set at pre-compile, origin=RB, with-auto=true  # Array Size Semantics | Specifies the semantics which the array will follow in case this data type is a variable size array.
              FIXED_SIZE  # FIXED-SIZE
              VARIABLE_SIZE  # VARIABLE-SIZE
            reference rba_SysElem_ImplDataTypeRef: set at pre-compile, origin=RB, destination=rba_SysElem_ImplementationDataType  # Implementation Data Type Reference | Reference to the Implementation Data Type
            foreign reference rba_SysElem_ImplementationDataTypeForeignRef [0..1]: set at pre-compile, origin=RB, destination-type=IMPLEMENTATION-DATA-TYPE  # Implementation Data Type Foreign Ref | References the Original IMPLEMENTATION-DATA-TYPE from System Extract from Software-AR-Packages
          container rba_SysElem_PrimitiveImplDataType [0..1]  # Primitive Implementation Data Type | Implementation Data Type of Category: Primitive
            enumeration rba_SysElem_BaseDataType: {boolean, uint8, uint16, uint32, uint64, sint8, sint16, sint32, sint64, float32, float64}, set at pre-compile, origin=RB, with-auto=true  # Base data type | Is this Implementation Data Type a Base Data Type?
            enumeration rba_SysElem_Category: {VALUE, TYPE_REFERENCE, DATA_REFERENCE, FUNCTION_REFERENCE, STRUCTURE, UNION, ARRAY}, set at pre-compile, origin=RB, with-auto=true  # Category | The Category of this Implementation Data Type: - TYPE-REFERENCE - VALUE - ARRAY
            foreign reference rba_SysElem_ImplementationDataTypeForeignRef [0..1]: set at pre-compile, origin=RB, destination-type=IMPLEMENTATION-DATA-TYPE  # Implementation Data Type Foreign Ref | References the Original IMPLEMENTATION-DATA-TYPE from System Extract from Software-AR-Packages
          container rba_SysElem_DynamicArrayImplDataType [0..1]  # Dynamic Array Implementation Data Type | Implementation Data Type of the Category: STRUCTURE. Handling of Variable-Size Array Datatypes
            enumeration rba_SysElem_arraySizeHandling [0..1]: set at pre-compile, origin=RB, with-auto=true  # Array Size Handling | Specifies the array size handling for Dynamic Arrays.
              ALL_INDICES_DIFFERENT_ARRAY_SIZE  # ALL-INDICES-DIFFERENT-ARRAY-SIZE
              ALL_INDICES_SAME_ARRAY_SIZE  # ALL-INDICES-SAME-ARRAY-SIZE
              INHERITED_FROM_ARRAY_ELEMENT_TYPE_SIZE  # INHERITED-FROM-ARRAY-ELEMENT-TYPE-SIZE
            enumeration rba_SysElem_dynamicArraySizeProfile [0..1]: {VSA_LINEAR, VSA_SQUARE, VSA_RECTANGULAR, VSA_FULLY_FLEXIBLE}, set at pre-compile, origin=RB, with-auto=true  # Dynamic Array Size Profile | Specifies the profile for Dynamic Arrays.
            integer rba_SysElem_maxNumberOfElements: set at pre-compile, origin=RB, with-auto=true  # Maximum Number of array elements | Maximum Number of Elements in the Array.
            foreign reference rba_SysElem_ImplementationDataTypeForeignRef [0..1]: set at pre-compile, origin=RB, destination-type=IMPLEMENTATION-DATA-TYPE  # Implementation Data Type Foreign Ref | References the Original IMPLEMENTATION-DATA-TYPE from System Extract from Software-AR-Packages
            container rba_SysElem_DynArray_Size  # DynArray_Size | Size Indicator of a Variable-Size Array Data Type holds the number of valid elements of the array
              reference rba_SysElem_ImplDataTypeRef [0..1]: set at pre-compile, origin=RB, destination=rba_SysElem_ImplementationDataType  # Implementation Data Type Reference | Reference to the Implementation Data Type
            container rba_SysElem_DynArray_Payload  # DynArray_Payload | PayLoad of a Variable-Size Array Data Type to indicate the maximum number of elements of the array
              reference rba_SysElem_ImplDataTypeRef: set at pre-compile, origin=RB, destination=rba_SysElem_ImplementationDataType  # Implementation Data Type Reference | Reference to the Implementation Data Type
          container rba_SysElem_StringImplDataType [0..1]  # String Implementation Data Type | Implementation Data Type of Category: String
            enumeration rba_SysElem_StringEncoding: set at pre-compile, origin=RB, with-auto=true  # String Encoding
              UTF_8  # UTF-8
              UTF_16  # UTF-16
            integer rba_SysElem_swMaxTextSize: set at pre-compile, origin=RB, with-auto=true  # swMaxTextSize | Specifies the maximum text size in characters
            integer rba_SysElem_swFillCharacter [0..1]: set at pre-compile, origin=RB, with-auto=true  # swFillCharacter | Filler character for text parameter to pad up to the maximum length swMaxTextSize.
            reference rba_SysElem_ImplDataTypeRef: set at pre-compile, origin=RB, destination=rba_SysElem_ImplementationDataType  # Implementation Data Type Reference | Reference to the Implementation Data Type
            foreign reference rba_SysElem_ImplementationDataTypeForeignRef [0..1]: set at pre-compile, origin=RB, destination-type=IMPLEMENTATION-DATA-TYPE  # Implementation Data Type Foreign Ref | References the Original IMPLEMENTATION-DATA-TYPE from System Extract from Software-AR-Packages
          container rba_SysElem_RecordImplDataType [0..1]  # Record Implementation Data Type | Implementation Data Type of the Category: RECORD
            enumeration rba_SysElem_Category: {VALUE, TYPE_REFERENCE, DATA_REFERENCE, FUNCTION_REFERENCE, STRUCTURE, UNION, ARRAY}, set at pre-compile, origin=RB, with-auto=true  # Category | Category of the RECORD
            boolean rba_SysElem_isStructWithOptionalElement [0..1]: set at pre-compile, origin=RB  # Optional Element Structure | Specifies if the Structure is Optional Element Structure.
            foreign reference rba_SysElem_ImplementationDataTypeForeignRef [0..1]: set at pre-compile, origin=RB, destination-type=IMPLEMENTATION-DATA-TYPE  # Implementation Data Type Foreign Ref | References the Original IMPLEMENTATION-DATA-TYPE from System Extract from Software-AR-Packages
            container rba_SysElem_SubElement [1..*]  # SubElement | SubElement inside a Record Datatype
              integer rba_SysElem_Index: 0.., set at pre-compile, origin=RB, with-auto=true  # Index | This index is used to ensure the correct order of the SubElements inside a Record Datatype independent of the used tools in the workflow.
              boolean rba_SysElem_isOptional [0..1]: set at pre-compile, origin=RB  # Optional Element | Specifies if the Element is Optional in the Structure.
              reference rba_SysElem_ImplDataTypeRef: set at pre-compile, origin=RB, destination=rba_SysElem_ImplementationDataType  # Implementation Data Type Reference | Reference to the Implementation Data Type
          container rba_SysElem_UnionImplDataType [0..1]  # Union Implementation Data Type | Implementation Data Type of the Category: UNION
            enumeration rba_SysElem_Category: {VALUE, TYPE_REFERENCE, DATA_REFERENCE, FUNCTION_REFERENCE, STRUCTURE, UNION, ARRAY}, set at pre-compile, origin=RB, with-auto=true  # Category | Category of the Union Implementation Data Type
            foreign reference rba_SysElem_ImplementationDataTypeForeignRef [0..1]: set at pre-compile, origin=RB, destination-type=IMPLEMENTATION-DATA-TYPE  # Implementation Data Type Foreign Ref | References the Original IMPLEMENTATION-DATA-TYPE from System Extract from Software-AR-Packages
            container rba_SysElem_SubElement [1..*]  # SubElement | SubElement of the Array
              reference rba_SysElem_ImplDataTypeRef: set at pre-compile, origin=RB, destination=rba_SysElem_ImplementationDataType  # Implementation Data Type Reference | Reference to the Implementation Data Type
      container rba_SysElem_PortInterfaces [0..1]  # PortInterfaces | Container for PortInterfaces
        choice container rba_SysElem_PortInterface [0..*]  # PortInterface | Required or Provided Interface of the Port
          container rba_SysElem_ClientServerInterface [0..1]  # ClientServerInterface | A client/server interface declares a number of operations that can be invoked on a server by a client.
            boolean rba_SysElem_IsService [0..1]: set at pre-compile, origin=RB, with-auto=true  # IsService | This flag is set if the Port Interface is used for communication with a ServiceSwComponentType
            foreign reference rba_SysElem_ClientServerInterfaceForeignRef: set at pre-compile, origin=RB, destination-type=CLIENT-SERVER-INTERFACE  # ClientServerInterface Foreign Reference | Reference to the Client-Server Interface.
            container rba_SysElem_ApplicationError [0..*]  # ApplicationError | Application errors that are defined as part of this interface.
              integer rba_SysElem_ErrorCode: set at pre-compile, origin=RB, with-auto=true  # ErrorCode | Possible errors that may by raised by the referring operation.
              foreign reference rba_SysElem_ApplicationErrorForeignRef: set at pre-compile, origin=RB, destination-type=APPLICATION-ERROR  # ApplicationError Foreign Reference | Reference to the ApplicationError
            container rba_SysElem_ClientServerOperation [1..*]  # ClientServerOperation | ClientServerOperation(s) of this ClientServerInterface.
              foreign reference rba_SysElem_ClientServerOperationForeignRef: set at pre-compile, origin=RB, destination-type=CLIENT-SERVER-OPERATION  # ClientServerOperation Foreign Reference | Reference to this ClientServerOperation in the SystemExtract.
              container rba_SysElem_ArgumentDataPrototype [0..*]  # ArgumentDataPrototype | An argument of this ClientServerOperation
                enumeration rba_SysElem_Direction [0..1]: {in, out, inout}, set at pre-compile, origin=RB, with-auto=true  # Direction | This attribute specifies the direction of the argument prototype. - in: The argument value is passed to the callee. - out: The argument value is passed from the callee to the caller. - inout: The argument value is passed to the callee but also passed back from the callee to the caller.
                integer rba_SysElem_Index [0..1]: 0.., set at pre-compile, origin=RB, with-auto=true  # Index | The 'argument's of the ClientServerOperation is a ordered list. The index can be used to ensure the correct order. Background: Because the sequence of the 'arguments' get created in correct order by using the rba_SysElem-importer script, so the index is more a fallback in case a file split and merge would swap or mix the order.
                enumeration rba_SysElem_ServerArgumentImplPolicy [0..1]: set at pre-compile, origin=RB, with-auto=true  # ServerArgumentImplPolicy | This defines how the argument type of the servers RunnableEntity is implemented. If the attribute is not defined this has the same semantics as if the attribute is set to the value useArgumentType for primitive arguments and structures and to the value useArrayBaseType for arrays. - useArgumentType: The argument type of the RunnableEntity is derived from the AutosarDataType of the ArgumentPrototype. - useArrayBaseType: The argument type of the RunnableEntity is derived from the AutosarDataType of the elements of the array that corresponds to the ArgumentPrototype. This represents the base type of the array in C. - useVoid: The argument type of the RunnableEntity is void.
                  useArgumentType  # Use Argument Type
                  useArrayBaseType  # Use Array-Base Type
                  useVoid  # Use Void
                reference rba_SysElem_DatatypeRef: set at pre-compile, origin=RB, destination=rba_SysElem_ImplementationDataType  # Datatype Reference | References to the implementation Datatype
              container rba_SysElem_PossibleErrors [0..1]  # PossibleErrors | tbd
                reference rba_SysElem_ApplicationErrorRef [1..*]: set at pre-compile, origin=RB, destination=rba_SysElem_ApplicationError  # ApplicationError Reference | tbd
          container rba_SysElem_SenderReceiverInterface [0..1]  # SenderReceiverInterface | A sender/receiver interface declares a number of data elements to be sent and received.
            foreign reference rba_SysElem_SenderReceiverInterfaceForeignRef: set at pre-compile, origin=RB, destination-type=SENDER-RECEIVER-INTERFACE  # SenderReceiverInterface Foreign Reference | Reference to this SenderReceiverInterface in the SystemExtract.
            container rba_SysElem_VariableDataPrototype [1..*]  # VariableDataPrototype | A VariableDataPrototype is used to contain values in an ECU application. This means that most likely a VariableDataPrototype allocates "static" memory on the ECU. In some cases optimization strategies might lead to a situation where the memory allocation can be avoided.
              reference rba_SysElem_DatatypeRef: set at pre-compile, origin=RB, destination=rba_SysElem_ImplementationDataType  # Datatype Reference | Reference to the Datatype.
              foreign reference rba_SysElem_VariableDataPrototypeForeignRef: set at pre-compile, origin=RB, destination-type=VARIABLE-DATA-PROTOTYPE  # VariableDataPrototype Foreign Reference | Reference to this VariableDataPrototype in the SystemExtract.
      container rba_SysElem_SystemSignalGroups [0..1]  # System Signal Groups | Container for System Signal Groups
        container rba_SysElem_SystemSignalGroup [0..*]  # System Signal Group | A signal group refers to a set of signals that must always be kept together. A signal group is used to guarantee the atomic transfer of AUTOSAR composite data types. The SystemSignalGroup defines a signal grouping on VFB level. On cluster level the Signal grouping is described by the ISignalGroup element.
          reference rba_SysElem_SystemSignal [0..*]: set at pre-compile, origin=RB, destination=rba_SysElem_SystemSignal  # SystemSignal | Reference to a set of SystemSignals that must always be kept together.
          foreign reference rba_SysElem_SystemSignalGroupForeignRef: set at pre-compile, origin=RB, destination-type=SYSTEM-SIGNAL-GROUP  # System Signal Group Foreign Reference | Reference to this SystemSignalGroup in the SystemExtract.
          reference rba_SysElem_TransformingSystemSignalRef [0..1]: set at pre-compile, origin=RB, destination=rba_SysElem_SystemSignal  # Transforming SystemSignal Reference | Optional reference to the SystemSignal which shall contain the transformed (linear) data.
      container rba_SysElem_SystemSignals [0..1]  # System Signals | Container for SystemSignals
        container rba_SysElem_SystemSignal [0..*]  # System Signal | The system signal represents the communication system's view of data exchanged between SW components which reside on different ECUs. The system signals allow to represent this communication in a flattened structure, with exactly one system signal defined for each data element prototype sent and received by connected SW component instances.
          boolean rba_SysElem_DynamicLength: set at pre-compile, origin=RB, with-auto=true  # DynamicLength | The length of dynamic length signals is variable in run-time. Only a maximum length of such a signal is specified in the configuration (attribute length in ISignal element).
          foreign reference rba_SysElem_SystemSignalForeignRef: set at pre-compile, origin=RB, destination-type=SYSTEM-SIGNAL  # System Signal Foreign Reference | Reference to this SystemSignal in the SystemExtract.
      container rba_SysElem_TransformationTechnologies [0..1]  # Transformation Technologies | Container for TransformationTechnology
        container rba_SysElem_TransformationTechnology [0..*]  # TransformationTechnology | A TransformationTechnology is a transformer inside a transformer chain.
          boolean rba_SysElem_NeedsOriginalData [0..1]: set at pre-compile, origin=RB, with-auto=true  # NeedsOriginalData | Specifies whether this transformer gets access to the SWC's original data.
          string rba_SysElem_Protocol: set at pre-compile, origin=RB, with-auto=true  # Protocol | Specifies the protocol that is implemented by this transformer.
          enumeration rba_SysElem_TransformerClass: set at pre-compile, origin=RB, with-auto=true  # TransformerClass | Specifies to which transformer class this transformer belongs.
            serializer  # SERIALIZER
            safety  # SAFETY
            security  # SECURITY
            custom  # CUSTOM
          string rba_SysElem_Version: set at pre-compile, origin=RB, with-auto=true  # Version | Version of the implemented protocol.
          foreign reference rba_SysElem_TransformationTechnologyForeignRef: set at pre-compile, origin=RB, destination-type=TRANSFORMATION-TECHNOLOGY  # TransformationTechnology Foreign Reference | Reference to this TransformationTechnology in the SystemExtract.
          container rba_SysElem_BufferProperties  # BufferProperties | Configuration of the buffer properties the transformer needs to work.
            integer rba_SysElem_HeaderLength: set at pre-compile, origin=RB, with-auto=true  # HeaderLength | Defines the length of the header (in bits) this transformer will add in front of the data.
            boolean rba_SysElem_InPlace: set at pre-compile, origin=RB, with-auto=true  # InPlace | If set, the transformer uses the input buffer as output buffer.
            container rba_SysElem_CompuScale [0..1]  # CompuScale | If the transformer changes the size of the data, the CompuScale can be used to specify a rule to derive the size of the output data based on the size of the input data.
              float rba_SysElem_Denominator: set at pre-compile, origin=RB, with-auto=true  # Denominator | Part of the Buffer Computation
              float rba_SysElem_Numerator1: set at pre-compile, origin=RB, with-auto=true  # Numerator1 | Part of the Buffer Computation
              float rba_SysElem_Numerator2: set at pre-compile, origin=RB, with-auto=true  # Numerator2 | Part of the Buffer Computation
          choice container rba_SysElem_TransformationDescription [0..1]  # TransformationDescription | A transformer can be configured with transformer specific parameters which are represented by the TransformerDescription.
            container rba_SysElem_EndToEndTransformationDescription [0..1]  # EndToEndTransformationDescription | EndToEndTransformationDescription holds these attributes which are profile specific and have the same value for all E2E transformers.
              integer rba_SysElem_CounterOffset [0..1]: 0.., set at pre-compile, origin=RB, with-auto=true  # Counter Offset | Offset of the counter in the Data[] array in bits.
              integer rba_SysElem_CrcOffset [0..1]: 0.., set at pre-compile, origin=RB, with-auto=true  # CRC Offset | Offset of the CRC in the Data[] array in bits.
              enumeration rba_SysElem_DataIdMode [0..1]: {all16Bit, alternating8Bit, lower8Bit, lower12Bit}, set at pre-compile, origin=RB, with-auto=true  # Data ID Mode | This attribute describes the inclusion mode that is used to include the implicit two-byte Data ID in the one-byte CRC.
              integer rba_SysElem_DataIdNibbleOffset [0..1]: 0.., set at pre-compile, origin=RB, with-auto=true  # Data ID Nibble Offset | Offset of the Data ID nibble in the Data[] array in bits.
              integer rba_SysElem_MaxDeltaCounter [0..1]: 0.., set at pre-compile, origin=RB, with-auto=true  # Maximum Delta Counter | Maximum allowed gap between two counter values of two consecutive checks.
              integer rba_SysElem_MaxErrorStateInit [0..1]: 0.., set at pre-compile, origin=RB, with-auto=true  # Maximum Error State Init | Maximal number of checks in which ProfileStatus equal to E2E_P_ERROR was determined, within the last WindowSize checks, for the state E2E_SM_INIT.
              integer rba_SysElem_MaxErrorStateInvalid [0..1]: 0.., set at pre-compile, origin=RB, with-auto=true  # Maximum Error State Invalid | Maximal number of checks in which ProfileStatus equal to E2E_P_ERROR was determined, within the last WindowSize checks, for the state E2E_SM_INVALID.
              integer rba_SysElem_MaxErrorStateValid [0..1]: 0.., set at pre-compile, origin=RB, with-auto=true  # Maximum Error State Valid | Maximal number of checks in which ProfileStatus equal to E2E_P_ERROR was determined, within the last WindowSize checks, for the state E2E_SM_VALID.
              integer rba_SysElem_MaxNoNewOrRepeatedData [0..1]: 0.., set at pre-compile, origin=RB, with-auto=true  # Maximum Number Of New Or Repeated Data | The maximum allowed amount of consecutive failed counter checks.
              integer rba_SysElem_MinOkStateInit [0..1]: 0.., set at pre-compile, origin=RB, with-auto=true  # Minimum OK State Init | Minimal number of checks in which ProfileStatus equal to E2E_P_OK was determined, within the last WindowSize checks, for the state E2E_SM_INIT.
              integer rba_SysElem_MinOkStateInvalid [0..1]: 0.., set at pre-compile, origin=RB, with-auto=true  # Minimum OK State Invalid | Minimal number of checks in which ProfileStatus equal to E2E_P_OK was determined, within the last WindowSize checks, for the state E2E_SM_INVALID.
              integer rba_SysElem_MinOkStateValid [0..1]: 0.., set at pre-compile, origin=RB, with-auto=true  # Minimum OK State Valid | Minimal number of checks in which ProfileStatus equal to E2E_P_OK was determined, within the last WindowSize checks, for the state E2E_SM_VALID.
              integer rba_SysElem_Offset [0..1]: 0.., set at pre-compile, origin=RB, with-auto=true  # Offset | Offset of the E2E header in the Data[] array in bits.
              enumeration rba_SysElem_ProfileBehavior [0..1]: {PRE_R4_2, R4_2}, set at pre-compile, origin=RB, with-auto=true  # Profile Behaviour | Behavior of the check functionality
              string rba_SysElem_ProfileName: set at pre-compile, origin=RB, with-auto=true  # Profile Name | Definition of the E2E profile.
              integer rba_SysElem_SyncCounterInit [0..1]: 0.., set at pre-compile, origin=RB, with-auto=true  # Sync Counter Init | Number of checks required for validating the consistency of the counter that must be received with a valid counter (i.e. counter within the allowed lock-in range) after the detection of an unexpected behavior of a received counter.
              integer rba_SysElem_UpperHeaderBitsToShift: 0.., set at pre-compile, origin=RB, with-auto=true  # Upper Header Bits To Shift | This attribute describes the number of upper-header bits to be shifted. value = 0 or not present: shift of upper header is NOT performed. value > 0: the E2E Transformer on the protect-side, takes the first upperHeaderBitsToShift bits from the upper buffer (e.g. SOME/IP header part generated by SOME/IP transformer) and shifts them towards the lower bytes and bits within the Data[] for the length of the E2E header (e.g. 12 bytes in case of E2E Profile 4). This means the shift distance is fixed - it depends on the E2E header size - what is configured here is the number of bits that are to be shifted. This option is defined because the Some/IP header generated by SOME/IP transformer must be, due to compatibility between non-protected and E2E-protected communication, at the same position, which is before E2E header.
              integer rba_SysElem_WindowSize [0..1]: 0.., set at pre-compile, origin=RB, with-auto=true  # Window Size | Size of the monitoring window for the E2E state machine.
            container rba_SysElem_SOMEIPTransformationDescription [0..1]  # SOMEIPTransformationDescription | The SOMEIPTransformationDescription is used to specify SOME/IP transformer specific attributes.
              integer rba_SysElem_Alignment: 0.., set at pre-compile, origin=RB, with-auto=true  # Alignment | Specifies the alignment of dynamic data in the serialized data stream. The alignment shall be specified in Bits.
              enumeration rba_SysElem_ByteOrder: {mostSignificantByteFirst, mostSignificantByteLast, opaque}, set at pre-compile, origin=RB, with-auto=true  # ByteOrder | Defines which byte order shall be serialized by the SOME/IP transformer.
              integer rba_SysElem_InterfaceVersion: 0.., set at pre-compile, origin=RB, with-auto=true  # InterfaceVersion | The interface version the SOME/IP transformer shall use.
            container rba_SysElem_UserDefinedTransformationDescription [0..1]  # UserDefinedTransformationDescription | The UserDefinedTransformationDescription is used to specify details and documentation for custom transformers.
              string rba_SysElem_Description [0..1]: set at pre-compile, origin=RB, with-auto=true  # Desc | This represents a general but brief (one paragraph) description what the object in question is about. It is only one paragraph! Desc is intended to be collected into overview tables. This property helps a human reader to identify the object in question
    container rba_SysElem_XfrmAdp_Component [0..1]  # rba_XfrmAdp Configuration | Configuration of the Transformers Adapter for SomeIpXf or ComXf.
      container rba_SysElem_InternalBehaviour [0..1]  # InternalBehaviour | Internal Behaviour of the Runnable Entity.
        foreign reference rba_SysElem_DataTypeMappingSetForeignRef [1..*]: set at pre-compile, origin=RB, destination-type=DATA-TYPE-MAPPING-SET  # DataTypeMappingSet Foreign Reference | Reference to the DataTypeMappingSet.
        choice container rba_SysElem_RTEEvent [0..*]  # RTEEvent | Abstract base class for all RTE-related events
          container rba_SysElem_AsynchronousServerCallReturnsEvent [0..1]  # AsynchronousServerCallReturnsEvent | This event is raised when an asynchronous server call is finished. It invokes the RunnableEntity of the Client-SWC
            reference rba_SysElem_EventSource: set at pre-compile, origin=RB, destination=rba_SysElem_AsynchronousServerCallResultPoint  # EventSource | The referenced AsynchronousServerCallResultPoint which is raises the RTEEvent in case of returning asynchronous server call. \RunnableEntity\AsynchronousServerCallResultPoint
            reference rba_SysElem_StartOnEvent: set at pre-compile, origin=RB, destination=rba_SysElem_RunnableEntity  # StartOnEvent | RunnableEntity starts when the corresponding RTEEvent occurs.
          container rba_SysElem_DataReceivedEvent [0..1]  # DataReceivedEvent | Event describing the Receive of Data.
            reference rba_SysElem_PortRef: set at pre-compile, origin=RB, destination=rba_SysElem_RPortPrototype  # Port Reference | Reference to the Port is used for Communication
            reference rba_SysElem_StartOnEvent: set at pre-compile, origin=RB, destination=rba_SysElem_RunnableEntity  # StartOnEvent | Defines if the Runnable will be started on Event or not.
            reference rba_SysElem_VariableDataPrototypeRef: set at pre-compile, origin=RB, destination=rba_SysElem_VariableDataPrototype  # VariableDataPrototype Reference | Reference to the Variable Data Prototype.
          container rba_SysElem_OperationInvokedEvent [0..1]  # OperationInvokedEvent | Configures which Event will be invoked by the Operation.
            reference rba_SysElem_OperationRef: set at pre-compile, origin=RB, destination=rba_SysElem_ClientServerOperation  # ClientServerOperation Reference | References ClientServerOperation inside the CS-Interface
            reference rba_SysElem_PortRef: set at pre-compile, origin=RB, destination=rba_SysElem_PPortPrototype  # Port Reference | Reference to the Port.
            reference rba_SysElem_StartOnEvent: set at pre-compile, origin=RB, destination=rba_SysElem_RunnableEntity  # StartOnEvent | defines if the Runnable Entity will be started with the Event.
          container rba_SysElem_TimingEvent [0..1]  # TimingEvent | Defines the Timing
            float rba_SysElem_Period: set at pre-compile, origin=RB, with-auto=true  # Period | Period of the Timing
            reference rba_SysElem_StartOnEvent: set at pre-compile, origin=RB, destination=rba_SysElem_RunnableEntity  # StartOnEvent | Defines if the Runnable will be started on Event or not.
        container rba_SysElem_RunnableEntity [1..*]  # RunnableEntity | A RunnableEntity represents the smallest code-fragment that is provided by an AtomicSwComponentType and are executed under control of the RTE. RunnableEntities are for instance set up to respond to data reception or operation invocation on a server.
          choice container rba_SysElem_DataAccess [0..*]  # DataAccess | Defines the Access to the Data (Read or Write)
            container rba_SysElem_DataReadAccess [0..1]  # DataReadAccess | Defines the Read Access to the Data Element
              reference rba_SysElem_PortRef: set at pre-compile, origin=RB, destination=rba_SysElem_RPortPrototype  # Port Reference | Reference to the Port.
              reference rba_SysElem_VariableDataPrototypeRef: set at pre-compile, origin=RB, destination=rba_SysElem_VariableDataPrototype  # VariableDataPrototype Reference | Reference to the Variable Data Prototype
            container rba_SysElem_DataReceivePointByArguments [0..1]  # DataReceivePointByArguments | RunnableEntity has explicit read access to dataElement of a sender-receiver PortPrototype or nv data of a nv data PortPrototype. The result is passed back to the application by means of an argument in the function signature.
              reference rba_SysElem_PortRef: set at pre-compile, origin=RB, destination=rba_SysElem_RPortPrototype  # Port Reference | Reference to the Port.
              reference rba_SysElem_VariableDataPrototypeRef: set at pre-compile, origin=RB, destination=rba_SysElem_VariableDataPrototype  # VariableDataPrototype Reference | Reference to the Variable Data Prototype
            container rba_SysElem_DataSendPoint [0..1]  # DataSendPoint | RunnableEntity has explicit write access to dataElement of a sender-receiver PortPrototype or nv data of a nv data PortPrototype.
              reference rba_SysElem_PortRef: set at pre-compile, origin=RB, destination=rba_SysElem_PPortPrototype  # Port Reference | Reference to the Port
              reference rba_SysElem_VariableDataPrototypeRef: set at pre-compile, origin=RB, destination=rba_SysElem_VariableDataPrototype  # VariableDataPrototype Reference | Reference to the Variable Data Prototype
            container rba_SysElem_DataWriteAccess [0..1]  # DataWriteAccess | RunnableEntity has implicit write access to dataElement of a sender-receiver PortPrototype or nv data of a nv data PortPrototype.
              reference rba_SysElem_PortRef: set at pre-compile, origin=RB, destination=rba_SysElem_PPortPrototype  # Port Reference | Reference to the Port
              reference rba_SysElem_VariableDataPrototypeRef: set at pre-compile, origin=RB, destination=rba_SysElem_VariableDataPrototype  # VariableDataPrototype Reference | Reference to the Variable Data Prototype
          choice container rba_SysElem_OperationAccess [0..*]  # OperationAccess | Server Call Point
            container rba_SysElem_AsynchronousServerCallPoint [0..1]  # AsynchronousServerCallPoint | The RunnableEntity has a ServerCallPoint. The aggregation of ServerCallPoint is subject to variability with the purpose to support the conditional existence of client server PortPrototypes or the variant existence of server call points in the implementation.
              reference rba_SysElem_OperationRef: set at pre-compile, origin=RB, destination=rba_SysElem_ClientServerOperation  # ClientServerOperation Reference | References ClientServerOperation inside the CS-Interface
              reference rba_SysElem_PortRef: set at pre-compile, origin=RB, destination=rba_SysElem_RPortPrototype  # Port Reference | Context RPort
            container rba_SysElem_AsynchronousServerCallResultPoint [0..1]  # AsynchronousServerCallResultPoint | If a RunnableEntity owns a AsynchronousServerCallResultPoint it is entitled to get the result of the referenced AsynchronousServerCallPoint. If it is associated with AsynchronousServerCallReturnsEvent, this RTEEvent notifies the completion of the required ClientServerOperation or a timeout. The occurrence of this event can either unblock a WaitPoint or can lead to the invocation of a RunnableEntity.
              reference rba_SysElem_AsynchronousServerCallPointRef: set at pre-compile, origin=RB, destination=rba_SysElem_AsynchronousServerCallPoint  # AsynchronousServerCallPoint Reference | Context RPort
            container rba_SysElem_SynchronousServerCallPoint [0..1]  # SynchronousServerCallPoint | The RunnableEntity has a ServerCallPoint. The aggregation of ServerCallPoint is subject to variability with the purpose to support the conditional existence of client server PortPrototypes or the variant existence of server call points in the implementation.
              reference rba_SysElem_OperationRef: set at pre-compile, origin=RB, destination=rba_SysElem_ClientServerOperation  # ClientServerOperation Reference | References ClientServerOperation inside the CS-Interface
              reference rba_SysElem_PortRef: set at pre-compile, origin=RB, destination=rba_SysElem_RPortPrototype  # Port Reference | Context RPort
      choice container rba_SysElem_PortPrototype [0..*]  # PortPrototype | Reference to the Port Prototype
        container rba_SysElem_PPortPrototype [0..1]  # PPortPrototype | Reference to the Providing Port Prototype
          boolean rba_SysElem_MultipleClients [0..1]: set at pre-compile, origin=RB  # MultipleClients | Specifies whether Multiple Clients are present in the Client ECU.
          integer rba_SysElem_ClientID [0..1]: set at pre-compile, origin=RB, with-auto=true  # ClientID | ID of a specific Client
          reference rba_SysElem_CallSignalRef [0..1]: set at pre-compile, origin=RB, destination=rba_SysElem_SystemSignal  # CallSignalRef | References the original ISignal that should be transformed via this Port in case of a ClientServer Communication
          reference rba_SysElem_IsOfType: set at pre-compile, origin=RB, destination=rba_SysElem_PortInterface  # IsOfType | References the Interfaces that is used by the original sending (or receiving) Port of ApplicationSwComponentPrototype
          reference rba_SysElem_ReturnSignalRef [0..1]: set at pre-compile, origin=RB, destination=rba_SysElem_SystemSignal  # ReturnSignalRef | References the original ISignal that should be transformed via this Port in case of a ClientServer Communication
          reference rba_SysElem_ClientServerOperationRef [0..1]: set at pre-compile, origin=RB, destination=rba_SysElem_ClientServerOperation  # ClientServerOperation Reference | Reference to a ClientServerOperation, which is mapped to a call SystemSignal and a return SystemSignal
          reference rba_SysElem_SystemSignalGroupRef [0..1]: set at pre-compile, origin=RB, destination=rba_SysElem_SystemSignalGroup  # SystemSignalGroupRef | References the original ISignalGroup that should be transformed via this Port in case of a Sender-Receiver Communication
          reference rba_SysElem_SystemSignalRef [0..1]: set at pre-compile, origin=RB, destination=rba_SysElem_SystemSignal  # SystemSignalRef | References the original ISignal that should be transformed via this Port in case of a Sender-Receiver Communication
          container rba_SysElem_ProvidedServerComSpec [0..1]  # ProvidedServerComSpec | Communication attributes for a sender port
            integer rba_SysElem_QueueLength: 0.., set at pre-compile, origin=RB, with-auto=true  # QueueLength | Length of call queue on the server side. The queue is implemented by the RTE. The value shall be greater or equal to 1. Setting the value of queueLength to 1 implies that incoming requests are rejected while another request that arrived earlier is being processed.
            reference rba_SysElem_E2ETransformationComSpecPropsISignalRef [0..*]: set at pre-compile, origin=RB, destination=rba_SysElem_ISignal/rba_SysElem_TransformationComSpecProps  # E2ETransformationComSpecProps ISignal Reference | specifies port specific configuration properties for EndToEnd transformer attributes.
            reference rba_SysElem_OperationRef: set at pre-compile, origin=RB, destination=rba_SysElem_ClientServerOperation  # ClientServerOperation Reference | References ClientServerOperation
            container rba_SysElem_EndToEndTransformationComSpecProps [0..1]  # EndToEndTransformationComSpecProps | Specifies port specific configuration properties for EndToEnd transformer attributes
              boolean rba_SysElem_DisableEndToEndCheck: set at pre-compile, origin=RB, with-auto=true  # DisableEndToEndCheck | Disables/Enables the E2E check. The E2Eheader is removed from the payload independent from the setting of this attribute
              integer rba_SysElem_MaxDeltaCounter [0..1]: 0.., set at pre-compile, origin=RB, with-auto=true  # MaxDeltaCounter | Maximum allowed gap between two counter values of two consecutive checks
              integer rba_SysElem_MaxErrorStateInit [0..1]: 0.., set at pre-compile, origin=RB, with-auto=true  # MaxErrorStateInit | Maximal number of checks in which ProfileStatus equal to E2E_P_ERROR was determined, within the last WindowSize checks, for the state E2E_SM_INIT. The minimum value is 0
              integer rba_SysElem_MaxErrorStateInvalid [0..1]: 0.., set at pre-compile, origin=RB, with-auto=true  # MaxErrorStateInvalid | Maximal number of checks in which ProfileStatus equal to E2E_P_ERROR was determined, within the last WindowSize checks, for the state E2E_SM_INVALID. The minimum value is 0
              integer rba_SysElem_MaxErrorStateValid: 0.., set at pre-compile, origin=RB, with-auto=true  # MaxErrorStateValid | Maximal number of checks in which ProfileStatus equal to E2E_P_ERROR was determined, within the last WindowSize checks, for the state E2E_SM_VALID. The minimum value is 0
              integer rba_SysElem_MaxNoNewOrRepeatedData [0..1]: 0.., set at pre-compile, origin=RB, with-auto=true  # MaxNoNewOrRepeatedData | The maximum amount of missing or repeated Data which the receiver does not expect to exceed under normal communication conditions.
              integer rba_SysElem_MinOkStateInit [0..1]: 1.., set at pre-compile, origin=RB, with-auto=true  # MinOkStateInit | Minimal number of checks in which ProfileStatus equal to E2E_P_OK was determined, within the last WindowSize checks, for the state E2E_SM_INIT. The minimum value is 1
              integer rba_SysElem_MinOkStateInvalid [0..1]: 1.., set at pre-compile, origin=RB, with-auto=true  # MinOkStateInvalid | Minimal number of checks in which ProfileStatus equal to E2E_P_OK was determined, within the last WindowSize checks, for the state E2E_SM_INVALID. The minimum value is 1
              integer rba_SysElem_MinOkStateValid [0..1]: 1.., set at pre-compile, origin=RB, with-auto=true  # MinOkStateValid | Minimal number of checks in which ProfileStatus equal to E2E_P_OK was determined, within the last WindowSize checks, for the state E2E_SM_VALID. The minimum value is 1
              integer rba_SysElem_SyncCounterInit [0..1]: 0.., set at pre-compile, origin=RB, with-auto=true  # SyncCounterInit | Number of Data required for validating the consistency of the counter that must be received with a valid counter (i.e. counter within the allowed lock-in range) after the detection of an unexpected behavior of a received counter.
              integer rba_SysElem_WindowSize [0..1]: 0.., set at pre-compile, origin=RB, with-auto=true  # WindowSize | Size of the monitoring window for the E2E state machine
        container rba_SysElem_RPortPrototype [0..1]  # RPortPrototype | Component port requiring a certain port interface.
          boolean rba_SysElem_MultipleClients [0..1]: set at pre-compile, origin=RB  # MultipleClients | Specifies whether Multiple Clients are present in the Server ECU.
          integer rba_SysElem_ServerQueueLength [0..1]: 0.., set at pre-compile, origin=RB  # ServerQueueLength | QueueLength configured in the Server ECU
          string rba_SysElem_QueueName [0..1]: set at pre-compile, origin=RB  # QueueName | Required for the Queue Handling. If multiple client server to signal mappings refer same CallSignal then only one time the callsignal name needs to be used
          reference rba_SysElem_CallSignalRef [0..1]: set at pre-compile, origin=RB, destination=rba_SysElem_SystemSignal  # CallSignalRef | References the original ISignal that should be transformed via this Port in case of a ClientServer Communication
          reference rba_SysElem_IsOfType: set at pre-compile, origin=RB, destination=rba_SysElem_PortInterface  # IsOfType | References the Interfaces that is used by the original sending (or receiving) Port of ApplicationSwComponentPrototype
          reference rba_SysElem_ReturnSignalRef [0..1]: set at pre-compile, origin=RB, destination=rba_SysElem_SystemSignal  # ReturnSignalRef | References the original ISignal that should be transformed via this Port in case of a ClientServer Communication
          reference rba_SysElem_SystemSignalGroupRef [0..1]: set at pre-compile, origin=RB, destination=rba_SysElem_SystemSignalGroup  # SystemSignalGroupRef | References the original ISignalGroup that should be transformed via this Port in case of a Sender-Receiver Communication
          reference rba_SysElem_SystemSignalRef [0..1]: set at pre-compile, origin=RB, destination=rba_SysElem_SystemSignal  # SystemSignalRef | References the original ISignal that should be transformed via this Port in case of a Sender-Receiver Communication
          container rba_SysElem_RequiredClientComSpec [0..1]  # RequiredClientComSpec | Client specific communication attributes
            reference rba_SysElem_E2ETransformationComSpecPropsISignalRef [0..*]: set at pre-compile, origin=RB, destination=rba_SysElem_ISignal/rba_SysElem_TransformationComSpecProps  # E2ETransformationComSpecProps ISignal Reference | specifies port specific configuration properties for EndToEnd transformer attributes.
            reference rba_SysElem_OperationRef: set at pre-compile, origin=RB, destination=rba_SysElem_ClientServerOperation  # ClientServerOperation Reference | References ClientServerOperation
            container rba_SysElem_EndToEndTransformationComSpecProps [0..1]  # EndToEndTransformationComSpecProps | Specifies port specific configuration properties for EndToEnd transformer attributes
              boolean rba_SysElem_DisableEndToEndCheck: set at pre-compile, origin=RB, with-auto=true  # DisableEndToEndCheck | Disables/Enables the E2E check. The E2Eheader is removed from the payload independent from the setting of this attribute
              integer rba_SysElem_MaxDeltaCounter [0..1]: 0.., set at pre-compile, origin=RB, with-auto=true  # MaxDeltaCounter | Maximum allowed gap between two counter values of two consecutive checks
              integer rba_SysElem_MaxErrorStateInit [0..1]: 0.., set at pre-compile, origin=RB, with-auto=true  # MaxErrorStateInit | Maximal number of checks in which ProfileStatus equal to E2E_P_ERROR was determined, within the last WindowSize checks, for the state E2E_SM_INIT. The minimum value is 0
              integer rba_SysElem_MaxErrorStateInvalid [0..1]: 0.., set at pre-compile, origin=RB, with-auto=true  # MaxErrorStateInvalid | Maximal number of checks in which ProfileStatus equal to E2E_P_ERROR was determined, within the last WindowSize checks, for the state E2E_SM_INVALID. The minimum value is 0
              integer rba_SysElem_MaxErrorStateValid: 0.., set at pre-compile, origin=RB, with-auto=true  # MaxErrorStateValid | Maximal number of checks in which ProfileStatus equal to E2E_P_ERROR was determined, within the last WindowSize checks, for the state E2E_SM_VALID. The minimum value is 0
              integer rba_SysElem_MaxNoNewOrRepeatedData [0..1]: 0.., set at pre-compile, origin=RB, with-auto=true  # MaxNoNewOrRepeatedData | The maximum amount of missing or repeated Data which the receiver does not expect to exceed under normal communication conditions.
              integer rba_SysElem_MinOkStateInit [0..1]: 1.., set at pre-compile, origin=RB, with-auto=true  # MinOkStateInit | Minimal number of checks in which ProfileStatus equal to E2E_P_OK was determined, within the last WindowSize checks, for the state E2E_SM_INIT. The minimum value is 1
              integer rba_SysElem_MinOkStateInvalid [0..1]: 1.., set at pre-compile, origin=RB, with-auto=true  # MinOkStateInvalid | Minimal number of checks in which ProfileStatus equal to E2E_P_OK was determined, within the last WindowSize checks, for the state E2E_SM_INVALID. The minimum value is 1
              integer rba_SysElem_MinOkStateValid [0..1]: 1.., set at pre-compile, origin=RB, with-auto=true  # MinOkStateValid | Minimal number of checks in which ProfileStatus equal to E2E_P_OK was determined, within the last WindowSize checks, for the state E2E_SM_VALID. The minimum value is 1
              integer rba_SysElem_SyncCounterInit [0..1]: 0.., set at pre-compile, origin=RB, with-auto=true  # SyncCounterInit | Number of Data required for validating the consistency of the counter that must be received with a valid counter (i.e. counter within the allowed lock-in range) after the detection of an unexpected behavior of a received counter.
              integer rba_SysElem_WindowSize [0..1]: 0.., set at pre-compile, origin=RB, with-auto=true  # WindowSize | Size of the monitoring window for the E2E state machine

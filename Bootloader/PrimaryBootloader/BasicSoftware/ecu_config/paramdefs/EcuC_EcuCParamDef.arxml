AUTOSAR XML (schema 4-2-2)
package /AUTOSAR_EcuC/EcucModuleDefs
  module definition EcuC [0..1]: category=VENDOR_SPECIFIC_MODULE_DEFINITION, post-build-variant-support=true, refined-module-def=EcuC, variants pre-compile/post-build  # ECU Configuration | Virtual Module to Collect ECU Configuration Specific/Global Configuration Information.
    container EcuCRbSettings  # Robert Bosch Specific Settings
      enumeration EcuCRbArRelease: {AR40_Rev2, AR42_Rev2, AR45_Rev0}, scope=ECU, multiplicity set at pre-compile, origin=RB:42.8.0.0:2020-06-26, set at pre-compile  # Select the AUTOSAR Version/Revision,the Project is Based on. | This parameter indicates the basic AR-Version a complete Project is based on. Only Versions rolled out to complete CUBAS will be listed here. I.e. AR40_Rev2 AR42_Rev2.AR44_Rev1 may be in future…
      boolean EcuCRbEnablePrototype [0..1]: scope=ECU, multiplicity set at pre-compile, origin=RB:42.7.0.0:2019-11-26, set at pre-compile  # Switch to enable(true)/disable(false) the possibility to use CUBAS prototype elements within your project. The prototype setting is NOT ALLOWED FOR SERIES-PRODUCTION. Please note that additional parameter settings are needed in the related components to actually select the related functionality. For series production: false (MANDATORY) For prototype: true or false or not available can be selected | This configuration parameter is a Switch to enable(true)/disable(false) the possibility to use CUBAS prototype elements within your project.
      boolean EcuCRbMetadata [0..1]: scope=ECU, multiplicity set at pre-compile, origin=RB:42.9.0.1:2021-02-17, set at pre-compile, default-value=true  # PduInfoType structure generate with MetaDataPtr element. Used in ComStack file for generation. This parameter is kept for backward compatibility for AR42 version. If this is set to true or not configured, MetaDataPt is generated in PduInfoType
      boolean EcuCRbRteInUse: scope=ECU, multiplicity set at pre-compile, origin=RB:42.2.0.0:2017-05-09, set at pre-compile  # If the value is false, RTE is disabled, else it’s enabled in the Configuration. All BSW modules(except CUCEL/EcuC) shall analyze the parameter EcuCRbRteInUse and Rte generated headers shall be included in the project as below. If EcuCRbRteInUse is TRUE, Rte Header “SchM_<Module>.h” shall be included in <Module>.c (Conditional compilation) If EcuCRbRteInUse is TRUE, Rte Header “Rte_<Module>.h” shall be included in <Module>.c (Conditional compilation) If EcuCRbRteInUse is TRUE, the module header file "<Module>.h" and the header file "<Module>_Types.h" shall contain only the elements which are needed to interact with BSW modules and are not part of the RTE generated headers. If EcuCRbRteInUse is FALSE then "<Module>.h" and "<Module>_Types.h" shall provide all the function prototypes, type definitions and macros which are needed to interact with other BSW modules. | All BSW modules(except CUCEL/EcuC) shall analyze the parameter EcuCRbRteInUse and Rte generated headers shall be included in the project as below. If EcuCRbRteInUse is TRUE, Rte Header “SchM_<Module>.h” shall be included in <Module>.c (Conditional compilation) If EcuCRbRteInUse is TRUE, Rte Header “Rte_<Module>.h” shall be included in <Module>.c (Conditional compilation) If EcuCRbRteInUse is TRUE, the module header file "<Module>.h" and the header file "<Module>_Types.h" shall contain only the elements which are needed to interact with BSW modules and are not part of the RTE generated headers. If EcuCRbRteInUse is FALSE then "<Module>.h" and "<Module>_Types.h" shall provide all the function prototypes, type definitions and macros which are needed to interact with other BSW modules.
      enumeration EcuCRbSoftwareDeliveryConfiguration [0..1]: {SWSRC, SWOBJ}, scope=ECU, multiplicity set at pre-compile, origin=RB:42.6.0.0:2019-06-12, set at pre-compile, default-value=SWSRC  # This container contains the configuration parameter of SWSRC/SWOBJ. It shall be possible to generate the tag of the section with the value “SWOBJ” instead of the currently hard-coded value “SWSRC” in <Module>_Cfg_SWCD.arxml file. A new configuration option shall be implemented to determine which of these two values should be forwarded for all BSW Components. When this tag is set to “SWSRC” the RTE-generator implements the functionality as a macro or inline function, and with the value “SWOBJ” it will be generated as a function. | This configuration parameter for control RTE generation optimization of API to macro
      boolean EcuCRbVecuEnabled [0..1]: scope=ECU, multiplicity set at pre-compile, origin=RB:42.7.0.0:2019-11-11, set at pre-compile, default-value=false  # This container contains the configuration parameter which when enabled indicates virtual target else when disabled indicates that the Target is a Real Target. Background: For the virtualized CUBAS Drivers need a differentiation attribute to see if the build is for a virtual or a real target. | This configuration parameter to see whether the build is for a virtual or a real target
    container EcucConfigSet [0..1]  # This container contains the configuration parameters and sub containers of the global PduCollection.
      container EcucPduCollection [0..1]  # Collection of all PDU objects flowing through the Com-Stack.
        enumeration PduIdTypeEnum: {uint16, uint8}  # The PduIdType is used within the entire AUTOSAR Com Stack except for bus drivers. The size of this global type depends on the maximum number of PDUs used within one software module. If no software module deals with more PDUs that 256, this type can be set to uint8. If at least one software module handles more than 256 PDUs, this type must be set to uint16. See AUTOSAR_SWS_CommunicationStackTypes for more details.
        enumeration PduLengthTypeEnum: {uint16, uint32, uint8}  # The PduLengthType is used within the entire AUTOSAR Com Stack except for bus drivers. The size of this global type depends on the maximum length of PDUs to be sent by an ECU. If no segmentation is used the length depends on the maximum payload size of a frame of the underlying communication system (for FlexRay maximum size is 255 bytes, therefore uint8). If segementation is used it depends on the maximum length of a segmeneted N-PDU (in general uint16 is used). See AUTOSAR_SWS_CommunicationStackTypes for more details.
        container Pdu [0..*]: multiplicity set at post-build in variant post-build / pre-compile in variant pre-compile, post-build-variant-multiplicity=true  # One Pdu flowing through the COM-Stack. | This PDU is used by all Com-Stack modules to agree on referencing the same PDU.
          boolean DynamicLength [0..1]: multiplicity set at post-build in variant post-build / pre-compile in variant pre-compile, post-build-variant-multiplicity=true, post-build-variant-value=true, set at post-build in variant post-build / pre-compile in variant pre-compile  # This parameter defines whether the Pdu has dynamic length (true) ornot (false). Please note that the usage of this attribute is restricted by[constr_3448].
          boolean J1939Requestable [0..1]: multiplicity set at post-build in variant post-build / pre-compile in variant pre-compile, post-build-variant-multiplicity=true, post-build-variant-value=true, set at post-build in variant post-build / pre-compile in variant pre-compile  # PDU can be triggered by the J1939 request message.
          integer MetaDataLength [0..1]: 0..4, multiplicity set at post-build in variant post-build / pre-compile in variant pre-compile, post-build-variant-multiplicity=true, post-build-variant-value=true, set at post-build in variant post-build / pre-compile in variant pre-compile, default-value=0  # Number of additional bytes in PDU data that contain auxiliary information (MetaData) for the PDU, e.g. the CAN ID. These bytes are handled as part of the PDU data and increase the PDU data length accordingly.
          integer PduLength: 0..4294967295, post-build-variant-value=true, set at post-build in variant post-build / pre-compile in variant pre-compile  # Length of the Pdu in bytes. It should be noted that in former AUTOSAR releases (Rel 2.1, Rel 3.0, Rel 3.1, Rel 4.0 Rev. 1) this parameter was defined in bits.
          foreign reference SysTPduToFrameTriggeringRef [0..1]: multiplicity set at post-build in variant post-build / pre-compile in variant pre-compile, post-build-variant-multiplicity=true, post-build-variant-value=true, set at post-build in variant post-build / pre-compile in variant pre-compile, destination-type=FRAME-TRIGGERING  # Reference to the FrameTriggering from the SystemTemplate which this Pdu belongs to. | SysTPduToFrameTriggeringRef shall be used for UserDefinedPdus, NmPdus and NPdus which are not going through the Pdu Router. This reference shall not be used if SysTPduToPduTriggeringRef exists.
          foreign reference SysTPduToPduTriggeringRef [0..1]: multiplicity set at post-build in variant post-build / pre-compile in variant pre-compile, post-build-variant-multiplicity=true, post-build-variant-value=true, set at post-build in variant post-build / pre-compile in variant pre-compile, destination-type=PDU-TRIGGERING  # Reference to the PduTriggering from the SystemTemplate which this Pdu represents. | SysTPduToPduTriggeringRef shall be used for all Pdus except UserDefinedPdus, NmPdus and NPdus which are not going through the Pdu Router. For these Pdus, SysTPduToFrameTriggeringRef shall be used.
    container EcucHardware [0..1]  # Hardware definition of this Ecu.
      container EcucCoreDefinition [0..*]  # Definition of one Core on this Ecu.
        integer EcucCoreId: 0..65535, set at pre-compile, symbolic-name-value=true  # ID of the core.
        foreign reference EcucCoreHwRef [0..1]: multiplicity set at pre-compile, set at pre-compile, destination-type=HW-ELEMENT  # Optional reference to the HwElement of HwCategory ProcessingUnit that represents this Core in the ECU Resource Template.
    container EcucPartitionCollection [0..1]  # Collection of Partitions defined for this ECU.
      container EcucPartition [0..*]: multiplicity set at pre-compile  # Definition of one Partition on this ECU. | One Partition will be implemented using one Os-Application.
        boolean EcucPartitionBswModuleExecution: set at pre-compile  # Denotes that this partition will execute BSW Modules. BSW Modules can only be executed in such partitions.
        boolean EcucPartitionQmBswModuleExecution [0..0]: scope=ECU, set at pre-compile, default-value=true  # Denotes that this partition will execute QM BSW.
        boolean PartitionCanBeRestarted: set at pre-compile  # Specifies the requirement whether the Partition can be restarted. If set to true all software executing in this partition shall be capable of handling a restart.
        foreign reference EcucPartitionBswModuleDistinguishedPartition [0..*]: multiplicity set at pre-compile, set at pre-compile, destination-type=BSW-DISTINGUISHED-PARTITION  # This maps the abstract partition of the Bsw Module to a concrete Partition existing in the ECU.
        instance reference EcucPartitionSoftwareComponentInstanceRef [0..*]: multiplicity set at pre-compile, set at pre-compile, destination-context=ROOT-SW-COMPOSITION-PROTOTYPE, destination-type=SW-COMPONENT-PROTOTYPE  # References the SW Component instances from the Ecu Extract that shall be executed in this partition.
    container EcucPostBuildVariants [0..1]  # Collection of toplevel PostBuildSelectable variants. The PredefinedVariants linked inside this container will determine how many PostBuildSelectableVariants exist. If this container exist the name pattern for initialization of BSW modules will be <Mip>_Config_<PredefinedVariant.shortName>. If this container does not exist the name pattern for initialization of BSW modules will be <Mip>_Config.
      foreign reference EcucPostBuildVariantRef [1..*]: multiplicity set at pre-compile, set at pre-compile, destination-type=PREDEFINED-VARIANT  # Reference to a PredefinedVariant that defines one toplevel postBuild configuration set (covering all post-build capable BSW modules). PredefinedVariants that are referenced here shall contain only PostBuildVariantCriterionValueSets.
    container EcucUnitGroupAssignment [0..0]  # Collection of UnitGroup references to support the generation of ASAM MCD file.
      foreign reference EcucUnitGroupRef [0..0]: multiplicity set at pre-compile, set at pre-compile, destination-type=UNIT-GROUP  # Optional reference to the UnitGroup to support the generation of ASAM MCD file. These UnitGroups are selecting a set of units for a specific country.
    container EcucVariationResolver [0..1]  # Collection of PredefinedVariant elements containing definition of values for SwSystemconst which shall be applied when resolving the variability during ECU Configuration.
      foreign reference PredefinedVariantRef [1..*]: multiplicity set at pre-compile, set at pre-compile, destination-type=PREDEFINED-VARIANT  # Collection of PredefinedVariant elements containing definition of values for SwSystemconst which shall be applied when resolving the variability during ECU Configuration.

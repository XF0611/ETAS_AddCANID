AUTOSAR XML (schema 4-2-2)
package /AUTOSAR_FiM/EcucModuleDefs
  module definition FiM [0..1]: category=VENDOR_SPECIFIC_MODULE_DEFINITION, refined-module-def=FiM, variants pre-compile  # Configuration of the FiM (Function Inhibition Manager) module.
    container FiMConfigSet  # This container contains the configuration parameters and sub containers of the FiM module supporting multiple configuration sets.
      container FiMFID [1..*]  # This container includes symbolic names of all FIDs.
        integer FiMFunctionId: 0..65535, scope=ECU, set at pre-compile, symbolic-name-value=true, with-auto=true  # Unique identifier of a FimFunctionId. This parameter should not be changeable by user, because the Id should be generated by Fim itself to prevent gaps and multiple use of an Id. | Note: The implementer can add the attribute 'withAuto' to the parameter definition which indicates that the value can be calculated by the generator automatically. When 'withAuto' is set to 'true' for this parameter definition the 'isAutoValue' can be set to 'true'. If 'isAutoValue' is set to 'true' the actual value will not be considered during ECU Configuration but will be (re-)calculated by the code generator and stored in the value attribute afterwards.
        integer FiMRbFIdSequence [0..1]: 1..65535, scope=ECU, multiplicity set at pre-compile, origin=RB:AR42.9.0.0:2020-12-15, set at pre-compile  # Sequence Number of a FimFunctionId. This configuration specifies the sequence of FID's and must be unique. This must be configured if FiMRbFidSortMethod is set as Sequence number.
        string FiMRbFIDDescription [0..1]: scope=ECU, origin=RB, set at pre-compile  # The purpose of the specified FiMFID shall be described.
        string FiMRbShiftView [0..1]: multiplicity set at pre-compile, origin=RB:40.6.0.0:2013-07-26  # This parameter is added for DGS FiM. It specifies where to arrange calibration parameters of the FiMFID in asap file (shiftview). DGS DSM creates diagnostic calibration parameters for fids. If your module has own calibration parameters then give your assigned function name in a2l-file and DGS-DSM will shift the diagnostic calibration parameters to this a2l function. Otherwise define a function name for the diagnostic calibration, only.
        reference FiMRbProvidingRef [0..*]: multiplicity set at pre-compile, origin=RB:40.6.0.0:2013-07-26, destination=DemEventParameter  # This parameter is added for DGS FiM. It refereces to the Dem events defined by this FiMFunction.
        container FiMRbDoc [0..1]: multiplicity set at pre-compile  # Documentation | This container contains the documentation for the FiMFID.
          add info FiMRbDocSubstReaction [0..1]: category=RB_ADD_INFO, origin=RB, set at pre-compile  # Substitute function | Verbal description of the substitute function.
      container FiMInhibitionConfiguration [1..*]: multiplicity set at post-build in variant post-build / pre-compile in variant pre-compile, post-build-variant-multiplicity=true  # This container includes all configuration parameters concerning the relationship between event and FID.
        enumeration FiMInhInhibitionMask: {FIM_FAILED_OR_NOT_TESTED, FIM_LAST_FAILED, FIM_NOT_TESTED, FIM_TESTED, FIM_TESTED_AND_FAILED}, post-build-variant-value=true, set at post-build in variant post-build / pre-compile in variant pre-compile  # The configuration parameter is used to specify the inhibition mask for an event - FID relation.
        reference FiMInhComponentRef [0..*]: multiplicity set at post-build in variant post-build / pre-compile in variant pre-compile, post-build-variant-multiplicity=true, post-build-variant-value=true, set at post-build in variant post-build / pre-compile in variant pre-compile, destination=DemComponent  # Reference to a DemComponent which is necessary for function permission. | At least one FiMInhSumRef or FiMInhEventRef or FiMInhComponentRef needs to be configured.
        symbolic name reference FiMInhEventRef [0..*]: multiplicity set at post-build in variant post-build / pre-compile in variant pre-compile, post-build-variant-multiplicity=true, post-build-variant-value=true, set at post-build in variant post-build / pre-compile in variant pre-compile, destination=DemEventParameter  # Selection of an single DEM Event. | At least one FiMInhSumRef or FiMInhEventRef or FiMInhComponentRef needs to be configured.
        reference FiMInhFunctionIdRef: post-build-variant-value=true, set at post-build in variant post-build / pre-compile in variant pre-compile, destination=FiMFID  # Reference to a FiM Function ID for this inhibition configuration.
        reference FiMInhSumRef [0..*]: multiplicity set at post-build in variant post-build / pre-compile in variant pre-compile, post-build-variant-multiplicity=true, post-build-variant-value=true, set at post-build in variant post-build / pre-compile in variant pre-compile, destination=FiMSummaryEvent  # Selection of a summarized Event. | At least one FiMInhSumRef or FiMInhEventRef or FiMInhComponentRef needs to be configured.
      container FiMSummaryEvent [0..*]: multiplicity set at post-build in variant post-build / pre-compile in variant pre-compile, post-build-variant-multiplicity=true  # The summarized EventId definition record consists of a summarized event ID and specific Dem Events. | This record means that a particular FID that has to be disabled in case of summarized event (defined above) is to be disabled in any of the specific events. A possible solution could be assigning events as summarized events along with a list of specific events. During the configuration process the summarized event substitutes the referenced single events. However, it is not outlined how this requirement is solved - whether by configuration process or by implementation within the FiM. The FiM configuration tool could also build up a suitable data structure for summarized events and deal with it in the FiM implementation.
        string FiMRbSummaryEventDescription [0..1]: multiplicity set at pre-compile, origin=RB  # The purpose of the specified FiMSummaryEvent shall be described.
        string FiMRbSummaryEventShiftView [0..1]: multiplicity set at pre-compile, origin=RB  # This parameter is added for DGS FiM for documentation purpose.
        symbolic name reference FiMInputEventRef [1..*]: multiplicity set at post-build in variant post-build / pre-compile in variant pre-compile, post-build-variant-multiplicity=true, post-build-variant-value=true, set at post-build in variant post-build / pre-compile in variant pre-compile, destination=DemEventParameter  # Reference to DemEventParameters combined to this summarized event.
    container FiMGeneral  # This container contains the general configuration parameters.
      boolean FiMAvailabilitySupport [0..1]: set at pre-compile, with-auto=true, default-value=false  # This configuration parameter specifies, if the Fim shall support the service to set the Availabity of a Funtionality. RB: parameter not used | true: Service is supported. false: Service is not supported
      boolean FiMDataFixed [0..1]: set at pre-compile, with-auto=true  # Enable or disable calibration of inhibit relations The scope of the parameter is to meet the requirement (FIM008) to have the option to calibrate inhibit data on the one hand side and also to provide the option to protect inhibit data for consistency reasons. RB: parameter not used
      boolean FiMDevErrorDetect: set at pre-compile  # Switches the Default Error Tracer (Det) detection and notification ON or OFF. | * true: enabled (ON). * false: disabled (OFF).
      boolean FiMEventUpdateTriggeredByDem: set at pre-compile  # This configuration parameter specifies the way FIM obtains status of EventIds. | TRUE: the DEM informs FIM about changes of event status, FALSE: the FIM polls event status from the DEM module either cyclically or on demand.
      integer FiMMaxEventsPerFidInhibitionConfiguration [0..1]: 1..65535, set at pre-compile, with-auto=true  # This configuration parameter specifies the total maximum number of inhibiting events in a FiMInhibitionConfiguration. RB: parameter not used | Its applicable for post build configuration versions only and may be used to allocate the maximum size of memory to store and execute the configuration.
      integer FiMMaxFiMInhibitionConfigurations [0..1]: 1..65535, set at pre-compile, with-auto=true  # This configuration parameter specifies the total maximum number of FiMInhibitionConfigurations. RB: parameter not used | Its applicable for post build configuration versions only and may be used to allocate the maximum size of memory to store and execute the configuration.
      integer FiMMaxInputEventsPerSummaryEvents [0..1]: 1..65535, set at pre-compile, with-auto=true  # This configuration parameter specifies the total maximum number of input events per summary event. RB: parameter not used | Its applicable for post build configuration versions only and may be used to allocate the maximum size of memory to store and execute the configuration.
      integer FiMMaxSumEventsPerFidInhibitionConfiguration [0..1]: 1..65535, set at pre-compile, with-auto=true  # This configuration parameter specifies the total maximum number of inhibiting summary events in a FiMInhibitionConfiguration. RB: parameter not used | Its applicable for post build configuration versions only and may be used to allocate the maximum size of memory to store and execute the configuration.
      integer FiMMaxSummaryEvents [0..1]: 0..65535, set at pre-compile, with-auto=true  # This configuration parameter specifies the maximum number of summarized events that can be configured. RB: parameter not used
      float FiMTaskTime: 0..0.1, scope=ECU, origin=AUTOSAR_ECUC V1.0.0, set at pre-compile  # Allow to configure the time for the periodic cyclic task. Please note: This configuration value shall be equal to the value in the Basic Software Scheduler configuration of the RTE module. Tags: atp.Status=obsolete | The AUTOSAR configuration standard is to use SI units, so this parameter is defined as float value in seconds. DEM configuration tools must convert this float value to the appropriate value format for the use in the software implementation of DEM. min: A negative value is not allowed. max: FID must be set after a maximal time of 100ms after DEM status is set. upperMultiplicity: Exactly one TaskTime must be specified per configuration. lowerMultiplicity: Exactly one TaskTime must be specified per configuration. This element is obsolete and will be removed in a future revision.
      boolean FiMVersionInfoApi: set at pre-compile  # This configuration parameter is used to switch on or to switch off the API to get the version information.
      container FiMRbGeneral  # This container contains the RB General configuration parameters.
        boolean FiMRbCheckApiConsistency [0..1]: origin=RB:AR42.2.0.0:2017-05-23, set at pre-compile, default-value=true  # The RTE generates some of the APIs which are already provided by FiM itself. This results in redundant redeclarations of these functions, which is wanted to ensure consistency between generated and normal APIs. Important:If no RTE is used, this parameter needs to be TRUE TRUE Consistency check which results in compiler warnings FALSE Only RTE-generated APIs are used
        integer FiMRbEventsPerMonitorCycle [0..1]: 1..65535, origin=RB:40.6.0.0:2013-07-26, set at pre-compile  # This RB-specific configuration parameter specifies the number of Dem events to be processed in a scheduling cycle during monitoring and cyclic event evaluation (in the phase CHECK). If the Parameter FiMCyclicEventEvaluation is set to FALSE, this value is ignored. A value of 0xFFFF indicates that all Dem events shall be processed in one scheduling cycle. The number of events to be processed controls the runtime of the FiM_MainFunction() process. Reasonable values may be 50.100 events per cycle.
        integer FiMRbFidsPerMonitorCycle [0..1]: 1..65535, origin=RB:40.6.0.0:2013-07-26, set at pre-compile  # This RB-specific configuration parameter specifies the number of FIds to be processed in a scheduling cycle during monitoring and cyclic event evaluation (in the phase INITIALIZATION and EVALUATION). If the Parameter FiMCyclicEventEvaluation is set to FALSE, this value is ignored. A value of 0xFFFF indicates that all FIds shall be processed in one scheduling cycle. The number of FIds to be processed controls the runtime of the FiM_MainFunction() process. Reasonable values may be 50..100 FIds per cycle
        string FiMRbHeaderFileInclusion [0..*]: origin=RB:40.8.0.0:2014-07-24, set at pre-compile, regular-expression=[a-zA-Z0-9_]([a-zA-Z0-9\._])*  # Name of the header file(s) to be included by the FiM module containing the used C-callback declarations.
        boolean FiMRbObdServ07VisCalc [0..1]: origin=RB:AR40.9.0.0:2014-11-01, set at pre-compile, default-value=false  # This RB-specific configuration parameter gives an option to enable or disable the OBD service $07 visibility calculation for each FID. If enabled, the API FiM_GetService07Visibility will be available.
        enumeration FiMRbFunctionIdType [0..1]: {UINT8, UINT16}, scope=ECU, origin=RB:AR42.8.0.0:2020-07-07, set at link in variant link-time / pre-compile in variant post-build+pre-compile, default-value=uint16  # Provide the implementation data type belonging to a FunctionId. If the number of configured FiM Function IDs is more than 255 ,then the type must be selected as datatype uint16. If the number of configured FiM Function IDs is less than or equal to 255 ,then the data type should be selected as uint8. If this parameter is not configured,the default value will be taken as uint16.
        enumeration FiMRbFidSortMethod [0..1]: {SHORTNAME, SEQUENCE_NUMBER}, scope=ECU, origin=RB:AR42.9.0.0:2020-12-15, set at link in variant link-time / pre-compile in variant post-build+pre-compile, default-value=SHORTNAME  # Provides the sorting method for FunctionId. If the FIDs are to be sorted by shortname ,then the SortMethod must be selected as SHORTNAME. If the FIDs are to be sorted by sequence number ,then the SortMethod must be selected as SEQUENCE_NUMBER. If this parameter is not configured,the default value will be taken as SHORTNAME.
        container FiMRbCallbackClass [0..1]  # This container contains the configuration (parameters) for an internal/external callback class.
          container FiMRbExternalCSCallbackClass  # This container contains the configuration (parameters) for an external client/server based callback class. | It defines, how the FiM can obtain the callback function from either a SW-C or another BSW module. Whether a client/server port or a C function-call is used, is defined by DemDataElementUsePort.
            function name FiMRbCallbackReadFnc [0..1]: origin=RB, set at pre-compile  # In case of FiMCallbackUsePort is false, this parameter defines the prototype of the C function
            boolean FiMRbCallbackUsePort: origin=RB, set at pre-compile  # If the parameter is set to True, a R-Port is generated, to obtain the data element (interface DataServices_<SyncDataElement>). | If the parameter is set to False, the information is obtained by C function-call on another BSW module specified by the parameter DemDataElementReadFnc.

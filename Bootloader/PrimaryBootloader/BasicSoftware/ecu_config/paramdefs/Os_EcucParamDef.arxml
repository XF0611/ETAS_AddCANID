AUTOSAR XML (schema 00046)
package /AUTOSAR_Os/EcucModuleDefs
  module definition Os [0..1]: category=VENDOR_SPECIFIC_MODULE_DEFINITION, refined-module-def=Os, variants pre-compile  # Configuration of the Os (Operating System) module.
    container OsAlarm [0..*]  # An OsAlarm may be used to asynchronously inform or activate a specific task. It is possible to start alarms automatically at system start-up depending on the application mode.
      reference OsAlarmAccessingApplication [0..*]: multiplicity set at pre-compile, set at pre-compile, destination=OsApplication  # Reference to applications which have an access to this object.
      reference OsAlarmCounterRef: set at pre-compile, destination=OsCounter  # Reference to the assigned counter for that alarm
      choice container OsAlarmAction  # This container defines which type of notification is used when the alarm expires.
        container OsAlarmActivateTask [0..1]  # This container specifies the parameters to activate a task.
          reference OsAlarmActivateTaskRef: set at pre-compile, destination=OsTask  # Reference to the task that will be activated by that alarm action
        container OsAlarmCallback [0..1]  # This container specifies the parameters to call a callback OS alarm action.
          function name OsAlarmCallbackName: set at pre-compile  # Name of the function that is called when this alarm callback is triggered.
        container OsAlarmIncrementCounter [0..1]  # This container specifies the parameters to increment a counter.
          reference OsAlarmIncrementCounterRef: scope=ECU, set at pre-compile, destination=OsCounter  # Reference to the counter that will be incremented by that alarm action
        container OsAlarmSetEvent [0..1]  # This container specifies the parameters to set an event
          reference OsAlarmSetEventRef: set at pre-compile, destination=OsEvent  # Reference to the event that will be set by that alarm action
          reference OsAlarmSetEventTaskRef: set at pre-compile, destination=OsTask  # Reference to the task that will be activated by that event
      container OsAlarmAutostart [0..1]  # If present this container defines if an alarm is started automatically at system start-up depending on the application mode.
        integer OsAlarmAlarmTime: 0..18446744073709551615, set at pre-compile  # The relative or absolute tick value when the alarm expires for the first time. Note that for an alarm which is RELATIVE the value must be at bigger than 0.
        enumeration OsAlarmAutostartType: {ABSOLUTE, RELATIVE}, set at pre-compile  # This specifies the type of autostart for the alarm..
        integer OsAlarmCycleTime: 0..18446744073709551615, set at pre-compile  # Cycle time of a cyclic alarm in ticks. If the value is 0 than the alarm is not cyclic.
        reference OsAlarmAppModeRef [1..*]: multiplicity set at pre-compile, set at pre-compile, destination=OsAppMode  # Reference to the application modes for which the AUTOSTART shall be performed
    container OsAppMode [1..*]  # OsAppMode is the object used to define ISO 17356-3 properties for an ISO 17356-3 application mode. | No standard attributes are defined for AppMode. In a CPU, at least one AppMode object has to be defined. [source: ISO 17356-6] An OsAppMode called OSDEFAULTAPPMODE must always be there for ISO 17356 compatibility.
    container OsApplication [0..*]  # An AUTOSAR OS must be capable of supporting a collection of OS objects (tasks, interrupts, alarms, hooks etc.) that form a cohesive functional unit. This collection of objects is termed an OS-Application. | All objects which belong to the same OS-Application have access to each other. Access means to allow to use these objects within API services. Access by other applications can be granted separately.
      boolean OsTrusted: scope=ECU, set at pre-compile, default-value=false  # Parameter to specify if an OS-Application is trusted or not. | true: OS-Application is trusted false: OS-Application is not trusted (default)
      boolean OsTrustedApplicationDelayTimingViolationCall: scope=ECU, set at pre-compile, default-value=true  # Parameter to specify if a timing violation which occurs within an trusted OS-Application is raised immediately of if it is delayed until the current task returns to the calling OS-Application (return of CallTrustedFunction) | true: violation / call to ProtectionHook() is delayed false: timing violation cause an immediate call to the ProtectionHook().
      boolean OsTrustedApplicationWithProtection: scope=ECU, set at pre-compile, default-value=false  # Parameter to specify if a trusted OS-Application is executed with memory protection or not. | true: OS-Application runs within a protected environment. This means that write access is limited. false: OS-Application has full write access (default)
      reference OsAppAlarmRef [0..*]: scope=ECU, multiplicity set at pre-compile, set at pre-compile, destination=OsAlarm  # Specifies the OsAlarms that belong to the OsApplication.
      reference OsAppCounterRef [0..*]: scope=ECU, multiplicity set at pre-compile, set at pre-compile, destination=OsCounter  # References the OsCounters that belong to the OsApplication.
      reference OsAppEcucPartitionRef [0..1]: multiplicity set at pre-compile, set at pre-compile, destination=EcucPartition  # Denotes which "EcucPartition" is implemented by this "OSApplication".
      reference OsAppIsrRef [0..*]: scope=ECU, multiplicity set at pre-compile, set at pre-compile, destination=OsIsr  # references which OsIsrs belong to the OsApplication
      reference OsApplicationCoreRef [0..1]: multiplicity set at pre-compile, set at pre-compile, destination=EcucCoreDefinition  # Reference to the Core Definition in the Ecuc Module where the CoreId is defined. This reference is used to describe to which Core the OsApplication is bound.
      reference OsAppScheduleTableRef [0..*]: scope=ECU, multiplicity set at pre-compile, set at pre-compile, destination=OsScheduleTable  # References the OsScheduleTables that belong to the OsApplication.
      reference OsAppTaskRef [0..*]: scope=ECU, multiplicity set at pre-compile, set at pre-compile, destination=OsTask  # references which OsTasks belong to the OsApplication
      reference OsRestartTask [0..1]: scope=ECU, multiplicity set at pre-compile, set at pre-compile, destination=OsTask  # Optionally one task of an OS-Application may be defined as Restart Task. | Multiplicity = 1: Restart Task is activated by the Operating System if the protection hook requests it. Multiplicity = 0: No task is automatically started after a protection error happened.
      container OsApplicationHooks  # Container to structure the OS-Application-specific hooks
        boolean OsAppErrorHook: scope=ECU, set at pre-compile  # Select the OS-Application error hook. | true: Hook is called false: Hook is not called
        boolean OsAppShutdownHook: scope=ECU, set at pre-compile  # Select the OS-Application specific shutdown hook for the OS-Application. | true: Hook is called false: Hook is not called
        boolean OsAppStartupHook: scope=ECU, set at pre-compile  # Select the OS-Application specific startup hook for the OS-Application. | true: Hook is called false: Hook is not called
        foreign reference OsMemoryMappingCodeLocationRef [0..1]: scope=ECU, set at pre-compile, destination-type=SW-ADDR-METHOD  # Reference to the memory mapping containing details about the section where the code is placed.
      container OsApplicationTrustedFunction [0..*]  # Container to structure the configuration parameters of trusted functions
        function name OsTrustedFunctionName: scope=ECU, set at pre-compile  # Trusted function (as part of a trusted OS-Application) available to other OS-Applications. This also supersedes the ISO 17356-6 attribute TRUSTED in APPLICATION because the optionality of this parameter is describing that already.
    container OsCounter [0..*]  # Configuration information for the counters that belong to the OsApplication.
      integer OsCounterMaxAllowedValue: 1..18446744073709551615, set at pre-compile  # Maximum possible allowed value of the system counter in ticks.
      integer OsCounterMinCycle: 1..18446744073709551615, set at pre-compile  # The MINCYCLE attribute specifies the minimum allowed number of counter ticks for a cyclic alarm linked to the counter.
      integer OsCounterTicksPerBase: 1..4294967295, set at pre-compile  # The TICKSPERBASE attribute specifies the number of ticks required to reach a counterspecific unit. The interpretation is implementation-specific.
      enumeration OsCounterType: {HARDWARE, SOFTWARE}, scope=ECU, set at pre-compile  # This parameter contains the natural type or unit of the counter.
      string OsFormat [0..1]: origin=ETAS-RTA-OS_v6.2.0, set at pre-compile  # A string that specifies a format for each tracepoint.
      float OsSecondsPerTick [0..1]: 0..Inf, scope=ECU, multiplicity set at pre-compile, set at pre-compile  # Time of one counter tick in seconds.
      reference OsCounterAccessingApplication [0..*]: multiplicity set at pre-compile, set at pre-compile, destination=OsApplication  # Reference to applications which have an access to this object.
      container OsDriver [0..1]  # This Container contains the information who will drive the counter. | This configuration is only valid if the counter has OsCounterType set to HARDWARE. If the container does not exist (multiplicity=0) the timer is managed by the OS internally (OSINTERNAL). If the container exists the OS can use the GPT interface to manage the timer. The user have to supply the GPT channel. If the counter is driven by some other (external to the OS) source (like a TPU for example) this must be described as a vendor specific extension.
        reference OsGptChannelRef [0..1]: scope=ECU, multiplicity set at pre-compile, set at pre-compile, requires-symbolic-name-value=true, destination=GptChannelConfiguration  # Reference to the GPT channel.
      container OsTimeConstant [0..*]  # Allows the user to define constants which can be e.g. used to compare time values with timer tick values. | A time value will be converted to a timer tick value during generation and can later on accessed via the OsConstName. The conversation is done by rounding time values to the nearest fitting tick value.
        float OsTimeValue: 0..Inf, scope=ECU, set at pre-compile  # This parameter contains the value of the constant in seconds.
    container OsEvent [0..*]  # Representation of OS events in the configuration context. Adopted from the ISO 17356-6 specification.
      integer OsEventMask [0..1]: 0..18446744073709551615, multiplicity set at pre-compile, set at pre-compile  # If event mask would be set to AUTO in OIL, this parameter should be omitted here.
    container OsIoc [0..1]  # Configuration of the IOC (Inter OS Application Communicator).
      container OsIocCommunication [0..*]  # Representation of a 1:1 or N:1 or N:M (unqueued only) communication between software parts located in different OS-Applications that are bound to the same or to different cores. | The name shall begin with the name of the sending software service and be followed by a unique identifier delivered by the sending software service. In the case of RTE as user attention shall be paid on the fact that uniqueness for identifier names has to be reached over ports, data elements, object instances and maybe additional identification properties (E.g. Case 1:N mapping to 1:1). Example: - <NameSpace>_UniqueID
        integer OsIocBufferLength [0..1]: 0..4294967295, multiplicity set at pre-compile, set at pre-compile  # This attribute defines the size of the IOC internal queue to be allocated for a queued communication. | This configuration information shall allow the optimization of the needed memory for communications requiring buffers within the RTE and within the IOC.
        container OsIocDataProperties [1..*]  # Data properties of the data to be transferred on the IOC communication channel.
          integer OsIocDataPropertyIndex [0..1]: 0..255, multiplicity set at pre-compile, set at pre-compile  # This parameter is used to define in which order the data is send, e.g. whether IocSendGroup(A,B) or IocSendGroup(B,A) shall be used.
          string OsIocInitValue [0..1]: multiplicity set at pre-compile, set at pre-compile  # Initial Value for the data to be transferred on the IOC communication channel.
          foreign reference OsIocDataTypeRef: set at pre-compile, destination-type=IMPLEMENTATION-DATA-TYPE  # This is the type of the data to be transferred on the IOC communication channel. This attribute is necessary to generate the parameter type of the Ioc functions. Additionally this information should be used to compute the data size for necessary data copy operations within the Ioc module. | If more than one attribute is defined, the IOC generator should generate an IocXxxGroup function (Xxx= CHOICE [Send, Receive, Write, Read]). N:1 or N:M communication (Multiplicity of OsIocSenderProperties > 1) is only allowed for multiplicity of OsIocDataTypeRef = 1
          foreign reference OsIocMeasurementFlatInstanceDescriptorRef [0..*]: origin=ETAS-RTA-OS_v6.2.0, set at pre-compile, destination-type=FLAT-INSTANCE-DESCRIPTOR  # A reference to a Flatmap indicating that the communication is measurable.
        container OsIocReceiverProperties [1..*]  # Representation of receiver properties for one communication. For each OsIocCommunication one (1:1) or many receivers (N:M) have to be defined. This container should be instantiated within an OsIocCommunication.
          enumeration OsIocFunctionImplementationKind [0..1]: {DO_NOT_CARE, FUNCTION, MACRO}, multiplicity set at pre-compile, set at pre-compile, default-value=DO_NOT_CARE  # This parameter is used to select whether this communication is implemented as a macro or as a function.
          function name OsIocReceiverPullCB [0..1]: multiplicity set at pre-compile, set at pre-compile  # This attribute defines the name of a callback function that the IOC shall call on the receiving core for each data reception. | In case of non existence of this attribute no ReceiverPullCB notification shall be applied by the IOC. The name of the function shall begin with the name of the receiving module, followed with a callback name and followed by the IocId. Example: void RTE_ReceiverPullCB_RTE25 (void). If this attribute does not exist, it means that no ReceiverPullCB shall be called (No notification from IOC is required). If this attribute exists the IOC shall call the callback function on the receiving core.
          reference OsIocReceivingOsApplicationRef: set at pre-compile, destination=OsApplication  # This attribute is a reference to the receiving OsApplication instance defined in the configuration file of the OS. | This information allows for the generator to get additional information necessary for the code generation like: * The protection properties of the communicating OsApplications to find out which protections have to be crossed * The core identifiers to find out if an intra or an inter core communication has to be realized * Interrupt details in case of cross core notification to realize over IRQs
        container OsIocSenderProperties [1..*]  # Representation of sender properties for one communication. For each OsIocCommunication one (1:1) or many senders (N:1 or N:M) have to be defined. Multiplicity > 1 (N:1 or N:M communication) is only allowed for Multiplicity of OsIocDataTypeRef = 1. | This container should be instantiated within an OsIocCommunication.
          enumeration OsIocFunctionImplementationKind [0..1]: {DO_NOT_CARE, FUNCTION, MACRO}, multiplicity set at pre-compile, set at pre-compile, default-value=DO_NOT_CARE  # This parameter is used to select whether this communication is implemented as a macro or as a function.
          integer OsIocSenderId [0..1]: 0..255, scope=ECU, multiplicity set at pre-compile, set at pre-compile  # Representation of a sender in a N:1 or N:M communication to distinguish between senders. | This parameter does not exist in 1:1 communication.
          reference OsIocSendingOsApplicationRef: set at pre-compile, destination=OsApplication  # This attribute is a reference to the sending OS-Application instance defined in the configuration file of the OS. | This information shall allows the generator to get additional information necessary for the code generation like: * The protection properties of the communicating OS-Applications to find out which protection boundaries have to be crossed. * The core identifiers to find out if an intra or an inter core communication has to be realized * Interrupt details in case of cross core notification to realize over IRQs
      container OsIocReadGroup [0..*]  # Grouping of IOC communications for reading.
        reference OsIocReadingIsrRef [0..*]: origin=ETAS-RTA-OS_v6.2.0, set at pre-compile, destination=OsIsr  # A reference to an ISR reading the group.
        reference OsIocReadingTaskRef [0..*]: origin=ETAS-RTA-OS_v6.2.0, set at pre-compile, destination=OsTask  # A reference to a task reading the group.
        reference OsIocReceiverRef [0..*]: origin=ETAS-RTA-OS_v6.2.0, set at pre-compile, destination=OsIocReceiverProperties  # A reference to an IOC receive property.
      container OsIocWriteGroup [0..*]  # Grouping of IOC communications for writing.
        reference OsIocWritingIsrRef [0..*]: origin=ETAS-RTA-OS_v6.2.0, set at pre-compile, destination=OsIsr  # A reference to an ISR writing the group.
        reference OsIocWritingTaskRef [0..*]: origin=ETAS-RTA-OS_v6.2.0, set at pre-compile, destination=OsTask  # A reference to a task writing the group.
        container OsIocWriteGroupParam [0..*]  # Subgrouping of senders.
          reference OsIocSenderRef [0..*]: origin=ETAS-RTA-OS_v6.2.0, set at pre-compile, destination=OsIocSenderProperties  # A reference to an IOC sender property.
    container OsIsr [0..*]  # The OsIsr container represents an ISO 17356 interrupt service routine.
      string OsIsrBudget [0..1]: origin=ETAS-RTA-OS_v6.2.0, set at pre-compile  # Execution budget expressed as a float, then timebase name, then units.
      enumeration OsIsrCategory: {CATEGORY_1, CATEGORY_2}, set at pre-compile  # This attribute specifies the category of this ISR.
      float OsIsrPeriod [0..1]: origin=ETAS-RTA-OS_v6.2.0, set at pre-compile  # If this parameter is not given the interrupt can be activated sporadicly or cyclically with a unknown period value. This value is information, e.g. for time base calculations in the RTE in case TimingEvents are mapped onto this OsIsr. Be aware, that this parameter is not supposed to be relevant for the OS! It's the responsibility of the integrator to ensure the activation of the ISR according the configured period. This information is given as part of the OS configuration to support configuration work flows using a fixed set of OsIsrs.
      string OsIsrStackAllocation [0..1]: origin=ETAS-RTA-OS_v6.2.0, set at pre-compile  # ISR manual stack allocation in bytes.
      enumeration OsIsrAddress: origin=ETAS-RTA-TDA4VM-R5-TI_TDA4VM_MCU_R5FSS0_CORE0_v5.0.3  # ISR Address
        Interrupt_CPU Trap1  # CPU Undefined instruction
        Interrupt_CPU Trap2  # CPU SVC
        Interrupt_CPU Trap3  # CPU Prefetch abort
        Interrupt_CPU Trap4  # CPU Data abort
        Interrupt_CPU Trap5  # CPU IRQ
        Interrupt_CPU Trap6  # CPU FIQ
        Interrupt_VIM{0..511}  # VIM input {0..511}
      enumeration OsIsrPriority: origin=ETAS-RTA-TDA4VM-R5-TI_TDA4VM_MCU_R5FSS0_CORE0_v5.0.3  # ISR Priority
        IPL_{1..17}  # Prio_{1..17}
      reference OsIsrResourceRef [0..*]: multiplicity set at pre-compile, set at pre-compile, destination=OsResource  # This reference defines the resources accessed by this ISR.
      foreign reference OsMemoryMappingCodeLocationRef [0..1]: scope=ECU, set at pre-compile, destination-type=SW-ADDR-METHOD  # Reference to the memory mapping containing details about the section where the code is placed.
      reference OsRegSetRef [0..*]: origin=ETAS-RTA-OS_v6.2.0, set at pre-compile, destination=OsRegSet  # A reference to the register sets that are used by this ISR.
      container OsIsrTimingProtection [0..1]  # This container contains all parameters which are related to timing protection | If the container exists, the timing protection is used for this interrupt. If the container does not exist, the interrupt is not supervised regarding timing violations.
        float OsIsrAllInterruptLockBudget [0..1]: 0..Inf, scope=ECU, multiplicity set at pre-compile, set at pre-compile  # This parameter contains the maximum time for which the ISR is allowed to lock all interrupts (via SuspendAllInterrupts() or DisableAllInterrupts()) (in seconds).
        float OsIsrExecutionBudget [0..1]: 0..Inf, scope=ECU, multiplicity set at pre-compile, set at pre-compile  # The parameter contains the maximum allowed execution time of the interrupt (in seconds).
        float OsIsrOsInterruptLockBudget [0..1]: 0..Inf, scope=ECU, multiplicity set at pre-compile, set at pre-compile  # This parameter contains the maximum time for which the ISR is allowed to lock all Category 2 interrupts (via SuspendOSInterrupts()) (in seconds).
        float OsIsrTimeFrame [0..1]: 0..Inf, scope=ECU, multiplicity set at pre-compile, set at pre-compile  # This parameter contains the minimum inter-arrival time between successive interrupts (in seconds).
        container OsIsrResourceLock [0..*]  # This container contains a list of times the interrupt uses resources.
          float OsIsrResourceLockBudget: 0..Inf, scope=ECU, set at pre-compile  # This parameter contains the maximum time the interrupt is allowed to hold the given resource (in seconds).
          reference OsIsrResourceLockResourceRef: scope=ECU, set at pre-compile, destination=OsResource  # Reference to the resource the locking time is depending on
    container OsOS  # OS is the object used to define ISO 17356-3 properties for an ISO 17356 application. | Per CPU exactly one OS object has to be defined.
      integer OsCyclesPerSecond [0..1]: 0.., origin=ETAS-RTA-OS_v6.2.0, set at pre-compile  # Defines the clock speed of the target.
      string OsDefCat1Stack [0..1]: origin=ETAS-RTA-OS_v6.2.0, set at pre-compile  # Default category 1 stack values. Multiple parameters indicate the target supports multiple stacks.
      string OsDefCat2Stack [0..1]: origin=ETAS-RTA-OS_v6.2.0, set at pre-compile  # Default category 2 stack values. Multiple parameters indicate the target supports multiple stacks.
      string OsDefTaskStack [0..1]: origin=ETAS-RTA-OS_v6.2.0, set at pre-compile  # Default task stack values. Multiple parameters indicate the target supports multiple stacks.
      function name OsDefaultInterrupt [0..1]: origin=ETAS-RTA-OS_v6.2.0, set at pre-compile  # The name of a handler that catches any unhandled interrupt.
      integer OsNumberOfCores [0..1]: 1..65535, multiplicity set at pre-compile, set at pre-compile  # Maximum number of cores that are controlled by the OS. | The OS uses the value internally. It depends on the ECU HW.
      enumeration OsScalabilityClass [0..1]: {SC1, SC2, SC3, SC4}, scope=ECU, set at pre-compile  # A scalability class for each System Object "OS" has to be selected. In order to customize the operating system to the needs of the user and to take full advantage of the processor features the operating system can be scaled according to the scalability classes. | If the scalability class is omitted this translates to the OIL AUTO mechanism.
      boolean OsStackMonitoring: scope=ECU, set at pre-compile  # Select stack monitoring of Tasks/Category 2 ISRs | true: Stacks are monitored false: Stacks are not monitored
      enumeration OsStatus: {EXTENDED, STANDARD}, set at pre-compile  # The Status attribute specifies whether a system with standard or extended status has to be used. Automatic assignment is not supported for this attribute.
      boolean OsSuppressVectorGen [0..1]: origin=ETAS-RTA-OS_v6.2.0, set at pre-compile, default-value=false  # Suppresses generation of the vector table. Default if absent is false.
      integer OsTicksPerSecond [0..1]: 0.., origin=ETAS-RTA-OS_v6.2.0, set at pre-compile  # Defines the stopwatch speed of the target.
      boolean OsUseGetServiceId: set at pre-compile  # As defined by ISO 17356
      boolean OsUseParameterAccess: set at pre-compile  # As defined by ISO 17356
      boolean OsUseResScheduler: set at pre-compile, default-value=true  # The OsUseResScheduler attribute defines whether the resource RES_SCHEDULER is used within the application.
      container OsHooks  # Container to structure all hooks belonging to the OS
        boolean OsErrorHook: set at pre-compile  # Error hook as defined by ISO 17356 | true: Hook is called false: Hook is not called
        boolean OsPostTaskHook: set at pre-compile  # Post-task hook as defined by ISO 17356 | true: Hook is called false: Hook is not called
        boolean OsPreTaskHook: set at pre-compile  # Pre-task hook as defined by ISO 17356 | true: Hook is called false: Hook is not called
        boolean OsProtectionHook [0..1]: scope=ECU, multiplicity set at pre-compile, set at pre-compile  # Switch to enable/disable the call to the (user supplied) protection hook. | true: Protection hook is called on protection error false: Protection hook is not called
        boolean OsShutdownHook: set at pre-compile  # Shutdown hook as defined by ISO 17356 | true: Hook is called false: Hook is not called
        boolean OsStackFaultHook [0..1]: origin=ETAS-RTA-OS_v6.2.0, set at pre-compile, default-value=false  # Use stack fault hook. Default if absent is false.
        boolean OsStartupHook: set at pre-compile  # Startup hook as defined by ISO 17356 | true: Hook is called false: Hook is not called
        foreign reference OsMemoryMappingCodeLocationRef [0..1]: scope=ECU, set at pre-compile, destination-type=SW-ADDR-METHOD  # Reference to the memory mapping containing details about the section where the code is placed.
      container Param [0..*]  # OS-specific parameter representation.
        container core_local [0..1]  # If true, multicore applications will have their core-local data put into separate MemMap sections so that they can be located locally to each appropriate processor core. Defaults to FALSE.
          boolean VALUE: origin=ETAS-RTA-OS, set at pre-compile  # Value for Optimize for core-local memory
        container lightweight [0..1]  # Declare that ChainTask() and TerminateTask() are only used in the Task entry function and their return value is not checked. This allows the OS to optimize task termination. Defaults to FALSE.
          boolean VALUE: origin=ETAS-RTA-OS, set at pre-compile  # Value for Fast Terminate
        container no_upward_activation [0..1]  # Declare that no task activates a higher priority task using ActivateTask or SetEvent. This allows the OS to optimize the time taken to activate tasks. Defaults to FALSE.
          boolean VALUE: origin=ETAS-RTA-OS, set at pre-compile  # Value for Disallow upwards activation
        container no_chain [0..1]  # Declare that ChainTask will not be used. This allows the OS to optimize task switching time. Defaults to FALSE.
          boolean VALUE: origin=ETAS-RTA-OS, set at pre-compile  # Value for Disallow ChainTask()
        container no_schedule [0..1]  # Declare that Schedule() will not be used. This can reduce the worst-case stack size of a system. Defaults to FALSE.
          boolean VALUE: origin=ETAS-RTA-OS, set at pre-compile  # Value for Disallow Schedule()
        container optimize_schedule [0..1]  # Changes the implementation of the Schedule() macro in order to avoid the run-time overhead of making a full OS call in cases where the OS can quickly determine that the OS call would have no effect. The return type of Schedule() should be assumed to be void when this is selected. Defaults to FALSE.
          boolean VALUE: origin=ETAS-RTA-OS, set at pre-compile  # Value for Optimize Schedule()
        container std_sc34_checks [0..1]  # Allow STANDARD Status to be selected in Scalability Class 3 or 4 to reduce error checking overheads. AUTOSAR does not normally allow this. Defaults to FALSE.
          boolean VALUE: origin=ETAS-RTA-OS, set at pre-compile  # Value for Allow STANDARD Status in SC3/SC4
        container sc234_alarmcallbacks [0..1]  # Allow Alarm Callbacks in any Scalability Class. AUTOSAR normally only allows these in SC1. Defaults to FALSE.
          boolean VALUE: origin=ETAS-RTA-OS, set at pre-compile  # Value for Allow Alarm Callbacks in SC2/SC3/SC4
        container no_ecc_activate_in_wait [0..1]  # ECC Tasks are normally activated once and do not terminate. When this is the case, RTA-OS can optimize task activation code by omitting the extra run-time checks to see if a task is WAITING. Defaults to TRUE.
          boolean VALUE: origin=ETAS-RTA-OS, set at pre-compile  # Value for Omit activation checks for WAITING state
        container async_tasks [0..1]  # The ActivateTask, ChainTask and SetEvent APIs change so that cross-core invocations no longer use an internal spinlock to coordinate between cores. Instead a message is sent to a queue on the core that owns the Task, and that core performs the required operation. When this option is in effect, the E_OS_LIMIT error can not be detected for cross-core activations. A different error E_OS_SYS_XCORE_QFULL may be seen if the queue on the receiving core is full. See the option 'AsyncQ' for how to avoid this. Defaults to FALSE.
          boolean VALUE: origin=ETAS-RTA-OS, set at pre-compile  # Value for Asynchronous TASK activation
        container asyn_apis [0..1]  # These APIs were added in AUTOSAR V4.4.0. RTA-OS allows them to be used in any AUTOSAR version. This option has to be used to cause them to be generated because they add a small amount of extra run-time overhead. These APIs use the same mechanism that is used for the 'Asynchronous TASK activation' option, but allow you to have both synchronous and asynchronous versions at the same time. Defaults to FALSE.
          boolean VALUE: origin=ETAS-RTA-OS, set at pre-compile  # Value for Support ActivateTaskAsyn and SetEventAsyn
        container async_qlen [0..1]  # This option can be used to specify the size of the queue used when the 'Asynchronous TASK activation' or 'Support ActivateTaskAsyn and SetEventAsyn' options are in effect. The default queue size is 10 for each core. Specify one decimal number per core, using comma separators. A value 0 may only be used for cores that have no cross-core activation.
          string VALUE: origin=ETAS-RTA-OS, set at pre-compile  # Value for AsyncQ
        container timing_interrupt [0..1]  # TRUE to use a Category 1 Interrupt to enforce Timing Protection. When this is TRUE and timing protection is configured, you must respond to the Os_Cbk_SetTimeLimit and Os_Cbk_SuspendTimeLimit callbacks and call Os_TimingFaultDetected if the interrupt fires without being suspended. You must create and configure the interrupt. Each OS core should have its own Category 1 Timing Protection Interrupt. Defaults to FALSE.
          boolean VALUE: origin=ETAS-RTA-OS, set at pre-compile  # Value for Timing Protection Interrupt
        container no_timing_protection [0..1]  # Timing protection features are included in the OS if any Task or ISR is configured with Timing Protection values. This option allows you to omit all timing protection checks. Defaults to FALSE.
          boolean VALUE: origin=ETAS-RTA-OS, set at pre-compile  # Value for Omit Timing Protection
        container function_protection [0..1]  # Adds the ability to police execution limits and recover from memory protection exceptions in OS-Application functions. The API CallAndProtectFunction extends CallTrustedFunction by adding an execution time limit, and the ability to terminate a function. Defaults to FALSE.
          boolean VALUE: origin=ETAS-RTA-OS, set at pre-compile  # Value for Add Function Protection
        container no_memory_protection [0..1]  # Memory protection features are included in the OS if there are any OS-Applications that are Untrusted or have TrustedApplicationWithProtection set true. This option allows you to omit all memory protection features. Defaults to FALSE.
          boolean VALUE: origin=ETAS-RTA-OS, set at pre-compile  # Value for Omit Memory Protection
        container protection_allows_os_reads [0..1]  # When memory protection is enabled, it is assumed that untrusted code may not read OS variables. All OS service calls therefore switch the processor into protected mode. If, however, your memory protection strategy allows read-access to OS data then certain APIs can be optimized to avoid this mode switch because they only read OS data. (Also applies to OS-Applications that have TrustedApplicationWithProtection set to true. Defaults to FALSE.)
          boolean VALUE: origin=ETAS-RTA-OS, set at pre-compile  # Value for Untrusted code can read OS data
        container single_zone_protection [0..1]  # If all code that is subject to memory protection can run with a single set of MPU values, then the MPU can be set up before starting the OS and there is no need to call Os_Cbk_SetMemoryAccess. This option allows you to omit the Os_Cbk_SetMemoryAccess call. Defaults to FALSE.
          boolean VALUE: origin=ETAS-RTA-OS, set at pre-compile  # Value for Single Memory Protection Zone
        container stack_only_protection [0..1]  # If you want to run all untrusted code with the same basic memory protection settings but apply protection to the stack, then the OS only has to pass the stack-related fields (Address and Size) plus Application to Os_Cbk_SetMemoryAccess. This option removes the Task, ISR and Function values from the callback. (Also applies to OS-Applications that have TrustedApplicationWithProtection set to true.) Defaults to FALSE.
          boolean VALUE: origin=ETAS-RTA-OS, set at pre-compile  # Value for Stack Only Memory Protection
        container no_service_protection [0..1]  # AUTOSAR expects extra service protection checks to be applied in SC3 and SC4. This option allows you to omit these checks. Defaults to FALSE.
          boolean VALUE: origin=ETAS-RTA-OS, set at pre-compile  # Value for Omit Service Protection in SC3/SC4
        container no_terminate_application [0..1]  # The TerminateApplication API is normally supported in the OS if there are any OS-Applications. This option allows you to omit support for TerminateApplication() and reduce system overheads. Defaults to FALSE.
          boolean VALUE: origin=ETAS-RTA-OS, set at pre-compile  # Value for Omit TerminateApplication
        container only_terminate_untrusted [0..1]  # By default, Trusted OS-Applications can be terminated if there is a Timing Protection violation or TerminateApplication() is called. Setting this option tells the OS not to terminate trusted code. This can result in run-time savings. Defaults to FALSE.
          boolean VALUE: origin=ETAS-RTA-OS, set at pre-compile  # Value for Only Terminate Untrusted Applications
        container meter_execution [0..1]  # Record the execution times for Tasks and Category 2 ISRs. Defaults to FALSE.
          boolean VALUE: origin=ETAS-RTA-OS, set at pre-compile  # Value for Enable Time Monitoring
        container meter_elapsed_time [0..1]  # Accumulate the total execution time for Tasks, Category 2 ISRs and Idle. Defaults to FALSE. (Requires Time Recording to be enabled)
          boolean VALUE: origin=ETAS-RTA-OS, set at pre-compile  # Value for Enable Elapsed Time Recording
        container monitor_activations [0..1]  # Record the activation times for Tasks. Defaults to FALSE.
          boolean VALUE: origin=ETAS-RTA-OS, set at pre-compile  # Value for Enable Activation Monitoring
        container delayed_tasks [0..1]  # Adds support for the APIs Os_SetDelayedTasks, Os_AddDelayedTasks and Os_RemoveDelayedTasks. Defaults to FALSE.
          boolean VALUE: origin=ETAS-RTA-OS, set at pre-compile  # Value for Support Delayed Task Execution
        container metrics [0..1]  # Collects run-time information about how often OS features get used. Refer to Os_Metrics.h to see what data gets collected. Defaults to FALSE.
          boolean VALUE: origin=ETAS-RTA-OS, set at pre-compile  # Value for Collect OS usage metrics
        container task_lifetime_hooks [0..1]  # Adds support for Os_Cbk_TaskStart and Os_Cbk_TaskEnd hooks. These act like Pre/Post Task hooks but don't get called when the task is pre-empted. Defaults to FALSE.
          boolean VALUE: origin=ETAS-RTA-OS, set at pre-compile  # Value for Additional Task Hooks
        container task_activation_hooks [0..1]  # Adds support for Os_Cbk_TaskActivated hook. This gets called each time a Task is successfully activated. Defaults to FALSE.
          boolean VALUE: origin=ETAS-RTA-OS, set at pre-compile  # Value for Task Activation Hook
        container task_termination_hooks [0..1]  # Adds support for Os_Cbk_TaskTerminated hook. This gets called each time a Task is successfully terminated. Defaults to FALSE.
          boolean VALUE: origin=ETAS-RTA-OS, set at pre-compile  # Value for Task Termination Hook
        container isr_lifetime_hooks [0..1]  # Adds support for Os_Cbk_ISRStart, Os_Cbk_ISREnd, Os_Cbk_CrosscoreISRStart and Os_Cbk_CrosscoreISREnd hooks. These get called when an Category 2 or Crosscore ISR starts/ends. They don't get called again if the ISR is pre-empted. Defaults to FALSE.
          boolean VALUE: origin=ETAS-RTA-OS, set at pre-compile  # Value for Additional ISR Hooks
        container spinlock_info [0..1]  # Adds support for the GetSpinlockInfo API. Additional run-time statistics are recorded for spinlocks and the GetSpinlockInfo is supported to provide access to them. Defaults to FALSE.
          boolean VALUE: origin=ETAS-RTA-OS, set at pre-compile  # Value for Provide spinlock statistics
        container spinlock_std_check [0..1]  # The spinlock APIs do not check for errors in STANDARD status builds. This option can be used to force the spinlock checks in both EXTENDED and STANDARD status builds. Defaults to FALSE.
          boolean VALUE: origin=ETAS-RTA-OS, set at pre-compile  # Value for Force spinlock error checks
        container unchecked_spinlocks [0..1]  # The AUTOSAR spinlock APIs may only be called from TASKs or Category 2 ISRs. This option can be used to cause 3 new APIs UncheckedGetSpinlock, UncheckedTryToGetSpinlock and UncheckedReleaseSpinlock to be generated. These can be called from Category 1 ISRs, but the error checking that can be applied is much restricted so they should be used with care. Defaults to FALSE.
          boolean VALUE: origin=ETAS-RTA-OS, set at pre-compile  # Value for Add Spinlock APIs for CAT1 ISRs
        container stack_sampling [0..1]  # Adds support for Os_Cbk_CheckStackDepth hook. It gets called when a TASK or Category 2 ISR starts. It also gets called from within the Os_GetStackUsage API. Defaults to FALSE.
          boolean VALUE: origin=ETAS-RTA-OS, set at pre-compile  # Value for Stack Sampling
        container memmap_level [0..1]  # Select how the AUTOSAR MemMap inclusion mechanism applied to OS code.
          enumeration VALUE: origin=ETAS-RTA-OS, set at pre-compile  # Value for MemMap level
            NONE  # Omit MemMap includes
            DECLARATION  # MemMap inclusions are used around declarations
            FULL  # MemMap inclusions are used for declarations and definitions/externs (default)
        container ioc_data [0..1]  # Allows control over the MemMap sections used for some internal IOC data buffers.
          enumeration VALUE: origin=ETAS-RTA-OS, set at pre-compile  # Value for IOC Data
            Global  # Use OS VAR section
            Core  # Use VAR_CORE{n} section for communications that run on a single core (default)
            Writer  # Use _SEC_{app}_VAR section, where {app} is the OS-Application of the sender so that writes do not need to change the processor protection mode
        container ioc_code [0..1]  # Allows control over the MemMap sections used for IOC API code.
          enumeration VALUE: origin=ETAS-RTA-OS, set at pre-compile  # Value for IOC Code
            OS  # Use standard OS code section (default)
            Caller  # Use ..._SEC_{app}_LIB section, where {app} is the OS-Application of the API caller
        container no_ioc_optimization [0..1]  # RTA-RTE is able to provide RTA-OS with additional call-pattern information so that the IOC code can be better optimized. Set this option to TRUE to disable these optimizations. Defaults to FALSE.
          boolean VALUE: origin=ETAS-RTA-OS, set at pre-compile  # Value for Disable IOC optimizations
        container ioc_blocking_threshold [0..1]  # IOC code optimizations for RTA-RTE can result in data transfers for many IOC communications being performed in a single batch operation. Interrupts may be disabled during this transfer, which may block higher priority code from running. Setting a non-zero value here controls the number of bytes that will be transferred in a batch. Note that because transfers for each communication must not be split, a batch might be slightly bigger than the value specified.
          string VALUE: origin=ETAS-RTA-OS, set at pre-compile  # Value for IOC blocking threshold
        container ioc_atomic_copylen [0..1]  # The IOC code generator assumes that single value data that is the size of an integer or less can be copied atomically. This means that locks are not needed around the copy so it is fast. Some target/compiler combinations will do larger atomic copies (e.g 8 bytes), even for small structures. This option can be used to specify the size in bytes for which the compiler will copy data atomically.
          string VALUE: origin=ETAS-RTA-OS, set at pre-compile  # Value for IOC atomic copy size
        container omit_default_implementations [0..1]  # RTA-OS normally provides default implementations for Os_Cbk_Idle, Os_Cbk_InShutdown and Os_Cbk_StackOverrunHook in the generated library. Set this option to TRUE to omit these functions from the library. Defaults to FALSE.
          boolean VALUE: origin=ETAS-RTA-OS, set at pre-compile  # Value for Omit Default Implementations
        container omit_default_ioc_copy [0..1]  # RTA-OS normally provides a default implementation for Os_ioc_memcpy in the generated library. Set this option to TRUE to omit this function from the library. Defaults to FALSE.
          boolean VALUE: origin=ETAS-RTA-OS, set at pre-compile  # Value for Omit Default IOC copy
        container allow_forced_task_terminations [0..1]  # Many real-world AUTOSAR systems do not safely support termination of tasks part way through execution. If the OS sees that the configuration relates to a full-stack AUTOSAR system it will remove the ability to force-terminate tasks from the OS library unless this option is set to TRUE. This means that errors such as timing budget overruns must result in shutdown or reset of the ECU. Defaults to FALSE when full-stack AUTOSAR systems are detected in the configuration.
          boolean VALUE: origin=ETAS-RTA-OS, set at pre-compile  # Value for Allow forced TASK terminations
        container avoid_noinit [0..1]  # Some OS data is placed in NO_INIT memory sections. Set this option to TRUE to clear all OS data on resets. Defaults to FALSE.
          boolean VALUE: origin=ETAS-RTA-OS, set at pre-compile  # Value for Always clear OS data
        container memorystartaddress_as_void [0..1]  # When TRUE, MemoryStartAddressType is declared to be of type void * in accordance with the AUTOSAR version 4.5.0 (19-11) specification. Otherwise MemoryStartAddressType is a pointer to uint8 to retain backwards compatibility. Defaults to FALSE.
          boolean VALUE: origin=ETAS-RTA-OS, set at pre-compile  # Value for MemoryStartAddressType as void pointer
        container applicationtype_starts_zero [0..1]  # When TRUE, valid ApplicationTypes start at zero in accordance with the AUTOSAR version 4.5.0 (19-11) specification. When FALSE, INVALID_OSAPPLICATION is zero matching the original implementation used by RTA-OS. Defaults to TRUE for AUTOSAR 4.5.0 and above, otherwise FALSE.
          boolean VALUE: origin=ETAS-RTA-OS, set at pre-compile  # Value for ApplicationType starts at zero
    container OsPeripheralArea [0..65534]: multiplicity set at pre-compile  # Container to structure the configuration parameters of one peripheral area. The container short name can be used to access this area.
      integer OsPeripheralAreaEndAddress: 0..18446744073709551615, set at pre-compile  # Last valid address of a peripheral area.
      integer OsPeripheralAreaId: 0..18446744073709551615, symbolic-name-value=true  # Id of peripheral area.
      integer OsPeripheralAreaStartAddress: 0..18446744073709551615, set at pre-compile  # First valid address of a peripheral area.
      reference OsPeripheralAreaAccessingApplication [0..*]: destination=OsApplication  # Reference to application which have access to this object.
    container OsRTATarget [0..1]  # Parameters to represent a specific piece of target hardware.
      string OsRTATargetName: origin=ETAS-RTA-OS_v6.2.0, set at pre-compile  # The name of the target system.
      string OsRTATargetVersion [0..1]: origin=ETAS-RTA-OS_v6.2.0, set at pre-compile  # The version number of the target.
      enumeration OsRTATargetVariant: {TDA4VM_MCU_R5FSS0_CORE0}, origin=ETAS-RTA-OS_v6.2.0  # Target Variant
      container Param [0..*]  # Target-specific parameter representation.
        container SpPreStartOS [0..1]  # The amount of stack already in use at the point that StartOS() is called. This value is simply added to the total stack size that the OS needs to support all tasks and interrupts at run-time. Typically you use this to obtain the amount of stack that the linker must allocate. The value does not normally change if the OS configuration changes.
          string VALUE: origin=ETAS-RTA-OS, set at pre-compile  # Value for Stack used for C-startup
        container SpStartOS [0..1]  # The amount of stack used when the OS is in the idle state (typically inside Os_Cbk_Idle()). This is just the difference between the stack used at the point that Os_StartOS() is called and the stack used when no task or interrupt is running. This can be zero if Os_Cbk_Idle() is not used. It must include the stack used by any function called while in the idle state. The value does not normally change if the OS configuration changes.
          string VALUE: origin=ETAS-RTA-OS, set at pre-compile  # Value for Stack used when idle
        container SpIDisp [0..1]  # The extra amount of stack needed to activate a task from within an ISR. If a task is activated within a Category 2 ISR, and that task has a higher priority than any currently running task, then for some targets the OS may need to use marginally more stack than if it activates a task that is of lower priority. This value accounts for that. On most targets this value is zero. This value is used in worst-case stack size calculations. The value may change if significant changes are made to the OS configuration. e.g. STANDARD/EXTENDED, SC1/2/3/4.
          string VALUE: origin=ETAS-RTA-OS, set at pre-compile  # Value for Stack overheads for ISR activation
        container SpECC [0..1]  # The extra amount of stack needed to start an ECC task. ECC tasks need to save slightly more state on the stack when they are started than BCC tasks. This value contains the difference. The value may change if significant changes are made to the OS configuration. e.g. STANDARD/EXTENDED, SC1/2/3/4. Also note that if you are using stack repositioning (to align the stack of untrusted code to suit the MPU) then you will need to reduce the value by the amount of the adjustment.
          string VALUE: origin=ETAS-RTA-OS, set at pre-compile  # Value for Stack overheads for ECC tasks
        container SpPreemption [0..1]  # The amount of stack used to service a Category 2 ISR. When a Category 2 ISR interrupts a task, it usually places some data on the stack. If the ISR measures the stack to determine if the preempted task has exceeded its stack budget, then it will overestimate the stack usage unless this value is subtracted from the measured size. The value is also used when calculating the worst-case stack usage of the system. Be careful to set this value accurately. If its value is too high then when the subtraction occurs, 32-bit underflow can occur and cause the OS to think that a budget overrun has been detected. The value may change if significant changes are made to the OS configuration. e.g. STANDARD/EXTENDED, SC1/2/3/4.
          string VALUE: origin=ETAS-RTA-OS, set at pre-compile  # Value for Stack overheads for ISR
        container Orti22Lauterbach [0..1]  # Select ORTI 2.2 generation for the Lauterbach debugger.
          boolean VALUE: origin=ETAS-RTA-OS, set at pre-compile  # Value for Orti22/Lauterbach
        container Orti23Lauterbach [0..1]  # Select ORTI 2.3 generation for the Lauterbach debugger.
          boolean VALUE: origin=ETAS-RTA-OS, set at pre-compile  # Value for Orti23/Lauterbach
        container no_fast_compile [0..1]  # By default RTA-OS will compile the RTA-OS library using multiple CPU threads to reduce the overall build time.
          boolean VALUE: origin=ETAS-RTA-OS, set at pre-compile  # Value for No fast compile
        container AlignUntrustedStacks [0..1]  # Use to support realignment of the stack for untrusted code when there are MPU protection region granularity issues. Refer to the documentation for Os_Cbk_SetMemoryAccess.
          boolean VALUE: origin=ETAS-RTA-OS, set at pre-compile  # Value for Enable stack repositioning
        container DistrustStacks [0..1]  # Extra code can be placed in interrupt handlers to detect when untrusted code has an illegal stack pointer value. Also exception handlers run on a private stack (Refer to the documentation for Os_Cbk_GetAbortStack). This has a small performance overhead, so is made optional.
          boolean VALUE: origin=ETAS-RTA-OS, set at pre-compile  # Value for Enable untrusted stack check
        container always_call_GetAbortStack [0..1]  # When the abort ISR is triggered always use the Os_Cbk_GetAbortStack() callback to set up a safe area of memory to use as a stack executing the ProtectionHook (please refer to the documentation for Os_Cbk_GetAbortStack).
          boolean VALUE: origin=ETAS-RTA-OS, set at pre-compile  # Value for GetAbortStack always
        container FloatingPointMode [0..1]  # Enable or disable hardware floating-point instructions. Used in the compiler command line option --float_support to select the optional architectural feature for floating-point mode extensions to the instruction set. See the compiler documentation for more details of this command line option. ('vfpv3d16'=Hardware floating-point instructions are used for all floating-point operations and FPU register context is saved by RTA-OS. 'none'=Disables hardware floating point supportthe compiler will implement float support in software, and no FPU register context is saved by RTA-OS (default).
          enumeration VALUE: origin=ETAS-RTA-OS, set at pre-compile  # Value for Set floating-point mode
            vfpv3d16  # Hardware floating-point instructions are used for all floating-point operations and FPU register context is saved by RTA-OS
            none  # Disables hardware floating point supportthe compiler will implement float support in software, and no FPU register context is saved by RTA-OS (default)
        container cat1fpsave [0..1]  # Category 1 ISRs do not normally preserve the floating-point registers when the floating-point option is used. Set this option TRUE to add code for Category 1 ISRs to save the registers.
          boolean VALUE: origin=ETAS-RTA-OS, set at pre-compile  # Value for Cat1 ISR FP Preserve
        container support_interruptsource [0..1]  # The AUTOSAR InterruptSource APIs are not supported by default because there is some run-time overhead. Set this option TRUE to add support for these APIs for all Category 2 interrupts. Manipulation of the enable/disable and pending bits operates on the VIM, not the source peripheral.
          boolean VALUE: origin=ETAS-RTA-OS, set at pre-compile  # Value for Support InterruptSource APIs
        container spinlock_slot [0..1]  # Selects which slot in the SPINLOCK peripheral the OS should use for cross-core locking. Only used in multi-core configurations. Values 0 to 255. Default is 0.
          string VALUE: origin=ETAS-RTA-OS, set at pre-compile  # Value for SPINLOCK slot
        container mbox [0..1]  # Selects which cluster in the MAILBOX peripheral the OS should use for controlling cross-core interrupts. Only used in multi-core configurations. Values 0 to 11. Default is 0 when R5FSS0_CORE0 is the master, 1 when R5FSS1_CORE0 is the master.
          string VALUE: origin=ETAS-RTA-OS, set at pre-compile  # Value for MAILBOX cluster
        container vim_xcore_channel [0..1]  # Selects which VIM channel the OS should use for cross-core interrupts. Only used in multi-core configurations. Values 224 to 255. Default is 255.
          string VALUE: origin=ETAS-RTA-OS, set at pre-compile  # Value for CrossCore VIM Channel
    container OsRegSet [0..*]  # Target specific register sets that can be associated with a task or ISR. By association with a task or ISR, the integrator is specifying that a specific task or ISR uses this register set. Having no association defined allows potential optimization.
    container OsResource [0..*]  # An OsResource object is used to co-ordinate the concurrent access by tasks and ISRs to a shared resource, e.g. the scheduler, any program sequence, memory or any hardware area.
      enumeration OsResourceProperty: {INTERNAL, LINKED, STANDARD}, set at pre-compile  # This specifies the type of the resource.
      reference OsResourceAccessingApplication [0..*]: multiplicity set at pre-compile, set at pre-compile, destination=OsApplication  # Reference to applications which have an access to this object.
      reference OsResourceLinkedResourceRef [0..1]: multiplicity set at pre-compile, set at pre-compile, destination=OsResource  # The link to the resource. Must be valid if OsResourceProperty is LINKED. If OsResourceProperty is not LINKED the value is ignored.
    container OsScheduleTable [0..*]  # An OsScheduleTable addresses the synchronization issue by providing an encapsulation of a statically defined set of alarms that cannot be modified at runtime.
      integer OsScheduleTableDuration: 0..18446744073709551615, set at pre-compile  # This parameter defines the modulus of the schedule table (in ticks).
      boolean OsScheduleTableRepeating: scope=ECU, set at pre-compile  # true: first expiry point on the schedule table shall be processed at final expiry point delay ticks after the final expiry point is processed. | false: the schedule table processing stops when the final expiry point is processed.
      reference OsScheduleTableCounterRef: scope=ECU, set at pre-compile, destination=OsCounter  # This parameter contains a reference to the counter which drives the schedule table.
      reference OsSchTblAccessingApplication [0..*]: multiplicity set at pre-compile, set at pre-compile, destination=OsApplication  # Reference to applications which have an access to this object.
      container OsScheduleTableAutostart [0..1]  # This container specifies if and how the schedule table is started on startup of the Operating System. The options to start a schedule table correspond to the API calls to start schedule tables during runtime.
        enumeration OsScheduleTableAutostartType: {ABSOLUTE, RELATIVE, SYNCHRON}, set at pre-compile  # This specifies the type of the autostart for the schedule table.
        integer OsScheduleTableStartValue [0..1]: 0..18446744073709551615, scope=ECU, multiplicity set at pre-compile, set at pre-compile  # Absolute autostart tick value when the schedule table starts. Only used if the OsScheduleTableAutostartType is ABSOLUTE. | Relative offset in ticks when the schedule table starts. Only used if the OsScheduleTableAutostartType is RELATIVE.
        reference OsScheduleTableAppModeRef [1..*]: scope=ECU, multiplicity set at pre-compile, set at pre-compile, destination=OsAppMode  # Reference in which application modes the schedule table should be started during startup
      container OsScheduleTableExpiryPoint [1..*]  # The point on a Schedule Table at which the OS activates tasks and/or sets events
        integer OsScheduleTblExpPointOffset: 0..18446744073709551615, set at pre-compile  # The offset from zero (in ticks) at which the expiry point is to be processed.
        container OsScheduleTableEventSetting [0..*]  # Event that is triggered by that schedule table.
          reference OsScheduleTableSetEventRef: set at pre-compile, destination=OsEvent  # Reference to event that will be set by action
          reference OsScheduleTableSetEventTaskRef: set at pre-compile, destination=OsTask
        container OsScheduleTableTaskActivation [0..*]  # Task that is triggered by that schedule table.
          reference OsScheduleTableActivateTaskRef: scope=ECU, set at pre-compile, destination=OsTask  # Reference to task that will be activated by action
        container OsScheduleTblAdjustableExpPoint [0..1]  # Adjustable expiry point
          integer OsScheduleTableMaxLengthen: 0..18446744073709551615, set at pre-compile  # The maximum positive adjustment that can be made to the expiry point offset (in ticks).
          integer OsScheduleTableMaxShorten: 0..18446744073709551615, set at pre-compile  # The maximum negative adjustment that can be made to the expiry point offset (in ticks).
      container OsScheduleTableSync [0..1]  # This container specifies the synchronization parameters of the schedule table.
        integer OsScheduleTblExplicitPrecision [0..1]: 0..18446744073709551615, scope=ECU, multiplicity set at pre-compile, set at pre-compile  # This configuration is only valid if the explicit synchronization is used.
        enumeration OsScheduleTblSyncStrategy: {EXPLICIT, IMPLICIT, NONE}, scope=ECU, origin=AUTOSAR ECUC, set at pre-compile, default-value=NONE  # AUTOSAR OS provides support for synchronization in two ways: explicit and implicit.
    container OsSpinlock [0..*]  # An OsSpinlock object is used to co-ordinate concurrent access by TASKs/ISR2s on different cores to a shared resource.
      enumeration OsSpinlockLockMethod [0..1]: origin=ETAS-RTA-OS_v6.2.0, set at pre-compile, default-value=LOCK_NOTHING  # Determines the locking method for the Spinlock.
        COMMONABLE_LOCK_ALL_INTERRUPTS  # Lock all interrupts when spinlock is taken. Lock is commonable.
        COMMONABLE_LOCK_CAT2_INTERRUPTS  # Lock OS interrupts when spinlock is taken. Lock is commonable.
        COMMONABLE_LOCK_NOTHING  # No lock when spinlock is taken. Lock is commonable.
        COMMONABLE_LOCK_WITH_RES_SCHEDULER  # Lock RES_SCHEDULER when spinlock is taken. Lock is commonable.
        LOCK_ALL_INTERRUPTS  # Lock all interrupts when spinlock is taken.
        LOCK_CAT2_INTERRUPTS  # Lock OS interrupts when spinlock is taken.
        LOCK_NOTHING  # No lock when spinlock is taken.
        LOCK_WITH_RES_SCHEDULER  # Lock RES_SCHEDULER when spinlock is taken.
        NESTABLE_COMMONABLE_LOCK_ALL_INTERRUPTS  # Lock all interrupts when spinlock is taken. Allow nesting. Lock is commonable.
        NESTABLE_COMMONABLE_LOCK_CAT2_INTERRUPTS  # Lock OS interrupts when spinlock is taken. Allow nesting. Lock is commonable.
        NESTABLE_COMMONABLE_LOCK_NOTHING  # No lock when spinlock is taken. Allow nesting. Lock is commonable.
        NESTABLE_COMMONABLE_LOCK_WITH_RES_SCHEDULER  # Lock RES_SCHEDULER when spinlock is taken. Allow nesting. Lock is commonable.
        NESTABLE_LOCK_ALL_INTERRUPTS  # Lock all interrupts when spinlock is taken. Allow nesting.
        NESTABLE_LOCK_CAT2_INTERRUPTS  # Lock OS interrupts when spinlock is taken. Allow nesting.
        NESTABLE_LOCK_NOTHING  # No lock when spinlock is taken. Allow nesting.
        NESTABLE_LOCK_WITH_RES_SCHEDULER  # Lock RES_SCHEDULER when spinlock is taken. Allow nesting.
      reference OsSpinlockAccessingApplication [1..*]: multiplicity set at pre-compile, set at pre-compile, destination=OsApplication  # Reference to OsApplications that have an access to this object.
      reference OsSpinlockSuccessor [0..1]: multiplicity set at pre-compile, set at pre-compile, destination=OsSpinlock  # Reference to OsApplications that have an access to this object. | To check whether a spinlock can be occupied (in a nested way) without any danger of deadlock, a linked list of spinlocks can be defined. A spinlock can only be occupied in the order of the linked list. It is allowed to skip a spinlock. If no linked list is specified, spinlocks cannot be nested.
    container OsTask [0..*]  # This container represents an ISO 17356 task.
      integer OsTaskActivation: 1..4294967295, set at pre-compile  # This attribute defines the maximum number of queued activation requests for the task. A value equal to "1" means that at any time only a single activation is permitted for this task. Note that the value must be a natural number starting at 1.
      string OsTaskBudget [0..1]: origin=ETAS-RTA-OS_v6.2.0, set at pre-compile  # Execution budget expressed as a float, then timebase name, then units.
      boolean OsTaskCanCallSchedule [0..1]: origin=ETAS-RTA-OS_v6.2.0, set at pre-compile, default-value=true  # TRUE if a TASK calls, or might call, the Schedule() API. System stack usage may be reduced if this can be set FALSE. Ignored if global OS option 'Disallow Schedule()' is TRUE
      float OsTaskPeriod [0..1]: origin=ETAS-RTA-OS_v6.2.0, set at pre-compile  # If this parameter is not given the task can be activated sporadicly or cyclically with a unknown period value. This value is information, e.g. for time base calculations in the RTE in case TimingEvents are mapped onto this OsTask.Be aware, that this parameter is not supposed to be relevant for the OS! This information is given as part of the OS configuration to support configuration work flows using a fixed set of OsTasks.
      integer OsTaskPriority: 0..4294967295, set at pre-compile  # The priority of a task is defined by the value of this attribute. This value has to be understood as a relative value, i.e. the values show only the relative ordering of the tasks. | ISO 17356-3 defines the lowest priority as zero (0); larger values correspond to higher priorities.
      enumeration OsTaskSchedule: {FULL, NON}, set at pre-compile  # The OsTaskSchedule attribute defines the preemptability of the task. | If this attribute is set to NON, no internal resources may be assigned to this task.
      string OsTaskStackAllocation [0..1]: origin=ETAS-RTA-OS_v6.2.0, set at pre-compile  # Task manual stack allocation in bytes.
      string OsTaskWaitStack [0..1]: origin=ETAS-RTA-OS_v6.2.0, set at pre-compile  # Task stack usage when invoking WaitEvent.
      foreign reference OsMemoryMappingCodeLocationRef [0..1]: scope=ECU, set at pre-compile, destination-type=SW-ADDR-METHOD  # Reference to the memory mapping containing details about the section where the code is placed.
      reference OsRegSetRef [0..*]: origin=ETAS-RTA-OS_v6.2.0, set at pre-compile, destination=OsRegSet  # A reference to the register sets that are used by this Task.
      reference OsTaskAccessingApplication [0..*]: multiplicity set at pre-compile, set at pre-compile, destination=OsApplication  # Reference to applications which have an access to this object.
      reference OsTaskEventRef [0..*]: multiplicity set at pre-compile, set at pre-compile, destination=OsEvent  # This reference defines the list of events the extended task may react on.
      reference OsTaskResourceRef [0..*]: multiplicity set at pre-compile, set at pre-compile, destination=OsResource  # This reference defines a list of resources accessed by this task.
      container OsTaskAutostart [0..1]  # This container determines whether the task is activated during the system start-up procedure or not for some specific application modes. | If the task shall be activated during the system start-up, this container is present and holds the references to the application modes in which the task is auto-started.
        reference OsTaskAppModeRef [1..*]: multiplicity set at pre-compile, set at pre-compile, destination=OsAppMode  # Reference to application modes in which that task is activated on startup of the OS
      container OsTaskTimingProtection [0..1]  # This container contains all parameters regarding timing protection of the task.
        float OsTaskAllInterruptLockBudget [0..1]: 0..Inf, scope=ECU, multiplicity set at pre-compile, set at pre-compile  # This parameter contains the maximum time for which the task is allowed to lock all interrupts (via SuspendAllInterrupts() or DisableAllInterrupts()) (in seconds).
        float OsTaskExecutionBudget [0..1]: 0..Inf, scope=ECU, multiplicity set at pre-compile, set at pre-compile  # This parameter contains the maximum allowed execution time of the task (in seconds).
        float OsTaskOsInterruptLockBudget [0..1]: 0..Inf, scope=ECU, multiplicity set at pre-compile, set at pre-compile  # This parameter contains the maximum time for which the task is allowed to lock all Category 2 interrupts (via SuspendOSInterrupts()) (in seconds).
        float OsTaskTimeFrame [0..1]: 0..Inf, scope=ECU, multiplicity set at pre-compile, set at pre-compile  # The minimum inter-arrival time between activations and/or releases of a task (in seconds).
        container OsTaskResourceLock [0..*]  # This container contains the worst case time between getting and releasing a given resource (in seconds).
          float OsTaskResourceLockBudget: 0..Inf, scope=ECU, set at pre-compile  # This parameter contains the maximum time the task is allowed to lock the resource (in seconds)
          reference OsTaskResourceLockResourceRef: scope=ECU, set at pre-compile, destination=OsResource  # Reference to the resource used by the task

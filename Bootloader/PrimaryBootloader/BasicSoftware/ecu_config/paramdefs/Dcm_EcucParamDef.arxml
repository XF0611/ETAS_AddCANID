[part 1 of 3: package /AUTOSAR_Dcm/EcucModuleDefs]
AUTOSAR XML (schema 4-2-2)
package /AUTOSAR_Dcm/EcucModuleDefs
  module definition Dcm [0..1]: category=VENDOR_SPECIFIC_MODULE_DEFINITION, refined-module-def=Dcm, variants pre-compile  # Configuration of the Dcm (Diagnostic Communications Manager) module.
    container DcmConfigSet  # This container contains the configuration parameters and sub containers of the DCM module supporting multiple configuration sets. | This container is a MultipleConfigurationContainer, i.e. this container and its sub-containers exist once per configuration set.
      container DcmDsd  # These parameters apply to Diagnostic Service Dispatcher. All parameters for all service dispatchers are included in this one configuration container. | There must always be one service dispatcher in a DCM.
        boolean DcmDsdRequestManufacturerNotificationEnabled: scope=ECU, set at pre-compile  # Allows to enable or disable the requested notification mechanism for the Manufacturer.
        boolean DcmDsdRequestSupplierNotificationEnabled: scope=ECU, set at pre-compile  # Allows to enable or disable the requested notification mechanism for the Supplier.
        boolean DcmRbIndicationVersion [0..1]: scope=ECU, set at pre-compile, default-value=false  # Xxx_Indication() Autosar Version AR4.2 or AR4.5. | If DcmRbIndicationVersion is TRUE,then Dcm is allowing DataSize of uint32 in Xxx_Indication(). If DcmRbIndicationVersion is FALSE,then Dcm is allowing DataSize of uint16 in Xxx_Indication().
        container DcmDsdServiceRequestManufacturerNotification [0..*]  # The name of this container is used to define the name of the R-Port through which the DCM accesses the interface ServiceRequestNotification. | The R-Port is named ServiceRequestManufacturerNotification_{Name} where {Name} is the name of the container DcmDsdServiceRequestManufacturerNotification. The lowerMultiplicity is 0: If DcmDsdRequestManufacturerNotificationEnabled = false the Indication API is not available.
        container DcmDsdServiceRequestSupplierNotification [0..*]  # The name of this container is used to define the name of the R-Port through which the DCM accesses the interface ServiceRequestNotification. | The R-Port is named ServiceRequestSupplierNotification_<SWC> where <SWC> is the name of the container DcmDsdServiceRequestSupplierNotification. The lowerMultiplicity is 0: If DcmDsdRequestSupplierNotification = false the Indication API is not available.
        container DcmDsdServiceTable [1..256]  # This container contains the configuration (DSD parameters) for Service Identifier Table. | Note: It is allowed to add OBD services to a DcmDsdServiceTable related to a UDS Protocol. But it is not allowed to add UDS services to a DcmDsdServiceTable related to a OBD Protocol.
          integer DcmDsdSidTabId: 0..255, scope=ECU, set at link in variant link-time / pre-compile in variant post-build+pre-compile, with-auto=true  # Due the fact of using one or more service tables the member of the Service Identifier Table includes a unique id for the Service Identifier Table.
          integer DcmRbNRCForService [0..1]: 1..254, multiplicity set at link in variant link-time+post-build / pre-compile in variant pre-compile, origin=RB:AR42.1.0.0:2017-01-31, set at link in variant link-time+post-build / pre-compile in variant pre-compile, default-value=127  # The NRC updated in this field shall be returned for any request in the protocol referring this service table if the service is not supported in active session. ISO recommends that the parameter should be set to 0x7F for UDS.Users may configure any NRC value for this parameter, according to project requirements, for other protocols.
          container DcmDsdService [1..*]  # This container contains the configuration (DSD parameters) for Service.
            boolean DcmDsdServiceUsed [0..0]: set at link in variant link-time / post-build in variant post-build / pre-compile in variant pre-compile, with-auto=true  # Allow to activate or deactivate the usage of a Service, for multi purpose ECUs | true = Service available false = Service not available
            function name DcmDsdSidTabFnc [0..1]: scope=ECU, multiplicity set at link in variant link-time / pre-compile in variant post-build+pre-compile, set at link in variant link-time / pre-compile in variant post-build+pre-compile  # Callback function of the DSP or ECU Supplier specific component for the particular DcmDsdSidTabServiceId.User may see the function name for Dcm specific services by pressing "Ctrl+Enter" | This parameter is related to the interface <Module>_<DiagnosticService>. If it is not configured the service is handled Dcm-internally.
            integer DcmDsdSidTabServiceId: 0..255, scope=ECU, set at link in variant link-time / pre-compile in variant post-build+pre-compile  # Id of the Service identifier.The possible Service identifier are predefined in the ISO 14229-1 and ISO 15031-5 | The possible Service identifier are predefined in the ISO 14229-1 and ISO 15031-5 and in Table 4 and Table 5.
            boolean DcmDsdSidTabSubfuncAvail: scope=ECU, set at link in variant link-time / pre-compile in variant post-build+pre-compile  # Information whether the DcmDsdSidTabServiceId includes Sub functions or not. Used for handling of "suppressPosRspMsgIndicationBit". ISO14229-1 can be referenced here, as this specification gives fix definition, if an SID includes subfunction or not. The parameter should configured as TRUE if subservices for the service in DSD are used. Minimum length check shall be performed in DSD if the parameter is configured as TRUE. Other subservice related checks (subservice session/subservice security/subservice mode rule check shall be performed in DSD only if subservices under the Service DcmDsdService->DcmDsdSubService are configured. | true = sub-function available false = sub-function not available
            string DcmRbDsdSidTabSidInitFunction [0..1]: multiplicity set at link in variant link-time+post-build / pre-compile in variant pre-compile, origin=RB:AR42.1.0.0:2017-01-31, set at link in variant link-time+post-build / pre-compile in variant pre-compile  # Function pointer of the service initializing function.User may see the function name for Dcm specific services by pressing "Ctrl+Enter"
            function name DcmRbDsdSidTabUserModeRuleFnc [0..1]: multiplicity set at pre-compile, origin=RB:AR42.1.0.0:2017-01-31, set at pre-compile  # Function name used by the application to perform user specific checks on the SID.In case the checks fails, NRC value set by the application can be returned to the tester. In case the function is not configured for SID, the DcmAppl API Xxx_UserServiceModeRuleService shall be called.
            reference DcmDsdSidTabModeRuleRef [0..1]: scope=ECU, multiplicity set at link in variant link-time / pre-compile in variant post-build+pre-compile, set at link in variant link-time / pre-compile in variant post-build+pre-compile, destination=DcmModeRule  # Reference to DcmDspModeRule | Mode rule which controls the execution of the DcmDsdService. If there is no reference, no check of the mode rule shall be done.
            reference DcmDsdSidTabSecurityLevelRef [0..*]: scope=ECU, multiplicity set at link in variant link-time / pre-compile in variant post-build+pre-compile, set at link in variant link-time / pre-compile in variant post-build+pre-compile, destination=DcmDspSecurityRow  # Link to the Security Access Levels needed for execution of the DcmDsdService. Please refer to the ISO 14229-1, ISO 15031-5 and "Verification of the Security Access levels". User can configure multiple DcmDsdSidTabSecurityLevelRef per DcmDsdService. If reference is provided, then DcmDsdService shall be enabled only in the configured security levels. The service will be allowed in all security levels, if no reference is provided. The additional security levels configured for the subservice will also be considered as the security level of the service. | Please refer to the ISO 14229-1, ISO 15031-5 and "Verification of the Security Access levels". Please note, that it shall be provided to configure several DcmDsdSidTabSecurityLevelRef per DcmDsdService. If there is no reference, no check of security level shall be done.
            reference DcmDsdSidTabSessionLevelRef [0..*]: scope=ECU, multiplicity set at link in variant link-time / pre-compile in variant post-build+pre-compile, set at link in variant link-time / pre-compile in variant post-build+pre-compile, destination=DcmDspSessionRow  # Link to the Session Control needed for execution of the DcmDsdService. Please refer to the ISO 14229-1, ISO 15031-5 and "Verification of the Diagnostic Session". It is possible for user to configure multiple DcmDsdSidTabSessionLevelRef per DcmDsdService. If reference is provided,DcmDsdService to be enabled only in the configured session levels. If there is no reference, no check of session level shall be done. The additional session levels configured for the subservice will also be considered as the session level of the service.
            container DcmDsdSubService [0..*]  # This container contains the configuration (DSD parameters) for SubServices. Only those services may have subservices, which have the DcmDsdSidTabSubfuncAvail configured as TRUE. It is not advisable to configure Sub-Functions for RoutineControl Service(0x31).Any DcmDsdSubService configuration for RoutineControl Service(0x31) service will be ignored.
              function name DcmDsdSubServiceFnc [0..0]: multiplicity set at link in variant link-time / pre-compile in variant post-build+pre-compile, set at link in variant link-time / pre-compile in variant post-build+pre-compile, with-auto=true  # Callback function of the ECU Supplier specific component. This parameter is related to the interface <Module>_<DiagnosticService>_<SubService>. | If it is not configured the sub-service is handled Dcm-internally.
              integer DcmDsdSubServiceId: 0..255, scope=ECU, set at link in variant link-time / pre-compile in variant post-build+pre-compile  # Id of the SubService identifier. The possible Subfunction parameter value are predefined in the ISO 14229-1 and ISO 15031-5.
              boolean DcmDsdSubServiceUsed [0..0]: set at link in variant link-time / post-build in variant post-build / pre-compile in variant pre-compile, with-auto=true  # Allow to activate or deactivate the usage of a Subfunction, for multi purpose ECUs. | true = Subfunction available true = Subfunction not available
              function name DcmRbDsdSubFuncServHandler [0..1]: multiplicity set at link in variant link-time / pre-compile in variant post-build+pre-compile, origin=RB:AR42.1.0.0:2017-01-31, set at link in variant link-time / pre-compile in variant post-build+pre-compile  # Service Handler for configured RDTC Sub Function (0x01, 0x2 , 0x3, 0x4, 0x5, 0x6,0x7, 0x8, 0x09, 0xA, 0x0B, 0x0C, 0x0D, 0x0E, 0xF, 0x10, 0x11, 0x12, 0x13, 0x14, 0x15) If the user has not configured SubFuncServHandler for Sub function level 0x01, 0x2 ,0x3, 0x4, 0x5, 0x6, 0x7, 0x8, 0x09, 0xA, 0x0B, 0x0C, 0x0D, 0x0E, 0xF, 0x10, 0x11, 0x12, 0x13, 0x14, 0x15 ; , Default ServHandler names are configured. If the user configures ServHandler Name for Sub function level other than 0x01, 0x2 ,0x3, 0x4, 0x5,0x6, 0x7, 0x8, 0x09, 0xA, 0x0B, 0x0C, 0x0D, 0x0E, 0xF, 0x10, 0x11, 0x12, 0x13, 0x14, 0x15 ; the entered function name is configured. For any Sub Function levels other than (0x01, 0x2 ,0x3, 0x4, 0x5, 0x6, 0x7, 0x8, 0x09, 0xA, 0x0B, 0x0C, 0x0D, 0x0E, 0xF, 0x10, 0x11, 0x12, 0x13, 0x14, 0x15 ); The user has to enter the Service Handler name Mandatory. | If it is not configured the sub-service is handled Dcm-internally.
              function name DcmRbDsdSubServiceUserModeRuleFnc [0..1]: multiplicity set at pre-compile, origin=RB:AR42.1.0.0:2017-01-31, set at pre-compile  # Function name used by the application to perform user specific checks on the subfunction.In case the checks fails, NRC value set by the application can be returned to the tester. In case the function is not configured for sub service , the DcmAppl API DcmAppl_UserSubServiceModeRuleService shall be called. | Function name used by the application to perform user specific checks on the subfunction.In case the checks fails, NRC value set by the application can be returned to the tester. In case the function is not configured for sub service, the DcmAppl API DcmAppl_UserSubServiceModeRuleService shall be called.
              reference DcmDsdSubServiceModeRuleRef [0..1]: scope=ECU, multiplicity set at link in variant link-time / pre-compile in variant post-build+pre-compile, set at link in variant link-time / pre-compile in variant post-build+pre-compile, destination=DcmModeRule  # Reference to DcmDspModeRule which controls execution of this DcmDsdSubService. If there is no reference, no check of the mode rule shall be done before executing the subservice. Refer DcmProcessingConditions->DcmModeRule for more details regarding mode rules. | Mode rule which controls execution of this the DcmDsdSubService. If there is no reference, no check of the mode rule shall be done.
              reference DcmDsdSubServiceSecurityLevelRef [0..*]: scope=ECU, multiplicity set at link in variant link-time / pre-compile in variant post-build+pre-compile, set at link in variant link-time / pre-compile in variant post-build+pre-compile, destination=DcmDspSecurityRow  # Link to the Security Level needed for execution of the DcmDsdSubService. User can configure multiple DcmDsdSubServiceSecurityLevelRef per DcmDsdSubService. Please refer to ISO 14229-1, ISO 15031-5 and "Verification of the Diagnostic Session". If reference is provided, then DcmDsdSubService shall be enabled only in the configured security levels. If no reference is provided, DcmDsdSubService shall be allowed in all security levels. | Please refer to the ISO 14229-1, ISO 15031-5 and "Verification of the Diagnostic Session". Please note, that it shall be provided to configure several DcmDsdSubServiceSecurityLevelRef per DcmDsdSubService. If there is no reference, no check of security level shall be done.
              reference DcmDsdSubServiceSessionLevelRef [0..*]: scope=ECU, multiplicity set at link in variant link-time / pre-compile in variant post-build+pre-compile, set at link in variant link-time / pre-compile in variant post-build+pre-compile, destination=DcmDspSessionRow  # Link to the Session Control needed for execution of the DcmDsdSubService. Please refer to ISO 14229-1, ISO 15031-5 and "Verification of the Diagnostic Session". User can configure multiple DcmDsdSubServiceSessionLevelRef per DcmDsdSubService. If reference is provided, then DcmDsdSubService shall be enabled only in the configured session levels. If no reference is provided, no check of session level shall be done, before processing the subservice. | Please refer to the ISO 14229-1, ISO 15031-5 and "Verification of the Diagnostic Session". Please note, that it shall be provided to configure several DcmDsdSubServiceSessionLevelRef per DcmDsdSubService. If there is no reference, no check of session level shall be done.
      container DcmDsl  # These parameters apply to a Diagnostic Session Layer. There may be a parameter set (DSL Configuration) per protocol. Each DCM configuration must have exactly one DSL configuration. | upperMultiplicity: Each DCM configuration must have exactly one DSL configuration. lowerMultiplicity: Each DCM configuration must have exactly one DSL configuration.
        container DcmDslBuffer [1..256]  # This container contains the configuration (parameters) for the diagnostic buffer.
          integer DcmDslBufferSize: 8..4294967294, scope=ECU, set at pre-compile  # Size of Diagnostic Buffer (in Bytes).For a linear buffer: size of the buffer shall be as large as the longest message (request or response) For a paged buffer (only Tx possible): size has impacts on the application performance | For a linear buffer: size of the buffer shall be as large as the longest message (request or response) For a paged buffer (only Tx possible): size has impacts on the application performance Please note: max. range is the valid range for a CAN network. We assume a FlexRay (or other networks) implementation will work with this range (and the page buffer mechanism) without any problems.
        container DcmDslCallbackDCMRequestService [0..*]  # The name of this container is used to define the name of the R-Port through which the DCM access the interface CallbackDCMRequestServices(with operations Xxx_StartProtocol and Xxx_StopProtocol). The R-Port is named CallbackDCMRequestServices _SWC where _SWC is the name of the container DcmDslCallbackDCMRequestService. | The R-Port is named CallbackDCMRequestServices_<SWC> where _<SWC> is the name of the container DcmDslCallbackDCMRequestService.
        container DcmDslDiagResp  # This container contains the configuration (parameters) for the ResponsePending handling
          integer DcmDslDiagRespMaxNumRespPend: 0..255, scope=ECU, set at link in variant link-time / pre-compile in variant post-build+pre-compile  # Maximum number of negative responses with response code 0x78 (requestCorrectlyReceived-ResponsePending) allowed per request. DCM will send a negative response with response code 0x10 (generalReject), in case the limit value is reached. Value 255 (0xFF) configured for this parameter means that there is no limit on the number of 0x78 (ResponsePending). | Value 0xFF means that no limit number of NRC 0x78 response apply.
          boolean DcmDslDiagRespOnSecondDeclinedRequest [0..0]: scope=ECU, set at link in variant link-time / pre-compile in variant post-build+pre-compile  # Defines the reaction upon a second request (ClientB) that can not be processed (e.g. due to priority assessment). | TRUE: when the second request (Client B) can not be processed, it shall be answered with NRC21 BusyRepeatRequest. FALSE: when the second request (Client B) can not be processed, it shall not be responded.
        container DcmDslProtocol  # This container contains the configuration (parameters) for the protocol configuration (for each protocol) The following parameters needs to be configured per protocol.
          container DcmDslProtocolRow [1..*]  # Definition of a single Row of configuration for the protocol configuration (for each protocol)
            enumeration DcmDslProtocolID: {DCM_OBD_ON_CAN, DCM_OBD_ON_FLEXRAY, DCM_OBD_ON_IP, DCM_OBD_ON_KLINE, DCM_PERIODICTRANS_ON_CAN, DCM_PERIODICTRANS_ON_FLEXRAY, DCM_PERIODICTRANS_ON_IP, DCM_ROE_ON_CAN, DCM_ROE_ON_FLEXRAY, DCM_ROE_ON_IP, DCM_SUPPLIER_1, DCM_SUPPLIER_10, DCM_SUPPLIER_11, DCM_SUPPLIER_12, DCM_SUPPLIER_13, DCM_SUPPLIER_14, DCM_SUPPLIER_15, DCM_SUPPLIER_2, DCM_SUPPLIER_3, DCM_SUPPLIER_4, DCM_SUPPLIER_5, DCM_SUPPLIER_6, DCM_SUPPLIER_7, DCM_SUPPLIER_8, DCM_SUPPLIER_9, DCM_UDS_ON_CAN, DCM_UDS_ON_FLEXRAY, DCM_UDS_ON_IP, DCM_ACEA_ON_CAN, DCM_ACEA_ON_FLEXRAY, DCM_KWP_ON_KLINE, DCM_KWP_ON_CAN, DCM_CARB_ON_KLINE}, scope=ECU, set at pre-compile, symbolic-name-value=true  # The diagnostic protocol type for the DCM DSL protocol that is being configured. | Implementation Type: Dcm_ProtocolType
            integer DcmDslProtocolMaximumResponseSize [0..1]: 1..65535, scope=ECU, multiplicity set at pre-compile, set at pre-compile, default-value=4095  # The value of this parameter is the maximum response length possible in case paged buffer is enabled for any service (For example 0x19,0x22). The parameter should be configured by the user.In case the user leaves the parameter unconfigured, Dcm shall fill the value during generate Id as 4095 for CAN(If CanTpFlexibleDataRateSupport is not configured/ configured as FALSE in CanTp) and as 65535 for other protocols (Flexray, IP,CAN (if CanTpFlexibleDataRateSupport ios configured as TRUE)). Values configured by the user wil be overwritten by Dcm in this case.If paged buffer is enabled and the generated Response for a Request is longer than DcmDslProtocolMaximumResponseSize configured for the active protocol, the Dcm service shall respond with NRC 0x14 (DCM_E_RESPONSETOOLONG).Vendor specific services using paged buffer should also do a check based on this parameter. If paged buffer is disabled and the generated Response for a Request is longer than Dcm_MsgContextType structure element resMaxDataLen, the Dcm shall respond with NRC 0x14 (DCM_E_RESPONSETOOLONG).
            float DcmDslProtocolPreemptTimeout [0..0]: 0..1, scope=ECU, set at link in variant link-time / pre-compile in variant post-build+pre-compile, with-auto=true  # This is the value for the timeout in seconds of preempting protocol until protocol needs to be started. | This is defined in the AUTOSAR SWS for DCM as a uint16. The AUTOSAR configuration standard is to use SI units, so this parameter is defined as a float value in seconds. DCM configuration tools must convert this float value to the appropriate value format for the use in the software implementation of DCM. min: A negative value is not allowed. upperMultiplicity: Exactly one DcmDslProtocolPreemptTimeout value per DSL protocol timing structure. lowerMultiplicity: Exactly one DcmDslProtocolPreemptTimeout value per DSL timing structure. origin: Standard AUTOSAR configuration parameter.
            integer DcmDslProtocolPriority: 0..255, scope=ECU, set at link in variant link-time / pre-compile in variant post-build+pre-compile  # The SWS for DCM defines this item as uint8. This is the protocol priority that is used during protocol preemption handling. 0 is the highest priority and it reduces with the increase in value. | 0 = Highest priority (protocol may not be preempted by other protocols) 1, 2, 3... = Reducing priority. Protocol may be preempted by other protocols with lower priority value. upperMultiplicity: Exactly one priority must be provided per Tx Protocol. lowerMultiplicity: Exactly one priority must be provided per Tx Protocol. origin: Standard AUTOSAR configuration parameter.
            boolean DcmDslProtocolRowUsed [0..0]: set at link in variant link-time / post-build in variant post-build / pre-compile in variant pre-compile, with-auto=true  # Allow to activate or deactivate the usage of a Protocol, for multi purpose ECUs. | true = Protocol used false = Protocol not used
            enumeration DcmDslProtocolTransType [0..1]: {TYPE1, TYPE2}, scope=ECU, multiplicity set at link in variant link-time / pre-compile in variant post-build+pre-compile, set at link in variant link-time / pre-compile in variant post-build+pre-compile  # This parameter is used only if the protocol is of type DCM_ROE_ON_xxx or DCM_PERIODICTRANS_ON_xxx. It selects the transmission type of the protocol. TYPE1: Messages for ROE or Periodic Transmission uses the DcmTxPduId used for normal diagnostic responses. The outgoing messages must be synchronized with normal outgoing messages, which have a higher priority. TYPE2: Messages for ROE or Periodic Transmission are sent on a separate DcmTxPduId. | If the configuration parameter DcmDslProtocolId is not configure to Response on event or PeriodicTransmission the parameter should not be used
            boolean DcmRbDslProtocolNRC21OnPriorityAssessmentReject [0..1]: multiplicity set at link in variant link-time / post-build in variant post-build / pre-compile in variant pre-compile, origin=RB:AR42.1.0.0:2017-01-31, set at link in variant link-time / post-build in variant post-build / pre-compile in variant pre-compile, default-value=false  # This parameter defines the reaction when a new requests arrives on this protocol, when there is already a request with higher or same priority under processing. TRUE: answer with NRC21 BusyRepeatRequest FALSE: silently ignore the request In case the parameter is left unconfigured ,then the FALSE will be considered as the default value and the new request wth same priority will be ignored silently. | TRUE: answer with NRC21 BusyRepeatRequest. FALSE: silently ignore the request
            boolean DcmSendRespPendOnTransToBoot: set at link in variant link-time / pre-compile in variant post-build+pre-compile, default-value=true  # Parameter specifying if the ECU should send a NRC 0x78 (response pending) before transitioning to the bootloader (parameter set to TRUE) or if the transition shall be initiated without sending NRC 0x78 (parameter set to FALSE).
            float DcmTimStrP2ServerAdjust: 0..1, scope=ECU, set at link in variant link-time / pre-compile in variant post-build+pre-compile  # This parameter is used to guarantee that the DCM response is available on the bus before reaching P2.This parameter value in seconds has to be configured as a multiple of DcmTaskTime and is minimum in the timing handling of P2. The AUTOSAR configuration standard is to use SI units, so this parameter is defined as a float value in seconds. DCM configuration tools must convert this float value to the appropriate value format for the use in the software implementation of DCM. | The AUTOSAR configuration standard is to use SI units, so this parameter is defined as a float value in seconds. DCM configuration tools must convert this float value to the appropriate value format for the use in the software implementation of DCM.
            float DcmTimStrP2StarServerAdjust: 0..5, scope=ECU, set at link in variant link-time / pre-compile in variant post-build+pre-compile  # This parameter is used to guarantee that the DCM response is available on the bus before reaching P2*.This parameter value in seconds has to be configured as multiple of DcmTaskTime and is minimum in the timing handling of P2*. The AUTOSAR configuration standard is to use SI units, so this parameter is defined as a float value in seconds. DCM configuration tools must convert this float value to the appropriate value format for the use in the software implementation of DCM. | The AUTOSAR configuration standard is to use SI units, so this parameter is defined as a float value in seconds. DCM configuration tools must convert this float value to the appropriate value format for the use in the software implementation of DCM.
            reference DcmDemClientRef [0..1]: scope=ECU, multiplicity set at pre-compile, set at pre-compile, destination=DemClient  # Link to ClientID configuration used by the Dem to distinguish different client calls.
            reference DcmDslProtocolRxBufferRef [0..1]: scope=ECU, multiplicity set at link in variant link-time / post-build in variant post-build / pre-compile in variant pre-compile, set at link in variant link-time / pre-compile in variant post-build+pre-compile, destination=DcmDslBuffer  # Link to buffer configuration (DcmDslBuffer) for configuration of protocol buffer used for Rx actions. | upperMultiplicity / lowerMultiplicity:: Exactly one Rx buffer is required for protocol reception
            reference DcmDslProtocolSIDTable [0..1]: scope=ECU, multiplicity set at link in variant link-time / post-build in variant post-build / pre-compile in variant pre-compile, set at link in variant link-time / pre-compile in variant post-build+pre-compile, destination=DcmDsdServiceTable  # Link to the used diagnostic service table for this protocol. | upperMultiplicity: Must have exactly one service table for the protocol. lowerMultiplicity: Must have exactly one service table for the protocol.
            reference DcmDslProtocolTxBufferRef [0..1]: scope=ECU, multiplicity set at link in variant link-time / post-build in variant post-build / pre-compile in variant pre-compile, set at link in variant link-time / pre-compile in variant post-build+pre-compile, destination=DcmDslBuffer  # Link to buffer configuration (DcmDslBuffer) for configuration of protocol buffer used for Tx actions. | upperMultiplicity / lowerMultiplicity:: Exactly one Tx buffer is required for protocol transmission.
            choice container DcmDslConnection [1..*]  # This container contains links between Diagnostic Protocol (=DcmDslProtocolRow) and the according Rx or Tx channel. And also contains links to the ROE connection (DcmDslROEConnectionRef) and the Periodic Transmission Connection (DcmDslPeriodicTransmissionConRef). Tto allow more then one diagnostic tester (using different CAN channels), configuration of multiple DcmDslConnections is possible. | Because of the usecase to allow more then one diagnostic tester (using different CAN channels) it is necessary to allow configuration of multiple DcmDslConnections.
              container DcmDslMainConnection [0..1]  # This container contains configuration for Diagnostic Main Connection (DcmDslProtocolTx, DcmDslProtocolRx).In addition it contains links to the ROE connection (DcmDslROEConnectionRef) and the Periodic Transmission Connection (DcmDslPeriodicTransmissionConRef) relevant for protocols with DcmDslProtocolTransType = TYPE2 or TYPE1. | (DcmDslProtocolTx, DcmDslProtocolRx). In addition it contains links to the ROE connection (DcmDslROEConnectionRef) and the Periodic Transmission Connection (DcmDslPeriodicTransmissionConRef) relevant for protocols with DcmDslProtocolTransType = TYPE2 or TYPE1.
                integer DcmDslProtocolRxTesterSourceAddr [0..1]: 0..65535, scope=ECU, multiplicity set at pre-compile, set at link in variant link-time / pre-compile in variant post-build+pre-compile  # Tester source address uniquely describes a client and will be used e.g within the jump to Bootloader interfaces. This parameter is not required for generic connections (DcmPdus with MetaDataLength >= 1).
                reference DcmDslPeriodicTransmissionConRef [0..1]: scope=ECU, multiplicity set at pre-compile, set at link in variant link-time / pre-compile in variant post-build+pre-compile, destination=DcmDslPeriodicTransmission  # Configures the link to the connection of PeriodicTransmission protocol for the processing of the PeriodicTransmission events.
                symbolic name reference DcmDslProtocolComMChannelRef: scope=ECU, set at link in variant link-time / pre-compile in variant post-build+pre-compile, destination=ComMChannel  # Reference to the ComMChannel on which the DcmDslProtocolRxPdu is received and the DcmDslProtocolTxPdu is transmitted.
                reference DcmDslROEConnectionRef [0..1]: scope=ECU, multiplicity set at pre-compile, origin=AUTOSAR_ECUC V1.0.0, set at link in variant link-time / pre-compile in variant post-build+pre-compile, destination=DcmDslResponseOnEvent  # Configures the link to the connection of ROE protocol for processing of the ROE events.
                container DcmDslProtocolRx [1..*]  # This container contains the configuration (parameters) for the protocol configuration of RX channel (for each protocol).The following parameters needs to be configured per protocol. Please keep in mind, that the parameter DcmDslProtocolRxPduId can be given several times per protocol and that the combination from DcmDslProtocolRxPduId and DcmDslProtocolRxAddrType is unique. | The following parameters needs to be configured per protocol. Please keep in mind, that the parameter DcmDslProtocolRxPduId can be given several times per protocol and that the combination from DcmDslProtocolRxPduId and DcmDslProtocolRxAddrType is unique. Only one physical protocol is allowed per connection. upperMultiplicity: More than one receive PDU ID may be configured for reception (e.g. one for func requests, one for phys requests). lowerMultiplicity: At least one receive PDU ID configuration must be provided per protocol.
                  enumeration DcmDslProtocolRxAddrType: {DCM_FUNCTIONAL_TYPE, DCM_PHYSICAL_TYPE}, scope=ECU, set at link in variant link-time / pre-compile in variant post-build+pre-compile  # Declares the communication type of this DCM_PROTOCOL_DCMRXPDUID. PHYSICAL is used for 1 to 1 communication and FUNCTIONAL is used for 1 to n communication. | PHYSICAL is used for 1 to 1 communication FUNCTIONAL is used for 1 to n communication
                  integer DcmDslProtocolRxPduId: 0..65535, scope=ECU, set at pre-compile, symbolic-name-value=true, with-auto=true  # DcmRxPduId value for reception of requests. The user need not update this field. Instead the user may invoke generateId for Dcm inorder to automatically configure the same.
                  reference DcmDslProtocolRxPduRef: scope=ECU, set at link in variant link-time / pre-compile in variant post-build+pre-compile, destination=Pdu  # DcmRxPduId reference for reception of requests / Multiple links shall be allowed. (e.g. one DcmRxPduId to receive func requests, one DcmRxPduId to receive phys requests)
                container DcmDslProtocolTx  # This container contains the configuration (parameters) for the protocol configuration of TX channel (for each protocol) | The included parameters needs to be configured per protocol.
                  integer DcmDslTxConfirmationPduId: 0..65535, scope=ECU, set at pre-compile, symbolic-name-value=true, with-auto=true  # Handle Id to be used by the Lower Layer to confirm the transmission of the DcmDsProtocolTxPdu to the LowerLayer.The user need not update this field. Instead, the user may invoke generateId for Dcm inorder to automatically configure the same.
                  reference DcmDslProtocolTxPduRef: scope=ECU, set at link in variant link-time / pre-compile in variant post-build+pre-compile, destination=Pdu  # DcmTxPduId reference for transmission of responses
              container DcmDslPeriodicTransmission [0..1]  # This container contains the configuration (parameters) for Periodic Transmission service. Hint:Periodic Transmission request comes via DcmDslMainConnection and PeriodicTransmission Event response is given via DcmDslPeriodicTransmission. | Hint: Periodic Transmission request comes via DcmDslMainConnection and PeriodicTransmission Event response is given via DcmDslPeriodicTransmission.
                container DcmDslPeriodicConnection [0..*]  # Holding the TxPduId configuration for PeriodicTransmission.
                  integer DcmDslPeriodicTxConfirmationPduId: 0..65535, scope=ECU, set at pre-compile, symbolic-name-value=true, with-auto=true  # Handle Id to be used by the Lower Layer to confirm the transmission of the DcmDslPeriodicTxPdu to the LowerLayer.The user need not update this field. Instead, the user may invoke generateId for Dcm inorder to automatically configure the same.
                  reference DcmDslPeriodicTxPduRef: scope=ECU, set at link in variant link-time / pre-compile in variant post-build+pre-compile, destination=Pdu  # This is the reference to the PDU ID to be used by this DCM when sending Periodic Transmissions. It is only needed for Type2 Periodic Transmissions configurations.One or several DcmDslPeriodicTxPduRef can be defined if Periodic Transmission is enabled and TYPE2 Periodic Transmissions is configured.DcmDslPeriodicTxPduRef does not need to be defined if Periodic Transmission is not enabled or TYPE1 Periodic Transmissions is configured. | upperMultiplicity: one or several DcmDslPeriodicTxPduRef can be defined if Periodic Transmission is enabled and TYPE2 Periodic Transmissions is configured. lowerMultiplicity: DcmDslPeriodicTxPduRef does not need to be defined if Periodic Transmission is not enabled or TYPE1 Periodic Transmissions is configured..
              container DcmDslResponseOnEvent [0..1]  # This container contains the configuration (parameters) for ResponseOnEvent service.Hint- ROE service request is received via DcmDslMainConnection and Event response is given via DcmDslResposeOnEvent. | Hint: ROE service request is recept via DcmDslMainConnection and that Event response is given via DcmDslResposeOnEvent
                integer DcmDslRoeTxConfirmationPduId [0..1]: 0..65535, scope=ECU, multiplicity set at pre-compile, set at pre-compile, symbolic-name-value=true, with-auto=true  # Handle Id to be used by the Lower Layer to confirm the transmission of the DcmDslRoeTxPdu to the LowerLayer.
                reference DcmDslRoeTxPduRef [0..1]: scope=ECU, multiplicity set at pre-compile, set at link in variant link-time / pre-compile in variant post-build+pre-compile, destination=Pdu  # Reference to the PDU for transmission of ROE response (only needed for ROE Transmission Type is TYPE2). One PDU required if ROE Transmission Type is TYPE2. No PDU required if ROE Transmission Type is TYPE1. | upperMultiplicity: One PDU required if ROE Transmission Type is TYPE2. lowerMultiplicity: No PDU required if ROE Transmission Type is TYPE1.
            container DcmRbDslKWPTimings [0..1]  # Timings set required for KWP protocol
              float DcmRbP2MaxDefaultTime: 0..4293, origin=RB:AR42.1.0.0:2017-01-31, set at link in variant link-time+post-build / pre-compile in variant pre-compile  # Default time of P2 max (This time activated during the start of communication) in seconds
              float DcmRbP2MaxLimitTime: 0..4293, origin=RB:AR42.1.0.0:2017-01-31, set at link in variant link-time+post-build / pre-compile in variant pre-compile  # Limit time of P2 max (Aceess timing parameter service while changing the ECU timngs cross check the limit by refering this configured value) in seconds
              float DcmRbP3MaxDefaultTime: 0..4293, origin=RB:AR42.1.0.0:2017-01-31, set at link in variant link-time+post-build / pre-compile in variant pre-compile  # Default time of P3 max (This time activated during the start of communication) in seconds
              float DcmRbP3MaxLimitTime: 0..4293, origin=RB:AR42.1.0.0:2017-01-31, set at link in variant link-time+post-build / pre-compile in variant pre-compile  # Limit time of P3 max (Aceess timing parameter service while changing the ECU timngs cross check the limit by refering this configured value) in seconds
        container DcmRbDslKWPSplitResponseFeature [0..1]  # The container to enable/disable the feature of splitting the responses for KWP services. If configured, the split of responses from any service shall be supported for KWP2000 services. If not configured, the split of responses by the services shall be disabled. Based on the configuration of the above container, the compiler switch DCM_CFG_SPLITRESPSUPPORTEDFORKWP shall be generated. This container shall be effective only if there is a KWP protocol configured.
          float DcmRbDslKWPTimeBetweenSplitResponses: 0..4293.0, origin=RB:AR42.1.0.0:2017-01-31, set at link in variant link-time / pre-compile in variant post-build+pre-compile  # The parameter to define the timing between any 2 split responses in seconds. The timing has to be in multiples of DcmTaskTime. This parameter is mandatory if the container DcmRbDslKWPSplitResponseFeature is configured. The value in the parameter shall be generated as DCM_CFG_SPLITRESPONSETIMEFORKWP.

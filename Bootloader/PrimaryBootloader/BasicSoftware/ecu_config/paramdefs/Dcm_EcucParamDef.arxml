[part 3 of 3: package /AUTOSAR_Dcm/EcucModuleDefs]
AUTOSAR XML (schema 4-2-2)
package /AUTOSAR_Dcm/EcucModuleDefs  (continued)
  module definition Dcm [0..1]: category=VENDOR_SPECIFIC_MODULE_DEFINITION, refined-module-def=Dcm, variants pre-compile  (continued)
    container DcmConfigSet  (continued)
      container DcmPageBufferCfg  # This container contains the configuration (parameters) for Page Buffer handling
        boolean DcmPagedBufferEnabled: scope=ECU, set at pre-compile  # Allow to enable or disable the Page buffer mechanism.If configured as true, paged buffer handling is enabled. If configured as false, paged buffer handling is disabled | true = Page buffer handling enabled false = Page Buffer handling disabled
        float DcmPagedBufferTimeout [0..1]: 0..1, scope=ECU, multiplicity set at link in variant link-time / pre-compile in variant post-build+pre-compile, set at link in variant link-time / pre-compile in variant post-build+pre-compile  # Allow to configure the Timeout in seconds towards the application for filling the next page.This parameter is only relevant if the Page Buffer handling is enabled. (DcmPagedBufferEnabled = TRUE). Defined in the DCM SWS as uint16, this parameter contains a value in milliseconds.The AUTOSAR configuration standard is to use SI units, so this parameter is defined as float value in seconds. DCM configuration tools must convert this float value to the appropriate value format for the use in the software implementation of DCM. A negative value is not allowed. | This parameter is only relevant if the Page Buffer handling is enabled. (DcmPagedBufferEnabled = TRUE) The AUTOSAR configuration standard is to use SI units, so this parameter is defined as float value in seconds. DCM configuration tools must convert this float value to the appropriate value format for the use in the software implementation of DCM. min: A negative value is not allowed. upperMultiplicity: Exactly one Timeout must be specified per configuration. lowerMultiplicity: Exactly one Timeout must be specified per configuration.
      container DcmProcessingConditions [0..1]  # This container contains the configuration ( DSP parameter) for mode arbitration functionality of the Dcm
        container DcmModeCondition [1..*]  # This container contains the configuration of a mode condition or an environmental conditions which can be used as argument in DcmModeRules. | One DcmModeCondition shall contain either one DcmSwcModeRef or one DcmBswModeRef or one DcmSwcSRDataElementRef. Please note that the Dcm acts as well as mode manager. Therefore the references DcmSwcModeRef or one DcmBswModeRef. might point to provided ModeDeclarationGroupPrototypes of the Dcm itself as well as to provided ModeDeclarationGroupPrototypes of other Bsw Modules or software components. In case of a configured DcmSwcModeRef or DcmBswModeRef only the DcmConditionType DCM_EQUALS or DCM_EQUALS_NOT are applicable. In case of DcmSwcSRDataElementRef all literals of DcmConditionType are possible.
          enumeration DcmConditionType: {DCM_EQUALS, DCM_EQUALS_NOT, DCM_GREATER_OR_EQUAL, DCM_GREATER_THAN, DCM_LESS_OR_EQUAL, DCM_LESS_THAN}, set at pre-compile  # This parameter specifies what kind of comparison that is made for the evaluation of the mode condition.
          integer DcmRbSwcSRDataElementValue [0..1]: multiplicity set at link in variant link-time / pre-compile in variant post-build+pre-compile, origin=RB:AR42.2.0.0:2017-07-31, set at link in variant link-time / pre-compile in variant post-build+pre-compile  # This Parameter is used as constant value of type numerical.This value is used for comparison agsinst DcmSRDataElementRef.Enter the value in decimal eg:5,11.
          instance reference DcmBswModeRef [0..1]: multiplicity set at pre-compile, set at pre-compile, destination-context=MODE-DECLARATION-GROUP-PROTOTYPE, destination-type=MODE-DECLARATION  # This parameter references a mode of a ModeDeclarationGroupPrototype provided by a Basic Software Module used for the condition. | Please note that such ModeDeclarationGroupPrototype are owned by a Basic Software Module Description in the role providedModeGroup.
          instance reference DcmSwcModeRef [0..1]: multiplicity set at pre-compile, set at pre-compile, destination-context=ROOT-SW-COMPOSITION-PROTOTYPE SW-COMPONENT-PROTOTYPE P-PORT-PROTOTYPE MODE-DECLARATION-GROUP-PROTOTYPE, destination-type=MODE-DECLARATION  # This parameter references a mode in a particular mode request port of a software component that is used for the condition.
          reference DcmSwcSRDataElementRef [0..1]: multiplicity set at pre-compile, set at pre-compile, destination=DcmDspExternalSRDataElementClass  # Reference to environmental conditions
        container DcmModeRule [1..*]  # This container contains the configuration of a mode rule which represents a logical expression with DcmModeCondistions or other DcmModeRules as arguments. | All arguments are processed with the operator defined by DcmLogicalOperator, for instance: Argument_A AND Argument_B AND Argument_C
          enumeration DcmLogicalOperator [0..1]: {DCM_AND, DCM_OR}, multiplicity set at pre-compile, set at pre-compile  # This parameter specifies the logical operator to be used in the logical expression. If the expression only consists of a single condition this parameter shall not be used.
          integer DcmModeRuleNrcValue [0..1]: 1..255, scope=ECU, multiplicity set at link in variant link-time / pre-compile in variant pre-compile, set at link in variant link-time / pre-compile in variant pre-compile  # Optional parameter which defines the NRC to be sent in case the mode rule condition is not valid.
          choice reference DcmArgumentRef [1..*]: multiplicity set at pre-compile, requires-index=true, set at pre-compile, destination=[DcmModeCondition, DcmModeRule]  # This is a choice reference either to a mode condition or a an other mode rule serving as sub-expression.
    container DcmGeneral  # This container contains the configuration (parameters) for Component wide parameters
      boolean DcmDDDIDStorage [0..1]: multiplicity set at pre-compile, set at pre-compile, default-value=false  # This configuration switch defines, whether DDDID definition is stored non-volatile or not. | true: DDDID are stored non-volatile false: DDDID are only maintained volatile
      boolean DcmDevErrorDetect: set at pre-compile  # Preprocessor switch to enable or disable the Development Error Detection (DET) mechanism.
      string DcmHeaderFileInclusion [0..0]: scope=ECU, multiplicity set at pre-compile, set at pre-compile, with-auto=true, regular-expression=[a-zA-Z0-9_]([a-zA-Z0-9\._])*  # Name of the header file(s) to be included by the Dcm module containing the used C-callback declarations.
      boolean DcmRespondAllRequest: scope=ECU, set at pre-compile  # If set to FALSE the DCM will not respond to diagnostic request that contains a service ID which is in the range from 0x40 to 0x7F or in the range from 0xC0 to 0xFF (Response IDs).
      float DcmTaskTime: 1E-4..0.1, set at link in variant link-time / pre-compile in variant post-build+pre-compile  # Allow to configure the time for the periodic cyclic task. Please note: This configuration value shall be equal to the value in the ScheduleManager module. | The AUTOSAR configuration standard is to use SI units, so this parameter is defined as float value in seconds. DCM configuration tools must convert this float value to the appropriate value format for the use in the software implementation of DCM. min: A negative value and zero is not allowed. upperMultiplicity: Exactly one TaskTime must be specified per configuration. lowerMultiplicity: Exactly one TaskTime must be specified per configuration.
      boolean DcmVersionInfoApi: set at pre-compile  # Preprocessor switch to enable or disable the output Version info of the functionality.
      reference DcmVinRef [0..1]: multiplicity set at pre-compile, set at pre-compile, destination=DcmDspDid  # Reference to the Did containing the VIN Information. | This parameter is needed for function Dcm_GetVin
      container DcmRbGeneral  # This container contains the configuration (parameters) for Component wide parameters
        boolean DcmRbApplCallRequiredOnReqReception [0..1]: multiplicity set at pre-compile, origin=RB:AR42.1.0.0:2017-01-31, set at pre-compile, default-value=false  # Parameter to enable/disable the invocation of the application function from Dcm StartofReception/CopyRxData/RxIndication when a request is received at the Dcm. Autosar stack already ensures with Autosar 4.0 that every N-PDU is copied immediately to Application buffer (DSL/DSD). This parameter enables the feature which will provide an option for the Customer Teams to start working the receiving data (DSP) even before the reception is completed. This is achieved through the call-outs DcmAppl_StartOfReception, DcmAppl_CopyRxData and DcmAppl_TpRxIndication from Dcm which can provide the buffer pointer, total length, currently received length etc.. If set to TRUE, then DcmAppl_StartOfReception, DcmAppl_CopyRxData and DcmAppl_TpRxIndication will be called from Dcm. If set to FALSE or left unconfigured, then the mentioned functions will not be called from Dcm
        boolean DcmRbApplTxConfirmationRequiredAlways [0..1]: multiplicity set at pre-compile, origin=RB:AR42.1.0.0:2017-01-31, set at pre-compile, default-value=true  # Parameter to enable the Tx confirmation call for application. If the parameter is set to TRUE, then confirmation to the application after transmission of response will be provided even if service is located inside DSP. Also confirmation to the application will be sent in case of suppression of responses in case ApplTxConfirmationRequiredAlways is TRUE. If ApplTxConfirmationRequiredAlways is TRUE, Dcm Appl API DcmAppl_DcmConfirmation will be called from Dcm.
        boolean DcmRbConfirmForDSDGeneratedNegRes: origin=RB:AR42.1.0.0:2017-01-31, set at pre-compile  # To select confirmation for DSD generated negative responses.If set to true, DcmAppl API DcmAppl_DcmConfirmation_DcmNegResp will be called for DSD generated negative responses
        boolean DcmRbDemSREnabled [0..1]: multiplicity set at pre-compile, origin=RB:AR42.1.0.0:2017-04-31, set at pre-compile, default-value=false  # Enable / Disable Generation of Sender-Receiver Interfaces for Dem
        boolean DcmRbDiagAdaptSupport [0..1]: multiplicity set at pre-compile, origin=RB:AR42.1.0.0:2017-01-31, set at pre-compile, default-value=false  # Preprocessor switch to enable or disable rba_DiagAdapt Support in DCM.This is used to support vendor specific MEDC17 services along with DCM.
        boolean DcmRbDspSecurityStoreDelayCountAndTimerOnJump [0..1]: multiplicity set at pre-compile, origin=RB:AR42.1.0.0:2017-01-31, set at pre-compile, default-value=false  # Parameter to allow the user to decide on whether DelayCount and DelayTimer values needs to be stored during Boot Loader interactions. If set to TRUE, DelayCount and DelayTimer values shall be stored during Boot Loader interactions. If set to FALSE, DelayCount and DelayTimer values shall not be stored during Boot Loader interactions. If the parameter is left unconfigured, DelayCount and DelayTimer values shall not be stored during Boot Loader interactions.
        float DcmRbEcuResetTime [0..1]: 0..100, multiplicity set at link in variant link-time / pre-compile in variant post-build+pre-compile, origin=RB:AR42.1.0.0:2017-01-31, set at link in variant link-time / pre-compile in variant post-build+pre-compile  # The parameter provides the time taken for reset of the ECU and it is relevant only in case of bootloader jump. If the parameter is configured and during jump from boot using Dsp supported EcuReset service(0x11) or DiagnosticSessionControl service(0x10), if the time configured is greater than the remaining P2/P2* time ,Dcm shall again trigger a wait pend response and shall wait for a positive confirmation before triggering function to perform the reset. The parameter if configured should be in multiples of DcmTaskTime and shoule be less than the P2*Max configured for the protocol used for jump to bootloader. | The AUTOSAR configuration standard is to use SI units, so this parameter is defined as float value in seconds. DCM configuration tools must convert this float value to the appropriate value format for the use in the software implementation of DCM. A negative value is not allowed
        string DcmRbOSCounterId [0..1]: multiplicity set at link in variant link-time / pre-compile in variant post-build+pre-compile, origin=RB:AR42.1.0.0:2017-01-31, set at link in variant link-time / pre-compile in variant post-build+pre-compile  # The counterID is used by OStimer.The user shall configure the parameter as a string, which would be the name of the counter in the AUTOSAR OS
        string DcmRbOSCounterMacro [0..1]: multiplicity set at link in variant link-time / pre-compile in variant post-build+pre-compile, origin=RB:AR42.1.0.0:2017-01-31, set at link in variant link-time / pre-compile in variant post-build+pre-compile  # Macro used to calculate the current system time (Ticks)
        enumeration DcmRbOSTimerUse: origin=RB:AR42.1.0.0:2017-01-31, set at pre-compile  # Choose between Project Specific , AUTOSAR Specific and Cyclic Count Project Specific : CPU timer will be used for timer monitoring. Corresponding Project Specific OScounterMacro and OScounterID has to be configured with this option Project can make necessary changes in file os_bsw.h file which will be included when project specific is chosen AUTOSAR Specific : CPU timer will be used for timer monitoring. Corresponding AUTOSAR Specific OScounterMacro and OScounterID has to be configured with this option Autosar specific needs to be selected if the project wants to use mcu counter. Project can make necessary changes in file Dcm_Cfg_Timer.h file which will be included when autosar specific is chosen Cyclic Count: The Dcm scheduled cycle time will be used as reference for calculating the time. Cyclic Count E.g : If Dcm_mainfunction is scheduled in 5ms rastor & is called twice; The total time elapsed is calculated as Dcm task time X 2 Cyclic Count : With this option , there is no need to configure OScounterID & OScounterMAcro
          ProjectSpecific  # CPU timer will be used for timer monitoring. Corresponding MEDC17 OScounterMacro and OScounterID has to be configured with this option
          AutosarSpecific  # CPU timer will be used for timer monitoring. Corresponding AUTOSAR Specific OScounterMacro and OScounterID has to be configured with this option
          CyclicCount  # Cyclic Count: The Dcm scheduled cycle time will be used as reference for calculating the time. E.g : If Dcm_mainfunction is scheduled in 5ms rastor & is called twice; The total time elapsed is calculated as Dcm task time X 2With this option , there is no need to configure OScounterID & OScounterMAcro
        boolean DcmRbParallelProcessingAllowed [0..1]: origin=RB:AR42.5.0.0:2019-04-31, set at pre-compile, default-value=false  # If Configured - TRUE , then separate resources are allocated for OBD and non-OBD execution and the requests from these two protocols are handled separately without Pre-Emption. If Configure - FALSE . Then only one Protocol is active at a time and Protocols are Pre-Empted based on Protocol Priority
        boolean DcmRbQueuingOfRequestEnabled [0..1]: multiplicity set at pre-compile, origin=RB:AR42.1.0.0:2017-01-31, set at pre-compile  # Parameter to enable/disable the queuing of request reception, which is received in parallel to a running request processing. If set to TRUE, Queuing of request shall be enabled in Dcm. The queuing shall be done with a depth of 1 queued buffer returning FC_CTS to the tester. If the third request arrives, FC_WAIT has to be sent until one of the buffers is released. If set to FALSE or left unconfigured,then Queuing of request shall be disabled in Dcm.
        boolean DcmRbRTEsupport: origin=RB:AR42.1.0.0:2017-01-31, set at pre-compile  # Enables RTE Support for Communication control,Diagnostic Session Control and the EcuReset services. If this parameter is set to true RTE ports are generated for the mentioned services and if it is set to FALSE, no RTE ports are generated fro the mentioned servies
        boolean DcmRbRespondToRequestAfterEcuReset [0..1]: multiplicity set at pre-compile, origin=RB:AR42.1.0.0:2017-01-31, set at pre-compile, default-value=true  # The parameter is used to enable/disable the processing of new tester requests after the successful processing of Dsp EcuReset Service(0x11) request and before the actual reset happens. TRUE - DCM shall respond to further requests after sending the positive response of EcuReset (call of Dcm_TpTxConfirmation ) during reset- processing FALSE - DCM shall ignore all further requests during reset-processing. If the parameter is left unconfigured ,the default value (TRUE )will be taken.
        boolean DcmRbRestoringEnabled [0..1]: multiplicity set at pre-compile, origin=RB:AR42.1.0.0:2017-01-31, set at pre-compile, default-value=false  # Enable / Disable restoring of Diagnostic information (Jump from BootLoader)
        integer DcmRbSignalDefaultValue [0..1]: 0..255, multiplicity set at pre-compile, origin=RB:AR42.1.0.0:2017-01-31, set at pre-compile, default-value=0  # Default value to be configured for Signal Data with gaps.The value configured shall be used to fill the gaps if existing between signal data of a DID.The default value of this parameter is 0.
        boolean DcmRbSingleBufferConceptDisabled [0..1]: multiplicity set at pre-compile, origin=RB:AR42.1.0.0:2017-01-31, set at pre-compile, default-value=false  # Parameter to enable/disable the concept of single buffer sharing for reception and transmission. If set to TRUE, single buffer concept shall be disabled and a separate reception and transmission buffer will be assigned to the protocol. If set to FALSE,single buffer concept shall be enabled and a single buffer will be shared for reception and transmission of protocols. If the parameter is left unconfigured, the single buffer concept shall be used.
        boolean DcmRbStoringEnabled [0..1]: multiplicity set at link in variant link-time+post-build / pre-compile in variant pre-compile, origin=RB:AR42.1.0.0:2017-01-31, set at link in variant link-time+post-build / pre-compile in variant pre-compile, default-value=false  # Enable / Disable storing of Diagnostic information (Jump to BootLoader)
        string DcmRbSuppressNRC [0..1]: multiplicity set at link in variant link-time / pre-compile in variant post-build+pre-compile, origin=RB:AR42.1.0.0:2017-01-31, set at link in variant link-time / pre-compile in variant post-build+pre-compile, default-value=11,12,31,7E,7F  # This Parameter is used to configure NRC values which shall be suppressed if functional request received. The NRC values should be entered in Hexadecimal number seperated by comma.e.g 11,12,7E,7E. If configured as 00 then NRC values will not be suppressed. If this Parameter is not configured then default values of NRC will be suppressed.
        string DcmRbSwCompositionPath [0..1]: multiplicity set at link in variant link-time / pre-compile in variant post-build+pre-compile, origin=RB:AR42.7.0.0:2019-10-01, set at link in variant link-time / pre-compile in variant post-build+pre-compile, default-value=RB/PT/PCT_EcuFlatView/SwComponentTypes/EcuFlatView  # This Parameter is used to provide path to SwComposition in Flatview File.This is mandatory when dcmDspExternalSRDataElementClass is configured. e.g RB/PT/PCT_XXX/SwComponentTypes/XXX. Also the last name in the string(in given example "XXX") will be considered to generate the name of the flatview file e.g Dcm_Cfg_SWCD_XXX_Connectors.arxml
        boolean DcmRbSwDcmComponentNameGeneration [0..1]: multiplicity set at link in variant link-time+post-build / pre-compile in variant pre-compile, origin=RB:AR42.7.0.0:2019-10-01, set at link in variant link-time+post-build / pre-compile in variant pre-compile  # Enable / Disable generation of Dcm Component name in Flatview File(or Assembly connection file).This is mandatory when dcmDspExternalSRDataElementClass is configured.
        integer DcmRbVINMaxNumRespPend [0..1]: 0..255, scope=ECU, origin=RB:AR42.8.0.0:2020-06-16, set at link in variant link-time / pre-compile in variant post-build+pre-compile  # This parameter is introduced to fetch the Vehicle Identification Number(VIN) from VIN DID, When this parameter is configured, DCM will try to fetch the VIN data until VIN wait pend count reaches the configured range. If this parameter is not configured, then DcmDslDiagRespMaxNumRespPend parameter value will be considered as default value. | DCM will wait to fetch VIN DID data till the configured time elapses.
        string DcmRbSwDcmComponentName [0..1]: multiplicity set at link in variant link-time / pre-compile in variant post-build+pre-compile, origin=RB:AR42.7.0.0:2019-10-01, set at link in variant link-time / pre-compile in variant post-build+pre-compile, default-value=CPT_Dcm  # This Parameter is used to provide name of Dcm software component in flatview file(or Assembly connection file).TThis is mandatory when dcmDspExternalSRDataElementClass is configured.
        boolean DcmRbSwApplComponentNameGeneration [0..1]: multiplicity set at link in variant link-time+post-build / pre-compile in variant pre-compile, origin=RB:AR42.7.0.0:2019-10-01, set at link in variant link-time+post-build / pre-compile in variant pre-compile  # Enable / Disable generation of application Sw Component names in Flatview File(or Assembly connection file).This is mandatory when dcmDspExternalSRDataElementClass is configured.
        boolean DcmRbRTEsupportsPRportFunctionality: multiplicity set at link in variant link-time+post-build / pre-compile in variant pre-compile, origin=RB:AR42.7.0.0:2019-12-05, set at link in variant link-time+post-build / pre-compile in variant pre-compile, default-value=false  # Enables generation of PR port (incase conditions of generation of said Port are met) provided the RTE component used supports full PR port functionality.

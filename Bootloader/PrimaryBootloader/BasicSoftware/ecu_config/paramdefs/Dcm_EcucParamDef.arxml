[part 2 of 3: package /AUTOSAR_Dcm/EcucModuleDefs]
AUTOSAR XML (schema 4-2-2)
package /AUTOSAR_Dcm/EcucModuleDefs  (continued)
  module definition Dcm [0..1]: category=VENDOR_SPECIFIC_MODULE_DEFINITION, refined-module-def=Dcm, variants pre-compile  (continued)
    container DcmConfigSet  (continued)
      container DcmDsp [0..1]  # These parameters apply to Diagnostic Service Processing. There will always be one set of these parameters per DCM.
        boolean DcmDspDDDIDcheckPerSourceDID [0..1]: multiplicity set at link in variant link-time / pre-compile in variant post-build+pre-compile, set at link in variant link-time / pre-compile in variant post-build+pre-compile  # Defines the check the session, security and mode dependencies per source DIDs with a ReadDataByIdentifier (0x22) | TRUE: DCM module shall check the session, security and mode dependencies per source DIDs with a ReadDataByIdentifier (0x22) with DID in the range 0xF200 to 0xF3FF FALSE:DCM module shall not check the session, security and mode dependencies per source DIDs with a ReadDataByIdentifier (0x22) with DID in the range 0xF200 to 0xF3FF
        enumeration DcmDspDataDefaultEndianness: {BIG_ENDIAN, LITTLE_ENDIAN, OPAQUE}, set at link in variant link-time / pre-compile in variant post-build+pre-compile  # Defines the default endianness belonging to a DID, RID or PID if the corresponding data does not define an endianness.
        boolean DcmDspEnableObdMirror [0..0]: scope=ECU, set at link in variant link-time / pre-compile in variant post-build+pre-compile  # DcmDspEnableObdMirror defines whether a DID inside the OBD range (F400-F4FF) and the OBD InfoType range (F800-F8FF) shall get the DID value as defined for OBD on reception of the UDS Service ReadDataByIdentifier (0x22), or not.
        integer DcmDspMaxDidToRead [0..1]: 1..65535, scope=ECU, multiplicity set at link in variant link-time / pre-compile in variant post-build+pre-compile, set at link in variant link-time / pre-compile in variant post-build+pre-compile  # Indicates the maximum allowed DIDs in a single "ReadDataByIdentifier" request. If set to 0, then no limitation is applied,i.e,any number of DIDs in the request is supported. | If set to 0, then no limitation is applied.
        integer DcmDspMaxPeriodicDidToRead [0..1]: 1..65535, multiplicity set at link in variant link-time / pre-compile in variant post-build+pre-compile, set at link in variant link-time / pre-compile in variant post-build+pre-compile  # Indicates the maximum allowed periodicDIDs which can be read in a single "ReadDataByPeriodicIdentifier" request.
        integer DcmDspPowerDownTime [0..1]: 0..255, scope=ECU, multiplicity set at link in variant link-time / pre-compile in variant post-build+pre-compile, set at link in variant link-time / pre-compile in variant post-build+pre-compile  # This parameter indicates to the client the minimum time of the stand-by sequence the server will remain in the power-down sequence. The resolution of this parameter is one second per count.Values 0x00-0xFE are valid representing 0-254s.The resolution of this parameter is one second per count. The following values are valid: 00 - FE hex: 0 - 254 s powerDownTime; FF hex: indicates a failure or time not available. This value needs to be defined by the integrator according to the ECU capabilities. This parameter has to be available if the service EcuReset, sub-service enableRapidPowerShutDown is configured. | The resolution of this parameter is one second per count. The following values are valid: 00 - FE hex: 0 - 254 s powerDownTime; FF hex: indicates a failure or time not available. This value needs to be defined by the integrator according to the ECU capabilities. This parameter has to be available if the service EcuReset, sub-service enableRapidPowerShutDown is configured.
        boolean DcmRbDspLimitRDBIRespToBufSize [0..1]: multiplicity set at pre-compile, origin=RB:AR42.1.0.0:2017-01-31, set at pre-compile, default-value=false  # Preprocessor switch to enable or disable cut short positive response of RDBI in case if total response length of DID is greater than the available size of DCM response buffer. If set to false, the cutting positive response for RDBI service is disabled i.e., when ever the total response length of DIDs in a request is greater than the available DCM buffer size, the software will simply respond with NRC RESPONSE_TOO_LONG (NRC0x14) IF set to TRUE, the cutting positive response feature for RDBI service is enabled i.e., when the total response length of DIDs in a request is greater than the available DCM buffer size, the software will positively respond to the tester with DIDs which can be accommodated within the available DCM buffer. If the parameter is let unconfigured ,then the FALSE will be considered as the the default value and the if the response length is greater than the DCM buffer size NRC 0x14 will be triggered.
        boolean DcmRbDspRdbiPagedBufferEnabled [0..1]: multiplicity set at pre-compile, origin=RB:AR42.1.0.0:2017-01-31, set at pre-compile, default-value=false  # Vendor specific parameter to enable or disable the support of Paged Buffer for RDBI service. Inorder to support PagedBuffer for RDBI service in addition to this parameter, "DcmPagedBufferEnabled" should also be enabled. When this parameter is set to TRUE RDBI paged buffer support is enabled and the signal size of the DID can be greater than the page size (provided that the use port is configured as USE_RDBI_PAGED_FNC) or the DID should be fit within the page size,based on the configuration of use port of the signal(provided that the use port is configured to any value other than USE_RDBI_PAGED_FNC). When this parameter is set to false or not configured,RDBI paged buffer support is disabled
        boolean DcmRbDspRmbaPagedBufferEnabled [0..1]: multiplicity set at pre-compile, set at pre-compile, default-value=false  # Vendor specific parameter to enable or disable the support of Paged Buffer for RMBA service. Inorder to support PagedBuffer for RMBA service in addition to this parameter, "DcmPagedBufferEnabled" should also be enabled. When this parameter is set to TRUE RMBA paged buffer support is enabled and the Page size of the request can be greater than the DCM protocol buffer size When this parameter is set to false or not configured,RMBA paged buffer support is disabled
        integer DcmRbDspRmbaPageSize [0..1]: 8..4294967294, scope=ECU, set at pre-compile  # This Parameter is used as size of the response to be sent in a page when RMBA page buffer is enabled which is of unit32 type
        boolean DcmRbDspRdtcPagedBufferEnabled [0..1]: multiplicity set at pre-compile, origin=RB:AR42.1.0.0:2017-01-31, set at pre-compile, default-value=false  # Vendor specific parameter to enable or disable the support of Paged Buffer for RDTC service. Inorder to support PagedBuffer for RDTC service in addition to this parameter, "DcmPagedBufferEnabled" should also be enabled. When this parameter is set to TRUE, RDTC paged buffer support is enabled and the total record size of the DTCs can be greater than the page size. When this parameter is set to FALSE or not configured, RDTC paged buffer support is disabled
        boolean DcmRbDspSequenceCheckRequestDownloadDisabled [0..1]: multiplicity set at pre-compile, origin=RB:AR42.1.0.0:2017-01-31, set at pre-compile, default-value=false  # Parameter which decides whether sequence check is enabled or disabled for RequestDownload.If the parameter is set to FALSE , a sequence check shall be done according to the ISO 14229-1 NRC sequence if an RequestDownload request is received if Upload/Download is already active (A previous RequestUpload which is not yet completed with a successful RequestTransferExit request. A negative response with NRC set to 0x22 (ConditionsNotCorrect) shall be send in this case. If the parameter is set to TRUE, no sequence check will be done if a RequestDownload request is received when upload/download is already active.If the parameter is left unconfigured ,then FALSE will be considered as the default value and therefore the sequence check will be enabled..
        boolean DcmRbDspSequenceCheckRequestUploadDisabled [0..1]: multiplicity set at pre-compile, origin=RB:AR42.1.0.0:2017-01-31, set at pre-compile, default-value=false  # Parameter whihc decides whether sequence check is enabled or disabled for RequestUpload.If the parameter is set to FALSE , a sequence check shall be done according to the ISO 14229-1 NRC sequence if an RequestUpload request is received if Upload is already active (A previous RequestUpload which is not yet completed with a successful RequestTransferExit request. A negative response with NRC set to 0x22 (ConditionsNotCorrect) shall be send in this case. If the parameter is set to TRUE, no sequence check will be done if a RequestUpload request is received when upload is already active.If the parameter is left unconfigured ,then FALSE will be considered as the default value and therefore the sequence check will be enabled.
        enumeration DcmRbDspSesSecUsedInProtocol [0..1]: multiplicity set at link in variant link-time+post-build / pre-compile in variant pre-compile, origin=RB:AR42.1.0.0:2017-01-31, set at link in variant link-time+post-build / pre-compile in variant pre-compile, default-value=UDS  # The DcmRbDspSesSecUsedInProtocol is a reference container to DcmDslProtocolRow which uses the Dsp Session and Security Configuration.Configure the protocol that will be using the DcmDspSession and DcmDspSecurity Services. If configured as UDS: UDS protocol shall use the DcmDsp session and security configuration. If configured as KWP: KWP protocol shall use the DcmDsp session and security configuration.
          UDS  # The UDS protocol is using the DcmDsp session and security configuration.
          KWP  # The KWP protocol is using the DcmDsp session and security configuration.
        boolean DcmRbDspTransferDataMaxLenChkRequired [0..1]: multiplicity set at pre-compile, origin=RB:AR42.1.0.0:2017-01-31, set at pre-compile, default-value=true  # Parameter which decides whether the length for TransferData requests/ response following a RequestDownload / RequestUpload needs to be checked against the maxNumberOfBlockLength passed in the RequestUpload/RequestDownload response.If the parameter is configured as TRUE or left unconfigured , Dcm will check if the length for TransferData requests/ response following a RequestDownload / RequestUpload is equal to the parameter maxNumberOfBlockLength passed in response of RequestDownload/RequestUpload service.If the parameter is configured as FALSE, Dcm will not check the length against maxNumberOfBlockLength passed in the RequestUpload/RequestDownload response
        boolean DcmRbDspAutoConfigureDEMOBDPIDs [0..1]: multiplicity set at pre-compile, origin=RB:AR42.8.0.0:2020-07-01, set at pre-compile, default-value=false  # If the parameter is configured as TRUE, DCM will forward configuration of DEM relevant OBD Pid's [PID$01,PID$1C,PID$21,PID$30,PID$31,PID$41,PID$4D,PID$4E]. All these pid's are configured only for service$01.Ensure that static configuration doesn't exist for these pid's, otherwise it will result in build error because of multiple configuration.
        enumeration DcmResponseToEcuReset [0..0]: {AFTER_RESET, BEFORE_RESET}, set at pre-compile, with-auto=true  # Defines the answer to EcuReset service should come: Before or after the reset
        container DcmDspClearDTC [0..1]  # This container contains the configuration (parameters) for ClearDTCInformation service.(0x14)
          function name DcmDspClearDTCCheckFnc [0..1]: multiplicity set at pre-compile, set at pre-compile  # Callback function for condition check, manufacturer / supplier specific checks on the groupOfDTC, which is requested to clear.
          reference DcmDspClearDTCModeRuleRef [0..1]: multiplicity set at pre-compile, set at pre-compile, destination=DcmModeRule  # Mode rule which controls to clear the DTCs. If there is no reference, no check of the mode rule shall be done.
        container DcmDspComControl [0..1]  # --
          container DcmDspComControlAllChannel [0..*]  # Collection of ComM channels which shall be controlled if all networks are addressed.
            boolean DcmDspComControlAllChannelUsed [0..0]: set at link in variant link-time / post-build in variant post-build / pre-compile in variant pre-compile, with-auto=true  # Allow to activate or deactivate the usage of a ComM channel collection to be controlled, for multi purpose ECUs | true = ComM channel collection used false = ComM channel collection not used
            symbolic name reference DcmDspAllComMChannelRef: scope=ECU, set at link in variant link-time / post-build in variant post-build / pre-compile in variant pre-compile, destination=ComMChannel  # Reference to ComM channel.
          container DcmDspComControlSetting [0..1]  # Provide the configuration of the Communication control.
            function name DcmRbDspComControlReEnableUserModeRuleFnc [0..1]: multiplicity set at pre-compile, origin=RB:AR42.1.0.0:2017-01-31, set at pre-compile  # Function name used by the application to perform user specific check to verify if communication modes needs to be re-enabled for the channels.In case the checks fails, communication modes shall be re-enabled. In case the function is not configured , the DcmAppl API DcmAppl_UserCommCtrlReEnableModeRuleService shall be called. | Function name used by the application to perform user specific check to verify if communication modes needs to be re-enabled for the channels.In case the checks fails, communication modes shall be re-enabled. In case the function is not configured for sub service, the DcmAppl API DcmAppl_UserCommCtrlReEnableModeRuleService shall be called.
            reference DcmDspComControlCommunicationReEnableModeRuleRef [0..1]: scope=ECU, multiplicity set at link in variant link-time / pre-compile in variant post-build+pre-compile, set at link in variant link-time / pre-compile in variant post-build+pre-compile, destination=DcmModeRule  # Reference to DcmDspModeRule which controls re-enabling of communication by DCM. The DCM module shall call BswM_Dcm_CommunicationMode_CurrentState(DCM_ENABLE_RX_TX_NORM_NM)) in case that the referenced mode rule is not fulfilled anymore. | of communication by DCM. The DCM module shall call BswM_Dcm_CommunicationMode_CurrentState(DCM_ENABLE_RX_TX_NORM_NM)) in case that the referenced mode rule is not fulfilled anymore.
          container DcmDspComControlSpecificChannel [0..*]  # Assigns subnet number to ComM channel which will be controlled.
            boolean DcmDspComControlSpecificChannelUsed [0..0]: set at link in variant link-time / post-build in variant post-build / pre-compile in variant pre-compile, with-auto=true  # Allow to activate or deactivate the usage of a Subnet assigned to the ComM channel which will be controlled, for multi purpose ECUs. | true = Subnet used false = Subnet not used
            integer DcmDspSubnetNumber: 1..14, scope=ECU, set at pre-compile  # Subnet Number which controls the specific ComMChannel.
            symbolic name reference DcmDspSpecificComMChannelRef: scope=ECU, set at link in variant link-time / post-build in variant post-build / pre-compile in variant pre-compile, destination=ComMChannel  # Reference to ComM channel.
          container DcmDspComControlSubNode [0..65535]  # This container gives information about the node identification number and the ComM channel used to address a sub-network.
            integer DcmDspComControlSubNodeId: 1..65535, scope=ECU, set at link in variant link-time / pre-compile in variant post-build+pre-compile  # The node identification number DcmDspComControlSubNodeId is adressed by the CommunicationControl (0x28) request.
            boolean DcmDspComControlSubNodeUsed: set at link in variant link-time / post-build in variant post-build / pre-compile in variant pre-compile, default-value=true  # This parameter determines if a node control function is available or not.
            symbolic name reference DcmDspComControlSubNodeComMChannelRef: scope=ECU, set at link in variant link-time / post-build in variant post-build / pre-compile in variant pre-compile, destination=ComMChannel  # This parameter references a ComM channel where this node is connected to.
        container DcmDspCommonAuthorization [0..*]  # This container contains the configuration (parameters) for the common Authorization being equal for several services / sub-services.
          reference DcmDspCommonAuthorizationModeRuleRef [0..1]: scope=ECU, multiplicity set at link in variant link-time / pre-compile in variant post-build+pre-compile, set at link in variant link-time / pre-compile in variant post-build+pre-compile, destination=DcmModeRule  # Reference to DcmDspModeRule | Mode rule which controls this service/ sub-service. If there is no reference, no check of the mode rule shall be done.
          reference DcmDspCommonAuthorizationSecurityLevelRef [0..*]: scope=ECU, multiplicity set at link in variant link-time / pre-compile in variant post-build+pre-compile, set at link in variant link-time / pre-compile in variant post-build+pre-compile, destination=DcmDspSecurityRow  # Reference to DcmDspSecurityRow | Security levels allowed to control this service/ sub-service. If there is no reference, no check of security level shall be done.
          reference DcmDspCommonAuthorizationSessionRef [0..*]: scope=ECU, multiplicity set at link in variant link-time / pre-compile in variant post-build+pre-compile, set at link in variant link-time / pre-compile in variant post-build+pre-compile, destination=DcmDspSessionRow  # Reference to DcmDspSessionRow | Sessions allowed to control this service/ sub-service. If there is no reference, no check of session level shall be done.
        container DcmDspControlDTCSetting [0..1]  # Provide the configuration of the ControlDTCSetting mechanism.
          function name DcmRbDspControlDTCSettingReEnableUserModeRuleFnc [0..1]: multiplicity set at pre-compile, origin=RB:AR42.1.0.0:2017-01-31, set at pre-compile  # Function name used by the application to perform user specific check to verify if DTC setting needs to be re-enabled.In case the checks fails, DTC setting shall be re-enabled. In case the function is not configured , the DcmAppl API DcmAppl_UserDTCSettingEnableModeRuleService shall be called.
          boolean DcmSupportDTCSettingControlOptionRecord [0..1]: scope=ECU, multiplicity set at pre-compile, set at pre-compile, default-value=false  # This configuration switch defines if the DTCSettingControlOptionRecord is in general supported in the request message or not.
          reference DcmDspControlDTCSettingReEnableModeRuleRef [0..1]: scope=ECU, multiplicity set at link in variant link-time / pre-compile in variant post-build+pre-compile, set at link in variant link-time / pre-compile in variant post-build+pre-compile, destination=DcmModeRule  # Reference to DcmDspModeRule | Mode rule which controls re-enabling of controlDTCsetting by DCM. The DCM module shall execute a ControlDTCSetting.Off (call Dem_DcmEnableDTCSetting()) in case that the referenced mode rule is not fulfilled anymore.
        container DcmDspData [0..*]  # This container contains the configuration (parameters) of a Data belonging to a DID
          function name DcmDspDataConditionCheckReadFnc [0..1]: scope=ECU, multiplicity set at pre-compile, set at pre-compile  # Function name to demand application if the conditions (e.g. System state) to read the DID are correct. (ConditionCheckRead-function). | Multiplicity shall be equal to parameter DcmDspDataReadFnc. Only relevant if * DcmDspDataUsePort=="USE_DATA_SYNCH_FNC or * DcmDspDataUsePort==USE_DATA_ASYNCH_FNC" or * DcmDspDataUsePort==USE_DATA_ASYNCH_FNC_ERROR". This parameter is related to the interface Xxx_ConditionCheckRead.
          boolean DcmDspDataConditionCheckReadFncUsed [0..1]: multiplicity set at pre-compile, set at pre-compile  # This parameter determines if a condition check function is | available or not. If the parameter is set to 'TRUE' and DcmDspDataUsePort is set to * 'USE_DATA_ASYNCH_CLIENT_SERVER' or * 'USE_DATA_ASYNCH_CLIENT_SERVER_ERROR' or * 'USE_DATA_SYNCH_CLIENT_SERVER', the DCM shall generate the according function call. If the parameter is set to 'TRUE' and DcmDspDataUsePort is set to * 'USE_DATA_SYNCH_FNC' or * 'USE_DATA_ASYNCH_FNC_ERROR' * 'USE_DATA_ASYNCH_FNC', the parameter 'DcmDspDataConditionCheckReadFnc' shall contain a valid C-function.
          function name DcmDspDataEcuSignal [0..0]: scope=ECU, multiplicity set at pre-compile, set at pre-compile, with-auto=true  # Function name to control the access to a certain ECU Signal by the DCM. (IoHwAb_Dcm_<symbolic name of ECU signal>-function). | Only relevant if DcmDspDataUsePort==USE_ECU_SIGNAL.
          enumeration DcmDspDataEndianness [0..1]: {BIG_ENDIAN, LITTLE_ENDIAN, OPAQUE}, multiplicity set at link in variant link-time / pre-compile in variant post-build+pre-compile, set at link in variant link-time / pre-compile in variant post-build+pre-compile  # Defines the endianness of the data belonging to a DID.If projects configures OPAQUE no endianness conversion will be supported/applicable | If no DcmDspDataEndiness is defined the value of DcmDspDataDefaultEndianness is applicable.
          function name DcmDspDataFreezeCurrentStateFnc [0..1]: scope=ECU, multiplicity set at pre-compile, set at pre-compile  # Function name to request to application to freeze the current state of an IOControl. (FreezeCurrentState-function). | Only relevant if * DcmDspDataUsePort=="USE_DATA_SYNCH_FNC or * DcmDspDataUsePort==USE_DATA_ASYNCH_FNC" or * DcmDspDataUsePort==USE_DATA_ASYNCH_FNC_ERROR". This parameter is related to the interface Xxx_FreezeCurrentState.
          function name DcmDspDataGetScalingInfoFnc [0..0]: scope=ECU, multiplicity set at pre-compile, set at pre-compile, with-auto=true  # Function name to request to application the scaling information of the DID. (GetScalingInformation-function). | Only relevant if * DcmDspDataUsePort=="USE_DATA_SYNCH_FNC or * DcmDspDataUsePort==USE_DATA_ASYNCH_FNC" or * DcmDspDataUsePort==USE_DATA_ASYNCH_FNC_ERROR". This parameter is related to the interface Xxxx_GetScalingInformation.
          function name DcmDspDataReadDataLengthFnc [0..1]: scope=ECU, multiplicity set at pre-compile, set at pre-compile  # Function name to request from application the data length of a DID. (ReadDataLength-function). | Only relevant if * DcmDspDataUsePort=="USE_DATA_SYNCH_FNC or * DcmDspDataUsePort==USE_DATA_ASYNCH_FNC" or * DcmDspDataUsePort==USE_DATA_ASYNCH_FNC_ERROR". This parameter is related to the interface Xxx_ReadDataLength.
          function name DcmDspDataReadEcuSignal [0..0]: scope=ECU, multiplicity set at pre-compile, set at pre-compile, with-auto=true  # Function name for read access to a certain ECU Signal by the DCM. (IoHwAb_Dcm_Read<EcuSignalName>-function). | Only relevant if DcmDspDataUsePort==USE_ECU_SIGNAL.
          function name DcmDspDataReadFnc [0..1]: scope=ECU, multiplicity set at pre-compile, set at pre-compile  # Function name to request from application the data value of a DID. (ReadData-function). | Multiplicity shall be equal to parameter DcmDspDataConditionCheckReadFnc. Only relevant if * DcmDspDataConditionCheckReadFncUsed is set to 'TRUE' and * DcmDspDataUsePort=="USE_DATA_SYNCH_FNC or * DcmDspDataUsePort==USE_DATA_ASYNCH_FNC" or * DcmDspDataUsePort==USE_DATA_ASYNCH_FNC_ERROR". This parameter is related to the interface Xxx_ReadData.
          function name DcmDspDataResetToDefaultFnc [0..1]: scope=ECU, multiplicity set at pre-compile, set at pre-compile  # Function name to request to application to reset an IOControl to default value. (ResetToDefault-function). | Only relevant if * DcmDspDataUsePort=="USE_DATA_SYNCH_FNC or * DcmDspDataUsePort==USE_DATA_ASYNCH_FNC" or * DcmDspDataUsePort==USE_DATA_ASYNCH_FNC_ERROR". This parameter is related to the interface Xxx_ResetToDefault.
          function name DcmDspDataReturnControlToEcuFnc [0..1]: scope=ECU, multiplicity set at pre-compile, set at pre-compile  # Function name to request to application to return control to ECU of an IOControl. (ReturnControlToECU-function). | Only relevant if * DcmDspDataUsePort=="USE_DATA_SYNCH_FNC or * DcmDspDataUsePort==USE_DATA_ASYNCH_FNC" or * DcmDspDataUsePort==USE_DATA_ASYNCH_FNC_ERROR". This parameter is related to the interface Xxx_ReturnControlToECU.
          function name DcmDspDataShortTermAdjustmentFnc [0..1]: scope=ECU, multiplicity set at pre-compile, set at pre-compile  # Function name to request to application to adjuste the IO signal. (ShortTermAdjustment-function). | Only relevant if * DcmDspDataUsePort=="USE_DATA_SYNCH_FNC or * DcmDspDataUsePort==USE_DATA_ASYNCH_FNC" or * DcmDspDataUsePort==USE_DATA_ASYNCH_FNC_ERROR". This parameter is related to the interface Xxx_ShortTermAdjustment.
          integer DcmDspDataSize [0..1]: 0..65535, scope=ECU, multiplicity set at link in variant link-time / pre-compile in variant post-build+pre-compile, set at link in variant link-time / pre-compile in variant post-build+pre-compile  # Length of data in bits associated to the Data. If Data has variable datalength, that corresponds to the maximum datalength. If DcmDspDataSize parameter is configured then the parameter DcmDspDataByteSize shall not be configured and both parameter shall not be configured at a time, either one of them has to be configured. If DcmDspDataSize is configred, then DcmDspDidDataPos shall be used. If the the parameter DcmDspDataUsePort is configured as USE_DATA_SENDER_RECEIVER/USE_BLOCK_ID, the user need not update this field. Instead the user may invoke generateId for Dcm inorder to automatically configure the same depending on parameter DcmDspDataType/DcmDspDataBlockIdRef->NvMNvBlockLength.respectively
          integer DcmDspDataByteSize [0..1]: 0..65535, scope=ECU, multiplicity set at link in variant link-time / pre-compile in variant post-build+pre-compile, set at link in variant link-time / pre-compile in variant post-build+pre-compile  # Defines the array length in bytes or the the maximum array length for variable datalengths. If DcmDspDataByteSize parameter is configured then the parameter DcmDspDataSize shall not be configured and both parameter shall not be configured at a time, either one of them has to be configured. If DcmDspDataByteSize is configured, then DcmDspDidByteOffset shall be used. If the the parameter DcmDspDataUsePort is configured as USE_DATA_SENDER_RECEIVER/USE_BLOCK_ID, the user need not update this field. Instead the user may invoke generateId for Dcm inorder to automatically configure the same depending on parameter DcmDspDataType/DcmDspDataBlockIdRef->NvMNvBlockLength.respectively
          enumeration DcmDspDataType: {BOOLEAN, SINT16, SINT16_N, SINT32, SINT32_N, SINT8, SINT8_N, UINT16, UINT16_N, UINT32, UINT32_N, UINT8, UINT8_DYN, UINT8_N}, scope=ECU, set at link in variant link-time / pre-compile in variant post-build+pre-compile  # Provide the implementation data type of data belonging to a DID.
          enumeration DcmDspDataUsePort: {USE_BLOCK_ID, USE_DATA_ASYNCH_CLIENT_SERVER, USE_DATA_ASYNCH_FNC, USE_DATA_SENDER_RECEIVER, USE_DATA_SENDER_RECEIVER_AS_SERVICE, USE_DATA_SYNCH_CLIENT_SERVER, USE_DATA_SYNCH_FNC, USE_DATA_RDBI_PAGED_FNC}, scope=ECU, set at pre-compile  # Defines which interface shall be used to access the data.
          function name DcmDspDataWriteFnc [0..1]: scope=ECU, multiplicity set at pre-compile, set at pre-compile  # Function name to request application to write the data value of a DID. (WriteData-function). | Only relevant if * DcmDspDataUsePort=="USE_DATA_SYNCH_FNC or * DcmDspDataUsePort==USE_DATA_ASYNCH_FNC" or * DcmDspDataUsePort==USE_DATA_ASYNCH_FNC_ERROR". This parameter is related to the interface Xxx_WriteData.
          string DcmRbDspDataArrayInfoSubElement [0..1]: multiplicity set at link in variant link-time / pre-compile in variant post-build+pre-compile, origin=RB:AR42.2.0.0:2017-07-31, set at link in variant link-time / pre-compile in variant post-build+pre-compile  # String Input which contains the information Sub Array Index for DcmSubElementInImplDataElementInstance or structure type info for DcmSubElementInDataElementInstance. If DcmSubElementInDataElementInstance is configured then this parameter should the structure Type as well as the as the sub-structure type separated by commas: eg: struct Test { uint8 A, uint32 B }; If B is the SubElement required then this parameter must be filled with - Test,B If DcmSubElementInImplDataElementInstance is configured then this parameter should contain the sub array index to be accessed:
          boolean DcmRbDspDataUseAsynchronousServerCallPoint [0..1]: multiplicity set at link in variant link-time+post-build / pre-compile in variant pre-compile, origin=RB:AR42.1.0.0:2017-01-31, set at link in variant link-time+post-build / pre-compile in variant pre-compile, default-value=false  # Only relevant in case DcmDspDataUsePort is set to USE_DATA_ASYNCH_CLIENT_SERVER.This parameter is used to select the type of Server Handling required.Set the value to TRUE for Asynchronous server call point handling else Synchronous server call point handling is carried out
          symbolic name reference DcmDspDataBlockIdRef [0..1]: scope=ECU, multiplicity set at pre-compile, set at pre-compile, destination=NvMBlockDescriptor  # NVRAM blockId to access the data.Only relevant if DcmDspDataUsePort==USE_BLOCK_ID. | Only relevant if DcmDspDataUsePort==USE_BLOCK_ID.
          reference DcmDspDataInfoRef [0..0]: scope=ECU, set at pre-compile, destination=DcmDspDataInfo  # Reference to 1 DcmDspDataInfo
          choice container DcmDspDiagnosisScaling [0..1]  # This container contains the configuration (parameters) of an alternative Diagnosis Representation. Out if this the scaling between Diagnosis and ECU internal representation and vice versa can be calculated.
            container DcmDspAlternativeDataInterface [0..0]  # This container contains the configuration (parameters) of an alternative Diagnosis Representation by the means of a VariableDataPrototoype in a DataInterface. | Additionally a reference to PortInterfaceMapping can be defined which provide already the mapping rules between the VariableDataPrototoype in a DataInterface used by the software component (DcmDspExternalSRDataElementClass) and the intended Diagnosis Representation defined by DcmDataElement.
              foreign reference DcmDataElement [0..0]: set at pre-compile, destination-type=VARIABLE-DATA-PROTOTYPE  # Alternative Diagnosis Representation for the data defined by the means of a VariableDataPrototoype in a DataInterface.
              foreign reference DcmPortInterfaceMapping [0..0]: multiplicity set at pre-compile, set at pre-compile, destination-type=PORT-INTERFACE-MAPPING  # Optional reference to PortInterfaceMapping which defines the mapping rules.
            container DcmDspAlternativeDataProps [0..1]  # This container contains the configuration (parameters) of an alternative Diagnosis Representation by the means of ECU configuration parameters. | The physical unit of the alternative data representation is defined by the DataPrototype referenced by DcmDspExternalSRDataElementClass. Additionally the definition of a text table mapping can be a defined for DcmDspDataTypeCategory TEXTTABLE and SCALE_LINEAR_AND_TEXTTABLE
              enumeration DcmDspDataTypeCategory [0..0]: {LINEAR, SCALE_LINEAR_AND_TEXTTABLE, TEXTTABLE}, scope=ECU, set at pre-compile, with-auto=true  # Data category of the alternative Diagnosis Representation.
              container DcmDspLinearScale [0..1]  # This container contains the configuration (parameters) of an linear scale of the alternative Diagnosis Representation.
                float DcmDspDiagnosisRepresentationDataLowerRange: -Inf..Inf, scope=ECU, set at pre-compile  # Lower Range for this scale of the data in the alternative Diagnosis Representation.
                float DcmDspDiagnosisRepresentationDataOffset: 0..Inf, scope=ECU, set at pre-compile, default-value=0  # Data offset of the alternative Diagnosis Representation for this scale.
                float DcmDspDiagnosisRepresentationDataResolution: 0..Inf, scope=ECU, set at pre-compile  # Data resolution of the alternative Diagnosis Representation for this scale.
                float DcmDspDiagnosisRepresentationDataUpperRange: -Inf..Inf, scope=ECU, set at pre-compile  # Upper Range for this scale of the data in the alternative Diagnosis Representation.
              container DcmDspTextTableMapping [0..0]  # This container contains the configuration (parameters) of the mapping a DataPrototype typed by AutosarDataType that refer to a CompuMethods of category TEXTTABLE or SCALE_LINEAR_AND_TEXTTABLE. | Each DcmDspTextTableMapping defines a value pair which is used to map the ECU internal value (DcmDspInternalDataValue) to the vale used in the diagnosis representation (DcmDspDiagnosisRepresentationDataValue) and vice versa. The set of all DcmDspTextTableMappings defines the whole mapping of an data.
                integer DcmDspDiagnosisRepresentationDataValue [0..0]: 0..18446744073709551615, scope=ECU, set at pre-compile  # The data value in the diagnosis representation.
                integer DcmDspInternalDataValue [0..0]: 0..18446744073709551615, scope=ECU, set at pre-compile, with-auto=true  # The ECU internal data value.
            container DcmDspAlternativeDataType [0..1]  # This container contains the configuration (parameters) of an alternative Diagnosis Representation by the means of an ApplicationDataType. | Additionally the definition of a text table mapping can be a defined for ApplicationDataTypes of category TEXTTABLE and SCALE_LINEAR_AND_TEXTTABLE.
              foreign reference DcmApplicationDataType: set at pre-compile, destination-type=APPLICATION-DATA-TYPE  # Alternative Diagnosis Representation for the data defined by the means of a ApplicationPrimitiveDataType of category VALUE or BOOLEAN.
              container DcmDspTextTableMapping [0..0]  # This container contains the configuration (parameters) of the mapping a DataPrototype typed by AutosarDataType that refer to a CompuMethods of category TEXTTABLE or SCALE_LINEAR_AND_TEXTTABLE. | Each DcmDspTextTableMapping defines a value pair which is used to map the ECU internal value (DcmDspInternalDataValue) to the vale used in the diagnosis representation (DcmDspDiagnosisRepresentationDataValue) and vice versa. The set of all DcmDspTextTableMappings defines the whole mapping of an data.
                integer DcmDspDiagnosisRepresentationDataValue [0..0]: 0..18446744073709551615, scope=ECU, set at pre-compile, with-auto=true  # The data value in the diagnosis representation.
                integer DcmDspInternalDataValue [0..0]: 0..18446744073709551615, scope=ECU, set at pre-compile, with-auto=true  # The ECU internal data value.
          choice container DcmDspExternalSRDataElementClass [0..1]  # This container defines the source of data in a provided port which shall be read respectively the target of data in a required port which shall be written. | This container shall contain either one DcmSubElementInDataElementInstance OR DcmDataElementInstance OR DcmSubElementInImplDataElementInstance reference.
            container DcmDataElementInstance [0..1]  # Instance Reference to the primitive data in a port where the data element is typed with an ApplicationPrimitveDataType or an ImplementationDataType.
              instance reference DcmDataElementInstanceRef: set at pre-compile, destination-context=ROOT-SW-COMPOSITION-PROTOTYPE SW-COMPONENT-PROTOTYPE PORT-PROTOTYPE, destination-type=AUTOSAR-DATA-PROTOTYPE  # Instance Reference to the primitive data which shall be read or written. | Supported are VariableDataPrototypes in SenderReceiverInterfaces and NvDataInterfaces and ParameterDataPrototypes in ParameterInterfaces (read only). This reference is applicable if the AutosarDataPrototype is typed with a ApplicationPrimitiveDataType of category VALUE or BOOLEAN or if the AutosarDataPrototype is typed with a ImplementationDataType of category VALUE or ARRAY or TYPE_REFERENCE that in turn boils down to VALUE
            container DcmSubElementInDataElementInstance [0..1]  # Instance Reference to the primitve sub-element (at any level) of composite data in a port where the data element is typed with an ApplicationCompositeDataType.
              instance reference DcmSubElementInDataElementInstanceRef: set at pre-compile, destination-context=ROOT-SW-COMPOSITION-PROTOTYPE SW-COMPONENT-PROTOTYPE PORT-PROTOTYPE AUTOSAR-DATA-PROTOTYPE APPLICATION-COMPOSITE-ELEMENT-DATA-PROTOTYPE*, destination-type=APPLICATION-COMPOSITE-ELEMENT-DATA-PROTOTYPE  # Instance Reference to the primitve sub-element (at any level) of composite data in a port which shall be read. | Supported are VariableDataPrototypes in SenderReceiverInterfaces and NvDataInterfaces and ParameterDataPrototypes in ParameterInterfaces (read only). This reference is applicable if the AutosarDataPrototype is typed with a ApplicationCompositeDataType.
            container DcmSubElementInImplDataElementInstance [0..1]  # Instance Reference to the primitve sub-element (at any level) of composite data in a port where the data element is typed with an ImplementationDataType.
              instance reference DcmSubElementInImplDataElementInstanceRef: set at pre-compile, destination-context=ROOT-SW-COMPOSITION-PROTOTYPE SW-COMPONENT-PROTOTYPE PORT-PROTOTYPE AUTOSAR-DATA-PROTOTYPE IMPLEMENTATION-DATA-TYPE-ELEMENT*, destination-type=IMPLEMENTATION-DATA-TYPE-ELEMENT  # Instance Reference to the primitve sub-element (at any level) of composite data in a port which shall be read. | Supported are VariableDataPrototypes in SenderReceiverInterfaces and NvDataInterfaces and ParameterDataPrototypes in ParameterInterfaces (read only). This reference is applicable if the AutosarDataPrototype is typed with a ImplementationDataType of category STRUCTURE or ARRAY. Please note that in case of ARRAY the index attribute in the target reference has to be set to select a single array element.
        container DcmDspDataInfo [0..0]  # This container contains the configuration (parameters) of a Data
          integer DcmDspDataScalingInfoSize [0..0]: 0..4294967295, scope=ECU, multiplicity set at link in variant link-time / pre-compile in variant post-build+pre-compile, set at link in variant link-time / pre-compile in variant post-build+pre-compile, with-auto=true  # If Scaling information service is available for this Data, it provides the size in bytes of the scaling information.
        container DcmDspDid [0..*]  # This container contains the configuration (parameters) of the DID.
          integer DcmDspDidIdentifier: 0..65535, scope=ECU, set at link in variant link-time / pre-compile in variant post-build+pre-compile  # 2 byte Identifier of the DID | Within each DcmConfigSet all DcmDspDidIdentifier values shall be unique.
          enumeration DcmDspDidUsePort: {USE_ATOMIC_NV_DATA_INTERFACE, USE_ATOMIC_SENDER_RECEIVER_INTERFACE, USE_ATOMIC_SENDER_RECEIVER_INTERFACE_AS_SERVICE, USE_DATA_ELEMENT_SPECIFIC_INTERFACES}, scope=ECU, set at pre-compile, default-value=USE_DATA_ELEMENT_SPECIFIC_INTERFACES  # Selects application interface type for DID data elements between a single operation for all data elements or data element specific operations.
          boolean DcmRbAtomicSenderReceiverCommunication: multiplicity set at link in variant link-time+post-build / pre-compile in variant pre-compile, origin=RB:AR42.7.0.0:2019-11-19, set at link in variant link-time+post-build / pre-compile in variant pre-compile, default-value=false  # This parameter is used to select the type of communication required.Set the value to TRUE for Atomic SenderReceiver communication else regular SenderReceiver communication will be carried out
          boolean DcmDspDidUsed [0..0]: scope=ECU, set at link in variant link-time / post-build in variant post-build / pre-compile in variant pre-compile, with-auto=true  # Allow to activate or deactivate the usage of a DID, for multi purpose ECUs | true = DID available false = DID not available
          function name DcmRbDspIsDIDAvailableFnc [0..1]: multiplicity set at pre-compile, origin=RB:AR42.1.0.0:2017-01-31, set at pre-compile  # Function name to request the application to check if the DID requested is supported in the variant.The user can leave the field empty if the check is not required for this DID
          reference DcmDspDidInfoRef: scope=ECU, set at link in variant link-time / pre-compile in variant post-build+pre-compile, destination=DcmDspDidInfo  # Reference to DcmDspDidInfo containing information on this DID.
          reference DcmDspDidInfotypeRef [0..0]: scope=ECU, multiplicity set at link in variant link-time / pre-compile in variant post-build+pre-compile, set at link in variant link-time / pre-compile in variant post-build+pre-compile, destination=DcmDspVehInfo  # Reference to DcmDspVehInfo | DcmDspVehInfo contains the configuration (parameters) of the "Request vehicle information service" (service $09).
          reference DcmDspDidPidRef [0..0]: scope=ECU, multiplicity set at link in variant link-time / pre-compile in variant post-build+pre-compile, set at link in variant link-time / pre-compile in variant post-build+pre-compile, destination=DcmDspPid  # Reference to DcmDspPid. | DcmDspPid defines the availability of a PID to the DCM
          reference DcmDspDidRef [0..0]: scope=ECU, multiplicity set at link in variant link-time / pre-compile in variant post-build+pre-compile, requires-index=true, set at link in variant link-time / pre-compile in variant post-build+pre-compile, destination=DcmDspDid  # Reference to DcmDspDid in case this DID refer to one or serveral other DID's
          container DcmDspDidExtRoe [0..1]  # Provide information to manage a responseOnEvent request on this DID externally. If this container doesn't exist, an ROE event on this DID will be managed internally.In RTA-BSW DCM internally managed DIDs are not supported, if the projects want monitoring of DID as per Autosar 4.0.2, then it is mandatory to configure the DcmDspDidExtRoe | The R-Port for ROEServices interface is named ROEServices_<SWC> where <SWC> is the name of this container.
            function name DcmDspDidRoeActivateFnc [0..1]: multiplicity set at link in variant link-time / pre-compile in variant post-build+pre-compile, set at link in variant link-time / pre-compile in variant post-build+pre-compile  # Function name to activate/deactivate an ROE event managed externally.This parameter is related to the interface xxx_ActivateEvent.This parameter is to be configured mandatorily if atleast one of the signal of the DID is of the following DcmDspDataUsePort==USE_DATA_SYNCH_FNC/USE_DATA_ASYNCH_FNC/USE_BLOCK_ID. IF all the signals of the DID are set to ===USE_DATA_SENDER_RECEIVER/USE_DATA_ASYNCH_CLIENT_SERVER/USE_DATA_SYNCH_CLIENT_SERVER | Only relevant if DcmDspDataUsePort== USE_DATA_SYNCH_FNC/USE_DATA_ASYNCH_FNC. This parameter is related to the interface xxx_ActivateEvent.
            integer DcmDspDidRoeEventId: 0..255, set at link in variant link-time / pre-compile in variant post-build+pre-compile  # EventId to be used within Apis Dcm_TriggerOnEvent() and xxx_ActivateEvent()
          container DcmDspDidSignal [0..*]  # This container defines the reference to 1 DcmDspData container and position relevant for this DID.
            integer DcmDspDidDataPos [0..1]: 0..65535, scope=ECU, set at link in variant link-time / pre-compile in variant post-build+pre-compile  # Defines the position of the data defined by DcmDspDidDataRef reference to DcmDspData container in the DID. | The position is defined in bits.
            integer DcmDspDidByteOffset [0..1]: 0..65535, scope=ECU, set at link in variant link-time / pre-compile in variant post-build+pre-compile  # Defines the absolute byte offset of the data defined by DcmDspDidDataRef reference to DcmDspData container in the DID. | The position is defined in bytes.
            reference DcmDspDidDataRef: scope=ECU, set at link in variant link-time / pre-compile in variant post-build+pre-compile, destination=DcmDspData  # Reference to 1 DcmDspData container relevant for this DID.
        container DcmDspDidInfo [0..*]  # This container contains the configuration (parameters) of the DID's Info
          integer DcmDspDDDIDMaxElements [0..1]: 1..255, multiplicity set at link in variant link-time / pre-compile in variant post-build+pre-compile, set at link in variant link-time / pre-compile in variant post-build+pre-compile  # Maximum number of source elements of a DDDID.
          boolean DcmDspDidDynamicallyDefined: scope=ECU, set at link in variant link-time / pre-compile in variant post-build+pre-compile  # Indicates if this DID can be dynamically defined | true = DID can be dynamically defined false = DID can not be dynamically defined
          container DcmDspDidControl [0..1]  # This container contains the configuration (parameters) of the DID control.
            enumeration DcmDspDidControlMask: {DCM_CONTROLMASK_EXTERNAL, DCM_CONTROLMASK_INTERNAL, DCM_CONTROLMASK_NO}, set at link in variant link-time / pre-compile in variant post-build+pre-compile, default-value=DCM_CONTROLMASK_INTERNAL  # This indicates the presence of "controlEnableMask" in the AUTOSR interface.
            integer DcmDspDidControlMaskSize [0..1]: 0..4, multiplicity set at link in variant link-time / pre-compile in variant post-build+pre-compile, set at link in variant link-time / pre-compile in variant post-build+pre-compile  # The value defines the size of the controlEnableMaskRecord in bytes.
            boolean DcmDspDidFreezeCurrentState: scope=ECU, set at pre-compile  # This indicates the presence of "FreezeCurrentState".
            boolean DcmDspDidResetToDefault: scope=ECU, set at pre-compile  # This indicates the presence of "ResetToDefault".
            boolean DcmDspDidShortTermAdjustment: scope=ECU, set at pre-compile  # This indicates the presence of "ShortTermAdjustment".
            function name DcmRbDspDidControlUserModeRuleFnc [0..1]: multiplicity set at pre-compile, origin=RB:AR42.1.0.0:2017-01-31, set at pre-compile  # Function name used by the application to perform user specific checks before IO Control of a DID.In case the checks fails, NRC value set by the application can be returned to the tester. In case the function is not configured for DID Control, the DcmAppl API DcmAppl_UserDIDModeRuleService shall be called.
            boolean DcmRbDspIoCtrlResetOnSessSecurityChange [0..1]: multiplicity set at pre-compile, origin=RB:AR42.1.0.0:2017-01-31, set at pre-compile, default-value=true  # Indicates if resetting of IOControl on session / security change is enabled / disabled. | True = IOcontrol on session / security change is enabled False = IOcontrol on session / security change is disabled
            reference DcmDspDidControlModeRuleRef [0..1]: scope=ECU, multiplicity set at link in variant link-time / pre-compile in variant post-build+pre-compile, set at link in variant link-time / pre-compile in variant post-build+pre-compile, destination=DcmModeRule  # Reference to DcmDspModeRule | Mode rule which controls this DID. If there is no reference, no check of the mode rule shall be done.
            reference DcmDspDidControlSecurityLevelRef [0..*]: scope=ECU, multiplicity set at link in variant link-time / pre-compile in variant post-build+pre-compile, set at link in variant link-time / pre-compile in variant post-build+pre-compile, destination=DcmDspSecurityRow  # Reference to DcmDspSecurityRow | Security levels allowed to control this DID. If there is no reference, no check of security level shall be done.
            reference DcmDspDidControlSessionRef [0..*]: scope=ECU, multiplicity set at link in variant link-time / pre-compile in variant post-build+pre-compile, set at link in variant link-time / pre-compile in variant post-build+pre-compile, destination=DcmDspSessionRow  # Reference to DcmDspSessionRow | Sessions allowed to control this DID. If there is no reference, no check of session level shall be done.
            container DcmDspDidControlEnableMask [0..0]  # The shortname of the container value defines the symbol of the controlMask.
              integer DcmDspDidControlMaskBitPosition [0..0]: 0..31, scope=ECU, set at pre-compile  # Defines the position of the bit in the controlMask starting from most significant bit (MSB first) to least significant bit. | This Bit endianness is identical to the controlMask in UDS. The DcmDspDidControlMaskSize should be considered for most significant bit.
          container DcmDspDidRead [0..1]  # This container contains the configuration (parameters) of the DID read.
            function name DcmRbDspDidReadUserModeRuleFnc [0..1]: multiplicity set at pre-compile, origin=RB:AR42.1.0.0:2017-01-31, set at pre-compile  # Function name used by the application to perform user specific checks before Reading a DID.In case the checks fails, NRC value set by the application can be returned to the tester. In case the function is not configured for DID Read, the DcmAppl API DcmAppl_UserDIDModeRuleService shall be called.
            reference DcmDspDidReadModeRuleRef [0..1]: scope=ECU, multiplicity set at link in variant link-time / pre-compile in variant post-build+pre-compile, set at link in variant link-time / pre-compile in variant post-build+pre-compile, destination=DcmModeRule  # Reference to DcmDspModeRule | Mode rule which controls to read this DID. If there is no reference, no check of the mode rule shall be done.
            reference DcmDspDidReadSecurityLevelRef [0..*]: scope=ECU, multiplicity set at link in variant link-time / pre-compile in variant post-build+pre-compile, set at link in variant link-time / pre-compile in variant post-build+pre-compile, destination=DcmDspSecurityRow  # Reference to DcmDspSecurityRow | Security levels allowed to read this DID. If there is no reference, no check of security level shall be done.
            reference DcmDspDidReadSessionRef [0..*]: scope=ECU, multiplicity set at link in variant link-time / pre-compile in variant post-build+pre-compile, set at link in variant link-time / pre-compile in variant post-build+pre-compile, destination=DcmDspSessionRow  # Reference to DcmDspSessionRow | Sessions allowed to read this DID. If there is no reference, no check of session level shall be done.
          container DcmDspDidWrite [0..1]  # This container contains the configuration (parameters) of the DID write.
            function name DcmRbDspDidWriteUserModeRuleFnc [0..1]: multiplicity set at pre-compile, origin=RB:AR42.1.0.0:2017-01-31, set at pre-compile  # Function name used by the application to perform user specific checks before writing a DID.In case the checks fails, NRC value set by the application can be returned to the tester. In case the function is not configured for DID Write, the DcmAppl API DcmAppl_UserDIDModeRuleService shall be called.
            reference DcmDspDidWriteModeRuleRef [0..1]: scope=ECU, multiplicity set at link in variant link-time / pre-compile in variant post-build+pre-compile, set at link in variant link-time / pre-compile in variant post-build+pre-compile, destination=DcmModeRule  # Reference to DcmDspModeRule | Mode rule which controls to write this DID. If there is no reference, no check of the mode rule shall be done.
            reference DcmDspDidWriteSecurityLevelRef [0..*]: scope=ECU, multiplicity set at link in variant link-time / pre-compile in variant post-build+pre-compile, set at link in variant link-time / pre-compile in variant post-build+pre-compile, destination=DcmDspSecurityRow  # Reference to DcmDspSecurityRow | Security levels allowed to write this DID. If there is no reference, no check of security level shall be done.
            reference DcmDspDidWriteSessionRef [0..*]: scope=ECU, multiplicity set at link in variant link-time / pre-compile in variant post-build+pre-compile, set at link in variant link-time / pre-compile in variant post-build+pre-compile, destination=DcmDspSessionRow  # Reference to DcmDspSessionRow | Sessions allowed to write this DID. If there is no reference, no check of session level shall be done.
        container DcmDspDidRange [0..*]  # This container defines the DID Range
          boolean DcmDspDidRangeHasGaps: scope=ECU, set at link in variant link-time / pre-compile in variant post-build+pre-compile  # Parameter specifying if there are gaps in the DID range (parameter set to TRUE) or not (parameter set to FALSE)
          integer DcmDspDidRangeIdentifierLowerLimit: 0..65535, scope=ECU, set at link in variant link-time / pre-compile in variant post-build+pre-compile  # Lower limit of DID range.
          integer DcmDspDidRangeIdentifierUpperLimit: 0..65535, scope=ECU, set at link in variant link-time / pre-compile in variant post-build+pre-compile  # Upper limit of DID range.
          function name DcmDspDidRangeIsDidAvailableFnc [0..1]: scope=ECU, multiplicity set at pre-compile, set at pre-compile  # Function name to request from application if a specific DID is available within the range or not. | Only relevant if DcmDspDidRangeUsePort is set to false. This parameter is related to the interface Xxx_IsDidAvailable.
          integer DcmDspDidRangeMaxDataLength: 0..65535, scope=ECU, set at link in variant link-time / pre-compile in variant post-build+pre-compile  # Maximum data length in bytes
          function name DcmDspDidRangeReadDataLengthFnc [0..1]: multiplicity set at pre-compile, set at pre-compile  # Function name to request from application the data Length value for range of a DID.(ReadData-function).The parameter should be entered always,when DcmDspDidRangeUsePort is set to FALSE. | This parameter is related to the interface Xxx_ReadDidData. This parameter is related to the interface Xxx_ReadDidRangeDataLength.
          function name DcmDspDidRangeReadDidFnc [0..1]: scope=ECU, multiplicity set at pre-compile, set at pre-compile  # Function name to request from application the data range value of a DID.(ReadData-function). | Only relevant if DcmDspDidRangeUsePort is set to false. This parameter is related to the interface Xxx_ReadDidData.
          boolean DcmDspDidRangeUsePort: scope=ECU, set at pre-compile  # When the parameter DcmDspDidRangeUsePort is set to true the DCM will access the Data using an R-Port requiring a PortInteface DataServices_DIDRange. In that case, DcmDspDidRangeIsDidAvailableFnc, DcmDspDidRangeReadDidFnc and DcmDspDidRangeWriteDidFnc are ignored and the RTE APIs are used. When the parameter DcmDspDidRangeUsePort is false, the DCM calls the functions defined in DcmDspDidRangeIsDidAvailableFnc, DcmDspDidRangeReadDidFnc and DcmDspDidRangeWriteDidFnc.
          function name DcmDspDidRangeWriteDidFnc [0..1]: scope=ECU, multiplicity set at pre-compile, set at pre-compile  # Function name to request application to write the data range value of a DID.(WriteData-function). | Only relevant if DcmDspDidRangeUsePort is set to false. This parameter is related to the interface Xxx_WriteDidData.
          reference DcmDspDidRangeInfoRef: scope=ECU, set at link in variant link-time / pre-compile in variant post-build+pre-compile, destination=DcmDspDidInfo  # Reference to DcmDspDidInfo containing information on this DID Range.
        container DcmDspMemory [0..1]  # This container contains the configuration of the memory access.
          container DcmDspAddressAndLengthFormatIdentifier [0..0]  # This container contains the configuration of the supported AddressAndLengthFormatIdentifiers for memory access.
            integer DcmDspSupportedAddressAndLengthFormatIdentifier [0..0]: 0..255, scope=ECU, multiplicity set at link in variant link-time / pre-compile in variant post-build+pre-compile, set at link in variant link-time / pre-compile in variant post-build+pre-compile, with-auto=true  # This parameter defines the supported AddressAndLengthFormatIdentifier of the request message.
          container DcmDspMemoryIdInfo [1..*]  # Provides the value of memory identifier used to select the desired memory device | This container contains the configuration of the memory access requested through diagnostic services : ReadMemoryByAddress, WriteMemoryByAddress, RequestDownload, RequestUpload
            integer DcmDspMemoryIdValue [0..1]: 0..255, scope=ECU, multiplicity set at link in variant link-time / pre-compile in variant post-build+pre-compile, set at link in variant link-time / pre-compile in variant post-build+pre-compile  # Value of the memory device identifier used. | If this parameter is not configured, the DCM does not use MemoryIdentifier parameter. The Dcm_WriteMemory and Dcm_ReadMemory callouts are called without the MemoryIdentifier parameter. If this parameter is configured, the DCM does use MemoryIdentifier parameter to select the memory device to use. The Dcm_WriteMemory and Dcm_ReadMemory callouts are called with the MemoryIdentifier parameter. Each DcmDspMemoryIdInfo should have a unique ID. The MemoryIdValue is retrieved from the request messages (RMBA,WMBA,RD,RU,DDDI) according to ISO-14229-1.
            container DcmDspReadMemoryRangeByLabelInfo [0..*]  # Provides a memory range allowed for reading via labels (lower and higher address configured as strings). | This container contains the configuration of the memory range allowed for reading
              string DcmDspReadMemoryRangeByLabelHigh: set at link in variant link-time / pre-compile in variant post-build+pre-compile  # Higher memory address of a range allowed for reading. The address can be entered only in string format and the corresponding macro definition should be included in DcmAppl.h file
              string DcmDspReadMemoryRangeByLabelLow: set at link in variant link-time / pre-compile in variant post-build+pre-compile  # Lower memory address of a range allowed for reading. The address can be entered only in string format and the corresponding macro definition should be included in DcmAppl.h file
              function name DcmRbDspReadMemoryRangeUserModeRuleFnc [0..1]: multiplicity set at link in variant link-time+post-build / pre-compile in variant pre-compile, origin=RB:AR42.1.0.0:2017-01-31, set at pre-compile  # Function name used by the application to perform user specific checks before reading a memory range.In case the checks fails, NRC value set by the application can be returned to the tester. In case the function is not configured for memory range, the DcmAppl API DcmAppl_UserMemoryRangeModeRuleService shall be called.
              reference DcmDspReadMemoryRangeModeRuleRef [0..1]: multiplicity set at link in variant link-time+post-build / pre-compile in variant pre-compile, origin=RB:AR42.1.0.0:2017-01-31, set at link in variant link-time / pre-compile in variant post-build+pre-compile, destination=DcmModeRule  # Reference to DcmDspModeRule which controls read access on this memory address. If there is no reference, no check of the mode rule shall be done. Refer container DcmProcessingConditions->DcmModeRule for more information regarding mode rules | Mode rule which controls read access on this memory address. If there is no reference, no check of the mode rule shall be done.
              reference DcmDspReadMemoryRangeSecurityLevelRef [0..*]: multiplicity set at link in variant link-time+post-build / pre-compile in variant pre-compile, origin=RB:AR42.1.0.0:2017-01-31, set at link in variant link-time / pre-compile in variant post-build+pre-compile, destination=DcmDspSecurityRow  # Link to the Security Access Levels needed for read access on this memory address. User can configure multiple DcmDspReadMemoryRangeSecurityLevelRef for read access on this memory range. If reference is provided, then read access on this memory address shall be allowed only in the configured security levels. Read access on this memory address will be allowed in all security levels, if no reference is provided.
              reference DcmDspReadMemoryRangeSessionLevelRef [0..*]: multiplicity set at link in variant link-time+post-build / pre-compile in variant pre-compile, origin=RB:AR42.1.0.0:2017-01-31, set at link in variant link-time / pre-compile in variant post-build+pre-compile, destination=DcmDspSessionRow  # Link to the Session Levels needed for Read access on this memory address. User can configure multiple DcmDspReadMemoryRangeSessionLevelRef for Read access on this memory address. If reference is provided, then Read access on this memory address shall be enabled only in the configured session levels. No session level check shall be done before Read access on this memory address, if no reference is provided.
            container DcmDspReadMemoryRangeInfo [0..*]  # Provides the range of memory address allowed for reading
              integer DcmDspReadMemoryRangeHigh: 0..4294967294, scope=ECU, set at link in variant link-time / pre-compile in variant post-build+pre-compile  # High memory address of a range allowed for reading
              integer DcmDspReadMemoryRangeLow: 0..4294967294, scope=ECU, set at link in variant link-time / pre-compile in variant post-build+pre-compile  # Low memory address of a range allowed for reading
              function name DcmRbDspReadMemoryRangeUserModeRuleFnc [0..1]: multiplicity set at pre-compile, origin=RB:AR42.1.0.0:2017-01-31, set at pre-compile  # Function name used by the application to perform user specific checks before reading a memory range.In case the checks fails, NRC value set by the application can be returned to the tester. In case the function is not configured for memory range, the DcmAppl API DcmAppl_UserMemoryRangeModeRuleService shall be called.
              reference DcmDspReadMemoryRangeModeRuleRef [0..1]: scope=ECU, multiplicity set at link in variant link-time / pre-compile in variant post-build+pre-compile, set at link in variant link-time / pre-compile in variant post-build+pre-compile, destination=DcmModeRule  # Reference to DcmDspModeRule | Mode rule which controls read access on this memory address. If there is no reference, no check of the mode rule shall be done.
              reference DcmDspReadMemoryRangeSecurityLevelRef [0..*]: scope=ECU, multiplicity set at link in variant link-time / pre-compile in variant post-build+pre-compile, set at link in variant link-time / pre-compile in variant post-build+pre-compile, destination=DcmDspSecurityRow  # Link to the Security Access Levels needed for read access on this memory address. If there is no reference, no check of security level shall be done.
              reference DcmDspReadMemoryRangeSessionLevelRef [0..*]: multiplicity set at link in variant link-time / pre-compile in variant post-build+pre-compile, set at link in variant link-time / pre-compile in variant post-build+pre-compile, destination=DcmDspSessionRow  # Link to the Session Levels needed for read access on this memory address. User can configure multiple DcmDspReadMemoryRangeSessionLevelRef for read access on this memory address. If reference is provided, then read access on this memory address shall be enabled only in the configured session levels. No session level check shall be done before read access on this memory address, if no reference is provided.
            container DcmDspWriteMemoryRangeByLabelInfo [0..*]  # Provides a memory range allowed for Writing via labels (lower and higher address configured as strings). | This container contains the configuration of the memory range allowed for Writing
              string DcmDspWriteMemoryRangeByLabelHigh: origin=AR42.1.0.0:2017-01-31, set at link in variant link-time / pre-compile in variant post-build+pre-compile  # Higher memory address of a range allowed for Writing. The address can be entered only in string format and the corresponding macro definition should be included in DcmAppl.h file
              string DcmDspWriteMemoryRangeByLabelLow: origin=AR42.1.0.0:2017-01-31, set at link in variant link-time / pre-compile in variant post-build+pre-compile  # Lower memory address of a range allowed for Writing. The address can be entered only in string format and the corresponding macro definition should be included in DcmAppl.h file
              function name DcmRbDspWriteMemoryRangeUserModeRuleFnc [0..1]: multiplicity set at link in variant link-time+post-build / pre-compile in variant pre-compile, origin=RB:AR42.1.0.0:2017-01-31, set at pre-compile  # Function name used by the application to perform user specific checks before writing to a memory range.In case the checks fails, NRC value set by the application can be returned to the tester. In case the function is not configured for memory range, the DcmAppl API DcmAppl_UserMemoryRangeModeRuleService shall be called.
              reference DcmDspWriteMemoryRangeModeRuleRef [0..1]: multiplicity set at link in variant link-time+post-build / pre-compile in variant pre-compile, origin=AR42.1.0.0:2017-01-31, set at link in variant link-time / pre-compile in variant post-build+pre-compile, destination=DcmModeRule  # Reference to DcmDspModeRule which controls Write access on this memory address. If there is no reference, no check of the mode rule shall be done. Refer container DcmProcessingConditions->DcmModeRule for more information regarding mode rules | Mode rule which controls Write access on this memory address. If there is no reference, no check of the mode rule shall be done.
              reference DcmDspWriteMemoryRangeSecurityLevelRef [0..*]: multiplicity set at link in variant link-time+post-build / pre-compile in variant pre-compile, origin=AR42.1.0.0:2017-01-31, set at link in variant link-time / pre-compile in variant post-build+pre-compile, destination=DcmDspSecurityRow  # Link to the Security Access Levels needed for Write access on this memory address. User can configure multiple DcmDspWriteMemoryRangeSecurityLevelRef for Write access on this memory range. If reference is provided, then Write access on this memory address shall be allowed only in the configured security levels. Write access on this memory address will be allowed in all security levels, if no reference is provided.
              reference DcmDspWriteMemoryRangeSessionLevelRef [0..*]: multiplicity set at link in variant link-time+post-build / pre-compile in variant pre-compile, origin=RB:AR42.1.0.0:2017-01-31, set at link in variant link-time / pre-compile in variant post-build+pre-compile, destination=DcmDspSessionRow  # Link to the Session Levels needed for write access on this memory address. User can configure multiple DcmDspWriteMemoryRangeSessionLevelRef for write access on this memory address. If reference is provided, then write access on this memory address shall be enabled only in the configured session levels. No session level check shall be done before write access on this memory address, if no reference is provided.
            container DcmDspWriteMemoryRangeInfo [0..*]  # Provides the range of memory address allowed for writting.
              integer DcmDspWriteMemoryRangeHigh: 0..4294967294, scope=ECU, set at link in variant link-time / pre-compile in variant post-build+pre-compile  # High memory address of a range allowed for writting.
              integer DcmDspWriteMemoryRangeLow: 0..4294967294, scope=ECU, set at link in variant link-time / pre-compile in variant post-build+pre-compile  # Low memory address of a range allowed for writting
              function name DcmRbDspWriteMemoryRangeUserModeRuleFnc [0..1]: multiplicity set at pre-compile, origin=RB:AR42.1.0.0:2017-01-31, set at pre-compile  # Function name used by the application to perform user specific checks before writing to a memory range.In case the checks fails, NRC value set by the application can be returned to the tester. In case the function is not configured for memory range, the DcmAppl API DcmAppl_UserMemoryRangeModeRuleService shall be called.
              reference DcmDspWriteMemoryRangeModeRuleRef [0..1]: scope=ECU, multiplicity set at link in variant link-time / pre-compile in variant post-build+pre-compile, set at link in variant link-time / pre-compile in variant post-build+pre-compile, destination=DcmModeRule  # Reference to DcmDspModeRule | Mode rule which controls write access on this memory address. If there is no reference, no check of the mode rule shall be done.
              reference DcmDspWriteMemoryRangeSecurityLevelRef [0..*]: scope=ECU, multiplicity set at link in variant link-time / pre-compile in variant post-build+pre-compile, set at link in variant link-time / pre-compile in variant post-build+pre-compile, destination=DcmDspSecurityRow  # Link to the Security Access Levels needed for write access on this memory address. If there is no reference, no check of security level shall be done.
              reference DcmDspWriteMemoryRangeSessionLevelRef [0..*]: multiplicity set at link in variant link-time / pre-compile in variant post-build+pre-compile, set at link in variant link-time / pre-compile in variant post-build+pre-compile, destination=DcmDspSessionRow  # Link to the Session Levels needed for write access on this memory address. User can configure multiple DcmDspWriteMemoryRangeSessionLevelRef for write access on this memory address. If reference is provided, then write access on this memory address shall be enabled only in the configured session levels. No session level check shall be done before write access on this memory address, if no reference is provided.
            container DcmRbDspDownloadMemoryRangeInfo [0..*]  # Provides the range of memory address allowed for download
              integer DcmRbDspDownloadMemoryRangeHigh: 0..4294967294, origin=RB:AR42.1.0.0:2017-01-31, set at link in variant link-time / pre-compile in variant post-build+pre-compile  # High memory address of a range allowed for download
              integer DcmRbDspDownloadMemoryRangeLow: 0..4294967294, origin=RB:AR42.1.0.0:2017-01-31, set at link in variant link-time / pre-compile in variant post-build+pre-compile  # Low memory address of a range allowed for download.
              reference DcmRbDspDownloadMemoryRangeSecurityLevelRef [0..*]: multiplicity set at link in variant link-time / pre-compile in variant post-build+pre-compile, origin=RB:AR42.1.0.0:2017-01-31, set at link in variant link-time / pre-compile in variant post-build+pre-compile, destination=DcmDspSecurityRow  # Link to the Security Access Levels needed for download access on this memory address. If there is no reference, no check of security level shall be done.
            container DcmRbDspUploadMemoryRangeInfo [0..*]  # Provides the range of memory address allowed for upload
              integer DcmRbDspUploadMemoryRangeHigh: 0..4294967294, origin=RB:AR42.1.0.0:2017-01-31, set at link in variant link-time / pre-compile in variant post-build+pre-compile  # High memory address of a range allowed for upload.
              integer DcmRbDspUploadMemoryRangeLow: 0..4294967294, origin=RB:AR42.1.0.0:2017-01-31, set at link in variant link-time / pre-compile in variant post-build+pre-compile  # Low memory address of a range allowed for upload.
              reference DcmRbDspUploadMemoryRangeSecurityLevelRef [0..*]: scope=ECU, multiplicity set at link in variant link-time+post-build / pre-compile in variant pre-compile, origin=RB:AR42.1.0.0:2017-01-31, set at link in variant link-time / pre-compile in variant post-build+pre-compile, destination=DcmDspSecurityRow  # Link to the Security Access Levels needed for upload access on this memory address. If there is no reference, no check of security level shall be done.
        container DcmDspPeriodicDidTransmission [0..1]  # This container contains the configuration for the Periodic Did transmission. | This container exists only if the UDS Service ReadDataByPeriodicIdentifier(0x2A) is configured.
          integer DcmDspMaxPeriodicDidScheduler: 1..255, set at link in variant link-time / pre-compile in variant post-build+pre-compile  # Defines the maximum number of periodicDataIdentifiers that can be scheduled concurrently.
          enumeration DcmRbDspRDPIISOVersion [0..1]: {ISO14229_01_2013_03, ISO14229_01_2006_12}, multiplicity set at link in variant link-time / pre-compile in variant post-build+pre-compile, origin=RB:AR42.1.0.0:2017-01-31, set at link in variant link-time / pre-compile in variant post-build+pre-compile, default-value=ISO14229_01_2013_03  # This parameter indicates the version of ISO the project needs, the projects can choose between ISO version ISO14229-1 2013-03 edition and older edition ISO14229_01_2006_12. This parameter is only relevant to Rdpi and is used to choose the NRC sent when the no. of PDID in a request exceeds the configured DcmDspMaxPeriodicDidToRead. If ISO14229-1 2013-03 edition is chosen NRC 0x13 will be sent, else NRC 0x31 will be sent which is according to ISO14229_01_2006_12. ISO14229_01_2013_03 is the latest released ISO version. If the parameter is left unconfigured , ISO14229_01_2013_03 shall be considered as default | This parameter indicates the version of ISO the project needs, the projects can choose between ISO version ISO14229-1 2013-03 edition and older edition ISO14229_01_2006_12. This parameter is only relevant to Rdpi and is used to choose the NRC sent when the no. of PDID in a request exceeds the configured DcmDspMaxPeriodicDidToRead. If ISO14229-1 2013-03 edition is chosen NRC 0x13 will be sent, else NRC 0x31 will be sent which is according to ISO14229_01_2006_12. ISO14229_01_2013_03 is the latest released ISO version.
          integer DcmRbDspRdpiType2FreeTxPduCount [0..1]: 1..255, multiplicity set at pre-compile, origin=RB:AR42.1.0.0:2017-01-31, set at pre-compile, default-value=10  # This parameter indicates the number of main function calls available for Dcm before releasing the TxPdu in case of no confirmation from the lower layers. For example if this value is configured as 5 and say DcmTasktime is 10ms, 50 msecs of time is available for the confirmation to be received, if no confirmation is received the TxPduID is released for later transmission. This parameter has to be configured to a value greater than the timeout value for RDPI available in the Tp Modules
        container DcmDspPeriodicTransmission [0..1]  # This container contains the configuration (parameters) for Periodic Transmission Processing.
          float DcmDspPeriodicTransmissionFastRate [0..1]: 1E-4..0.255, multiplicity set at pre-compile, set at link in variant link-time / pre-compile in variant post-build+pre-compile  # This parameter give the transmission rate of the requested periodicDataIdentifiers to be used if the parameter transmissionMode given in the ReadDataByPeriodicID request is equal to 0x03 ("sendAtFastRate"). This parameter value in seconds have to be configured as a multiple of DcmTaskTime. | min: A negative value and zero is not allowed.
          float DcmDspPeriodicTransmissionMediumRate [0..1]: 1E-4..0.255, multiplicity set at pre-compile, set at link in variant link-time / pre-compile in variant post-build+pre-compile  # This parameter give the transmission rate of the requested periodicDataIdentifiers to be used if the parameter transmissionMode given in the ReadDataByPeriodicID request is equal to 0x02 ("sendAtMediumRate"). This parameter value in seconds have to be configured as a multiple of DcmTaskTime. | min: A negative value and zero is not allowed.
          float DcmDspPeriodicTransmissionSlowRate [0..1]: 1E-4..0.255, multiplicity set at pre-compile, set at link in variant link-time / pre-compile in variant post-build+pre-compile  # This parameter give the transmission rate of the requested periodicDataIdentifiers to be used if the parameter transmissionMode given in the ReadDataByPeriodicID request is equal to 0x01 ("sendAtSlowRate"). This parameter value in seconds have to be configured as a multiple of DcmTaskTime. | min: A negative value and zero is not allowed.
        container DcmDspPid [0..*]  # This container defines the availability of a PID to the DCM.
          integer DcmDspPidIdentifier: 0..255, scope=ECU, set at link in variant link-time / pre-compile in variant post-build+pre-compile  # 1 byte Identifier of the PID | Within each DcmConfigSet all DcmDspPidIdentifier values shall be unique.
          enumeration DcmDspPidService: {DCM_SERVICE_01, DCM_SERVICE_01_02, DCM_SERVICE_02}, scope=ECU, set at link in variant link-time / pre-compile in variant post-build+pre-compile  # Allow to indicate if this PID is used for service $01 or/and $02.
          integer DcmDspPidSize: 0..255, scope=ECU, set at link in variant link-time / pre-compile in variant post-build+pre-compile  # Length of the PID in byte.
          boolean DcmDspPidUsed [0..0]: scope=ECU, set at link in variant link-time / post-build in variant post-build / pre-compile in variant pre-compile, with-auto=true  # Allow to activate or deactivate the usage of a PID, for multi purpose ECUs | true = PID available false = PID not available
          container DcmDspPidData [1..*]  # This container defines the parameter for a Signal in the PID.
            integer DcmDspPidDataPos: 0..2040, scope=ECU, set at link in variant link-time / pre-compile in variant post-build+pre-compile  # This is the position in bit of the PID structure and will not start at position 0 in case a support information is availabe (for bit-mapped PIDs).
            integer DcmDspPidDataSize [0..1]: 0..2040, scope=ECU, multiplicity set at link in variant link-time / pre-compile in variant post-build+pre-compile, set at link in variant link-time / pre-compile in variant post-build+pre-compile  # Length of data associated to the PID in bit.
            container DcmDspPidDataSupportInfo [0..1]  # This container defines the supported information.
              integer DcmDspPidDataSupportInfoBit: 0..255, scope=ECU, set at link in variant link-time / pre-compile in variant post-build+pre-compile  # referenced Bit of the SupportInfo
              reference DcmDspPidDataSupportInfoRef: scope=ECU, set at link in variant link-time / pre-compile in variant post-build+pre-compile, destination=DcmDspPidSupportInfo  # Reference to DcmDspPidSupportInfo
            container DcmDspPidService01 [0..1]  # Contains specific configuration parameter of PID for service $01. This container exists only if DcmDspPidService is set to DCM_SERVICE_01 or DCM_SERVICE_01_02.
              enumeration DcmDspPidDataEndianness [0..1]: {BIG_ENDIAN, LITTLE_ENDIAN, OPAQUE}, scope=ECU, multiplicity set at pre-compile, set at pre-compile  # Defines the endianness of the data belonging to a PID. | If no DcmDspPidDataEndianness is defined the value of DcmDspDataDefaultEndianness is applicable.
              function name DcmDspPidDataReadFnc [0..1]: scope=ECU, multiplicity set at pre-compile, set at pre-compile  # Function name for reading PID data value. | This is only relevant if DcmDspPidDataUsePort==USE_DATA_SYNCH_FNC. This parameter is related to the interface Xxx_ReadData.
              enumeration DcmDspPidDataType: {BOOLEAN, SINT16, SINT16_N, SINT32, SINT32_N, SINT8, SINT8_N, UINT16, UINT16_N, UINT32, UINT32_N, UINT8, UINT8_N}, scope=ECU, multiplicity set at link in variant link-time / pre-compile in variant post-build+pre-compile, set at link in variant link-time / pre-compile in variant post-build+pre-compile  # Provide the implementation data type of data belonging to a PID.
              enumeration DcmDspPidDataUsePort: {USE_DATA_SENDER_RECEIVER, USE_DATA_SYNCH_CLIENT_SERVER, USE_DATA_SYNCH_FNC}, scope=ECU, set at pre-compile  # If this parameter is set to USE_DATA_SYNCH_FNC, the DCM will use the function defined in DcmDspPidDataReadFnc to get the PID data value. | If this parameter is set to USE_DATA_SYNCH_CLIENT_SERVER, the DCM will have an R-Port requiring the interface DataServices_{Data}. If this parameter is set to USE_DATA_SENDER_RECEIVER, the DCM will have an R-Port requiring a SenderReceiverInterface The R-Port is named DataServices_{Data} where {Data} is the name of the container DcmDspPidData.
            container DcmDspPidService02 [0..1]  # Contains specific configuration parameter of PID for service $02. This container exists only if DcmDspPidService is set to DCM_SERVICE_02 or DCM_SERVICE_01_02.
              reference DcmDspPidDataDemRef [0..1]: scope=ECU, multiplicity set at link in variant link-time / pre-compile in variant post-build+pre-compile, set at link in variant link-time / pre-compile in variant post-build+pre-compile, destination=DemPidDataElement  # Reference to DemPidDataElement in DEM configuration. Allows to link the DCM PID and DEM PID configuration for Mode $02.
              reference DcmRbDspPidDemDataElementClassRef [0..1]: multiplicity set at pre-compile, origin=RB:AR42.1.0.0:2017-01-31, set at pre-compile, destination=DemExternalCSDataElementClass  # Reference to DemDataElementClass in DEM configuration.Allows to link the DCM PID and DEM PID configuration for Mode $02.
          container DcmDspPidSupportInfo [0..*]  # This container defines the support information (typically byte A) to declare the usability of the data bytes within the so-called bit-mapped PIDs (e.g. PID$68).
            integer DcmDspPidSupportInfoLen: 0..255, scope=ECU, set at link in variant link-time / pre-compile in variant post-build+pre-compile  # Length of the supported information in bytes.
            integer DcmDspPidSupportInfoPos: 0..255, scope=ECU, set at link in variant link-time / pre-compile in variant post-build+pre-compile  # Position of the supported information in bytes.
        container DcmDspRequestControl [0..*]  # This container contains the configuration (parameters) of the "Request control of on-board system, test or component" service (Service $08). | The DCM will request the control using an R-Port requiring a PortInteface RequestControlServices_{Tid}. The R-Port is named RequestControlServices_{Tid} where {Tid} is the name of the container DcmDspRequestControl.
          integer DcmDspRequestControlInBufferSize: 0..255, scope=ECU, set at link in variant link-time / pre-compile in variant post-build+pre-compile  # Number of bytes to be provided in the input buffer of the interface RequestControlServices_{Tid} for OBD Service $08
          integer DcmDspRequestControlOutBufferSize: 0..255, scope=ECU, set at link in variant link-time / pre-compile in variant post-build+pre-compile  # Number of bytes to be provided in the output buffer of the interface RequestControlServices_{Tid} for OBD Service $08
          integer DcmDspRequestControlTestId: 0..255, scope=ECU, set at link in variant link-time / pre-compile in variant post-build+pre-compile  # Test Id for Service $08
          function name DcmRbDspRequestControlFnc [0..1]: multiplicity set at pre-compile, origin=RB:AR42.1.0.0:2017-01-31, set at pre-compile  # Function name for reading value by TID (DcmDspRequestControlFnc-function). This is only relevant if DcmDspRequestControlUsePort==FALSE.
          boolean DcmRbDspRequestControlUsePort: origin=RB:AR42.1.0.0:2017-01-31, set at pre-compile  # If this is false, the DCM will use the function defined in DcmDspRequestControlFnc. If this is true, R-Port requiring the interface. The name of this port is the name of the container.
        container DcmDspRequestFileTransfer [0..0]  # This container contains the configuration RequestFileTransfer. | This container only exists if RequestFileTransfer is configured.
          integer DcmRequestFileTransferFileSizeParameterLength [0..0]: 0..255, scope=ECU, set at pre-compile, with-auto=true  # Length of the fileSizeCompressed and fileSizeUncompressedOrDirInfoLength in the Dcm_ProcessRequestFileTransfer operation and response message.
          integer DcmRequestFileTransferLengthFormatIdentifier [0..0]: 0..255, scope=ECU, set at pre-compile, with-auto=true  # Defines the length (number of bytes) of the maxNumberOfBlockLength parameter.
        container DcmDspRoe [0..1]  # Provide the configuration of the ResponseOnEvent mechanism.
          float DcmDspRoeInterMessageTime: 0..5, set at link in variant link-time / pre-compile in variant post-build+pre-compile  # Provide the minimum time in seconds between two transmissions of ROE event. It is used for the delay between two different consecutive Roe transmissions.
          boolean DcmRbDspWindowTimeInReportEvents: origin=RB:AR42.1.0.0:2017-07-31  # If set to TRUE the Event Window Time will be the part of Roe request for event type ReportActiveEvents. If set to FALSE the Event Window Time will not be the part of Roe request for event type ReportActiveEvents;
          container DcmDspRoeEvent [1..255]  # This container contains a list of all supported Roe eventTypeRecords which are accepted by this ECU. | At most one DcmDspRoeEvent container is allowed to define a DcmDspRoeEventProperties container with the choice DcmDspRoeOnDTCStatusChange.
            integer DcmDspRoeEventId: 0..254, set at pre-compile, symbolic-name-value=true  # EventId for a global identification of this ROE event it is used within APIs Dcm_TriggerOnEvent() and the ModeDeclarationGroup. | The ratio Ids should be sequentially ordered beginning with 0 and no gaps in between.
            enumeration DcmDspRoeInitialEventStatus: {DCM_ROE_CLEARED, DCM_ROE_STOPPED}, set at link in variant link-time / pre-compile in variant post-build+pre-compile, default-value=DCM_ROE_CLEARED  # Initial Roe status of this RoeEvent
            choice container DcmDspRoeEventProperties  # This container contains the properties of Roe eventTypeRecords. | In one DcmDspRoeEventProperties container one DcmDspRoeOnDTCStatusChange or DcmDspRoeOnChangeOfDataIdentifier container shall be defined.
              container DcmDspRoeOnChangeOfDataIdentifier [0..1]  # This container contains configuration of a eventTypeRecord onChangeOfDataIdentifier accepted by this ECU.
                reference DcmDspRoeDidRef: set at link in variant link-time / pre-compile in variant post-build+pre-compile, destination=DcmDspDid  # Reference to a Did which is watched.
              container DcmDspRoeOnDTCStatusChange [0..1]  # This container contains configuration of a eventTypeRecord onDTCStatusChange accepted by this ECU. | Please note that currently are no additional parameters for DcmDspRoeOnDTCStatusChange are defined. Therefore the existence of the container denotes the choice.
          container DcmDspRoeEventWindowTime [1..*]  # This container configures the available EventWindowTime in this Ecu. | This container contains a sub-set of EventWindowTimes supported by the Dcm, to limit the Ecu resources.
            enumeration DcmDspRoeEventWindowTime: {DCM_ROE_EVENT_WINDOW_CURRENT_CYCLE, DCM_ROE_EVENT_WINDOW_INFINITE, DCM_ROE_EVENT_WINDOW_CURRENT_AND_FOLLOWING_CYCLE}, set at pre-compile  # Value of the EventWindowTime
            boolean DcmDspRoeStorageState: set at pre-compile  # If this parameter is set to TRUE the StorageStateBit will be evaluated if this EventWindowTime is requested.
        container DcmDspRoutine [0..*]  # This container contains the configuration (parameters) for Routines
          integer DcmDspRoutineIdentifier: 0..65535, scope=ECU, set at link in variant link-time / pre-compile in variant post-build+pre-compile  # 2 bytes Identifier of the RID | Within each DcmConfigSet all DcmDspRoutineIdentifier values shall be unique.
          integer DcmDspRoutineInfoByte [0..0]: 0..255, scope=ECU, set at link in variant link-time / pre-compile in variant post-build+pre-compile  # Manufacturer specific value reported to the tester for the record identifiers 0xE000 to OxE1FF. (OBD use cases)
          boolean DcmDspRoutineUsePort: scope=ECU, multiplicity set at pre-compile, set at pre-compile  # If this parameter is set to true, the DCM uses a port requiring a PortInterface RoutineServices_{RoutineName}. | The R-Port is named RoutineServices_{RoutineName} where {RoutineName} is the name of the container DcmDspRoutine In that case, the configuration must not provide function names in DcmDspStartRoutineFnc, DcmDspStopRoutineFnc or DcmDspRequestResultsRoutineFnc. If this is false, the DCM expects to find the names of the functions to be used in DcmDspStartRoutineFnc, DcmDspStopRoutineFnc or DcmDspRequestResultsRoutineFnc.
          boolean DcmDspRoutineUsed [0..0]: scope=ECU, set at link in variant link-time / post-build in variant post-build / pre-compile in variant pre-compile, with-auto=true  # Allow to activate or deactivate the usage of a Routine, for multi purpose ECUs | true = Routine available false = Routine not available
          function name DcmRbDspIsRIDAvailableFnc [0..1]: multiplicity set at pre-compile, origin=RB:AR42.1.0.0:2017-01-31, set at pre-compile  # Function name to request the application to check if the routine identifier (RID) requested is supported in the variant.The user can leave the field empty if the check is not required for this RID
          boolean DcmRbDspReqSequenceErrorEnabled [0..1]: multiplicity set at pre-compile, origin=RB:AR42.1.0.0:2017-01-31, set at pre-compile, default-value=true  # Indicates Request Sequence Error (NRC 0x24) shall be triggered for a RequestResults/Stop subfunction with/without a prior Start subfunction request for Routines which supports both RequestResults and Start subfunctions/ Stop and Start Subfunctions. True :For a Routine which supports both RequestResults/Stop and Start Subfunction,NRC 0x24 shall be triggered if Routine Control tester request with RequestResults subfunction(0x03)/Stop subfunction(0x02) comes for a Routine which is not started (without a prior Routine Control request with Start subfunction(0x01)) False:For a Routine which supports both RequestResults/Stop and Start Subfunction,positive response shall be triggered if valid Routine Control tester request with RequestResults subfunction(0x03)/Stop subfunction(0x02) comes without a prior Routine Control request with Start subfunction(0x01) Dependency: Applicable only if Start subfunction (DcmDspStartRoutineSupported configured as TRUE or left unconfigured) and RequestResults subfunction(DcmDspRequestResultsRoutineSupported configured as TRUE)/Stop subfunction(DcmDspStopRoutineSupported configured as TRUE) is supported for RID, otherwise not valid.If the parameter is left unconfigured , default value will be considered as TRUE and the request sequence error will be enabled. | True:For a Routine which supports both RequestResults/Stop and Start Subfunction,NRC 0x24 shall be triggered if Routine Control tester request with RequestResults subfunction(0x03/Stop subfunction(0x02) comes for a Routine which is not started (without a prior Routine Control request with Start subfunction(0x01)) False:For a Routine which supports both RequestResults/Stop and Start Subfunction,positive response shall be triggered if Routine Control tester request with RequestResults subfunction(0x03)/Stop subfunction(0x02) comes without a prior Routine Control request with Start subfunction(0x01)
          boolean DcmRbDspRoutineUseAsynchronousServerCallPoint [0..1]: multiplicity set at link in variant link-time+post-build / pre-compile in variant pre-compile, origin=RB:AR42.13.0.0:2017-01-31, set at link in variant link-time+post-build / pre-compile in variant pre-compile, default-value=false  # Only relevant in case DcmDspRoutineUsePort is set to TRUE.This parameter is used to select the type of Server Handling required.Set the value to TRUE for Asynchronous server call point handling else Synchronous server call point handling is carried out
          function name DcmRbDspRoutineUserRoutineModeRuleFnc [0..1]: multiplicity set at pre-compile, origin=RB:AR42.1.0.0:2017-01-31, set at pre-compile  # Function name used by the application to perform user specific checks before accessing a Routine.In case the checks fails, NRC value set by the application can be returned to the tester. In case the function is not configured for the Routine, the DcmAppl API DcmAppl_UserRIDModeRuleService shall be called.
          boolean DcmRbDspStopRoutineOnSessionChange [0..1]: multiplicity set at pre-compile, origin=RB:AR42.1.0.0:2017-01-31, set at pre-compile, default-value=false  # Indicates if the StopRoutine operation needs to be performed on any session change. True = Stop this Routine if it is active on transition to default session / Stop this routine if it is not supported in the new nondefault session. False = No action on session transitions Dependency: Applicable only if StopRoutine operation is supported for RID (DcmDspStopRoutineSupported = true), otherwise not valid.If the parameter is left unconfigured FALSE will be considered as the default value. | true = stopRoutine is supported on session change false = stopRoutine is not supported on session change
          reference DcmDspCommonAuthorizationRef [0..0]: scope=ECU, multiplicity set at link in variant link-time / pre-compile in variant post-build+pre-compile, set at link in variant link-time / pre-compile in variant post-build+pre-compile, destination=DcmDspCommonAuthorization  # Reference to DcmDspCommonAuthorization | Common authorization configuration taken from the referenced DcmDspCommonAuthorization. If there is no reference, no check on the commonly defined authorization conditions shall be done.
          reference DcmDspRoutineTidRef [0..0]: scope=ECU, multiplicity set at link in variant link-time / pre-compile in variant post-build+pre-compile, set at link in variant link-time / pre-compile in variant post-build+pre-compile, destination=DcmDspRequestControl  # Reference to DcmDspRequestControl | DcmDspRequestControl contains the configuration (parameters) of the "Request control of on-board system, test or component" service (Service $08).
          container DcmDspRequestRoutineResults [0..1]  # Provides the configuration of RequestResult subservice for RoutineControl service. | Existence indicates that the RequestRoutineResults in the RoutineControl is supported.
            function name DcmDspRequestRoutineResultsFnc [0..1]: scope=ECU, multiplicity set at pre-compile, set at pre-compile  # Function name for request to application the results of a routine. (Routine_RequestResults-function) | This parameter is related to the interface Xxx_RequestResults.
            reference DcmDspRequestRoutineResultsCommonAuthorizationRef [0..1]: scope=ECU, multiplicity set at link in variant link-time / pre-compile in variant post-build+pre-compile, set at link in variant link-time / pre-compile in variant post-build+pre-compile, destination=DcmDspCommonAuthorization  # Reference to DcmDspCommonAuthorization | Common authorization configuration taken from the referenced DcmDspRequestRoutineResultsCommonAuthorizationRef. If there is no reference, no check on the commonly defined authorization conditions shall be done to get the routine result.
            container DcmDspRequestRoutineResultsOut [0..1]  # Provide description of output parameter of RequestResult subservice for RoutineControl service.
              container DcmDspRequestRoutineResultsOutSignal [1..*]: requires-index=true  # Provide description of a routine signal used in RoutineControl service. | The ordering defined via the index attribute of the subcontainers in this list represents the order of the dataOutN elements in the XXX_RequestResult function call.
                enumeration DcmDspRoutineSignalEndianness [0..1]: {BIG_ENDIAN, LITTLE_ENDIAN, OPAQUE}, scope=ECU, multiplicity set at link in variant link-time / pre-compile in variant post-build+pre-compile, set at link in variant link-time / pre-compile in variant post-build+pre-compile  # Defines the endianness of the data belonging to a Request Routine Response Out Signal. | If no DcmDspRoutineSignalEndianness is defined the value of DcmDspDataDefaultEndianness is applicable.
                integer DcmDspRoutineSignalLength [0..1]: 0..65535, scope=ECU, multiplicity set at link in variant link-time / pre-compile in variant post-build+pre-compile, set at link in variant link-time / pre-compile in variant post-build+pre-compile  # Provide the length in bits of the signal in the RoutineControl request/response
                integer DcmDspRoutineSignalPos: 0..65535, scope=ECU, set at link in variant link-time / pre-compile in variant post-build+pre-compile  # Provide the position of the signal in the RoutineControl request/response. | The position is defined in bits.
                enumeration DcmDspRoutineSignalType: {BOOLEAN, SINT16, SINT16_N, SINT32, SINT32_N, SINT8, SINT8_N, UINT16, UINT16_N, UINT32, UINT32_N, UINT8, UINT8_N, VARIABLE_LENGTH}, scope=ECU, set at link in variant link-time / pre-compile in variant post-build+pre-compile  # Provide the type of the signal in the RoutineControl request/response.
                choice container DcmDspArgumentScaling [0..1]  # This container contains the configuration (parameters) of an alternative Diagnosis Representation. Out if this the scaling between Diagnosis and ECU internal representation and vice versa can be calculated.
                  container DcmDspAlternativeArgumentData [0..0]  # This container contains the configuration (parameters) of an alternative Diagnosis Representation by the means of a ArgumentDataPrototype.
                    foreign reference DcmDataElement [0..0]: set at pre-compile, destination-type=ARGUMENT-DATA-PROTOTYPE  # Alternative Diagnosis Representation for the data defined by the means of a ArgumentDataPrototype
                  container DcmDspAlternativeDataProps [0..1]  # This container contains the configuration (parameters) of an alternative Diagnosis Representation by the means of ECU configuration parameters.The physical unit of the alternative data representation is defined by the DataPrototype referenced by DcmDspExternalSRDataElementClass. Additionally the definition of a text table mapping can be a defined for DcmDspDataTypeCategory TEXTTABLE and SCALE_LINEAR_AND_TEXTTABLE | The physical unit of the alternative data representation is defined by the DataPrototype referenced by DcmDspExternalSRDataElementClass. Additionally the definition of a text table mapping can be a defined for DcmDspDataTypeCategory TEXTTABLE and SCALE_LINEAR_AND_TEXTTABLE
                    container DcmDspLinearScale  # This container contains the configuration (parameters) of an linear scale of the alternative Diagnosis Representation.
                      float DcmDspDiagnosisRepresentationDataLowerRange: -Inf..Inf, scope=ECU, set at pre-compile  # Lower Range for this scale of the data in the alternative Diagnosis Representation.
                      float DcmDspDiagnosisRepresentationDataOffset: 0..Inf, scope=ECU, set at pre-compile, default-value=0  # Data offset of the alternative Diagnosis Representation for this scale.
                      float DcmDspDiagnosisRepresentationDataResolution: 0..Inf, scope=ECU, set at pre-compile  # Data resolution of the alternative Diagnosis Representation for this scale.
                      float DcmDspDiagnosisRepresentationDataUpperRange: -Inf..Inf, set at pre-compile  # Upper Range for this scale of the data in the alternative Diagnosis Representation.
                  container DcmDspAlternativeDataType [0..1]  # This container contains the configuration (parameters) of an alternative Diagnosis Representation by the means of an ApplicationDataType. | Additionally the definition of a text table mapping can be a defined for ApplicationDataTypes of category TEXTTABLE and SCALE_LINEAR_AND_TEXTTABLE.
                    foreign reference DcmApplicationDataType: set at pre-compile, destination-type=APPLICATION-DATA-TYPE  # Alternative Diagnosis Representation for the data defined by the means of a ApplicationPrimitiveDataType of category VALUE or BOOLEAN.
                    container DcmDspTextTableMapping [0..0]  # This container contains the configuration (parameters) of the mapping a DataPrototype typed by AutosarDataType that refer to a CompuMethods of category TEXTTABLE or SCALE_LINEAR_AND_TEXTTABLE. | Each DcmDspTextTableMapping defines a value pair which is used to map the ECU internal value (DcmDspInternalDataValue) to the vale used in the diagnosis representation (DcmDspDiagnosisRepresentationDataValue) and vice versa. The set of all DcmDspTextTableMappings defines the whole mapping of an data.
                      integer DcmDspDiagnosisRepresentationDataValue [0..0]: 0..18446744073709551615, scope=ECU, set at pre-compile, with-auto=true  # The data value in the diagnosis representation.
                      integer DcmDspInternalDataValue [0..0]: 0..18446744073709551615, scope=ECU, set at pre-compile  # The ECU internal data value.
            container DcmRbDspRequestRoutineResultsIn [0..1]  # Provide description of input parameter of RequestResults subservice for RoutineControl service.
              container DcmRbDspRequestRoutineResultsInSignal [1..*]: requires-index=true  # Provide description of a routine signal used in RoutineControl service.
                enumeration DcmRbDspRoutineSignalEndianness [0..1]: {BIG_ENDIAN, LITTLE_ENDIAN, OPAQUE}, multiplicity set at link in variant link-time / pre-compile in variant post-build+pre-compile, set at link in variant link-time / pre-compile in variant post-build+pre-compile  # Defines the endianness of the data belonging to a Request Routine Response In Signal.If projects configures OPAQUE no endianness conversion will be supported/applicable | If no DcmDspRoutineSignalEndianness is defined the value of DcmDspDataDefaultEndianness is applicable.
                integer DcmRbDspRoutineSignalLength [0..1]: 0..65535, multiplicity set at link in variant link-time / pre-compile in variant post-build+pre-compile, origin=RB:AR42.1.0.0:2017-01-31, set at link in variant link-time / pre-compile in variant post-build+pre-compile  # Provide the length of the Routine signal in bits.If DcmDspRoutineRequestResINSignal is configured as VARIABLE_LENGTH, then Dcm shall update the currentDataLength parameter of the configured DcmAppl API (DcmDspRequestResultsRoutineFnc) in BYTES before calling the API .CurrentDataLength parameter signifies the actual length of the variable length signal positioned at the end in request.
                integer DcmRbDspRoutineSignalPos: 0..65535, origin=RB:AR42.1.0.0:2017-01-31, set at link in variant link-time / pre-compile in variant post-build+pre-compile  # Provide the position of the signal in the RoutineControl request/response.The position is defined in bits. | The position is defined in bits.
                enumeration DcmRbDspRoutineSignalType: {BOOLEAN, SINT16, SINT16_N, SINT32, SINT32_N, SINT8, SINT8_N, UINT16, UINT16_N, UINT32, UINT32_N, UINT8, UINT8_N, VARIABLE_LENGTH}, origin=RB:AR42.1.0.0:2017-01-31, set at link in variant link-time / pre-compile in variant post-build+pre-compile  # Provide the type of the signal in the RoutineControl request/response.
          container DcmDspStartRoutine [0..1]  # Provides the configuration of Start subservice for RoutineControl service.
            function name DcmDspStartRoutineFnc [0..1]: scope=ECU, multiplicity set at pre-compile, set at pre-compile  # Function name for request to application to start a routine. (Routine_Start-function) | This parameter is related to the interface Xxx_Start.
            reference DcmDspStartRoutineCommonAuthorizationRef [0..1]: scope=ECU, multiplicity set at link in variant link-time / pre-compile in variant post-build+pre-compile, set at link in variant link-time / pre-compile in variant post-build+pre-compile, destination=DcmDspCommonAuthorization  # Reference to DcmDspCommonAuthorization | Common authorization configuration taken from the referenced DcmDspStartRoutineCommonAuthorizationRef. If there is no reference, no check on the commonly defined authorization conditions shall be done to start the routine.
            container DcmDspStartRoutineIn [0..1]  # Provide description of input parameter of Start subservice for RoutineControl service
              container DcmDspStartRoutineInSignal [1..*]: requires-index=true  # Provide description of a routine signal used in RoutineControl service. | The ordering defined via the index attribute of the subcontainers in this list represents the order of the dataInN elements in the XXX_Start function call.
                enumeration DcmDspRoutineSignalEndianness [0..1]: {BIG_ENDIAN, LITTLE_ENDIAN, OPAQUE}, scope=ECU, multiplicity set at link in variant link-time / pre-compile in variant post-build+pre-compile, set at link in variant link-time / pre-compile in variant post-build+pre-compile  # Defines the endianness of the data belonging to a Start Routine In Signal. | If no DcmDspRoutineSignalEndianness is defined the value of DcmDspDataDefaultEndianness is applicable.
                integer DcmDspRoutineSignalLength [0..1]: 0..65535, scope=ECU, multiplicity set at link in variant link-time / pre-compile in variant post-build+pre-compile, set at link in variant link-time / pre-compile in variant post-build+pre-compile  # Provide the length in bits of the signal in the RoutineControl request/response
                integer DcmDspRoutineSignalPos: 0..65535, scope=ECU, set at link in variant link-time / pre-compile in variant post-build+pre-compile  # Provide the position of the signal in the RoutineControl request/response. | The position is defined in bits.
                enumeration DcmDspRoutineSignalType: {BOOLEAN, SINT16, SINT16_N, SINT32, SINT32_N, SINT8, SINT8_N, UINT16, UINT16_N, UINT32, UINT32_N, UINT8, UINT8_N, VARIABLE_LENGTH}, scope=ECU, set at link in variant link-time / pre-compile in variant post-build+pre-compile  # Provide the type of the signal in the RoutineControl request/response.
                choice container DcmDspArgumentScaling [0..1]  # This container contains the configuration (parameters) of an alternative Diagnosis Representation. Out if this the scaling between Diagnosis and ECU internal representation and vice versa can be calculated.
                  container DcmDspAlternativeDataProps [0..1]  # This container contains the configuration (parameters) of an alternative Diagnosis Representation by the means of ECU configuration parameters.The physical unit of the alternative data representation is defined by the DataPrototype referenced by DcmDspExternalSRDataElementClass. Additionally the definition of a text table mapping can be a defined for DcmDspDataTypeCategory TEXTTABLE and SCALE_LINEAR_AND_TEXTTABLE | The physical unit of the alternative data representation is defined by the DataPrototype referenced by DcmDspExternalSRDataElementClass. Additionally the definition of a text table mapping can be a defined for DcmDspDataTypeCategory TEXTTABLE and SCALE_LINEAR_AND_TEXTTABLE
                    container DcmDspLinearScale  # This container contains the configuration (parameters) of an linear scale of the alternative Diagnosis Representation.
                      float DcmDspDiagnosisRepresentationDataLowerRange: -Inf..Inf, scope=ECU, set at pre-compile  # Lower Range for this scale of the data in the alternative Diagnosis Representation.
                      float DcmDspDiagnosisRepresentationDataOffset: 0..Inf, scope=ECU, set at pre-compile, default-value=0  # Data offset of the alternative Diagnosis Representation for this scale.
                      float DcmDspDiagnosisRepresentationDataResolution: 0..Inf, scope=ECU, set at pre-compile  # Data resolution of the alternative Diagnosis Representation for this scale.
                      float DcmDspDiagnosisRepresentationDataUpperRange: -Inf..Inf, scope=ECU, set at pre-compile  # Upper Range for this scale of the data in the alternative Diagnosis Representation.
                  container DcmDspAlternativeDataType [0..1]  # This container contains the configuration (parameters) of an alternative Diagnosis Representation by the means of an ApplicationDataType. | Additionally the definition of a text table mapping can be a defined for ApplicationDataTypes of category TEXTTABLE and SCALE_LINEAR_AND_TEXTTABLE.
                    foreign reference DcmApplicationDataType: set at pre-compile, destination-type=APPLICATION-DATA-TYPE  # Alternative Diagnosis Representation for the data defined by the means of a ApplicationPrimitiveDataType of category VALUE or BOOLEAN.
                    container DcmDspTextTableMapping [0..0]  # This container contains the configuration (parameters) of the mapping a DataPrototype typed by AutosarDataType that refer to a CompuMethods of category TEXTTABLE or SCALE_LINEAR_AND_TEXTTABLE. | Each DcmDspTextTableMapping defines a value pair which is used to map the ECU internal value (DcmDspInternalDataValue) to the vale used in the diagnosis representation (DcmDspDiagnosisRepresentationDataValue) and vice versa. The set of all DcmDspTextTableMappings defines the whole mapping of an data.
                      integer DcmDspDiagnosisRepresentationDataValue [0..0]: 0..18446744073709551615, scope=ECU, set at pre-compile, with-auto=true  # The data value in the diagnosis representation.
                      integer DcmDspInternalDataValue [0..0]: 0..18446744073709551615, scope=ECU, set at pre-compile  # The ECU internal data value.
            container DcmDspStartRoutineOut [0..1]  # Provide description of output parameter of Start subservice for RoutineControl service.
              container DcmDspStartRoutineOutSignal [1..*]: requires-index=true  # Provide description of a routine signal used in RoutineControl service. | The ordering defined via the index attribute of the subcontainers in this list represents the order of the dataOutN elements in the XXX_Start function call.
                enumeration DcmDspRoutineSignalEndianness [0..1]: {BIG_ENDIAN, LITTLE_ENDIAN, OPAQUE}, scope=ECU, multiplicity set at link in variant link-time / pre-compile in variant post-build+pre-compile, set at link in variant link-time / pre-compile in variant post-build+pre-compile  # Defines the endianness of the data belonging to a Start Routine Out Signal. | If no DcmDspRoutineSignalEndianness is defined the value of DcmDspDataDefaultEndianness is applicable.
                integer DcmDspRoutineSignalLength [0..1]: 0..65535, scope=ECU, multiplicity set at link in variant link-time / pre-compile in variant post-build+pre-compile, set at link in variant link-time / pre-compile in variant post-build+pre-compile  # Provide the length in bits of the signal in the RoutineControl request/response.
                integer DcmDspRoutineSignalPos [0..1]: 0..65535, scope=ECU, multiplicity set at link in variant link-time / pre-compile in variant post-build+pre-compile, set at link in variant link-time / pre-compile in variant post-build+pre-compile  # Provide the position of the signal in the RoutineControl request/response. | The position is defined in bits.
                enumeration DcmDspRoutineSignalType: {BOOLEAN, SINT16, SINT16_N, SINT32, SINT32_N, SINT8, SINT8_N, UINT16, UINT16_N, UINT32, UINT32_N, UINT8, UINT8_N, VARIABLE_LENGTH}, scope=ECU, set at link in variant link-time / pre-compile in variant post-build+pre-compile  # Provide the type of the signal in the RoutineControl request/response.
                choice container DcmDspArgumentScaling [0..1]  # This container contains the configuration (parameters) of an alternative Diagnosis Representation. Out if this the scaling between Diagnosis and ECU internal representation and vice versa can be calculated.
                  container DcmDspAlternativeDataProps [0..1]  # This container contains the configuration (parameters) of an alternative Diagnosis Representation by the means of ECU configuration parameters.The physical unit of the alternative data representation is defined by the DataPrototype referenced by DcmDspExternalSRDataElementClass. Additionally the definition of a text table mapping can be a defined for DcmDspDataTypeCategory TEXTTABLE and SCALE_LINEAR_AND_TEXTTABLE | The physical unit of the alternative data representation is defined by the DataPrototype referenced by DcmDspExternalSRDataElementClass. Additionally the definition of a text table mapping can be a defined for DcmDspDataTypeCategory TEXTTABLE and SCALE_LINEAR_AND_TEXTTABLE
                    container DcmDspLinearScale  # This container contains the configuration (parameters) of an linear scale of the alternative Diagnosis Representation.
                      float DcmDspDiagnosisRepresentationDataLowerRange: -Inf..Inf, scope=ECU, set at pre-compile  # Lower Range for this scale of the data in the alternative Diagnosis Representation.
                      float DcmDspDiagnosisRepresentationDataOffset: 0..Inf, scope=ECU, set at pre-compile, default-value=0  # Data offset of the alternative Diagnosis Representation for this scale.
                      float DcmDspDiagnosisRepresentationDataResolution: 0..Inf, scope=ECU, set at pre-compile  # Data resolution of the alternative Diagnosis Representation for this scale.
                      float DcmDspDiagnosisRepresentationDataUpperRange: -Inf..Inf, scope=ECU, set at pre-compile  # Upper Range for this scale of the data in the alternative Diagnosis Representation.
                  container DcmDspAlternativeDataType [0..1]  # This container contains the configuration (parameters) of an alternative Diagnosis Representation by the means of an ApplicationDataType. | Additionally the definition of a text table mapping can be a defined for ApplicationDataTypes of category TEXTTABLE and SCALE_LINEAR_AND_TEXTTABLE.
                    foreign reference DcmApplicationDataType: set at pre-compile, destination-type=APPLICATION-DATA-TYPE  # Alternative Diagnosis Representation for the data defined by the means of a ApplicationPrimitiveDataType of category VALUE or BOOLEAN.
                    container DcmDspTextTableMapping [0..0]  # This container contains the configuration (parameters) of the mapping a DataPrototype typed by AutosarDataType that refer to a CompuMethods of category TEXTTABLE or SCALE_LINEAR_AND_TEXTTABLE. | Each DcmDspTextTableMapping defines a value pair which is used to map the ECU internal value (DcmDspInternalDataValue) to the vale used in the diagnosis representation (DcmDspDiagnosisRepresentationDataValue) and vice versa. The set of all DcmDspTextTableMappings defines the whole mapping of an data.
                      integer DcmDspDiagnosisRepresentationDataValue [0..0]: 0..18446744073709551615, scope=ECU, set at pre-compile, with-auto=true  # The data value in the diagnosis representation.
                      integer DcmDspInternalDataValue [0..0]: 0..18446744073709551615, scope=ECU, set at pre-compile  # The ECU internal data value.
          container DcmDspStopRoutine [0..1]  # Provides the configuration of Stop subservice for RoutineControl service. | Existence indicates that the StopRoutine in the RoutineControl is supported.
            function name DcmDspStopRoutineFnc [0..1]: scope=ECU, multiplicity set at pre-compile, set at pre-compile  # Function name for request to application to stop a routine. (Routine_Stop-function) | This parameter is related to the interface Xxx_Stop.
            reference DcmDspStopRoutineCommonAuthorizationRef [0..1]: scope=ECU, multiplicity set at link in variant link-time / pre-compile in variant post-build+pre-compile, set at link in variant link-time / pre-compile in variant post-build+pre-compile, destination=DcmDspCommonAuthorization  # Reference to DcmDspCommonAuthorization | Common authorization configuration taken from the referenced DcmDspStopRoutineCommonAuthorizationRef. If there is no reference, no check on the commonly defined authorization conditions shall be done to stop the routine.
            container DcmDspStopRoutineIn [0..1]  # Provide description of input parameter of Stop subservice for RoutineControl service.
              container DcmDspStopRoutineInSignal [1..*]: requires-index=true  # Provide description of a routine signal used in RoutineControl service. | The ordering defined via the index attribute of the subcontainers in this list represents the order of the dataInN elements in the XXX_Stop function call.
                enumeration DcmDspRoutineSignalEndianness [0..1]: {BIG_ENDIAN, LITTLE_ENDIAN, OPAQUE}, scope=ECU, multiplicity set at link in variant link-time / pre-compile in variant post-build+pre-compile, set at link in variant link-time / pre-compile in variant post-build+pre-compile  # Defines the endianness of the data belonging to a Stop Routine In Signal. | If no DcmDspRoutineSignalEndianness is defined the value of DcmDspDataDefaultEndianness is applicable.
                integer DcmDspRoutineSignalLength [0..1]: 0..65535, scope=ECU, multiplicity set at link in variant link-time / pre-compile in variant post-build+pre-compile, set at link in variant link-time / pre-compile in variant post-build+pre-compile  # Provide the length in bits of the signal in the RoutineControl request/response
                integer DcmDspRoutineSignalPos: 0..65535, scope=ECU, set at link in variant link-time / pre-compile in variant post-build+pre-compile  # Provide the position of the signal in the RoutineControl request/response. | The position is defined in bits.
                enumeration DcmDspRoutineSignalType: {BOOLEAN, SINT16, SINT16_N, SINT32, SINT32_N, SINT8, SINT8_N, UINT16, UINT16_N, UINT32, UINT32_N, UINT8, UINT8_N, VARIABLE_LENGTH}, scope=ECU, set at link in variant link-time / pre-compile in variant post-build+pre-compile  # Provide the type of the signal in the RoutineControl request/response.
                choice container DcmDspArgumentScaling [0..1]  # This container contains the configuration (parameters) of an alternative Diagnosis Representation. Out if this the scaling between Diagnosis and ECU internal representation and vice versa can be calculated.
                  container DcmDspAlternativeDataProps [0..1]  # This container contains the configuration (parameters) of an alternative Diagnosis Representation by the means of ECU configuration parameters.The physical unit of the alternative data representation is defined by the DataPrototype referenced by DcmDspExternalSRDataElementClass. Additionally the definition of a text table mapping can be a defined for DcmDspDataTypeCategory TEXTTABLE and SCALE_LINEAR_AND_TEXTTABLE | The physical unit of the alternative data representation is defined by the DataPrototype referenced by DcmDspExternalSRDataElementClass. Additionally the definition of a text table mapping can be a defined for DcmDspDataTypeCategory TEXTTABLE and SCALE_LINEAR_AND_TEXTTABLE
                    container DcmDspLinearScale  # This container contains the configuration (parameters) of an linear scale of the alternative Diagnosis Representation.
                      float DcmDspDiagnosisRepresentationDataLowerRange: -Inf..Inf, scope=ECU, set at pre-compile  # Lower Range for this scale of the data in the alternative Diagnosis Representation.
                      float DcmDspDiagnosisRepresentationDataOffset: 0..Inf, scope=ECU, set at pre-compile, default-value=0  # Data offset of the alternative Diagnosis Representation for this scale.
                      float DcmDspDiagnosisRepresentationDataResolution: 0..Inf, scope=ECU, set at pre-compile  # Data resolution of the alternative Diagnosis Representation for this scale.
                      float DcmDspDiagnosisRepresentationDataUpperRange: -Inf..Inf, scope=ECU, set at pre-compile  # Upper Range for this scale of the data in the alternative Diagnosis Representation.
                  container DcmDspAlternativeDataType [0..1]  # This container contains the configuration (parameters) of an alternative Diagnosis Representation by the means of an ApplicationDataType. | Additionally the definition of a text table mapping can be a defined for ApplicationDataTypes of category TEXTTABLE and SCALE_LINEAR_AND_TEXTTABLE.
                    foreign reference DcmApplicationDataType: set at pre-compile, destination-type=APPLICATION-DATA-TYPE  # Alternative Diagnosis Representation for the data defined by the means of a ApplicationPrimitiveDataType of category VALUE or BOOLEAN.
                    container DcmDspTextTableMapping [0..0]  # This container contains the configuration (parameters) of the mapping a DataPrototype typed by AutosarDataType that refer to a CompuMethods of category TEXTTABLE or SCALE_LINEAR_AND_TEXTTABLE. | Each DcmDspTextTableMapping defines a value pair which is used to map the ECU internal value (DcmDspInternalDataValue) to the vale used in the diagnosis representation (DcmDspDiagnosisRepresentationDataValue) and vice versa. The set of all DcmDspTextTableMappings defines the whole mapping of an data.
                      integer DcmDspDiagnosisRepresentationDataValue [0..0]: 0..18446744073709551615, scope=ECU, set at pre-compile, with-auto=true  # The data value in the diagnosis representation.
                      integer DcmDspInternalDataValue [0..0]: 0..18446744073709551615, scope=ECU, set at pre-compile  # The ECU internal data value.
            container DcmDspStopRoutineOut [0..1]  # Provide description of output parameter of Stop subservice for RoutineControl service.
              container DcmDspStopRoutineOutSignal [1..*]: requires-index=true  # Provide description of a routine signal used in RoutineControl service. | The ordering defined via the index attribute of the subcontainers in this list represents the order of the dataOutN elements in the XXX_Stop function call.
                enumeration DcmDspRoutineSignalEndianness [0..1]: {BIG_ENDIAN, LITTLE_ENDIAN, OPAQUE}, scope=ECU, multiplicity set at link in variant link-time / pre-compile in variant post-build+pre-compile, set at link in variant link-time / pre-compile in variant post-build+pre-compile  # Defines the endianness of the data belonging to a Stop Routine Out Signal. | If no DcmDspRoutineSignalEndianness is defined the value of DcmDspDataDefaultEndianness is applicable.
                integer DcmDspRoutineSignalLength [0..1]: 0..65535, scope=ECU, multiplicity set at link in variant link-time / pre-compile in variant post-build+pre-compile, set at link in variant link-time / pre-compile in variant post-build+pre-compile  # Provide the length in bits of the signal in the RoutineControl request/response
                integer DcmDspRoutineSignalPos: 0..65535, scope=ECU, set at link in variant link-time / pre-compile in variant post-build+pre-compile  # Provide the position of the signal in the RoutineControl request/response. | The position is defined in bits.
                enumeration DcmDspRoutineSignalType: {BOOLEAN, SINT16, SINT16_N, SINT32, SINT32_N, SINT8, SINT8_N, UINT16, UINT16_N, UINT32, UINT32_N, UINT8, UINT8_N, VARIABLE_LENGTH}, scope=ECU, set at link in variant link-time / pre-compile in variant post-build+pre-compile  # Provide the type of the signal in the RoutineControl request/response.
                choice container DcmDspArgumentScaling [0..1]  # This container contains the configuration (parameters) of an alternative Diagnosis Representation. Out if this the scaling between Diagnosis and ECU internal representation and vice versa can be calculated.
                  container DcmDspAlternativeDataProps [0..1]  # This container contains the configuration (parameters) of an alternative Diagnosis Representation by the means of ECU configuration parameters.The physical unit of the alternative data representation is defined by the DataPrototype referenced by DcmDspExternalSRDataElementClass. Additionally the definition of a text table mapping can be a defined for DcmDspDataTypeCategory TEXTTABLE and SCALE_LINEAR_AND_TEXTTABLE | The physical unit of the alternative data representation is defined by the DataPrototype referenced by DcmDspExternalSRDataElementClass. Additionally the definition of a text table mapping can be a defined for DcmDspDataTypeCategory TEXTTABLE and SCALE_LINEAR_AND_TEXTTABLE
                    container DcmDspLinearScale  # This container contains the configuration (parameters) of an linear scale of the alternative Diagnosis Representation.
                      float DcmDspDiagnosisRepresentationDataLowerRange: -Inf..Inf, scope=ECU, set at pre-compile  # Lower Range for this scale of the data in the alternative Diagnosis Representation.
                      float DcmDspDiagnosisRepresentationDataOffset: 0..Inf, scope=ECU, set at pre-compile, default-value=0  # Data offset of the alternative Diagnosis Representation for this scale.
                      float DcmDspDiagnosisRepresentationDataResolution: 0..Inf, scope=ECU, set at pre-compile  # Data resolution of the alternative Diagnosis Representation for this scale.
                      float DcmDspDiagnosisRepresentationDataUpperRange: -Inf..Inf, scope=ECU, set at pre-compile  # Upper Range for this scale of the data in the alternative Diagnosis Representation.
                  container DcmDspAlternativeDataType [0..1]  # This container contains the configuration (parameters) of an alternative Diagnosis Representation by the means of an ApplicationDataType. | Additionally the definition of a text table mapping can be a defined for ApplicationDataTypes of category TEXTTABLE and SCALE_LINEAR_AND_TEXTTABLE.
                    foreign reference DcmApplicationDataType: set at pre-compile, destination-type=APPLICATION-DATA-TYPE  # Alternative Diagnosis Representation for the data defined by the means of a ApplicationPrimitiveDataType of category VALUE or BOOLEAN.
                    container DcmDspTextTableMapping [0..0]  # This container contains the configuration (parameters) of the mapping a DataPrototype typed by AutosarDataType that refer to a CompuMethods of category TEXTTABLE or SCALE_LINEAR_AND_TEXTTABLE. | Each DcmDspTextTableMapping defines a value pair which is used to map the ECU internal value (DcmDspInternalDataValue) to the vale used in the diagnosis representation (DcmDspDiagnosisRepresentationDataValue) and vice versa. The set of all DcmDspTextTableMappings defines the whole mapping of an data.
                      integer DcmDspDiagnosisRepresentationDataValue [0..0]: 0..18446744073709551615, scope=ECU, set at pre-compile, with-auto=true  # The data value in the diagnosis representation.
                      integer DcmDspInternalDataValue [0..0]: 0..18446744073709551615, scope=ECU, set at pre-compile  # The ECU internal data value.
        container DcmDspSecurity  # This container contains the configuration ( DSP parameter) for security level configuration (per security level) | Description This container contains Rows of DcmDspSecurityRow
          float DcmDspSecurityMaxAttemptCounterReadoutTime [0..1]: 0..65535, set at link in variant link-time / pre-compile in variant post-build+pre-compile  # Delay, in seconds, from startup (measured from the first call of the Dcm_MainFunction()), allowed for all AttemptCounter values to be obtained from the Application. | AttemptCounter value has upper limit as 255 because it is passed to Xxx_GetSecurityAttemptCounter argument which is uint8 type. Based on the limit of DcmTaskTime (.0001 to .1), limit of DcmDspSecurityMaxAttemptCounterReadoutTime is 0.0254 to 25.4
          enumeration DcmRbDspSecurityDelayTimerMonitor [0..1]: {REQUEST_SEED, SEND_KEY}, multiplicity set at link in variant link-time+post-build / pre-compile in variant pre-compile, origin=RB:AR42.1.0.0:2017-01-31, set at link in variant link-time+post-build / pre-compile in variant pre-compile, default-value=REQUEST_SEED  # According to ISO-14229-1 (2006-12-01) Security Access service shall return a NRC requiredTimeDelayNotExpired when requested action will not be taken because theclient?s latest attempt to gain security access was initiated before the server?s required timeout period had been elapsed. This provides an option to OEMs to either decide to send this NRC for either a REQUEST SEED sub-function or SEND KEY sub-function. It is possible to choose here for which of the two it is required to monitor the delay time and send this NRC with this vendor specific attribute.
          enumeration DcmRbDspSecurityNRCExceedNoOfAttempt [0..1]: {NumAttDelayAndNumAttLock, NumAttLock}, multiplicity set at link in variant link-time+post-build / pre-compile in variant pre-compile, origin=RB:AR42.1.0.0:2017-01-31, set at link in variant link-time+post-build / pre-compile in variant pre-compile, default-value=NumAttDelayAndNumAttLock  # This parameter is to choose NRC return value in case of Exceeded Number Invalid Unlock Attempts. Literal "NumAttDelayAndNumAttLock" is in accordance to ISO 14229-1; For every invalid key sent, NRC 35 (INVALID_KEY) is returned till configured no of attempts (NumAttDelay) is reached. When Failed Attempts reaches or exceeds configured value (>= NummAttDelay) NRC 36 (EXCEEDED NUMBER OF ATTEMPTS) is returned. Or In case the failed attempts reaches or exceeds no of attempts to Lock (NumAttLock) ,NRC 36 will be returned. The Literal "NumAttLock" specifys that only on reaching or exceeding Number of attempts for Lock (NumAttLock) ,NRC 36 will be sent. Untill then NRC 35 is returned on invalid attempt.
          boolean DcmRbDspSecurityStoreSeed: origin=RB:AR42.1.0.0:2017-01-31, set at link in variant link-time+post-build / pre-compile in variant pre-compile  # DcmDspSecurity - DcmDspSecurityStoreSeed = TRUE, print DCM_CFG_ON
          container DcmDspSecurityRow [0..31]  # Definition of a single Row of configuration for security level configuration (per security level) | The name of this container is used to define the name of the R-Port through which the DCM accesses the interface SecurityAccess_{SecurityLevel}. The R-Port is named SecurityAccess_{SecurityLevel} where {SecurityLevel} is the name of the container DcmDspSecurityRow. If there is no reference, no check of security level shall be done.
            integer DcmDspSecurityADRSize [0..1]: 1..4294967285, multiplicity set at link in variant link-time / pre-compile in variant post-build+pre-compile, set at link in variant link-time / pre-compile in variant post-build+pre-compile  # Size in bytes of the AccessDataRecord used in GetSeed
            boolean DcmDspSecurityAttemptCounterEnabled: scope=ECU, set at link in variant link-time / pre-compile in variant post-build+pre-compile  # Allows to enable the external storage of the security attempt counter (e.g. to survival a reset of the ECU).
            function name DcmDspSecurityCompareKeyFnc [0..1]: multiplicity set at link in variant link-time / pre-compile in variant post-build+pre-compile, set at link in variant link-time / pre-compile in variant post-build+pre-compile  # Function name to request the result of a key comparison. | Parameter is only relevant if DcmDspSecurityUsePort=="USE_ ASYNCH_FNC". This parameter is related to the interface Xxx_CompareKey.
            float DcmDspSecurityDelayTime: 0..65535, set at link in variant link-time / pre-compile in variant post-build+pre-compile  # Delay time after failed security access in seconds. | This is started after DcmDspSecurityNumAttDelay number of failed security accesses. min: A negative value is not allowed.
            float DcmDspSecurityDelayTimeOnBoot: 0..65535, set at link in variant link-time / pre-compile in variant post-build+pre-compile  # Start delay timer on power on in seconds. | This delay indicates the time at ECU boot power-on time where the Dcm remains in the default session and does not accept a security access. min: A negative value is not allowed.
            function name DcmDspSecurityGetAttemptCounterFnc [0..1]: multiplicity set at link in variant link-time / pre-compile in variant post-build+pre-compile, set at link in variant link-time / pre-compile in variant post-build+pre-compile  # Function name to request a attempt counter. | Parameter is only relevant if DcmDspSecurityUsePort=="USE_ASYNCH_FNC". This parameter is related to the interface Xxx_ GetSecurityAttemptCounter.
            function name DcmDspSecurityGetSeedFnc [0..1]: multiplicity set at link in variant link-time / pre-compile in variant post-build+pre-compile, set at link in variant link-time / pre-compile in variant post-build+pre-compile  # Function name to request a seed. | Parameter is only relevant if DcmDspSecurityUsePort=="USE_ASYNCH_FNC". This parameter is related to the interface Xxx_GetSeed.
            integer DcmDspSecurityKeySize: 1..4294967285, set at link in variant link-time / pre-compile in variant post-build+pre-compile  # size of the security key (in Bytes).
            integer DcmDspSecurityLevel: 1..63, set at pre-compile, symbolic-name-value=true  # Value of Security level. | The locked state cannot be configured explicitly. 1,2,3...63: configuration dependent - Conversion formula to calculate SecurityLevel out of tester requested SecurityAccessType parameter: SecurityLevel = (SecurityAccessType + 1) / 2 Type: Dcm_SecLevelType
            integer DcmDspSecurityNumAttDelay: 1..255, set at link in variant link-time / pre-compile in variant post-build+pre-compile  # Number of failed security accesses after which the delay time is activated
            integer DcmDspSecuritySeedSize: 1..4294967285, set at link in variant link-time / pre-compile in variant post-build+pre-compile  # size of the security seed (in Bytes).
            function name DcmDspSecuritySetAttemptCounterFnc [0..1]: multiplicity set at link in variant link-time / pre-compile in variant post-build+pre-compile, set at link in variant link-time / pre-compile in variant post-build+pre-compile  # Function name to set a attempt counter. | Parameter is only relevant if DcmDspSecurityUsePort=="USE_ASYNCH_FNC". This parameter is related to the interface Xxx_ SetSecurityAttemptCounter.
            enumeration DcmDspSecurityUsePort: {USE_ASYNCH_CLIENT_SERVER, USE_ASYNCH_FNC}, set at pre-compile  # Defines which kind of interface shall be used for security access.
            integer DcmRbDspSecurityNumAttLock: 0..255, origin=RB:AR42.1.0.0:2017-01-31, set at pre-compile  # Number of failed security accesses after which security access is locked. 0 indicates that the security access will be left untouched and the ECU never locks.
            boolean DcmRbDspSecurityRowUseAsynchronousServerCallPoint [0..1]: multiplicity set at link in variant link-time+post-build / pre-compile in variant pre-compile, origin=RB:AR42.1.0.0:2017-01-31, set at link in variant link-time+post-build / pre-compile in variant pre-compile, default-value=false  # Only relevant in case DcmDspSecurityUsePort is set to USE_DATA_ASYNCH_CLIENT_SERVER.This parameter is used to select the type of Server Handling required.Set the value to TRUE for Asynchronous server call point handling else Synchronous server call point handling is carried out
            boolean DcmRbDspSecurityRowUseFlexibleLength [0..1]: origin=RB:AR42.8.0.0:2020-07-24, set at link in variant link-time+post-build / pre-compile in variant pre-compile, default-value=false  # Parameter to enable/ disable use of flexible Seed Length and Key Length handling for a security level If configured as TRUE, flexible length handling is used for this particular level
        container DcmDspSession  # This container contains the configuration ( DSP parameter) session control. configuration (per session control) | This container contains Rows of DcmDspSessionRow.
          boolean DcmRbDspSessionParamRecordEnabled [0..1]: multiplicity set at link in variant link-time+post-build / pre-compile in variant pre-compile, origin=RB:AR42.1.0.0:2017-01-31, set at link in variant link-time+post-build / pre-compile in variant pre-compile, default-value=true  # If DcmDspSessionParamRecordEnabled = true, then the session parameter record will be part of session control service positive response. If DcmDspSessionParamRecordEnabled = false, then the session parameter record will not be part of session control service positive response. Session parameter record conatins the P2 Can Server and P2* Can Server times according to ISO15765-3 CAN requirements
          reference DcmRbDspKWPDefaultSesRef [0..1]: multiplicity set at link in variant link-time+post-build / pre-compile in variant pre-compile, origin=RB:AR42.1.0.0:2017-01-31, set at link in variant link-time+post-build / pre-compile in variant pre-compile, destination=DcmDspSessionRow  # The DcmDspKWPDefaultSesRef is a reference container to DcmDspSessionRow. If the KWP protocol is using the Dcm Dsp session and security configurations (i.e. DcmDspSesSecUsedInProtocol is configured to KWP) then configure a Default Session for KWP protocol
          container DcmDspSessionRow [0..31]  # Definition of a single Row of session control configuration (per session control)
            enumeration DcmDspSessionForBoot: {DCM_NO_BOOT, DCM_OEM_BOOT, DCM_SYS_BOOT}, set at link in variant link-time / pre-compile in variant post-build+pre-compile  # This parameter defines whether this diagnostic session allows to jump to Bootloader (OEM Bootloader or System Supplier Bootloader). If this diagnostic session doesn't allow to jump to Bootloader the value DCM_NO_BOOT shall be chosen.
            integer DcmDspSessionLevel: 1..126, set at pre-compile, symbolic-name-value=true  # subFunction value of the DiagnosticSession. | 0, 127 and all values above 127 are reserved by ISO, SWS defines the Dcm_SesCtrlType: 1 DEFAULT_SESSION 2 PROGRAMMING_SESSION 3 EXTENDED_DIAGNOSTIC_SESSION 4 SAFETY_SYSTEM_DIAGNOSTIC_SESSION 5...63 Reserved by Document 64...126 <configuration dependent (according "diagnosticSessionType" parameter DiagnosticSessionControl request> 127...254 Reserved by Document 255 ALL_SESSION_LEVEL
            float DcmDspSessionP2ServerMax: 0..1, set at link in variant link-time / pre-compile in variant post-build+pre-compile  # This is the session value for P2ServerMax in seconds (per Session Control). | The AUTOSAR configuration standard is to use SI units, so this parameter is defined as a float value in seconds. DCM configuration tools must convert this float value to the appropriate value format for the use in the software implementation of DCM.
            float DcmDspSessionP2StarServerMax: 0..100, set at link in variant link-time / pre-compile in variant post-build+pre-compile  # This is the session value for P2*ServerMax in seconds (per Session Control). | The AUTOSAR configuration standard is to use SI units, so this parameter is defined as a float value in seconds. DCM configuration tools must convert this float value to the appropriate value format for the use in the software implementation of DCM.
        container DcmDspVehInfo [0..*]  # This container contains the configuration (parameters) of the "Request vehicle information service" (service $09).
          integer DcmDspVehInfoInfoType: 0..255, scope=ECU, set at link in variant link-time / pre-compile in variant post-build+pre-compile  # value of InfoType. | Within each DcmConfigSet all DcmDspVehInfoInfoType values shall be unique.
          function name DcmRbDspVehInfoSupportFnc [0..1]: scope=ECU, multiplicity set at pre-compile, set at pre-compile  # Function name to trigger the application to check if the requested infotype is supported or not.User can leave the field empty, if the check is not required for this Infotype.
          boolean DcmDspVehInfoNODIProvResp [0..1]: multiplicity set at pre-compile, set at pre-compile, default-value=false  # If this is false, the DCM is responsible to fill the number of data items (NODI).If this is true,Provider is responsible to fill the number of data items (NODI) and only one DcmDspVehInfoData container is allowed.
          container DcmDspVehInfoData [1..*]  # Data Item of an InfoType; post-fix of the port interface name.
            integer DcmDspVehInfoDataOrder: 0..255, scope=ECU, set at pre-compile  # Defines the order of the data item in the InfoType; values: 0..255; first data item having the order number 0; the next 1 and so on. | The configuration of order needs to be unique per InfoType.
            function name DcmDspVehInfoDataReadFnc [0..1]: scope=ECU, multiplicity set at pre-compile, set at pre-compile  # Function name for reading InfoType data item.
            integer DcmDspVehInfoDataSize: 0..255, scope=ECU, set at pre-compile  # Size in bytes of the InfoType data item.
            boolean DcmDspVehInfoDataUsePort: scope=ECU, set at pre-compile  # When this parameter is set to true the DCM will access the Data using an R-Port requiring a PortInteface IInfotypeServices_{VehInfoData}. | The R-Port is named InfotypeServices_{VehInfoData} where {VEHINFODATA} is the name of the container DcmDspVehInfoData. In that case, the DcmDspVehInfoDataReadFnc is ignored and the RTE APIs are used. When this parameter is set to false, the DCM calls the function defined in DcmDspVehInfoDataReadFnc.
        container DcmRbDspEcuResetRow [0..*]  # Container to define the resetTypes and the type of reset(jump to bootloader or normal reset ) for each subfunction of EcuReset Service. ResetTypes supported by the ECU but not configured under this container will be considered for normal reset.
          integer DcmRbDspEcuResetType: 0..127, origin=RB:AR42.1.0.0:2017-01-31, set at link in variant link-time / pre-compile in variant post-build+pre-compile, symbolic-name-value=true  # Value of the Ecu Reset Type (subfunction of EcuReset Service)
          enumeration DcmRbDspResetForBoot: {DCM_NO_BOOT, DCM_OEM_BOOT, DCM_SYS_BOOT, DCM_DRIVE_TO_DRIVE}, origin=RB:AR42.1.0.0:2017-01-31, set at link in variant link-time / pre-compile in variant post-build+pre-compile  # This parameter defines whether this resetType allows to jump to Bootloader (OEM Bootloader/ System Supplier Bootloader/ Drive to Drive Jump). If the resetType is not allowed to jump to Boot/Drive, i.e., used for normal reset, the value DCM_NO_BOOT shall be chosen.ResetTypes supported by the ECU but not configured under the container DcmDspEcuResetRow will be considered as DCM_NO_BOOT ( normal reset)
        container DcmRbDspReadDTC [0..1]  # This container contains the configuration (parameters) of the service Read DTC Information - 0x19 (per sub-function type) This container contains Rows of DcmDspReadDTCRow
          integer DcmRbDspReadDTCMaxNumDTCRead: 1..255, origin=RB:AR42.1.0.0:2017-01-31, set at link in variant link-time+post-build / pre-compile in variant pre-compile  # Maximum number of DTC that can be read in 1 service call
          integer DcmRbDspReadDTCMaxNumRecordRead: 1..255, origin=RB:AR42.1.0.0:2017-01-31, set at link in variant link-time+post-build / pre-compile in variant pre-compile  # Max Number of Records that can be read in 1 service call
        container DcmRbDspRoutineRange [0..*]  # This container defines the Routine Ranges
          boolean DcmRbDspRoutineRangeHasGaps: scope=ECU, origin=RB:AR42.5.0.0:2019-01-31, set at link in variant link-time / pre-compile in variant post-build+pre-compile  # Parameter specifying if there are gaps in the Routine range (parameter set to TRUE) or not (parameter set to FALSE)
          integer DcmRbDspRoutineRangeIdentifierLowerLimit: 0..65535, scope=ECU, origin=RB:AR42.5.0.0:2019-01-31, set at link in variant link-time / pre-compile in variant post-build+pre-compile  # Lower limit of Routine range.
          integer DcmRbDspRoutineRangeIdentifierUpperLimit: 0..65535, scope=ECU, origin=RB:AR42.5.0.0:2019-01-31, set at link in variant link-time / pre-compile in variant post-build+pre-compile  # Upper limit of Routine range.
          function name DcmRbDspRoutineRangeIsRidAvailableFnc [0..1]: scope=ECU, multiplicity set at pre-compile, origin=RB:AR42.5.0.0:2019-01-31, set at pre-compile  # Function name to request from application if a specific Routine is available within the range or not. | Only relevant if DcmRbDspRoutineRangeUsePort is set to false. This parameter is related to the interface Xxx_IsRidAvailable.
          boolean DcmRbDspRoutineRangeReqSequenceErrorEnabled [0..1]: multiplicity set at pre-compile, origin=RB:AR42.5.0.0:2019-01-31, set at pre-compile, default-value=true  # Indicates Request Sequence Error (NRC 0x24) shall be triggered for a RequestResults/Stop subfunction with/without a prior Start subfunction request for Routines which supports both RequestResults and Start subfunctions/ Stop and Start Subfunctions. | True:For a Routine which supports both RequestResults/Stop and Start Subfunction,NRC 0x24 shall be triggered if Routine Control tester request with RequestResults subfunction(0x03/Stop subfunction(0x02) comes for a Routine which is not started (without a prior Routine Control request with Start subfunction(0x01)) False:For a Routine which supports both RequestResults/Stop and Start Subfunction,positive response shall be triggered if Routine Control tester request with RequestResults subfunction(0x03)/Stop subfunction(0x02) comes without a prior Routine Control request with Start subfunction(0x01)
          boolean DcmRbDspRoutineRangeStopRoutineOnSessionChange [0..1]: multiplicity set at pre-compile, origin=RB:AR42.5.0.0:2019-01-31, set at pre-compile, default-value=false  # Indicates if the StopRoutine operation needs to be performed on any session change. True = Stop this Routine if it is active on transition to default session / Stop this routine if it is not supported in the new nondefault session. False = No action on session transitions Dependency: Applicable only if StopRoutine operation is supported for RID (DcmDspStopRoutineSupported = true), otherwise not valid.If the parameter is left unconfigured FALSE will be considered as the default value. | true = stopRoutine is supported on session change false = stopRoutine is not supported on session change
          boolean DcmRbDspRoutineRangeUseAsynchronousServerCallPoint [0..1]: multiplicity set at link in variant link-time+post-build / pre-compile in variant pre-compile, origin=RB:AR42.5.0.0:2019-01-31, set at link in variant link-time+post-build / pre-compile in variant pre-compile, default-value=false  # Only relevant in case DcmRbDspRoutineRangeUsePort is set to TRUE. This parameter is used to select the type of Server Handling required. Set the value to TRUE for Asynchronous server call point handling else Synchronous server call point handling is carried out
          boolean DcmRbDspRoutineRangeUsePort: scope=ECU, origin=RB:AR42.5.0.0:2019-01-31, set at pre-compile  # If this parameter is set to true, the DCM uses an R-Port requiring a PortInteface RoutineRange_{RangeRoutineName} where {RangeRoutineName} is the name of the container DcmDspRoutineRange. In that case, DcmRbDspRoutineRangeIsRidAvailableFnc, DcmRbDspRoutineRangeStartRoutineFnc, DcmRbDspRoutineRangeStopRoutineFnc and DcmRbDspRoutineRangeRequestRoutineResultsFnc will be ignored and the RTE APIs are used. When the parameter DcmRbDspRoutineRangeUsePort is false, the DCM calls the functions defined in DcmRbDspRoutineRangeIsRidAvailableFnc, DcmRbDspRoutineRangeStartRoutineFnc, DcmRbDspRoutineRangeStopRoutineFnc and DcmRbDspRoutineRangeRequestRoutineResultsFnc.
          function name DcmRbDspRoutineRangeUserRoutineModeRuleFnc [0..1]: multiplicity set at pre-compile, origin=RB:AR42.5.0.0:2019-01-31, set at pre-compile  # Function name used by the application to perform user specific checks before accessing a Routine. | In case the checks fails, NRC value set by the application can be returned to the tester. In case the function is not configured for the Routine, the DcmAppl API DcmAppl_UserRIDModeRuleService shall be called.
          container DcmRbDspRoutineRangeRequestRoutineResults [0..1]  # Provides the configuration of RequestResult subservice for a Range of Routines for RoutineControl service. | Existence indicates that the RequestRoutineResults in the Range Routines in RoutineControl is supported.
            function name DcmRbDspRoutineRangeRequestRoutineResultsFnc [0..1]: scope=ECU, multiplicity set at pre-compile, origin=RB:AR42.5.0.0:2019-01-31, set at pre-compile  # Function name for request to application the results of a routine in a Range. (RoutineRange_RequestResults-function) | This parameter is related to the interface Xxx_RequestResults.
            reference DcmRbDspRoutineRangeRequestRoutineResultsCommonAuthorizationRef [0..1]: scope=ECU, multiplicity set at link in variant link-time / pre-compile in variant post-build+pre-compile, origin=RB:AR42.5.0.0:2019-01-31, set at link in variant link-time / pre-compile in variant post-build+pre-compile, destination=DcmDspCommonAuthorization  # Reference to DcmDspCommonAuthorization | Common authorization configuration taken from the referenced DcmRbDspRoutineRangeRequestRoutineResultsCommonAuthorizationRef. If there is no reference, no check on the commonly defined authorization conditions shall be done to get the routine result.
            container DcmRbDspRequestRoutineResultsIn [0..1]  # Provide description of input parameter of RequestResults subservice for RoutineControl service.
              container DcmRbDspRoutineRangeRequestRoutineResultsInSignal [1..*]: requires-index=true  # Provide description of a routine signal used in RoutineControl service.
                enumeration DcmRbDspRoutineSignalEndianness [0..1]: {BIG_ENDIAN, LITTLE_ENDIAN, OPAQUE}, multiplicity set at link in variant link-time / pre-compile in variant post-build+pre-compile, set at link in variant link-time / pre-compile in variant post-build+pre-compile  # Defines the endianness of the data belonging to a Request Routine Response In Signal.If projects configures OPAQUE no endianness conversion will be supported/applicable | If no DcmRbDspRoutineSignalEndianness is defined the value of DcmRbDspDataDefaultEndianness is applicable.
                integer DcmRbDspRoutineSignalLength [0..1]: 0..65535, multiplicity set at link in variant link-time / pre-compile in variant post-build+pre-compile, origin=RB:AR42.1.0.0:2017-01-31, set at link in variant link-time / pre-compile in variant post-build+pre-compile  # Provide the length of the Routine signal in bits.If DcmRbDspRoutineRequestResINSignal is configured as VARIABLE_LENGTH, then Dcm shall update the currentDataLength parameter of the configured DcmAppl API (DcmRbDspRequestResultsRoutineFnc) in BYTES before calling the API .CurrentDataLength parameter signifies the actual length of the variable length signal positioned at the end in request.
                integer DcmRbDspRoutineSignalPos: 0..65535, origin=RB:AR42.1.0.0:2017-01-31, set at link in variant link-time / pre-compile in variant post-build+pre-compile  # Provide the position of the signal in the RoutineControl request/response.The position is defined in bits. | The position is defined in bits.
                enumeration DcmRbDspRoutineSignalType: {BOOLEAN, SINT16, SINT16_N, SINT32, SINT32_N, SINT8, SINT8_N, UINT16, UINT16_N, UINT32, UINT32_N, UINT8, UINT8_N, VARIABLE_LENGTH}, origin=RB:AR42.1.0.0:2017-01-31, set at link in variant link-time / pre-compile in variant post-build+pre-compile  # Provide the type of the signal in the RoutineControl request/response.
                choice container DcmRbDspArgumentScaling [0..1]  # This container contains the configuration (parameters) of an alternative Diagnosis Representation. Out if this the scaling between Diagnosis and ECU internal representation and vice versa can be calculated.
                  container DcmRbDspAlternativeArgumentData [0..0]  # This container contains the configuration (parameters) of an alternative Diagnosis Representation by the means of a ArgumentDataPrototype.
                    foreign reference DcmRbDataElement [0..0]: origin=RB:AR42.5.0.0:2019-01-31, set at pre-compile, destination-type=ARGUMENT-DATA-PROTOTYPE  # Alternative Diagnosis Representation for the data defined by the means of a ArgumentDataPrototype
                  container DcmRbDspAlternativeDataProps [0..1]  # This container contains the configuration (parameters) of an alternative Diagnosis Representation by the means of ECU configuration parameters.The physical unit of the alternative data representation is defined by the DataPrototype referenced by DcmDspExternalSRDataElementClass. Additionally the definition of a text table mapping can be a defined for DcmDspDataTypeCategory TEXTTABLE and SCALE_LINEAR_AND_TEXTTABLE | The physical unit of the alternative data representation is defined by the DataPrototype referenced by DcmDspExternalSRDataElementClass. Additionally the definition of a text table mapping can be a defined for DcmDspDataTypeCategory TEXTTABLE and SCALE_LINEAR_AND_TEXTTABLE
                    container DcmRbDspLinearScale  # This container contains the configuration (parameters) of an linear scale of the alternative Diagnosis Representation.
                      float DcmRbDspDiagnosisRepresentationDataLowerRange: -Inf..Inf, scope=ECU, set at pre-compile  # Lower Range for this scale of the data in the alternative Diagnosis Representation.
                      float DcmRbDspDiagnosisRepresentationDataOffset: 0..Inf, scope=ECU, set at pre-compile, default-value=0  # Data offset of the alternative Diagnosis Representation for this scale.
                      float DcmRbDspDiagnosisRepresentationDataResolution: 0..Inf, scope=ECU, set at pre-compile  # Data resolution of the alternative Diagnosis Representation for this scale.
                      float DcmRbDspDiagnosisRepresentationDataUpperRange: -Inf..Inf, set at pre-compile  # Upper Range for this scale of the data in the alternative Diagnosis Representation.
                  container DcmRbDspAlternativeDataType [0..1]  # This container contains the configuration (parameters) of an alternative Diagnosis Representation by the means of an ApplicationDataType. | Additionally the definition of a text table mapping can be a defined for ApplicationDataTypes of category TEXTTABLE and SCALE_LINEAR_AND_TEXTTABLE.
                    foreign reference DcmRbApplicationDataType: set at pre-compile, destination-type=APPLICATION-DATA-TYPE  # Alternative Diagnosis Representation for the data defined by the means of a ApplicationPrimitiveDataType of category VALUE or BOOLEAN.
                    container DcmRbDspTextTableMapping [0..0]  # This container contains the configuration (parameters) of the mapping a DataPrototype typed by AutosarDataType that refer to a CompuMethods of category TEXTTABLE or SCALE_LINEAR_AND_TEXTTABLE. | Each DcmRbDspTextTableMapping defines a value pair which is used to map the ECU internal value (DcmRbDspInternalDataValue) to the vale used in the diagnosis representation (DcmRbDspDiagnosisRepresentationDataValue) and vice versa. The set of all DcmRbDspTextTableMappings defines the whole mapping of an data.
                      integer DcmRbDspDiagnosisRepresentationDataValue [0..0]: 0..18446744073709551615, scope=ECU, set at pre-compile, with-auto=true  # The data value in the diagnosis representation.
                      integer DcmRbDspInternalDataValue [0..0]: 0..18446744073709551615, scope=ECU, set at pre-compile  # The ECU internal data value.
            container DcmRbDspRequestRoutineResultsOut [0..1]  # Provide description of output parameter of RequestResult subservice for RoutineControl service.
              container DcmRbDspRequestRoutineResultsOutSignal [1..*]: requires-index=true  # Provide description of a routine signal used in RoutineControl service. | The ordering defined via the index attribute of the subcontainers in this list represents the order of the dataOutN elements in the XXX_RequestResult function call.
                enumeration DcmRbDspRoutineSignalEndianness [0..1]: {BIG_ENDIAN, LITTLE_ENDIAN, OPAQUE}, scope=ECU, multiplicity set at link in variant link-time / pre-compile in variant post-build+pre-compile, origin=RB:AR42.5.0.0:2019-01-31, set at link in variant link-time / pre-compile in variant post-build+pre-compile  # Defines the endianness of the data belonging to a Request Routine Response Out Signal. | If no DcmDspRoutineSignalEndianness is defined the value of DcmDspDataDefaultEndianness is applicable.
                integer DcmRbDspRoutineSignalLength [0..1]: 0..65535, scope=ECU, multiplicity set at link in variant link-time / pre-compile in variant post-build+pre-compile, origin=RB:AR42.5.0.0:2019-01-31, set at link in variant link-time / pre-compile in variant post-build+pre-compile  # Provide the length in bits of the signal in the RoutineControl request/response
                integer DcmRbDspRoutineSignalPos: 0..65535, scope=ECU, origin=RB:AR42.5.0.0:2019-01-31, set at link in variant link-time / pre-compile in variant post-build+pre-compile  # Provide the position of the signal in the RoutineControl request/response. | The position is defined in bits.
                enumeration DcmRbDspRoutineSignalType: {BOOLEAN, SINT16, SINT16_N, SINT32, SINT32_N, SINT8, SINT8_N, UINT16, UINT16_N, UINT32, UINT32_N, UINT8, UINT8_N, VARIABLE_LENGTH}, scope=ECU, origin=RB:AR42.5.0.0:2019-01-31, set at link in variant link-time / pre-compile in variant post-build+pre-compile  # Provide the type of the signal in the RoutineControl request/response.
                choice container DcmRbDspArgumentScaling [0..1]  # This container contains the configuration (parameters) of an alternative Diagnosis Representation. Out if this the scaling between Diagnosis and ECU internal representation and vice versa can be calculated.
                  container DcmRbDspAlternativeArgumentData [0..0]  # This container contains the configuration (parameters) of an alternative Diagnosis Representation by the means of a ArgumentDataPrototype.
                    foreign reference DcmRbDataElement [0..0]: origin=RB:AR42.5.0.0:2019-01-31, set at pre-compile, destination-type=ARGUMENT-DATA-PROTOTYPE  # Alternative Diagnosis Representation for the data defined by the means of a ArgumentDataPrototype
                  container DcmRbDspAlternativeDataProps [0..1]  # This container contains the configuration (parameters) of an alternative Diagnosis Representation by the means of ECU configuration parameters.The physical unit of the alternative data representation is defined by the DataPrototype referenced by DcmDspExternalSRDataElementClass. Additionally the definition of a text table mapping can be a defined for DcmDspDataTypeCategory TEXTTABLE and SCALE_LINEAR_AND_TEXTTABLE | The physical unit of the alternative data representation is defined by the DataPrototype referenced by DcmDspExternalSRDataElementClass. Additionally the definition of a text table mapping can be a defined for DcmDspDataTypeCategory TEXTTABLE and SCALE_LINEAR_AND_TEXTTABLE
                    container DcmRbDspLinearScale  # This container contains the configuration (parameters) of an linear scale of the alternative Diagnosis Representation.
                      float DcmRbDspDiagnosisRepresentationDataLowerRange: -Inf..Inf, scope=ECU, set at pre-compile  # Lower Range for this scale of the data in the alternative Diagnosis Representation.
                      float DcmRbDspDiagnosisRepresentationDataOffset: 0..Inf, scope=ECU, set at pre-compile, default-value=0  # Data offset of the alternative Diagnosis Representation for this scale.
                      float DcmRbDspDiagnosisRepresentationDataResolution: 0..Inf, scope=ECU, set at pre-compile  # Data resolution of the alternative Diagnosis Representation for this scale.
                      float DcmRbDspDiagnosisRepresentationDataUpperRange: -Inf..Inf, set at pre-compile  # Upper Range for this scale of the data in the alternative Diagnosis Representation.
                  container DcmRbDspAlternativeDataType [0..1]  # This container contains the configuration (parameters) of an alternative Diagnosis Representation by the means of an ApplicationDataType. | Additionally the definition of a text table mapping can be a defined for ApplicationDataTypes of category TEXTTABLE and SCALE_LINEAR_AND_TEXTTABLE.
                    foreign reference DcmRbApplicationDataType: set at pre-compile, destination-type=APPLICATION-DATA-TYPE  # Alternative Diagnosis Representation for the data defined by the means of a ApplicationPrimitiveDataType of category VALUE or BOOLEAN.
                    container DcmRbDspTextTableMapping [0..0]  # This container contains the configuration (parameters) of the mapping a DataPrototype typed by AutosarDataType that refer to a CompuMethods of category TEXTTABLE or SCALE_LINEAR_AND_TEXTTABLE. | Each DcmRbDspTextTableMapping defines a value pair which is used to map the ECU internal value (DcmRbDspInternalDataValue) to the vale used in the diagnosis representation (DcmRbDspDiagnosisRepresentationDataValue) and vice versa. The set of all DcmRbDspTextTableMappings defines the whole mapping of an data.
                      integer DcmRbDspDiagnosisRepresentationDataValue [0..0]: 0..18446744073709551615, scope=ECU, set at pre-compile, with-auto=true  # The data value in the diagnosis representation.
                      integer DcmRbDspInternalDataValue [0..0]: 0..18446744073709551615, scope=ECU, set at pre-compile  # The ECU internal data value.
          container DcmRbDspRoutineRangeStartRoutine [0..1]  # Provides the configuration of Start subservice for RoutineControl service.
            function name DcmRbDspRoutineRangeStartRoutineFnc [0..1]: scope=ECU, multiplicity set at pre-compile, set at pre-compile  # Function name for request to application to start a routine. (Routine_Start-function) | This parameter is related to the interface Xxx_Start.
            reference DcmRbDspRoutineRangeStartRoutineCommonAuthorizationRef [0..1]: scope=ECU, multiplicity set at link in variant link-time / pre-compile in variant post-build+pre-compile, set at link in variant link-time / pre-compile in variant post-build+pre-compile, destination=DcmDspCommonAuthorization  # Reference to DcmDspCommonAuthorization | Common authorization configuration taken from the referenced DcmRbDspStartRoutineCommonAuthorizationRef. If there is no reference, no check on the commonly defined authorization conditions shall be done to start the routine.
            container DcmRbDspStartRoutineIn [0..1]  # Provide description of input parameter of Start subservice for RoutineControl service
              container DcmRbDspStartRoutineInSignal [1..*]: requires-index=true  # Provide description of a routine signal used in RoutineControl service. | The ordering defined via the index attribute of the subcontainers in this list represents the order of the dataInN elements in the XXX_Start function call.
                enumeration DcmRbDspRoutineSignalEndianness [0..1]: {BIG_ENDIAN, LITTLE_ENDIAN, OPAQUE}, scope=ECU, multiplicity set at link in variant link-time / pre-compile in variant post-build+pre-compile, set at link in variant link-time / pre-compile in variant post-build+pre-compile  # Defines the endianness of the data belonging to a Start Routine In Signal. | If no DcmRbDspRoutineSignalEndianness is defined the value of DcmDspDataDefaultEndianness is applicable.
                integer DcmRbDspRoutineSignalLength [0..1]: 0..65535, scope=ECU, multiplicity set at link in variant link-time / pre-compile in variant post-build+pre-compile, set at link in variant link-time / pre-compile in variant post-build+pre-compile  # Provide the length in bits of the signal in the RoutineControl request/response
                integer DcmRbDspRoutineSignalPos: 0..65535, scope=ECU, set at link in variant link-time / pre-compile in variant post-build+pre-compile  # Provide the position of the signal in the RoutineControl request/response. | The position is defined in bits.
                enumeration DcmRbDspRoutineSignalType: {BOOLEAN, SINT16, SINT16_N, SINT32, SINT32_N, SINT8, SINT8_N, UINT16, UINT16_N, UINT32, UINT32_N, UINT8, UINT8_N, VARIABLE_LENGTH}, scope=ECU, set at link in variant link-time / pre-compile in variant post-build+pre-compile  # Provide the type of the signal in the RoutineControl request/response.
                choice container DcmRbDspArgumentScaling [0..1]  # This container contains the configuration (parameters) of an alternative Diagnosis Representation. Out if this the scaling between Diagnosis and ECU internal representation and vice versa can be calculated.
                  container DcmRbDspAlternativeDataProps [0..1]  # This container contains the configuration (parameters) of an alternative Diagnosis Representation by the means of ECU configuration parameters.The physical unit of the alternative data representation is defined by the DataPrototype referenced by DcmDspExternalSRDataElementClass. Additionally the definition of a text table mapping can be a defined for DcmDspDataTypeCategory TEXTTABLE and SCALE_LINEAR_AND_TEXTTABLE | The physical unit of the alternative data representation is defined by the DataPrototype referenced by DcmDspExternalSRDataElementClass. Additionally the definition of a text table mapping can be a defined for DcmDspDataTypeCategory TEXTTABLE and SCALE_LINEAR_AND_TEXTTABLE
                    container DcmRbDspLinearScale  # This container contains the configuration (parameters) of an linear scale of the alternative Diagnosis Representation.
                      float DcmRbDspDiagnosisRepresentationDataLowerRange: -Inf..Inf, scope=ECU, set at pre-compile  # Lower Range for this scale of the data in the alternative Diagnosis Representation.
                      float DcmRbDspDiagnosisRepresentationDataOffset: 0..Inf, scope=ECU, set at pre-compile, default-value=0  # Data offset of the alternative Diagnosis Representation for this scale.
                      float DcmRbDspDiagnosisRepresentationDataResolution: 0..Inf, scope=ECU, set at pre-compile  # Data resolution of the alternative Diagnosis Representation for this scale.
                      float DcmRbDspDiagnosisRepresentationDataUpperRange: -Inf..Inf, scope=ECU, set at pre-compile  # Upper Range for this scale of the data in the alternative Diagnosis Representation.
                  container DcmRbDspAlternativeDataType [0..1]  # This container contains the configuration (parameters) of an alternative Diagnosis Representation by the means of an ApplicationDataType. | Additionally the definition of a text table mapping can be a defined for ApplicationDataTypes of category TEXTTABLE and SCALE_LINEAR_AND_TEXTTABLE.
                    foreign reference DcmRbApplicationDataType: set at pre-compile, destination-type=APPLICATION-DATA-TYPE  # Alternative Diagnosis Representation for the data defined by the means of a ApplicationPrimitiveDataType of category VALUE or BOOLEAN.
                    container DcmRbDspTextTableMapping [0..0]  # This container contains the configuration (parameters) of the mapping a DataPrototype typed by AutosarDataType that refer to a CompuMethods of category TEXTTABLE or SCALE_LINEAR_AND_TEXTTABLE. | Each DcmRbDspTextTableMapping defines a value pair which is used to map the ECU internal value (DcmRbDspInternalDataValue) to the vale used in the diagnosis representation (DcmRbDspDiagnosisRepresentationDataValue) and vice versa. The set of all DcmRbDspTextTableMappings defines the whole mapping of an data.
                      integer DcmRbDspDiagnosisRepresentationDataValue [0..0]: 0..18446744073709551615, scope=ECU, set at pre-compile, with-auto=true  # The data value in the diagnosis representation.
                      integer DcmRbDspInternalDataValue [0..0]: 0..18446744073709551615, scope=ECU, set at pre-compile  # The ECU internal data value.
            container DcmRbDspStartRoutineOut [0..1]  # Provide description of output parameter of Start subservice for RoutineControl service.
              container DcmRbDspStartRoutineOutSignal [1..*]: requires-index=true  # Provide description of a routine signal used in RoutineControl service. | The ordering defined via the index attribute of the subcontainers in this list represents the order of the dataOutN elements in the XXX_Start function call.
                enumeration DcmRbDspRoutineSignalEndianness [0..1]: {BIG_ENDIAN, LITTLE_ENDIAN, OPAQUE}, scope=ECU, multiplicity set at link in variant link-time / pre-compile in variant post-build+pre-compile, set at link in variant link-time / pre-compile in variant post-build+pre-compile  # Defines the endianness of the data belonging to a Start Routine Out Signal. | If no DcmRbDspRoutineSignalEndianness is defined the value of DcmDspDataDefaultEndianness is applicable.
                integer DcmRbDspRoutineSignalLength [0..1]: 0..65535, scope=ECU, multiplicity set at link in variant link-time / pre-compile in variant post-build+pre-compile, set at link in variant link-time / pre-compile in variant post-build+pre-compile  # Provide the length in bits of the signal in the RoutineControl request/response.
                integer DcmRbDspRoutineSignalPos [0..1]: 0..65535, scope=ECU, multiplicity set at link in variant link-time / pre-compile in variant post-build+pre-compile, set at link in variant link-time / pre-compile in variant post-build+pre-compile  # Provide the position of the signal in the RoutineControl request/response. | The position is defined in bits.
                enumeration DcmRbDspRoutineSignalType: {BOOLEAN, SINT16, SINT16_N, SINT32, SINT32_N, SINT8, SINT8_N, UINT16, UINT16_N, UINT32, UINT32_N, UINT8, UINT8_N, VARIABLE_LENGTH}, scope=ECU, set at link in variant link-time / pre-compile in variant post-build+pre-compile  # Provide the type of the signal in the RoutineControl request/response.
                choice container DcmRbDspArgumentScaling [0..1]  # This container contains the configuration (parameters) of an alternative Diagnosis Representation. Out if this the scaling between Diagnosis and ECU internal representation and vice versa can be calculated.
                  container DcmRbDspAlternativeDataProps [0..1]  # This container contains the configuration (parameters) of an alternative Diagnosis Representation by the means of ECU configuration parameters.The physical unit of the alternative data representation is defined by the DataPrototype referenced by DcmDspExternalSRDataElementClass. Additionally the definition of a text table mapping can be a defined for DcmDspDataTypeCategory TEXTTABLE and SCALE_LINEAR_AND_TEXTTABLE | The physical unit of the alternative data representation is defined by the DataPrototype referenced by DcmDspExternalSRDataElementClass. Additionally the definition of a text table mapping can be a defined for DcmDspDataTypeCategory TEXTTABLE and SCALE_LINEAR_AND_TEXTTABLE
                    container DcmRbDspLinearScale  # This container contains the configuration (parameters) of an linear scale of the alternative Diagnosis Representation.
                      float DcmRbDspDiagnosisRepresentationDataLowerRange: -Inf..Inf, scope=ECU, set at pre-compile  # Lower Range for this scale of the data in the alternative Diagnosis Representation.
                      float DcmRbDspDiagnosisRepresentationDataOffset: 0..Inf, scope=ECU, set at pre-compile, default-value=0  # Data offset of the alternative Diagnosis Representation for this scale.
                      float DcmRbDspDiagnosisRepresentationDataResolution: 0..Inf, scope=ECU, set at pre-compile  # Data resolution of the alternative Diagnosis Representation for this scale.
                      float DcmRbDspDiagnosisRepresentationDataUpperRange: -Inf..Inf, scope=ECU, set at pre-compile  # Upper Range for this scale of the data in the alternative Diagnosis Representation.
                  container DcmRbDspAlternativeDataType [0..1]  # This container contains the configuration (parameters) of an alternative Diagnosis Representation by the means of an ApplicationDataType. | Additionally the definition of a text table mapping can be a defined for ApplicationDataTypes of category TEXTTABLE and SCALE_LINEAR_AND_TEXTTABLE.
                    foreign reference DcmRbApplicationDataType: set at pre-compile, destination-type=APPLICATION-DATA-TYPE  # Alternative Diagnosis Representation for the data defined by the means of a ApplicationPrimitiveDataType of category VALUE or BOOLEAN.
                    container DcmRbDspTextTableMapping [0..0]  # This container contains the configuration (parameters) of the mapping a DataPrototype typed by AutosarDataType that refer to a CompuMethods of category TEXTTABLE or SCALE_LINEAR_AND_TEXTTABLE. | Each DcmRbDspTextTableMapping defines a value pair which is used to map the ECU internal value (DcmRbDspInternalDataValue) to the vale used in the diagnosis representation (DcmRbDspDiagnosisRepresentationDataValue) and vice versa. The set of all DcmRbDspTextTableMappings defines the whole mapping of an data.
                      integer DcmRbDspDiagnosisRepresentationDataValue [0..0]: 0..18446744073709551615, scope=ECU, set at pre-compile, with-auto=true  # The data value in the diagnosis representation.
                      integer DcmRbDspInternalDataValue [0..0]: 0..18446744073709551615, scope=ECU, set at pre-compile  # The ECU internal data value.
          container DcmRbDspRoutineRangeStopRoutine [0..1]  # Provides the configuration of Stop subservice for RoutineControl service. | Existence indicates that the StopRoutine in the RoutineControl is supported.
            function name DcmRbDspRoutineRangeStopRoutineFnc [0..1]: scope=ECU, multiplicity set at pre-compile, set at pre-compile  # Function name for request to application to stop a routine. (Routine_Stop-function) | This parameter is related to the interface Xxx_Stop.
            reference DcmRbDspRoutineRangeStopRoutineCommonAuthorizationRef [0..1]: scope=ECU, multiplicity set at link in variant link-time / pre-compile in variant post-build+pre-compile, set at link in variant link-time / pre-compile in variant post-build+pre-compile, destination=DcmDspCommonAuthorization  # Reference to DcmDspCommonAuthorization | Common authorization configuration taken from the referenced DcmRbDspStopRoutineCommonAuthorizationRef. If there is no reference, no check on the commonly defined authorization conditions shall be done to stop the routine.
            container DcmRbDspStopRoutineIn [0..1]  # Provide description of input parameter of Stop subservice for RoutineControl service.
              container DcmRbDspStopRoutineInSignal [1..*]: requires-index=true  # Provide description of a routine signal used in RoutineControl service. | The ordering defined via the index attribute of the subcontainers in this list represents the order of the dataInN elements in the XXX_Stop function call.
                enumeration DcmRbDspRoutineSignalEndianness [0..1]: {BIG_ENDIAN, LITTLE_ENDIAN, OPAQUE}, scope=ECU, multiplicity set at link in variant link-time / pre-compile in variant post-build+pre-compile, set at link in variant link-time / pre-compile in variant post-build+pre-compile  # Defines the endianness of the data belonging to a Stop Routine In Signal. | If no DcmRbDspRoutineSignalEndianness is defined the value of DcmDspDataDefaultEndianness is applicable.
                integer DcmRbDspRoutineSignalLength [0..1]: 0..65535, scope=ECU, multiplicity set at link in variant link-time / pre-compile in variant post-build+pre-compile, set at link in variant link-time / pre-compile in variant post-build+pre-compile  # Provide the length in bits of the signal in the RoutineControl request/response
                integer DcmRbDspRoutineSignalPos: 0..65535, scope=ECU, set at link in variant link-time / pre-compile in variant post-build+pre-compile  # Provide the position of the signal in the RoutineControl request/response. | The position is defined in bits.
                enumeration DcmRbDspRoutineSignalType: {BOOLEAN, SINT16, SINT16_N, SINT32, SINT32_N, SINT8, SINT8_N, UINT16, UINT16_N, UINT32, UINT32_N, UINT8, UINT8_N, VARIABLE_LENGTH}, scope=ECU, set at link in variant link-time / pre-compile in variant post-build+pre-compile  # Provide the type of the signal in the RoutineControl request/response.
                choice container DcmRbDspArgumentScaling [0..1]  # This container contains the configuration (parameters) of an alternative Diagnosis Representation. Out if this the scaling between Diagnosis and ECU internal representation and vice versa can be calculated.
                  container DcmRbDspAlternativeDataProps [0..1]  # This container contains the configuration (parameters) of an alternative Diagnosis Representation by the means of ECU configuration parameters.The physical unit of the alternative data representation is defined by the DataPrototype referenced by DcmDspExternalSRDataElementClass. Additionally the definition of a text table mapping can be a defined for DcmDspDataTypeCategory TEXTTABLE and SCALE_LINEAR_AND_TEXTTABLE | The physical unit of the alternative data representation is defined by the DataPrototype referenced by DcmDspExternalSRDataElementClass. Additionally the definition of a text table mapping can be a defined for DcmDspDataTypeCategory TEXTTABLE and SCALE_LINEAR_AND_TEXTTABLE
                    container DcmRbDspLinearScale  # This container contains the configuration (parameters) of an linear scale of the alternative Diagnosis Representation.
                      float DcmRbDspDiagnosisRepresentationDataLowerRange: -Inf..Inf, scope=ECU, set at pre-compile  # Lower Range for this scale of the data in the alternative Diagnosis Representation.
                      float DcmRbDspDiagnosisRepresentationDataOffset: 0..Inf, scope=ECU, set at pre-compile, default-value=0  # Data offset of the alternative Diagnosis Representation for this scale.
                      float DcmRbDspDiagnosisRepresentationDataResolution: 0..Inf, scope=ECU, set at pre-compile  # Data resolution of the alternative Diagnosis Representation for this scale.
                      float DcmRbDspDiagnosisRepresentationDataUpperRange: -Inf..Inf, scope=ECU, set at pre-compile  # Upper Range for this scale of the data in the alternative Diagnosis Representation.
                  container DcmRbDspAlternativeDataType [0..1]  # This container contains the configuration (parameters) of an alternative Diagnosis Representation by the means of an ApplicationDataType. | Additionally the definition of a text table mapping can be a defined for ApplicationDataTypes of category TEXTTABLE and SCALE_LINEAR_AND_TEXTTABLE.
                    foreign reference DcmRbApplicationDataType: set at pre-compile, destination-type=APPLICATION-DATA-TYPE  # Alternative Diagnosis Representation for the data defined by the means of a ApplicationPrimitiveDataType of category VALUE or BOOLEAN.
                    container DcmRbDspTextTableMapping [0..0]  # This container contains the configuration (parameters) of the mapping a DataPrototype typed by AutosarDataType that refer to a CompuMethods of category TEXTTABLE or SCALE_LINEAR_AND_TEXTTABLE. | Each DcmRbDspTextTableMapping defines a value pair which is used to map the ECU internal value (DcmRbDspInternalDataValue) to the vale used in the diagnosis representation (DcmRbDspDiagnosisRepresentationDataValue) and vice versa. The set of all DcmRbDspTextTableMappings defines the whole mapping of an data.
                      integer DcmRbDspDiagnosisRepresentationDataValue [0..0]: 0..18446744073709551615, scope=ECU, set at pre-compile, with-auto=true  # The data value in the diagnosis representation.
                      integer DcmRbDspInternalDataValue [0..0]: 0..18446744073709551615, scope=ECU, set at pre-compile  # The ECU internal data value.
            container DcmRbDspStopRoutineOut [0..1]  # Provide description of output parameter of Stop subservice for RoutineControl service.
              container DcmRbDspStopRoutineOutSignal [1..*]: requires-index=true  # Provide description of a routine signal used in RoutineControl service. | The ordering defined via the index attribute of the subcontainers in this list represents the order of the dataOutN elements in the XXX_Stop function call.
                enumeration DcmRbDspRoutineSignalEndianness [0..1]: {BIG_ENDIAN, LITTLE_ENDIAN, OPAQUE}, scope=ECU, multiplicity set at link in variant link-time / pre-compile in variant post-build+pre-compile, set at link in variant link-time / pre-compile in variant post-build+pre-compile  # Defines the endianness of the data belonging to a Stop Routine Out Signal. | If no DcmRbDspRoutineSignalEndianness is defined the value of DcmDspDataDefaultEndianness is applicable.
                integer DcmRbDspRoutineSignalLength [0..1]: 0..65535, scope=ECU, multiplicity set at link in variant link-time / pre-compile in variant post-build+pre-compile, set at link in variant link-time / pre-compile in variant post-build+pre-compile  # Provide the length in bits of the signal in the RoutineControl request/response
                integer DcmRbDspRoutineSignalPos: 0..65535, scope=ECU, set at link in variant link-time / pre-compile in variant post-build+pre-compile  # Provide the position of the signal in the RoutineControl request/response. | The position is defined in bits.
                enumeration DcmRbDspRoutineSignalType: {BOOLEAN, SINT16, SINT16_N, SINT32, SINT32_N, SINT8, SINT8_N, UINT16, UINT16_N, UINT32, UINT32_N, UINT8, UINT8_N, VARIABLE_LENGTH}, scope=ECU, set at link in variant link-time / pre-compile in variant post-build+pre-compile  # Provide the type of the signal in the RoutineControl request/response.
                choice container DcmRbDspArgumentScaling [0..1]  # This container contains the configuration (parameters) of an alternative Diagnosis Representation. Out if this the scaling between Diagnosis and ECU internal representation and vice versa can be calculated.
                  container DcmRbDspAlternativeDataProps [0..1]  # This container contains the configuration (parameters) of an alternative Diagnosis Representation by the means of ECU configuration parameters.The physical unit of the alternative data representation is defined by the DataPrototype referenced by DcmDspExternalSRDataElementClass. Additionally the definition of a text table mapping can be a defined for DcmDspDataTypeCategory TEXTTABLE and SCALE_LINEAR_AND_TEXTTABLE | The physical unit of the alternative data representation is defined by the DataPrototype referenced by DcmDspExternalSRDataElementClass. Additionally the definition of a text table mapping can be a defined for DcmDspDataTypeCategory TEXTTABLE and SCALE_LINEAR_AND_TEXTTABLE
                    container DcmRbDspLinearScale  # This container contains the configuration (parameters) of an linear scale of the alternative Diagnosis Representation.
                      float DcmRbDspDiagnosisRepresentationDataLowerRange: -Inf..Inf, scope=ECU, set at pre-compile  # Lower Range for this scale of the data in the alternative Diagnosis Representation.
                      float DcmRbDspDiagnosisRepresentationDataOffset: 0..Inf, scope=ECU, set at pre-compile, default-value=0  # Data offset of the alternative Diagnosis Representation for this scale.
                      float DcmRbDspDiagnosisRepresentationDataResolution: 0..Inf, scope=ECU, set at pre-compile  # Data resolution of the alternative Diagnosis Representation for this scale.
                      float DcmRbDspDiagnosisRepresentationDataUpperRange: -Inf..Inf, scope=ECU, set at pre-compile  # Upper Range for this scale of the data in the alternative Diagnosis Representation.
                  container DcmRbDspAlternativeDataType [0..1]  # This container contains the configuration (parameters) of an alternative Diagnosis Representation by the means of an ApplicationDataType. | Additionally the definition of a text table mapping can be a defined for ApplicationDataTypes of category TEXTTABLE and SCALE_LINEAR_AND_TEXTTABLE.
                    foreign reference DcmRbApplicationDataType: set at pre-compile, destination-type=APPLICATION-DATA-TYPE  # Alternative Diagnosis Representation for the data defined by the means of a ApplicationPrimitiveDataType of category VALUE or BOOLEAN.
                    container DcmRbDspTextTableMapping [0..0]  # This container contains the configuration (parameters) of the mapping a DataPrototype typed by AutosarDataType that refer to a CompuMethods of category TEXTTABLE or SCALE_LINEAR_AND_TEXTTABLE. | Each DcmRbDspTextTableMapping defines a value pair which is used to map the ECU internal value (DcmRbDspInternalDataValue) to the vale used in the diagnosis representation (DcmRbDspDiagnosisRepresentationDataValue) and vice versa. The set of all DcmRbDspTextTableMappings defines the whole mapping of an data.
                      integer DcmRbDspDiagnosisRepresentationDataValue [0..0]: 0..18446744073709551615, scope=ECU, set at pre-compile, with-auto=true  # The data value in the diagnosis representation.
                      integer DcmRbDspInternalDataValue [0..0]: 0..18446744073709551615, scope=ECU, set at pre-compile  # The ECU internal data value.
        container DcmRbDspTestResultByObdmid [0..1]  # This container contains the configuration (parameters) of the "Request on-board monitoring test results" service (Service $06).
          container DcmRbDspTestResultObdmidTid [1..*]  # This container contains the configuration (parameters) of a OBDMID and the assigned TIDs for the "Request on-board monitoring test results" service (Service $06).
            integer DcmRbDspTestResultObdmid: 0..255, origin=RB:AR42.1.0.0:2017-01-31, set at link in variant link-time / pre-compile in variant post-build+pre-compile  # OBDMID for Service $06
            container DcmRbDspTestResultObdmidTids [1..*]  # This container contains the configuration (parameters) of the TIDs belonging to the OBDMID for the "Request on-board monitoring test results" service (Service $06).
              function name DcmRbDspTestResultObdmidGetDTRValueFnc [0..1]: multiplicity set at pre-compile, origin=RB:AR42.1.0.0:2017-01-31, set at pre-compile  # Function name for reading value by TID (DcmRbDspTestResultObdmidGetDTRValueFnc-function).This is only relevant if DcmRbDspTestResultObdmidUsePort==FALSE.
              integer DcmRbDspTestResultObdmidTidUaSid: 0..255, origin=RB:AR42.1.0.0:2017-01-31, set at link in variant link-time / pre-compile in variant post-build+pre-compile  # Unit And Scaling ID for Service $06
              boolean DcmRbDspTestResultObdmidUsePort: origin=RB:AR42.1.0.0:2017-01-31, set at pre-compile  # If this is false, the DCM will use the function defined in DcmRbDspTestResultObdmidGetDTRValueFnc.If this is true, R-Port requiring the interface. The name of this port is the name of the container.
              reference DcmRbDspTestResultObdmidTidRef: origin=RB:AR42.1.0.0:2017-01-31, set at link in variant link-time / post-build in variant post-build / pre-compile in variant pre-compile, destination=DcmRbDspTestResultTid  # Link to reported TIDs of this OBDMID | upperMultiplicity / lowerMultiplicity:: At least one TID must be reported for an OBDMID
          container DcmRbDspTestResultTid [1..*]  # This container contains the configuration (parameters) of a single TID for the "Request on-board monitoring test results" service (Service $06). | The DCM will access the Data using an R-Port requiring a PortInterface DTRServices. The R-Port is named DtrServices_<OBDMID>_<TID> where <TID> is the name of the container DcmRbDspTestResultTid and <OBDMID> is the name of the container DcmRbDspTestResultObdmidTid.
            integer DcmRbDspTestResultTestId: 0..255, origin=RB:AR42.1.0.0:2017-01-31, set at link in variant link-time / pre-compile in variant post-build+pre-compile  # Test Id for Service $06

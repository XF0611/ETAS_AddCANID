AUTOSAR XML (schema 00047)
package /ETAS_Project/EcucModuleConfigurationValuess
  ecuc value collection EcucValueCollection_0: ecu-extract=EXTR_EcuInstance_0, ecuc-values=[Rte, ComStack, NvM, Fee, EcuC, ComM, Dcm, CanIf, Can, CanTp, rba_ArxmlGen, PduR, Crc, EcuM, CanSM, MemIf, Os]

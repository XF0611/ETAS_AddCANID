ASAP2_VERSION 1 40
/begin PROJECT ECU_Base_Prj_CAN3Mon_UdsFlashing "Generated by ETAS from Project ECU_Base_Prj_CAN3Mon_UdsFlashing"
/begin HEADER "" VERSION "000" PROJECT_NO ASD /end HEADER
/begin MODULE ECU_Base_Prj_CAN3Mon_UdsFlashing "Generated by ETAS from Project ECU_Base_Prj_CAN3Mon_UdsFlashing"
/begin MOD_COMMON "2009-04-06 10:39:06	create by ETASHexVirtualAddressTableHeaderV2" BYTE_ORDER MSB_FIRST ALIGNMENT_BYTE 1 ALIGNMENT_WORD 2 ALIGNMENT_LONG 4 ALIGNMENT_FLOAT32_IEEE 4 ALIGNMENT_FLOAT64_IEEE 8 /end MOD_COMMON
/begin CHARACTERISTIC P_Do_Active_Grp.GRP_float32_float32_float32.All_Maps_GRP.Maps_Raster_1 "" VALUE 0x1D2978 STANDARD_VALUE_S8 0.0 ident 0 1 BIT_MASK 0x1 /end CHARACTERISTIC
/begin CHARACTERISTIC P_Do_Active_Grp.GRP_float32_float32_float32.All_Maps_GRP.Maps_Raster_2 "" VALUE 0x1D433C STANDARD_VALUE_S8 0.0 ident 0 1 BIT_MASK 0x1 /end CHARACTERISTIC
/begin CHARACTERISTIC P_Do_Active_Grp.GRP_float32_float32_float32.All_Maps_GRP.Maps_Raster_3 "" VALUE 0x1D5D00 STANDARD_VALUE_S8 0.0 ident 0 1 BIT_MASK 0x1 /end CHARACTERISTIC
/begin CHARACTERISTIC P_Do_Active_Grp.GRP_sint16_sint16_sint16.All_Maps_GRP.Maps_Raster_1 "" VALUE 0x1D2B70 STANDARD_VALUE_U8 0.0 ident 0 1 BIT_MASK 0x1 /end CHARACTERISTIC
/begin CHARACTERISTIC P_Do_Active_Grp.GRP_sint16_sint16_sint16.All_Maps_GRP.Maps_Raster_2 "" VALUE 0x1D4534 STANDARD_VALUE_U8 0.0 ident 0 1 BIT_MASK 0x1 /end CHARACTERISTIC
/begin CHARACTERISTIC P_Do_Active_Grp.GRP_sint16_sint16_sint16.All_Maps_GRP.Maps_Raster_3 "" VALUE 0x1D5EF8 STANDARD_VALUE_U8 0.0 ident 0 1 BIT_MASK 0x1 /end CHARACTERISTIC
/begin CHARACTERISTIC P_Do_Active_Grp.GRP_sint32_sint32_sint32.All_Maps_GRP.Maps_Raster_1 "" VALUE 0x1D2C78 STANDARD_VALUE_U8 0.0 ident 0 1 BIT_MASK 0x1 /end CHARACTERISTIC
/begin CHARACTERISTIC P_Do_Active_Grp.GRP_sint32_sint32_sint32.All_Maps_GRP.Maps_Raster_2 "" VALUE 0x1D463C STANDARD_VALUE_U8 0.0 ident 0 1 BIT_MASK 0x1 /end CHARACTERISTIC
/begin CHARACTERISTIC P_Do_Active_Grp.GRP_sint32_sint32_sint32.All_Maps_GRP.Maps_Raster_3 "" VALUE 0x1D6000 STANDARD_VALUE_U8 0.0 ident 0 1 BIT_MASK 0x1 /end CHARACTERISTIC
/begin CHARACTERISTIC P_Do_Active_Grp.GRP_sint8_sint8_sint8.All_Maps_GRP.Maps_Raster_1 "" VALUE 0x1D2E6C STANDARD_VALUE_U8 0.0 ident 0 1 BIT_MASK 0x1 /end CHARACTERISTIC
/begin CHARACTERISTIC P_Do_Active_Grp.GRP_sint8_sint8_sint8.All_Maps_GRP.Maps_Raster_2 "" VALUE 0x1D4830 STANDARD_VALUE_U8 0.0 ident 0 1 BIT_MASK 0x1 /end CHARACTERISTIC
/begin CHARACTERISTIC P_Do_Active_Grp.GRP_sint8_sint8_sint8.All_Maps_GRP.Maps_Raster_3 "" VALUE 0x1D61F4 STANDARD_VALUE_U8 0.0 ident 0 1 BIT_MASK 0x1 /end CHARACTERISTIC
/begin CHARACTERISTIC P_Do_Active_Grp.GRP_uint16_uint16_uint16.All_Maps_GRP.Maps_Raster_1 "" VALUE 0x1D2EF8 STANDARD_VALUE_U8 0.0 ident 0 1 BIT_MASK 0x1 /end CHARACTERISTIC
/begin CHARACTERISTIC P_Do_Active_Grp.GRP_uint16_uint16_uint16.All_Maps_GRP.Maps_Raster_2 "" VALUE 0x1D48BC STANDARD_VALUE_U8 0.0 ident 0 1 BIT_MASK 0x1 /end CHARACTERISTIC
/begin CHARACTERISTIC P_Do_Active_Grp.GRP_uint16_uint16_uint16.All_Maps_GRP.Maps_Raster_3 "" VALUE 0x1D6280 STANDARD_VALUE_U8 0.0 ident 0 1 BIT_MASK 0x1 /end CHARACTERISTIC
/begin CHARACTERISTIC P_Do_Active_Grp.GRP_uint32_uint32_uint32.All_Maps_GRP.Maps_Raster_1 "" VALUE 0x1D3000 STANDARD_VALUE_U8 0.0 ident 0 1 BIT_MASK 0x1 /end CHARACTERISTIC
/begin CHARACTERISTIC P_Do_Active_Grp.GRP_uint32_uint32_uint32.All_Maps_GRP.Maps_Raster_2 "" VALUE 0x1D49C4 STANDARD_VALUE_U8 0.0 ident 0 1 BIT_MASK 0x1 /end CHARACTERISTIC
/begin CHARACTERISTIC P_Do_Active_Grp.GRP_uint32_uint32_uint32.All_Maps_GRP.Maps_Raster_3 "" VALUE 0x1D6388 STANDARD_VALUE_U8 0.0 ident 0 1 BIT_MASK 0x1 /end CHARACTERISTIC
/begin CHARACTERISTIC P_Do_Active_Grp.GRP_uint8_uint8_uint8.All_Maps_GRP.Maps_Raster_1 "" VALUE 0x1D31F4 STANDARD_VALUE_U8 0.0 ident 0 1 BIT_MASK 0x1 /end CHARACTERISTIC
/begin CHARACTERISTIC P_Do_Active_Grp.GRP_uint8_uint8_uint8.All_Maps_GRP.Maps_Raster_2 "" VALUE 0x1D4BB8 STANDARD_VALUE_U8 0.0 ident 0 1 BIT_MASK 0x1 /end CHARACTERISTIC
/begin CHARACTERISTIC P_Do_Active_Grp.GRP_uint8_uint8_uint8.All_Maps_GRP.Maps_Raster_3 "" VALUE 0x1D657C STANDARD_VALUE_U8 0.0 ident 0 1 BIT_MASK 0x1 /end CHARACTERISTIC
/begin CHARACTERISTIC P_Do_Active_Std.FIX_float32_float32_float32.All_Maps_FIX.Maps_Raster_1 "" VALUE 0x1D21AC STANDARD_VALUE_S8 0.0 ident 0 1 BIT_MASK 0x1 /end CHARACTERISTIC
/begin CHARACTERISTIC P_Do_Active_Std.FIX_float32_float32_float32.All_Maps_FIX.Maps_Raster_2 "" VALUE 0x1D3B70 STANDARD_VALUE_S8 0.0 ident 0 1 BIT_MASK 0x1 /end CHARACTERISTIC
/begin CHARACTERISTIC P_Do_Active_Std.FIX_float32_float32_float32.All_Maps_FIX.Maps_Raster_3 "" VALUE 0x1D5534 STANDARD_VALUE_S8 0.0 ident 0 1 BIT_MASK 0x1 /end CHARACTERISTIC
/begin CHARACTERISTIC P_Do_Active_Std.FIX_sint16_sint16_sint16.All_Maps_FIX.Maps_Raster_1 "" VALUE 0x1D235C STANDARD_VALUE_U8 0.0 ident 0 1 BIT_MASK 0x1 /end CHARACTERISTIC
/begin CHARACTERISTIC P_Do_Active_Std.FIX_sint16_sint16_sint16.All_Maps_FIX.Maps_Raster_2 "" VALUE 0x1D3D20 STANDARD_VALUE_U8 0.0 ident 0 1 BIT_MASK 0x1 /end CHARACTERISTIC
/begin CHARACTERISTIC P_Do_Active_Std.FIX_sint16_sint16_sint16.All_Maps_FIX.Maps_Raster_3 "" VALUE 0x1D56E4 STANDARD_VALUE_U8 0.0 ident 0 1 BIT_MASK 0x1 /end CHARACTERISTIC
/begin CHARACTERISTIC P_Do_Active_Std.FIX_sint32_sint32_sint32.All_Maps_FIX.Maps_Raster_1 "" VALUE 0x1D2440 STANDARD_VALUE_U8 0.0 ident 0 1 BIT_MASK 0x1 /end CHARACTERISTIC
/begin CHARACTERISTIC P_Do_Active_Std.FIX_sint32_sint32_sint32.All_Maps_FIX.Maps_Raster_2 "" VALUE 0x1D3E04 STANDARD_VALUE_U8 0.0 ident 0 1 BIT_MASK 0x1 /end CHARACTERISTIC
/begin CHARACTERISTIC P_Do_Active_Std.FIX_sint32_sint32_sint32.All_Maps_FIX.Maps_Raster_3 "" VALUE 0x1D57C8 STANDARD_VALUE_U8 0.0 ident 0 1 BIT_MASK 0x1 /end CHARACTERISTIC
/begin CHARACTERISTIC P_Do_Active_Std.FIX_sint8_sint8_sint8.All_Maps_FIX.Maps_Raster_1 "" VALUE 0x1D25EC STANDARD_VALUE_U8 0.0 ident 0 1 BIT_MASK 0x1 /end CHARACTERISTIC
/begin CHARACTERISTIC P_Do_Active_Std.FIX_sint8_sint8_sint8.All_Maps_FIX.Maps_Raster_2 "" VALUE 0x1D3FB0 STANDARD_VALUE_U8 0.0 ident 0 1 BIT_MASK 0x1 /end CHARACTERISTIC
/begin CHARACTERISTIC P_Do_Active_Std.FIX_sint8_sint8_sint8.All_Maps_FIX.Maps_Raster_3 "" VALUE 0x1D5974 STANDARD_VALUE_U8 0.0 ident 0 1 BIT_MASK 0x1 /end CHARACTERISTIC
/begin CHARACTERISTIC P_Do_Active_Std.FIX_uint16_uint16_uint16.All_Maps_FIX.Maps_Raster_1 "" VALUE 0x1D2664 STANDARD_VALUE_U8 0.0 ident 0 1 BIT_MASK 0x1 /end CHARACTERISTIC
/begin CHARACTERISTIC P_Do_Active_Std.FIX_uint16_uint16_uint16.All_Maps_FIX.Maps_Raster_2 "" VALUE 0x1D4028 STANDARD_VALUE_U8 0.0 ident 0 1 BIT_MASK 0x1 /end CHARACTERISTIC
/begin CHARACTERISTIC P_Do_Active_Std.FIX_uint16_uint16_uint16.All_Maps_FIX.Maps_Raster_3 "" VALUE 0x1D59EC STANDARD_VALUE_U8 0.0 ident 0 1 BIT_MASK 0x1 /end CHARACTERISTIC
/begin CHARACTERISTIC P_Do_Active_Std.FIX_uint32_uint32_uint32.All_Maps_FIX.Maps_Raster_1 "" VALUE 0x1D2748 STANDARD_VALUE_U8 0.0 ident 0 1 BIT_MASK 0x1 /end CHARACTERISTIC
/begin CHARACTERISTIC P_Do_Active_Std.FIX_uint32_uint32_uint32.All_Maps_FIX.Maps_Raster_2 "" VALUE 0x1D410C STANDARD_VALUE_U8 0.0 ident 0 1 BIT_MASK 0x1 /end CHARACTERISTIC
/begin CHARACTERISTIC P_Do_Active_Std.FIX_uint32_uint32_uint32.All_Maps_FIX.Maps_Raster_3 "" VALUE 0x1D5AD0 STANDARD_VALUE_U8 0.0 ident 0 1 BIT_MASK 0x1 /end CHARACTERISTIC
/begin CHARACTERISTIC P_Do_Active_Std.FIX_uint8_uint8_uint8.All_Maps_FIX.Maps_Raster_1 "" VALUE 0x1D28F4 STANDARD_VALUE_U8 0.0 ident 0 1 BIT_MASK 0x1 /end CHARACTERISTIC
/begin CHARACTERISTIC P_Do_Active_Std.FIX_uint8_uint8_uint8.All_Maps_FIX.Maps_Raster_2 "" VALUE 0x1D42B8 STANDARD_VALUE_U8 0.0 ident 0 1 BIT_MASK 0x1 /end CHARACTERISTIC
/begin CHARACTERISTIC P_Do_Active_Std.FIX_uint8_uint8_uint8.All_Maps_FIX.Maps_Raster_3 "" VALUE 0x1D5C7C STANDARD_VALUE_U8 0.0 ident 0 1 BIT_MASK 0x1 /end CHARACTERISTIC
/begin CHARACTERISTIC P_Do_All_FIX_Maps.All_Maps_FIX.Maps_Raster_1 "" VALUE 0x1D219C STANDARD_VALUE_U8 0.0 ident 0 1 BIT_MASK 0x1 /end CHARACTERISTIC
/begin CHARACTERISTIC P_Do_All_FIX_Maps.All_Maps_FIX.Maps_Raster_2 "" VALUE 0x1D3B60 STANDARD_VALUE_U8 0.0 ident 0 1 BIT_MASK 0x1 /end CHARACTERISTIC
/begin CHARACTERISTIC P_Do_All_FIX_Maps.All_Maps_FIX.Maps_Raster_3 "" VALUE 0x1D5524 STANDARD_VALUE_U8 0.0 ident 0 1 BIT_MASK 0x1 /end CHARACTERISTIC
/begin CHARACTERISTIC P_Do_All_GRP_Maps.All_Maps_GRP.Maps_Raster_1 "" VALUE 0x1D2964 STANDARD_VALUE_U8 0.0 ident 0 1 BIT_MASK 0x1 /end CHARACTERISTIC
/begin CHARACTERISTIC P_Do_All_GRP_Maps.All_Maps_GRP.Maps_Raster_2 "" VALUE 0x1D4328 STANDARD_VALUE_U8 0.0 ident 0 1 BIT_MASK 0x1 /end CHARACTERISTIC
/begin CHARACTERISTIC P_Do_All_GRP_Maps.All_Maps_GRP.Maps_Raster_3 "" VALUE 0x1D5CEC STANDARD_VALUE_U8 0.0 ident 0 1 BIT_MASK 0x1 /end CHARACTERISTIC
/begin CHARACTERISTIC P_Do_GET.GRP_float32_float32_float32.All_Maps_GRP.Maps_Raster_1 "" VALUE 0x1D2979 STANDARD_VALUE_S8 0.0 ident 0 1 BIT_MASK 0x1 /end CHARACTERISTIC
/begin CHARACTERISTIC P_Do_GET.GRP_float32_float32_float32.All_Maps_GRP.Maps_Raster_2 "" VALUE 0x1D433D STANDARD_VALUE_S8 0.0 ident 0 1 BIT_MASK 0x1 /end CHARACTERISTIC
/begin CHARACTERISTIC P_Do_GET.GRP_float32_float32_float32.All_Maps_GRP.Maps_Raster_3 "" VALUE 0x1D5D01 STANDARD_VALUE_S8 0.0 ident 0 1 BIT_MASK 0x1 /end CHARACTERISTIC
/begin CHARACTERISTIC P_Do_GET.GRP_sint16_sint16_sint16.All_Maps_GRP.Maps_Raster_1 "" VALUE 0x1D2B71 STANDARD_VALUE_S8 0.0 ident 0 1 BIT_MASK 0x1 /end CHARACTERISTIC
/begin CHARACTERISTIC P_Do_GET.GRP_sint16_sint16_sint16.All_Maps_GRP.Maps_Raster_2 "" VALUE 0x1D4535 STANDARD_VALUE_S8 0.0 ident 0 1 BIT_MASK 0x1 /end CHARACTERISTIC
/begin CHARACTERISTIC P_Do_GET.GRP_sint16_sint16_sint16.All_Maps_GRP.Maps_Raster_3 "" VALUE 0x1D5EF9 STANDARD_VALUE_S8 0.0 ident 0 1 BIT_MASK 0x1 /end CHARACTERISTIC
/begin CHARACTERISTIC P_Do_GET.GRP_sint32_sint32_sint32.All_Maps_GRP.Maps_Raster_1 "" VALUE 0x1D2C79 STANDARD_VALUE_U8 0.0 ident 0 1 BIT_MASK 0x1 /end CHARACTERISTIC
/begin CHARACTERISTIC P_Do_GET.GRP_sint32_sint32_sint32.All_Maps_GRP.Maps_Raster_2 "" VALUE 0x1D463D STANDARD_VALUE_U8 0.0 ident 0 1 BIT_MASK 0x1 /end CHARACTERISTIC
/begin CHARACTERISTIC P_Do_GET.GRP_sint32_sint32_sint32.All_Maps_GRP.Maps_Raster_3 "" VALUE 0x1D6001 STANDARD_VALUE_U8 0.0 ident 0 1 BIT_MASK 0x1 /end CHARACTERISTIC
/begin CHARACTERISTIC P_Do_GET.GRP_sint8_sint8_sint8.All_Maps_GRP.Maps_Raster_1 "" VALUE 0x1D2E6D STANDARD_VALUE_S8 0.0 ident 0 1 BIT_MASK 0x1 /end CHARACTERISTIC
/begin CHARACTERISTIC P_Do_GET.GRP_sint8_sint8_sint8.All_Maps_GRP.Maps_Raster_2 "" VALUE 0x1D4831 STANDARD_VALUE_S8 0.0 ident 0 1 BIT_MASK 0x1 /end CHARACTERISTIC
/begin CHARACTERISTIC P_Do_GET.GRP_sint8_sint8_sint8.All_Maps_GRP.Maps_Raster_3 "" VALUE 0x1D61F5 STANDARD_VALUE_S8 0.0 ident 0 1 BIT_MASK 0x1 /end CHARACTERISTIC
/begin CHARACTERISTIC P_Do_GET.GRP_uint16_uint16_uint16.All_Maps_GRP.Maps_Raster_1 "" VALUE 0x1D2EF9 STANDARD_VALUE_S8 0.0 ident 0 1 BIT_MASK 0x1 /end CHARACTERISTIC
/begin CHARACTERISTIC P_Do_GET.GRP_uint16_uint16_uint16.All_Maps_GRP.Maps_Raster_2 "" VALUE 0x1D48BD STANDARD_VALUE_S8 0.0 ident 0 1 BIT_MASK 0x1 /end CHARACTERISTIC
/begin CHARACTERISTIC P_Do_GET.GRP_uint16_uint16_uint16.All_Maps_GRP.Maps_Raster_3 "" VALUE 0x1D6281 STANDARD_VALUE_S8 0.0 ident 0 1 BIT_MASK 0x1 /end CHARACTERISTIC
/begin CHARACTERISTIC P_Do_GET.GRP_uint32_uint32_uint32.All_Maps_GRP.Maps_Raster_1 "" VALUE 0x1D3001 STANDARD_VALUE_S8 0.0 ident 0 1 BIT_MASK 0x1 /end CHARACTERISTIC
/begin CHARACTERISTIC P_Do_GET.GRP_uint32_uint32_uint32.All_Maps_GRP.Maps_Raster_2 "" VALUE 0x1D49C5 STANDARD_VALUE_S8 0.0 ident 0 1 BIT_MASK 0x1 /end CHARACTERISTIC
/begin CHARACTERISTIC P_Do_GET.GRP_uint32_uint32_uint32.All_Maps_GRP.Maps_Raster_3 "" VALUE 0x1D6389 STANDARD_VALUE_S8 0.0 ident 0 1 BIT_MASK 0x1 /end CHARACTERISTIC
/begin CHARACTERISTIC P_Do_GET.GRP_uint8_uint8_uint8.All_Maps_GRP.Maps_Raster_1 "" VALUE 0x1D31F5 STANDARD_VALUE_S8 0.0 ident 0 1 BIT_MASK 0x1 /end CHARACTERISTIC
/begin CHARACTERISTIC P_Do_GET.GRP_uint8_uint8_uint8.All_Maps_GRP.Maps_Raster_2 "" VALUE 0x1D4BB9 STANDARD_VALUE_S8 0.0 ident 0 1 BIT_MASK 0x1 /end CHARACTERISTIC
/begin CHARACTERISTIC P_Do_GET.GRP_uint8_uint8_uint8.All_Maps_GRP.Maps_Raster_3 "" VALUE 0x1D657D STANDARD_VALUE_S8 0.0 ident 0 1 BIT_MASK 0x1 /end CHARACTERISTIC
/begin CHARACTERISTIC P_Do_X_SET.GRP_float32_float32_float32.All_Maps_GRP.Maps_Raster_1 "" VALUE 0x1D297A STANDARD_VALUE_S8 0.0 ident 0 1 BIT_MASK 0x1 /end CHARACTERISTIC
/begin CHARACTERISTIC P_Do_X_SET.GRP_float32_float32_float32.All_Maps_GRP.Maps_Raster_2 "" VALUE 0x1D433E STANDARD_VALUE_S8 0.0 ident 0 1 BIT_MASK 0x1 /end CHARACTERISTIC
/begin CHARACTERISTIC P_Do_X_SET.GRP_float32_float32_float32.All_Maps_GRP.Maps_Raster_3 "" VALUE 0x1D5D02 STANDARD_VALUE_S8 0.0 ident 0 1 BIT_MASK 0x1 /end CHARACTERISTIC
/begin CHARACTERISTIC P_Do_X_SET.GRP_sint16_sint16_sint16.All_Maps_GRP.Maps_Raster_1 "" VALUE 0x1D2B72 STANDARD_VALUE_S8 0.0 ident 0 1 BIT_MASK 0x1 /end CHARACTERISTIC
/begin CHARACTERISTIC P_Do_X_SET.GRP_sint16_sint16_sint16.All_Maps_GRP.Maps_Raster_2 "" VALUE 0x1D4536 STANDARD_VALUE_S8 0.0 ident 0 1 BIT_MASK 0x1 /end CHARACTERISTIC
/begin CHARACTERISTIC P_Do_X_SET.GRP_sint16_sint16_sint16.All_Maps_GRP.Maps_Raster_3 "" VALUE 0x1D5EFA STANDARD_VALUE_S8 0.0 ident 0 1 BIT_MASK 0x1 /end CHARACTERISTIC
/begin CHARACTERISTIC P_Do_X_SET.GRP_sint32_sint32_sint32.All_Maps_GRP.Maps_Raster_1 "" VALUE 0x1D2C7A STANDARD_VALUE_U8 0.0 ident 0 1 BIT_MASK 0x1 /end CHARACTERISTIC
/begin CHARACTERISTIC P_Do_X_SET.GRP_sint32_sint32_sint32.All_Maps_GRP.Maps_Raster_2 "" VALUE 0x1D463E STANDARD_VALUE_U8 0.0 ident 0 1 BIT_MASK 0x1 /end CHARACTERISTIC
/begin CHARACTERISTIC P_Do_X_SET.GRP_sint32_sint32_sint32.All_Maps_GRP.Maps_Raster_3 "" VALUE 0x1D6002 STANDARD_VALUE_U8 0.0 ident 0 1 BIT_MASK 0x1 /end CHARACTERISTIC
/begin CHARACTERISTIC P_Do_X_SET.GRP_sint8_sint8_sint8.All_Maps_GRP.Maps_Raster_1 "" VALUE 0x1D2E6E STANDARD_VALUE_S8 0.0 ident 0 1 BIT_MASK 0x1 /end CHARACTERISTIC
/begin CHARACTERISTIC P_Do_X_SET.GRP_sint8_sint8_sint8.All_Maps_GRP.Maps_Raster_2 "" VALUE 0x1D4832 STANDARD_VALUE_S8 0.0 ident 0 1 BIT_MASK 0x1 /end CHARACTERISTIC
/begin CHARACTERISTIC P_Do_X_SET.GRP_sint8_sint8_sint8.All_Maps_GRP.Maps_Raster_3 "" VALUE 0x1D61F6 STANDARD_VALUE_S8 0.0 ident 0 1 BIT_MASK 0x1 /end CHARACTERISTIC
/begin CHARACTERISTIC P_Do_X_SET.GRP_uint16_uint16_uint16.All_Maps_GRP.Maps_Raster_1 "" VALUE 0x1D2EFA STANDARD_VALUE_S8 0.0 ident 0 1 BIT_MASK 0x1 /end CHARACTERISTIC
/begin CHARACTERISTIC P_Do_X_SET.GRP_uint16_uint16_uint16.All_Maps_GRP.Maps_Raster_2 "" VALUE 0x1D48BE STANDARD_VALUE_S8 0.0 ident 0 1 BIT_MASK 0x1 /end CHARACTERISTIC
/begin CHARACTERISTIC P_Do_X_SET.GRP_uint16_uint16_uint16.All_Maps_GRP.Maps_Raster_3 "" VALUE 0x1D6282 STANDARD_VALUE_S8 0.0 ident 0 1 BIT_MASK 0x1 /end CHARACTERISTIC
/begin CHARACTERISTIC P_Do_X_SET.GRP_uint32_uint32_uint32.All_Maps_GRP.Maps_Raster_1 "" VALUE 0x1D3002 STANDARD_VALUE_S8 0.0 ident 0 1 BIT_MASK 0x1 /end CHARACTERISTIC
/begin CHARACTERISTIC P_Do_X_SET.GRP_uint32_uint32_uint32.All_Maps_GRP.Maps_Raster_2 "" VALUE 0x1D49C6 STANDARD_VALUE_S8 0.0 ident 0 1 BIT_MASK 0x1 /end CHARACTERISTIC
/begin CHARACTERISTIC P_Do_X_SET.GRP_uint32_uint32_uint32.All_Maps_GRP.Maps_Raster_3 "" VALUE 0x1D638A STANDARD_VALUE_S8 0.0 ident 0 1 BIT_MASK 0x1 /end CHARACTERISTIC
/begin CHARACTERISTIC P_Do_X_SET.GRP_uint8_uint8_uint8.All_Maps_GRP.Maps_Raster_1 "" VALUE 0x1D31F6 STANDARD_VALUE_S8 0.0 ident 0 1 BIT_MASK 0x1 /end CHARACTERISTIC
/begin CHARACTERISTIC P_Do_X_SET.GRP_uint8_uint8_uint8.All_Maps_GRP.Maps_Raster_2 "" VALUE 0x1D4BBA STANDARD_VALUE_S8 0.0 ident 0 1 BIT_MASK 0x1 /end CHARACTERISTIC
/begin CHARACTERISTIC P_Do_X_SET.GRP_uint8_uint8_uint8.All_Maps_GRP.Maps_Raster_3 "" VALUE 0x1D657E STANDARD_VALUE_S8 0.0 ident 0 1 BIT_MASK 0x1 /end CHARACTERISTIC
/begin CHARACTERISTIC P_Do_Y_SET.GRP_float32_float32_float32.All_Maps_GRP.Maps_Raster_1 "" VALUE 0x1D297B STANDARD_VALUE_S8 0.0 ident 0 1 BIT_MASK 0x1 /end CHARACTERISTIC
/begin CHARACTERISTIC P_Do_Y_SET.GRP_float32_float32_float32.All_Maps_GRP.Maps_Raster_2 "" VALUE 0x1D433F STANDARD_VALUE_S8 0.0 ident 0 1 BIT_MASK 0x1 /end CHARACTERISTIC
/begin CHARACTERISTIC P_Do_Y_SET.GRP_float32_float32_float32.All_Maps_GRP.Maps_Raster_3 "" VALUE 0x1D5D03 STANDARD_VALUE_S8 0.0 ident 0 1 BIT_MASK 0x1 /end CHARACTERISTIC
/begin CHARACTERISTIC P_Do_Y_SET.GRP_sint16_sint16_sint16.All_Maps_GRP.Maps_Raster_1 "" VALUE 0x1D2B73 STANDARD_VALUE_S8 0.0 ident 0 1 BIT_MASK 0x1 /end CHARACTERISTIC
/begin CHARACTERISTIC P_Do_Y_SET.GRP_sint16_sint16_sint16.All_Maps_GRP.Maps_Raster_2 "" VALUE 0x1D4537 STANDARD_VALUE_S8 0.0 ident 0 1 BIT_MASK 0x1 /end CHARACTERISTIC
/begin CHARACTERISTIC P_Do_Y_SET.GRP_sint16_sint16_sint16.All_Maps_GRP.Maps_Raster_3 "" VALUE 0x1D5EFB STANDARD_VALUE_S8 0.0 ident 0 1 BIT_MASK 0x1 /end CHARACTERISTIC
/begin CHARACTERISTIC P_Do_Y_SET.GRP_sint32_sint32_sint32.All_Maps_GRP.Maps_Raster_1 "" VALUE 0x1D2C7B STANDARD_VALUE_U8 0.0 ident 0 1 BIT_MASK 0x1 /end CHARACTERISTIC
/begin CHARACTERISTIC P_Do_Y_SET.GRP_sint32_sint32_sint32.All_Maps_GRP.Maps_Raster_2 "" VALUE 0x1D463F STANDARD_VALUE_U8 0.0 ident 0 1 BIT_MASK 0x1 /end CHARACTERISTIC
/begin CHARACTERISTIC P_Do_Y_SET.GRP_sint32_sint32_sint32.All_Maps_GRP.Maps_Raster_3 "" VALUE 0x1D6003 STANDARD_VALUE_U8 0.0 ident 0 1 BIT_MASK 0x1 /end CHARACTERISTIC
/begin CHARACTERISTIC P_Do_Y_SET.GRP_sint8_sint8_sint8.All_Maps_GRP.Maps_Raster_1 "" VALUE 0x1D2E6F STANDARD_VALUE_S8 0.0 ident 0 1 BIT_MASK 0x1 /end CHARACTERISTIC
/begin CHARACTERISTIC P_Do_Y_SET.GRP_sint8_sint8_sint8.All_Maps_GRP.Maps_Raster_2 "" VALUE 0x1D4833 STANDARD_VALUE_S8 0.0 ident 0 1 BIT_MASK 0x1 /end CHARACTERISTIC
/begin CHARACTERISTIC P_Do_Y_SET.GRP_sint8_sint8_sint8.All_Maps_GRP.Maps_Raster_3 "" VALUE 0x1D61F7 STANDARD_VALUE_S8 0.0 ident 0 1 BIT_MASK 0x1 /end CHARACTERISTIC
/begin CHARACTERISTIC P_Do_Y_SET.GRP_uint16_uint16_uint16.All_Maps_GRP.Maps_Raster_1 "" VALUE 0x1D2EFB STANDARD_VALUE_S8 0.0 ident 0 1 BIT_MASK 0x1 /end CHARACTERISTIC
/begin CHARACTERISTIC P_Do_Y_SET.GRP_uint16_uint16_uint16.All_Maps_GRP.Maps_Raster_2 "" VALUE 0x1D48BF STANDARD_VALUE_S8 0.0 ident 0 1 BIT_MASK 0x1 /end CHARACTERISTIC
/begin CHARACTERISTIC P_Do_Y_SET.GRP_uint16_uint16_uint16.All_Maps_GRP.Maps_Raster_3 "" VALUE 0x1D6283 STANDARD_VALUE_S8 0.0 ident 0 1 BIT_MASK 0x1 /end CHARACTERISTIC
/begin CHARACTERISTIC P_Do_Y_SET.GRP_uint32_uint32_uint32.All_Maps_GRP.Maps_Raster_1 "" VALUE 0x1D3003 STANDARD_VALUE_S8 0.0 ident 0 1 BIT_MASK 0x1 /end CHARACTERISTIC
/begin CHARACTERISTIC P_Do_Y_SET.GRP_uint32_uint32_uint32.All_Maps_GRP.Maps_Raster_2 "" VALUE 0x1D49C7 STANDARD_VALUE_S8 0.0 ident 0 1 BIT_MASK 0x1 /end CHARACTERISTIC
/begin CHARACTERISTIC P_Do_Y_SET.GRP_uint32_uint32_uint32.All_Maps_GRP.Maps_Raster_3 "" VALUE 0x1D638B STANDARD_VALUE_S8 0.0 ident 0 1 BIT_MASK 0x1 /end CHARACTERISTIC
/begin CHARACTERISTIC P_Do_Y_SET.GRP_uint8_uint8_uint8.All_Maps_GRP.Maps_Raster_1 "" VALUE 0x1D31F7 STANDARD_VALUE_S8 0.0 ident 0 1 BIT_MASK 0x1 /end CHARACTERISTIC
/begin CHARACTERISTIC P_Do_Y_SET.GRP_uint8_uint8_uint8.All_Maps_GRP.Maps_Raster_2 "" VALUE 0x1D4BBB STANDARD_VALUE_S8 0.0 ident 0 1 BIT_MASK 0x1 /end CHARACTERISTIC
/begin CHARACTERISTIC P_Do_Y_SET.GRP_uint8_uint8_uint8.All_Maps_GRP.Maps_Raster_3 "" VALUE 0x1D657F STANDARD_VALUE_S8 0.0 ident 0 1 BIT_MASK 0x1 /end CHARACTERISTIC
/begin CHARACTERISTIC P_In_X.FIX_float32_float32_float32.All_Maps_FIX.Maps_Raster_1 "" VALUE 0x1D21A4 STANDARD_VALUE_R32 0.0 ident -1.e+037 1.e+037 /end CHARACTERISTIC
/begin CHARACTERISTIC P_In_X.FIX_float32_float32_float32.All_Maps_FIX.Maps_Raster_2 "" VALUE 0x1D3B68 STANDARD_VALUE_R32 0.0 ident -1.e+037 1.e+037 /end CHARACTERISTIC
/begin CHARACTERISTIC P_In_X.FIX_float32_float32_float32.All_Maps_FIX.Maps_Raster_3 "" VALUE 0x1D552C STANDARD_VALUE_R32 0.0 ident -1.e+037 1.e+037 /end CHARACTERISTIC
/begin CHARACTERISTIC P_In_X.FIX_sint16_sint16_sint16.All_Maps_FIX.Maps_Raster_1 "" VALUE 0x1D2358 STANDARD_VALUE_S16 0.0 ident -32768.0 32767.0 /end CHARACTERISTIC
/begin CHARACTERISTIC P_In_X.FIX_sint16_sint16_sint16.All_Maps_FIX.Maps_Raster_2 "" VALUE 0x1D3D1C STANDARD_VALUE_S16 0.0 ident -32768.0 32767.0 /end CHARACTERISTIC
/begin CHARACTERISTIC P_In_X.FIX_sint16_sint16_sint16.All_Maps_FIX.Maps_Raster_3 "" VALUE 0x1D56E0 STANDARD_VALUE_S16 0.0 ident -32768.0 32767.0 /end CHARACTERISTIC
/begin CHARACTERISTIC P_In_X.FIX_sint32_sint32_sint32.All_Maps_FIX.Maps_Raster_1 "" VALUE 0x1D2438 STANDARD_VALUE_S32 0.0 ident -2147483648.0 2147483647.0 /end CHARACTERISTIC
/begin CHARACTERISTIC P_In_X.FIX_sint32_sint32_sint32.All_Maps_FIX.Maps_Raster_2 "" VALUE 0x1D3DFC STANDARD_VALUE_S32 0.0 ident -2147483648.0 2147483647.0 /end CHARACTERISTIC
/begin CHARACTERISTIC P_In_X.FIX_sint32_sint32_sint32.All_Maps_FIX.Maps_Raster_3 "" VALUE 0x1D57C0 STANDARD_VALUE_S32 0.0 ident -2147483648.0 2147483647.0 /end CHARACTERISTIC
/begin CHARACTERISTIC P_In_X.FIX_sint8_sint8_sint8.All_Maps_FIX.Maps_Raster_1 "" VALUE 0x1D25ED STANDARD_VALUE_S8 0.0 ident -128.0 127.0 /end CHARACTERISTIC
/begin CHARACTERISTIC P_In_X.FIX_sint8_sint8_sint8.All_Maps_FIX.Maps_Raster_2 "" VALUE 0x1D3FB1 STANDARD_VALUE_S8 0.0 ident -128.0 127.0 /end CHARACTERISTIC
/begin CHARACTERISTIC P_In_X.FIX_sint8_sint8_sint8.All_Maps_FIX.Maps_Raster_3 "" VALUE 0x1D5975 STANDARD_VALUE_S8 0.0 ident -128.0 127.0 /end CHARACTERISTIC
/begin CHARACTERISTIC P_In_X.FIX_uint16_uint16_uint16.All_Maps_FIX.Maps_Raster_1 "" VALUE 0x1D2660 STANDARD_VALUE_U16 0.0 ident 0.0 65535.0 /end CHARACTERISTIC
/begin CHARACTERISTIC P_In_X.FIX_uint16_uint16_uint16.All_Maps_FIX.Maps_Raster_2 "" VALUE 0x1D4024 STANDARD_VALUE_U16 0.0 ident 0.0 65535.0 /end CHARACTERISTIC
/begin CHARACTERISTIC P_In_X.FIX_uint16_uint16_uint16.All_Maps_FIX.Maps_Raster_3 "" VALUE 0x1D59E8 STANDARD_VALUE_U16 0.0 ident 0.0 65535.0 /end CHARACTERISTIC
/begin CHARACTERISTIC P_In_X.FIX_uint32_uint32_uint32.All_Maps_FIX.Maps_Raster_1 "" VALUE 0x1D2740 STANDARD_VALUE_U32 0.0 ident 0.0 4294967295.0 /end CHARACTERISTIC
/begin CHARACTERISTIC P_In_X.FIX_uint32_uint32_uint32.All_Maps_FIX.Maps_Raster_2 "" VALUE 0x1D4104 STANDARD_VALUE_U32 0.0 ident 0.0 4294967295.0 /end CHARACTERISTIC
/begin CHARACTERISTIC P_In_X.FIX_uint32_uint32_uint32.All_Maps_FIX.Maps_Raster_3 "" VALUE 0x1D5AC8 STANDARD_VALUE_U32 0.0 ident 0.0 4294967295.0 /end CHARACTERISTIC
/begin CHARACTERISTIC P_In_X.FIX_uint8_uint8_uint8.All_Maps_FIX.Maps_Raster_1 "" VALUE 0x1D28F5 STANDARD_VALUE_U8 0.0 ident 0.0 255.0 /end CHARACTERISTIC
/begin CHARACTERISTIC P_In_X.FIX_uint8_uint8_uint8.All_Maps_FIX.Maps_Raster_2 "" VALUE 0x1D42B9 STANDARD_VALUE_U8 0.0 ident 0.0 255.0 /end CHARACTERISTIC
/begin CHARACTERISTIC P_In_X.FIX_uint8_uint8_uint8.All_Maps_FIX.Maps_Raster_3 "" VALUE 0x1D5C7D STANDARD_VALUE_U8 0.0 ident 0.0 255.0 /end CHARACTERISTIC
/begin CHARACTERISTIC P_In_X.GRP_float32_float32_float32.All_Maps_GRP.Maps_Raster_1 "" VALUE 0x1D2970 STANDARD_VALUE_R32 0.0 ident -1.e+037 1.e+037 /end CHARACTERISTIC
/begin CHARACTERISTIC P_In_X.GRP_float32_float32_float32.All_Maps_GRP.Maps_Raster_2 "" VALUE 0x1D4334 STANDARD_VALUE_R32 0.0 ident -1.e+037 1.e+037 /end CHARACTERISTIC
/begin CHARACTERISTIC P_In_X.GRP_float32_float32_float32.All_Maps_GRP.Maps_Raster_3 "" VALUE 0x1D5CF8 STANDARD_VALUE_R32 0.0 ident -1.e+037 1.e+037 /end CHARACTERISTIC
/begin CHARACTERISTIC P_In_X.GRP_sint16_sint16_sint16.All_Maps_GRP.Maps_Raster_1 "" VALUE 0x1D2B6C STANDARD_VALUE_S16 0.0 ident -32768.0 32767.0 /end CHARACTERISTIC
/begin CHARACTERISTIC P_In_X.GRP_sint16_sint16_sint16.All_Maps_GRP.Maps_Raster_2 "" VALUE 0x1D4530 STANDARD_VALUE_S16 0.0 ident -32768.0 32767.0 /end CHARACTERISTIC
/begin CHARACTERISTIC P_In_X.GRP_sint16_sint16_sint16.All_Maps_GRP.Maps_Raster_3 "" VALUE 0x1D5EF4 STANDARD_VALUE_S16 0.0 ident -32768.0 32767.0 /end CHARACTERISTIC
/begin CHARACTERISTIC P_In_X.GRP_sint32_sint32_sint32.All_Maps_GRP.Maps_Raster_1 "" VALUE 0x1D2C70 STANDARD_VALUE_S32 0.0 ident -2147483648.0 2147483647.0 /end CHARACTERISTIC
/begin CHARACTERISTIC P_In_X.GRP_sint32_sint32_sint32.All_Maps_GRP.Maps_Raster_2 "" VALUE 0x1D4634 STANDARD_VALUE_S32 0.0 ident -2147483648.0 2147483647.0 /end CHARACTERISTIC
/begin CHARACTERISTIC P_In_X.GRP_sint32_sint32_sint32.All_Maps_GRP.Maps_Raster_3 "" VALUE 0x1D5FF8 STANDARD_VALUE_S32 0.0 ident -2147483648.0 2147483647.0 /end CHARACTERISTIC
/begin CHARACTERISTIC P_In_X.GRP_sint8_sint8_sint8.All_Maps_GRP.Maps_Raster_1 "" VALUE 0x1D2E70 STANDARD_VALUE_S8 0.0 ident -128.0 127.0 /end CHARACTERISTIC
/begin CHARACTERISTIC P_In_X.GRP_sint8_sint8_sint8.All_Maps_GRP.Maps_Raster_2 "" VALUE 0x1D4834 STANDARD_VALUE_S8 0.0 ident -128.0 127.0 /end CHARACTERISTIC
/begin CHARACTERISTIC P_In_X.GRP_sint8_sint8_sint8.All_Maps_GRP.Maps_Raster_3 "" VALUE 0x1D61F8 STANDARD_VALUE_S8 0.0 ident -128.0 127.0 /end CHARACTERISTIC
/begin CHARACTERISTIC P_In_X.GRP_uint16_uint16_uint16.All_Maps_GRP.Maps_Raster_1 "" VALUE 0x1D2EF4 STANDARD_VALUE_U16 0.0 ident 0.0 65535.0 /end CHARACTERISTIC
/begin CHARACTERISTIC P_In_X.GRP_uint16_uint16_uint16.All_Maps_GRP.Maps_Raster_2 "" VALUE 0x1D48B8 STANDARD_VALUE_U16 0.0 ident 0.0 65535.0 /end CHARACTERISTIC
/begin CHARACTERISTIC P_In_X.GRP_uint16_uint16_uint16.All_Maps_GRP.Maps_Raster_3 "" VALUE 0x1D627C STANDARD_VALUE_U16 0.0 ident 0.0 65535.0 /end CHARACTERISTIC
/begin CHARACTERISTIC P_In_X.GRP_uint32_uint32_uint32.All_Maps_GRP.Maps_Raster_1 "" VALUE 0x1D2FF8 STANDARD_VALUE_U32 0.0 ident 0.0 4294967295.0 /end CHARACTERISTIC
/begin CHARACTERISTIC P_In_X.GRP_uint32_uint32_uint32.All_Maps_GRP.Maps_Raster_2 "" VALUE 0x1D49BC STANDARD_VALUE_U32 0.0 ident 0.0 4294967295.0 /end CHARACTERISTIC
/begin CHARACTERISTIC P_In_X.GRP_uint32_uint32_uint32.All_Maps_GRP.Maps_Raster_3 "" VALUE 0x1D6380 STANDARD_VALUE_U32 0.0 ident 0.0 4294967295.0 /end CHARACTERISTIC
/begin CHARACTERISTIC P_In_X.GRP_uint8_uint8_uint8.All_Maps_GRP.Maps_Raster_1 "" VALUE 0x1D31F8 STANDARD_VALUE_U8 0.0 ident 0.0 255.0 /end CHARACTERISTIC
/begin CHARACTERISTIC P_In_X.GRP_uint8_uint8_uint8.All_Maps_GRP.Maps_Raster_2 "" VALUE 0x1D4BBC STANDARD_VALUE_U8 0.0 ident 0.0 255.0 /end CHARACTERISTIC
/begin CHARACTERISTIC P_In_X.GRP_uint8_uint8_uint8.All_Maps_GRP.Maps_Raster_3 "" VALUE 0x1D6580 STANDARD_VALUE_U8 0.0 ident 0.0 255.0 /end CHARACTERISTIC
/begin CHARACTERISTIC P_In_Y.FIX_float32_float32_float32.All_Maps_FIX.Maps_Raster_1 "" VALUE 0x1D21A8 STANDARD_VALUE_R32 0.0 ident -1.e+037 1.e+037 /end CHARACTERISTIC
/begin CHARACTERISTIC P_In_Y.FIX_float32_float32_float32.All_Maps_FIX.Maps_Raster_2 "" VALUE 0x1D3B6C STANDARD_VALUE_R32 0.0 ident -1.e+037 1.e+037 /end CHARACTERISTIC
/begin CHARACTERISTIC P_In_Y.FIX_float32_float32_float32.All_Maps_FIX.Maps_Raster_3 "" VALUE 0x1D5530 STANDARD_VALUE_R32 0.0 ident -1.e+037 1.e+037 /end CHARACTERISTIC
/begin CHARACTERISTIC P_In_Y.FIX_sint16_sint16_sint16.All_Maps_FIX.Maps_Raster_1 "" VALUE 0x1D235A STANDARD_VALUE_S16 0.0 ident -32768.0 32767.0 /end CHARACTERISTIC
/begin CHARACTERISTIC P_In_Y.FIX_sint16_sint16_sint16.All_Maps_FIX.Maps_Raster_2 "" VALUE 0x1D3D1E STANDARD_VALUE_S16 0.0 ident -32768.0 32767.0 /end CHARACTERISTIC
/begin CHARACTERISTIC P_In_Y.FIX_sint16_sint16_sint16.All_Maps_FIX.Maps_Raster_3 "" VALUE 0x1D56E2 STANDARD_VALUE_S16 0.0 ident -32768.0 32767.0 /end CHARACTERISTIC
/begin CHARACTERISTIC P_In_Y.FIX_sint32_sint32_sint32.All_Maps_FIX.Maps_Raster_1 "" VALUE 0x1D243C STANDARD_VALUE_S32 0.0 ident -2147483648.0 2147483647.0 /end CHARACTERISTIC
/begin CHARACTERISTIC P_In_Y.FIX_sint32_sint32_sint32.All_Maps_FIX.Maps_Raster_2 "" VALUE 0x1D3E00 STANDARD_VALUE_S32 0.0 ident -2147483648.0 2147483647.0 /end CHARACTERISTIC
/begin CHARACTERISTIC P_In_Y.FIX_sint32_sint32_sint32.All_Maps_FIX.Maps_Raster_3 "" VALUE 0x1D57C4 STANDARD_VALUE_S32 0.0 ident -2147483648.0 2147483647.0 /end CHARACTERISTIC
/begin CHARACTERISTIC P_In_Y.FIX_sint8_sint8_sint8.All_Maps_FIX.Maps_Raster_1 "" VALUE 0x1D25EE STANDARD_VALUE_S8 0.0 ident -128.0 127.0 /end CHARACTERISTIC
/begin CHARACTERISTIC P_In_Y.FIX_sint8_sint8_sint8.All_Maps_FIX.Maps_Raster_2 "" VALUE 0x1D3FB2 STANDARD_VALUE_S8 0.0 ident -128.0 127.0 /end CHARACTERISTIC
/begin CHARACTERISTIC P_In_Y.FIX_sint8_sint8_sint8.All_Maps_FIX.Maps_Raster_3 "" VALUE 0x1D5976 STANDARD_VALUE_S8 0.0 ident -128.0 127.0 /end CHARACTERISTIC
/begin CHARACTERISTIC P_In_Y.FIX_uint16_uint16_uint16.All_Maps_FIX.Maps_Raster_1 "" VALUE 0x1D2662 STANDARD_VALUE_U16 0.0 ident 0.0 65535.0 /end CHARACTERISTIC
/begin CHARACTERISTIC P_In_Y.FIX_uint16_uint16_uint16.All_Maps_FIX.Maps_Raster_2 "" VALUE 0x1D4026 STANDARD_VALUE_U16 0.0 ident 0.0 65535.0 /end CHARACTERISTIC
/begin CHARACTERISTIC P_In_Y.FIX_uint16_uint16_uint16.All_Maps_FIX.Maps_Raster_3 "" VALUE 0x1D59EA STANDARD_VALUE_U16 0.0 ident 0.0 65535.0 /end CHARACTERISTIC
/begin CHARACTERISTIC P_In_Y.FIX_uint32_uint32_uint32.All_Maps_FIX.Maps_Raster_1 "" VALUE 0x1D2744 STANDARD_VALUE_U32 0.0 ident 0.0 4294967295.0 /end CHARACTERISTIC
/begin CHARACTERISTIC P_In_Y.FIX_uint32_uint32_uint32.All_Maps_FIX.Maps_Raster_2 "" VALUE 0x1D4108 STANDARD_VALUE_U32 0.0 ident 0.0 4294967295.0 /end CHARACTERISTIC
/begin CHARACTERISTIC P_In_Y.FIX_uint32_uint32_uint32.All_Maps_FIX.Maps_Raster_3 "" VALUE 0x1D5ACC STANDARD_VALUE_U32 0.0 ident 0.0 4294967295.0 /end CHARACTERISTIC
/begin CHARACTERISTIC P_In_Y.FIX_uint8_uint8_uint8.All_Maps_FIX.Maps_Raster_1 "" VALUE 0x1D28F6 STANDARD_VALUE_U8 0.0 ident 0.0 255.0 /end CHARACTERISTIC
/begin CHARACTERISTIC P_In_Y.FIX_uint8_uint8_uint8.All_Maps_FIX.Maps_Raster_2 "" VALUE 0x1D42BA STANDARD_VALUE_U8 0.0 ident 0.0 255.0 /end CHARACTERISTIC
/begin CHARACTERISTIC P_In_Y.FIX_uint8_uint8_uint8.All_Maps_FIX.Maps_Raster_3 "" VALUE 0x1D5C7E STANDARD_VALUE_U8 0.0 ident 0.0 255.0 /end CHARACTERISTIC
/begin CHARACTERISTIC P_In_Y.GRP_float32_float32_float32.All_Maps_GRP.Maps_Raster_1 "" VALUE 0x1D2974 STANDARD_VALUE_R32 0.0 ident -1.e+037 1.e+037 /end CHARACTERISTIC
/begin CHARACTERISTIC P_In_Y.GRP_float32_float32_float32.All_Maps_GRP.Maps_Raster_2 "" VALUE 0x1D4338 STANDARD_VALUE_R32 0.0 ident -1.e+037 1.e+037 /end CHARACTERISTIC
/begin CHARACTERISTIC P_In_Y.GRP_float32_float32_float32.All_Maps_GRP.Maps_Raster_3 "" VALUE 0x1D5CFC STANDARD_VALUE_R32 0.0 ident -1.e+037 1.e+037 /end CHARACTERISTIC
/begin CHARACTERISTIC P_In_Y.GRP_sint16_sint16_sint16.All_Maps_GRP.Maps_Raster_1 "" VALUE 0x1D2B6E STANDARD_VALUE_S16 0.0 ident -32768.0 32767.0 /end CHARACTERISTIC
/begin CHARACTERISTIC P_In_Y.GRP_sint16_sint16_sint16.All_Maps_GRP.Maps_Raster_2 "" VALUE 0x1D4532 STANDARD_VALUE_S16 0.0 ident -32768.0 32767.0 /end CHARACTERISTIC
/begin CHARACTERISTIC P_In_Y.GRP_sint16_sint16_sint16.All_Maps_GRP.Maps_Raster_3 "" VALUE 0x1D5EF6 STANDARD_VALUE_S16 0.0 ident -32768.0 32767.0 /end CHARACTERISTIC
/begin CHARACTERISTIC P_In_Y.GRP_sint32_sint32_sint32.All_Maps_GRP.Maps_Raster_1 "" VALUE 0x1D2C74 STANDARD_VALUE_S32 0.0 ident -2147483648.0 2147483647.0 /end CHARACTERISTIC
/begin CHARACTERISTIC P_In_Y.GRP_sint32_sint32_sint32.All_Maps_GRP.Maps_Raster_2 "" VALUE 0x1D4638 STANDARD_VALUE_S32 0.0 ident -2147483648.0 2147483647.0 /end CHARACTERISTIC
/begin CHARACTERISTIC P_In_Y.GRP_sint32_sint32_sint32.All_Maps_GRP.Maps_Raster_3 "" VALUE 0x1D5FFC STANDARD_VALUE_S32 0.0 ident -2147483648.0 2147483647.0 /end CHARACTERISTIC
/begin CHARACTERISTIC P_In_Y.GRP_sint8_sint8_sint8.All_Maps_GRP.Maps_Raster_1 "" VALUE 0x1D2E71 STANDARD_VALUE_S8 0.0 ident -128.0 127.0 /end CHARACTERISTIC
/begin CHARACTERISTIC P_In_Y.GRP_sint8_sint8_sint8.All_Maps_GRP.Maps_Raster_2 "" VALUE 0x1D4835 STANDARD_VALUE_S8 0.0 ident -128.0 127.0 /end CHARACTERISTIC
/begin CHARACTERISTIC P_In_Y.GRP_sint8_sint8_sint8.All_Maps_GRP.Maps_Raster_3 "" VALUE 0x1D61F9 STANDARD_VALUE_S8 0.0 ident -128.0 127.0 /end CHARACTERISTIC
/begin CHARACTERISTIC P_In_Y.GRP_uint16_uint16_uint16.All_Maps_GRP.Maps_Raster_1 "" VALUE 0x1D2EF6 STANDARD_VALUE_U16 0.0 ident 0.0 65535.0 /end CHARACTERISTIC
/begin CHARACTERISTIC P_In_Y.GRP_uint16_uint16_uint16.All_Maps_GRP.Maps_Raster_2 "" VALUE 0x1D48BA STANDARD_VALUE_U16 0.0 ident 0.0 65535.0 /end CHARACTERISTIC
/begin CHARACTERISTIC P_In_Y.GRP_uint16_uint16_uint16.All_Maps_GRP.Maps_Raster_3 "" VALUE 0x1D627E STANDARD_VALUE_U16 0.0 ident 0.0 65535.0 /end CHARACTERISTIC
/begin CHARACTERISTIC P_In_Y.GRP_uint32_uint32_uint32.All_Maps_GRP.Maps_Raster_1 "" VALUE 0x1D2FFC STANDARD_VALUE_U32 0.0 ident 0.0 4294967295.0 /end CHARACTERISTIC
/begin CHARACTERISTIC P_In_Y.GRP_uint32_uint32_uint32.All_Maps_GRP.Maps_Raster_2 "" VALUE 0x1D49C0 STANDARD_VALUE_U32 0.0 ident 0.0 4294967295.0 /end CHARACTERISTIC
/begin CHARACTERISTIC P_In_Y.GRP_uint32_uint32_uint32.All_Maps_GRP.Maps_Raster_3 "" VALUE 0x1D6384 STANDARD_VALUE_U32 0.0 ident 0.0 4294967295.0 /end CHARACTERISTIC
/begin CHARACTERISTIC P_In_Y.GRP_uint8_uint8_uint8.All_Maps_GRP.Maps_Raster_1 "" VALUE 0x1D31F9 STANDARD_VALUE_U8 0.0 ident 0.0 255.0 /end CHARACTERISTIC
/begin CHARACTERISTIC P_In_Y.GRP_uint8_uint8_uint8.All_Maps_GRP.Maps_Raster_2 "" VALUE 0x1D4BBD STANDARD_VALUE_U8 0.0 ident 0.0 255.0 /end CHARACTERISTIC
/begin CHARACTERISTIC P_In_Y.GRP_uint8_uint8_uint8.All_Maps_GRP.Maps_Raster_3 "" VALUE 0x1D6581 STANDARD_VALUE_U8 0.0 ident 0.0 255.0 /end CHARACTERISTIC
/begin CHARACTERISTIC Two_D.FIX_float32_float32_float32.All_Maps_FIX.Maps_Raster_1 "" MAP 0x1D21C4 STANDARD_FIXED_R32 0.0 ident -1.e+037 1.e+037
 /begin AXIS_DESCR FIX_AXIS M_In_X.FIX_float32_float32_float32.All_Maps_FIX.Maps_Raster_1 ident 10 -1.e+037 1.e+037 FIX_AXIS_PAR_DIST 0 1 10 /end AXIS_DESCR
 /begin AXIS_DESCR FIX_AXIS M_In_Y.FIX_float32_float32_float32.All_Maps_FIX.Maps_Raster_1 ident 10 -1.e+037 1.e+037 FIX_AXIS_PAR_DIST 0 1 10 /end AXIS_DESCR
/end CHARACTERISTIC
/begin CHARACTERISTIC Two_D.FIX_float32_float32_float32.All_Maps_FIX.Maps_Raster_2 "" MAP 0x1D3B88 STANDARD_FIXED_R32 0.0 ident -1.e+037 1.e+037
 /begin AXIS_DESCR FIX_AXIS M_In_X.FIX_float32_float32_float32.All_Maps_FIX.Maps_Raster_2 ident 10 -1.e+037 1.e+037 FIX_AXIS_PAR_DIST 0 1 10 /end AXIS_DESCR
 /begin AXIS_DESCR FIX_AXIS M_In_Y.FIX_float32_float32_float32.All_Maps_FIX.Maps_Raster_2 ident 10 -1.e+037 1.e+037 FIX_AXIS_PAR_DIST 0 1 10 /end AXIS_DESCR
/end CHARACTERISTIC
/begin CHARACTERISTIC Two_D.FIX_float32_float32_float32.All_Maps_FIX.Maps_Raster_3 "" MAP 0x1D554C STANDARD_FIXED_R32 0.0 ident -1.e+037 1.e+037
 /begin AXIS_DESCR FIX_AXIS M_In_X.FIX_float32_float32_float32.All_Maps_FIX.Maps_Raster_3 ident 10 -1.e+037 1.e+037 FIX_AXIS_PAR_DIST 0 1 10 /end AXIS_DESCR
 /begin AXIS_DESCR FIX_AXIS M_In_Y.FIX_float32_float32_float32.All_Maps_FIX.Maps_Raster_3 ident 10 -1.e+037 1.e+037 FIX_AXIS_PAR_DIST 0 1 10 /end AXIS_DESCR
/end CHARACTERISTIC
/begin CHARACTERISTIC Two_D.FIX_sint16_sint16_sint16.All_Maps_FIX.Maps_Raster_1 "" MAP 0x1D236A STANDARD_FIXED_S16 0.0 ident -32768.0 32767.0
 /begin AXIS_DESCR FIX_AXIS M_In_X.FIX_sint16_sint16_sint16.All_Maps_FIX.Maps_Raster_1 ident 10 -32768.0 32767.0 FIX_AXIS_PAR_DIST 0 1 10 /end AXIS_DESCR
 /begin AXIS_DESCR FIX_AXIS M_In_Y.FIX_sint16_sint16_sint16.All_Maps_FIX.Maps_Raster_1 ident 10 -32768.0 32767.0 FIX_AXIS_PAR_DIST 0 1 10 /end AXIS_DESCR
/end CHARACTERISTIC
/begin CHARACTERISTIC Two_D.FIX_sint16_sint16_sint16.All_Maps_FIX.Maps_Raster_2 "" MAP 0x1D3D2E STANDARD_FIXED_S16 0.0 ident -32768.0 32767.0
 /begin AXIS_DESCR FIX_AXIS M_In_X.FIX_sint16_sint16_sint16.All_Maps_FIX.Maps_Raster_2 ident 10 -32768.0 32767.0 FIX_AXIS_PAR_DIST 0 1 10 /end AXIS_DESCR
 /begin AXIS_DESCR FIX_AXIS M_In_Y.FIX_sint16_sint16_sint16.All_Maps_FIX.Maps_Raster_2 ident 10 -32768.0 32767.0 FIX_AXIS_PAR_DIST 0 1 10 /end AXIS_DESCR
/end CHARACTERISTIC
/begin CHARACTERISTIC Two_D.FIX_sint16_sint16_sint16.All_Maps_FIX.Maps_Raster_3 "" MAP 0x1D56F2 STANDARD_FIXED_S16 0.0 ident -32768.0 32767.0
 /begin AXIS_DESCR FIX_AXIS M_In_X.FIX_sint16_sint16_sint16.All_Maps_FIX.Maps_Raster_3 ident 10 -32768.0 32767.0 FIX_AXIS_PAR_DIST 0 1 10 /end AXIS_DESCR
 /begin AXIS_DESCR FIX_AXIS M_In_Y.FIX_sint16_sint16_sint16.All_Maps_FIX.Maps_Raster_3 ident 10 -32768.0 32767.0 FIX_AXIS_PAR_DIST 0 1 10 /end AXIS_DESCR
/end CHARACTERISTIC
/begin CHARACTERISTIC Two_D.FIX_sint32_sint32_sint32.All_Maps_FIX.Maps_Raster_1 "" MAP 0x1D2458 STANDARD_FIXED_S32 0.0 ident -2147483648.0 2147483647.0
 /begin AXIS_DESCR FIX_AXIS M_In_X.FIX_sint32_sint32_sint32.All_Maps_FIX.Maps_Raster_1 ident 10 -2147483648.0 2147483647.0 FIX_AXIS_PAR_DIST 0 1 10 /end AXIS_DESCR
 /begin AXIS_DESCR FIX_AXIS M_In_Y.FIX_sint32_sint32_sint32.All_Maps_FIX.Maps_Raster_1 ident 10 -2147483648.0 2147483647.0 FIX_AXIS_PAR_DIST 0 1 10 /end AXIS_DESCR
/end CHARACTERISTIC
/begin CHARACTERISTIC Two_D.FIX_sint32_sint32_sint32.All_Maps_FIX.Maps_Raster_2 "" MAP 0x1D3E1C STANDARD_FIXED_S32 0.0 ident -2147483648.0 2147483647.0
 /begin AXIS_DESCR FIX_AXIS M_In_X.FIX_sint32_sint32_sint32.All_Maps_FIX.Maps_Raster_2 ident 10 -2147483648.0 2147483647.0 FIX_AXIS_PAR_DIST 0 1 10 /end AXIS_DESCR
 /begin AXIS_DESCR FIX_AXIS M_In_Y.FIX_sint32_sint32_sint32.All_Maps_FIX.Maps_Raster_2 ident 10 -2147483648.0 2147483647.0 FIX_AXIS_PAR_DIST 0 1 10 /end AXIS_DESCR
/end CHARACTERISTIC
/begin CHARACTERISTIC Two_D.FIX_sint32_sint32_sint32.All_Maps_FIX.Maps_Raster_3 "" MAP 0x1D57E0 STANDARD_FIXED_S32 0.0 ident -2147483648.0 2147483647.0
 /begin AXIS_DESCR FIX_AXIS M_In_X.FIX_sint32_sint32_sint32.All_Maps_FIX.Maps_Raster_3 ident 10 -2147483648.0 2147483647.0 FIX_AXIS_PAR_DIST 0 1 10 /end AXIS_DESCR
 /begin AXIS_DESCR FIX_AXIS M_In_Y.FIX_sint32_sint32_sint32.All_Maps_FIX.Maps_Raster_3 ident 10 -2147483648.0 2147483647.0 FIX_AXIS_PAR_DIST 0 1 10 /end AXIS_DESCR
/end CHARACTERISTIC
/begin CHARACTERISTIC Two_D.FIX_sint8_sint8_sint8.All_Maps_FIX.Maps_Raster_1 "" MAP 0x1D25F5 STANDARD_FIXED_S8 0.0 ident -128.0 127.0
 /begin AXIS_DESCR FIX_AXIS M_In_X.FIX_sint8_sint8_sint8.All_Maps_FIX.Maps_Raster_1 ident 10 -128.0 127.0 FIX_AXIS_PAR_DIST 0 1 10 /end AXIS_DESCR
 /begin AXIS_DESCR FIX_AXIS M_In_Y.FIX_sint8_sint8_sint8.All_Maps_FIX.Maps_Raster_1 ident 10 -128.0 127.0 FIX_AXIS_PAR_DIST 0 1 10 /end AXIS_DESCR
/end CHARACTERISTIC
/begin CHARACTERISTIC Two_D.FIX_sint8_sint8_sint8.All_Maps_FIX.Maps_Raster_2 "" MAP 0x1D3FB9 STANDARD_FIXED_S8 0.0 ident -128.0 127.0
 /begin AXIS_DESCR FIX_AXIS M_In_X.FIX_sint8_sint8_sint8.All_Maps_FIX.Maps_Raster_2 ident 10 -128.0 127.0 FIX_AXIS_PAR_DIST 0 1 10 /end AXIS_DESCR
 /begin AXIS_DESCR FIX_AXIS M_In_Y.FIX_sint8_sint8_sint8.All_Maps_FIX.Maps_Raster_2 ident 10 -128.0 127.0 FIX_AXIS_PAR_DIST 0 1 10 /end AXIS_DESCR
/end CHARACTERISTIC
/begin CHARACTERISTIC Two_D.FIX_sint8_sint8_sint8.All_Maps_FIX.Maps_Raster_3 "" MAP 0x1D597D STANDARD_FIXED_S8 0.0 ident -128.0 127.0
 /begin AXIS_DESCR FIX_AXIS M_In_X.FIX_sint8_sint8_sint8.All_Maps_FIX.Maps_Raster_3 ident 10 -128.0 127.0 FIX_AXIS_PAR_DIST 0 1 10 /end AXIS_DESCR
 /begin AXIS_DESCR FIX_AXIS M_In_Y.FIX_sint8_sint8_sint8.All_Maps_FIX.Maps_Raster_3 ident 10 -128.0 127.0 FIX_AXIS_PAR_DIST 0 1 10 /end AXIS_DESCR
/end CHARACTERISTIC
/begin CHARACTERISTIC Two_D.FIX_uint16_uint16_uint16.All_Maps_FIX.Maps_Raster_1 "" MAP 0x1D2672 STANDARD_FIXED_U16 0.0 ident 0.0 65535.0
 /begin AXIS_DESCR FIX_AXIS M_In_X.FIX_uint16_uint16_uint16.All_Maps_FIX.Maps_Raster_1 ident 10 0.0 65535.0 FIX_AXIS_PAR_DIST 0 1 10 /end AXIS_DESCR
 /begin AXIS_DESCR FIX_AXIS M_In_Y.FIX_uint16_uint16_uint16.All_Maps_FIX.Maps_Raster_1 ident 10 0.0 65535.0 FIX_AXIS_PAR_DIST 0 1 10 /end AXIS_DESCR
/end CHARACTERISTIC
/begin CHARACTERISTIC Two_D.FIX_uint16_uint16_uint16.All_Maps_FIX.Maps_Raster_2 "" MAP 0x1D4036 STANDARD_FIXED_U16 0.0 ident 0.0 65535.0
 /begin AXIS_DESCR FIX_AXIS M_In_X.FIX_uint16_uint16_uint16.All_Maps_FIX.Maps_Raster_2 ident 10 0.0 65535.0 FIX_AXIS_PAR_DIST 0 1 10 /end AXIS_DESCR
 /begin AXIS_DESCR FIX_AXIS M_In_Y.FIX_uint16_uint16_uint16.All_Maps_FIX.Maps_Raster_2 ident 10 0.0 65535.0 FIX_AXIS_PAR_DIST 0 1 10 /end AXIS_DESCR
/end CHARACTERISTIC
/begin CHARACTERISTIC Two_D.FIX_uint16_uint16_uint16.All_Maps_FIX.Maps_Raster_3 "" MAP 0x1D59FA STANDARD_FIXED_U16 0.0 ident 0.0 65535.0
 /begin AXIS_DESCR FIX_AXIS M_In_X.FIX_uint16_uint16_uint16.All_Maps_FIX.Maps_Raster_3 ident 10 0.0 65535.0 FIX_AXIS_PAR_DIST 0 1 10 /end AXIS_DESCR
 /begin AXIS_DESCR FIX_AXIS M_In_Y.FIX_uint16_uint16_uint16.All_Maps_FIX.Maps_Raster_3 ident 10 0.0 65535.0 FIX_AXIS_PAR_DIST 0 1 10 /end AXIS_DESCR
/end CHARACTERISTIC
/begin CHARACTERISTIC Two_D.FIX_uint32_uint32_uint32.All_Maps_FIX.Maps_Raster_1 "" MAP 0x1D2760 STANDARD_FIXED_U32 0.0 ident 0.0 4294967295.0
 /begin AXIS_DESCR FIX_AXIS M_In_X.FIX_uint32_uint32_uint32.All_Maps_FIX.Maps_Raster_1 ident 10 0.0 4294967295.0 FIX_AXIS_PAR_DIST 0 1 10 /end AXIS_DESCR
 /begin AXIS_DESCR FIX_AXIS M_In_Y.FIX_uint32_uint32_uint32.All_Maps_FIX.Maps_Raster_1 ident 10 0.0 4294967295.0 FIX_AXIS_PAR_DIST 0 1 10 /end AXIS_DESCR
/end CHARACTERISTIC
/begin CHARACTERISTIC Two_D.FIX_uint32_uint32_uint32.All_Maps_FIX.Maps_Raster_2 "" MAP 0x1D4124 STANDARD_FIXED_U32 0.0 ident 0.0 4294967295.0
 /begin AXIS_DESCR FIX_AXIS M_In_X.FIX_uint32_uint32_uint32.All_Maps_FIX.Maps_Raster_2 ident 10 0.0 4294967295.0 FIX_AXIS_PAR_DIST 0 1 10 /end AXIS_DESCR
 /begin AXIS_DESCR FIX_AXIS M_In_Y.FIX_uint32_uint32_uint32.All_Maps_FIX.Maps_Raster_2 ident 10 0.0 4294967295.0 FIX_AXIS_PAR_DIST 0 1 10 /end AXIS_DESCR
/end CHARACTERISTIC
/begin CHARACTERISTIC Two_D.FIX_uint32_uint32_uint32.All_Maps_FIX.Maps_Raster_3 "" MAP 0x1D5AE8 STANDARD_FIXED_U32 0.0 ident 0.0 4294967295.0
 /begin AXIS_DESCR FIX_AXIS M_In_X.FIX_uint32_uint32_uint32.All_Maps_FIX.Maps_Raster_3 ident 10 0.0 4294967295.0 FIX_AXIS_PAR_DIST 0 1 10 /end AXIS_DESCR
 /begin AXIS_DESCR FIX_AXIS M_In_Y.FIX_uint32_uint32_uint32.All_Maps_FIX.Maps_Raster_3 ident 10 0.0 4294967295.0 FIX_AXIS_PAR_DIST 0 1 10 /end AXIS_DESCR
/end CHARACTERISTIC
/begin CHARACTERISTIC Two_D.FIX_uint8_uint8_uint8.All_Maps_FIX.Maps_Raster_1 "" MAP 0x1D28FD STANDARD_FIXED_U8 0.0 ident 0.0 255.0
 /begin AXIS_DESCR FIX_AXIS M_In_X.FIX_uint8_uint8_uint8.All_Maps_FIX.Maps_Raster_1 ident 10 0.0 255.0 FIX_AXIS_PAR_DIST 0 1 10 /end AXIS_DESCR
 /begin AXIS_DESCR FIX_AXIS M_In_Y.FIX_uint8_uint8_uint8.All_Maps_FIX.Maps_Raster_1 ident 10 0.0 255.0 FIX_AXIS_PAR_DIST 0 1 10 /end AXIS_DESCR
/end CHARACTERISTIC
/begin CHARACTERISTIC Two_D.FIX_uint8_uint8_uint8.All_Maps_FIX.Maps_Raster_2 "" MAP 0x1D42C1 STANDARD_FIXED_U8 0.0 ident 0.0 255.0
 /begin AXIS_DESCR FIX_AXIS M_In_X.FIX_uint8_uint8_uint8.All_Maps_FIX.Maps_Raster_2 ident 10 0.0 255.0 FIX_AXIS_PAR_DIST 0 1 10 /end AXIS_DESCR
 /begin AXIS_DESCR FIX_AXIS M_In_Y.FIX_uint8_uint8_uint8.All_Maps_FIX.Maps_Raster_2 ident 10 0.0 255.0 FIX_AXIS_PAR_DIST 0 1 10 /end AXIS_DESCR
/end CHARACTERISTIC
/begin CHARACTERISTIC Two_D.FIX_uint8_uint8_uint8.All_Maps_FIX.Maps_Raster_3 "" MAP 0x1D5C85 STANDARD_FIXED_U8 0.0 ident 0.0 255.0
 /begin AXIS_DESCR FIX_AXIS M_In_X.FIX_uint8_uint8_uint8.All_Maps_FIX.Maps_Raster_3 ident 10 0.0 255.0 FIX_AXIS_PAR_DIST 0 1 10 /end AXIS_DESCR
 /begin AXIS_DESCR FIX_AXIS M_In_Y.FIX_uint8_uint8_uint8.All_Maps_FIX.Maps_Raster_3 ident 10 0.0 255.0 FIX_AXIS_PAR_DIST 0 1 10 /end AXIS_DESCR
/end CHARACTERISTIC
/begin CHARACTERISTIC Two_D.GRP_float32_float32_float32.All_Maps_GRP.Maps_Raster_1 "" MAP 0x1D297C STANDARD_GROUP_R32 0.0 ident -1.e+037 1.e+037
 /begin AXIS_DESCR COM_AXIS M_In_X.GRP_float32_float32_float32.All_Maps_GRP.Maps_Raster_1 ident 10 -1.e+037 1.e+037 AXIS_PTS_REF distrib_X.GRP_float32_float32_float32.All_Maps_GRP.Maps_Raster_1 /end AXIS_DESCR
 /begin AXIS_DESCR COM_AXIS M_In_Y.GRP_float32_float32_float32.All_Maps_GRP.Maps_Raster_1 ident 10 -1.e+037 1.e+037 AXIS_PTS_REF distrib_Y.GRP_float32_float32_float32.All_Maps_GRP.Maps_Raster_1 /end AXIS_DESCR
/end CHARACTERISTIC
/begin CHARACTERISTIC Two_D.GRP_float32_float32_float32.All_Maps_GRP.Maps_Raster_2 "" MAP 0x1D4340 STANDARD_GROUP_R32 0.0 ident -1.e+037 1.e+037
 /begin AXIS_DESCR COM_AXIS M_In_X.GRP_float32_float32_float32.All_Maps_GRP.Maps_Raster_2 ident 10 -1.e+037 1.e+037 AXIS_PTS_REF distrib_X.GRP_float32_float32_float32.All_Maps_GRP.Maps_Raster_2 /end AXIS_DESCR
 /begin AXIS_DESCR COM_AXIS M_In_Y.GRP_float32_float32_float32.All_Maps_GRP.Maps_Raster_2 ident 10 -1.e+037 1.e+037 AXIS_PTS_REF distrib_Y.GRP_float32_float32_float32.All_Maps_GRP.Maps_Raster_2 /end AXIS_DESCR
/end CHARACTERISTIC
/begin CHARACTERISTIC Two_D.GRP_float32_float32_float32.All_Maps_GRP.Maps_Raster_3 "" MAP 0x1D5D04 STANDARD_GROUP_R32 0.0 ident -1.e+037 1.e+037
 /begin AXIS_DESCR COM_AXIS M_In_X.GRP_float32_float32_float32.All_Maps_GRP.Maps_Raster_3 ident 10 -1.e+037 1.e+037 AXIS_PTS_REF distrib_X.GRP_float32_float32_float32.All_Maps_GRP.Maps_Raster_3 /end AXIS_DESCR
 /begin AXIS_DESCR COM_AXIS M_In_Y.GRP_float32_float32_float32.All_Maps_GRP.Maps_Raster_3 ident 10 -1.e+037 1.e+037 AXIS_PTS_REF distrib_Y.GRP_float32_float32_float32.All_Maps_GRP.Maps_Raster_3 /end AXIS_DESCR
/end CHARACTERISTIC
/begin CHARACTERISTIC Two_D.GRP_sint16_sint16_sint16.All_Maps_GRP.Maps_Raster_1 "" MAP 0x1D2B74 STANDARD_GROUP_S16 0.0 ident -32768.0 32767.0
 /begin AXIS_DESCR COM_AXIS M_In_X.GRP_sint16_sint16_sint16.All_Maps_GRP.Maps_Raster_1 ident 10 -32768.0 32767.0 AXIS_PTS_REF distrib_X.GRP_sint16_sint16_sint16.All_Maps_GRP.Maps_Raster_1 /end AXIS_DESCR
 /begin AXIS_DESCR COM_AXIS M_In_Y.GRP_sint16_sint16_sint16.All_Maps_GRP.Maps_Raster_1 ident 10 -32768.0 32767.0 AXIS_PTS_REF distrib_Y.GRP_sint16_sint16_sint16.All_Maps_GRP.Maps_Raster_1 /end AXIS_DESCR
/end CHARACTERISTIC
/begin CHARACTERISTIC Two_D.GRP_sint16_sint16_sint16.All_Maps_GRP.Maps_Raster_2 "" MAP 0x1D4538 STANDARD_GROUP_S16 0.0 ident -32768.0 32767.0
 /begin AXIS_DESCR COM_AXIS M_In_X.GRP_sint16_sint16_sint16.All_Maps_GRP.Maps_Raster_2 ident 10 -32768.0 32767.0 AXIS_PTS_REF distrib_X.GRP_sint16_sint16_sint16.All_Maps_GRP.Maps_Raster_2 /end AXIS_DESCR
 /begin AXIS_DESCR COM_AXIS M_In_Y.GRP_sint16_sint16_sint16.All_Maps_GRP.Maps_Raster_2 ident 10 -32768.0 32767.0 AXIS_PTS_REF distrib_Y.GRP_sint16_sint16_sint16.All_Maps_GRP.Maps_Raster_2 /end AXIS_DESCR
/end CHARACTERISTIC
/begin CHARACTERISTIC Two_D.GRP_sint16_sint16_sint16.All_Maps_GRP.Maps_Raster_3 "" MAP 0x1D5EFC STANDARD_GROUP_S16 0.0 ident -32768.0 32767.0
 /begin AXIS_DESCR COM_AXIS M_In_X.GRP_sint16_sint16_sint16.All_Maps_GRP.Maps_Raster_3 ident 10 -32768.0 32767.0 AXIS_PTS_REF distrib_X.GRP_sint16_sint16_sint16.All_Maps_GRP.Maps_Raster_3 /end AXIS_DESCR
 /begin AXIS_DESCR COM_AXIS M_In_Y.GRP_sint16_sint16_sint16.All_Maps_GRP.Maps_Raster_3 ident 10 -32768.0 32767.0 AXIS_PTS_REF distrib_Y.GRP_sint16_sint16_sint16.All_Maps_GRP.Maps_Raster_3 /end AXIS_DESCR
/end CHARACTERISTIC
/begin CHARACTERISTIC Two_D.GRP_sint32_sint32_sint32.All_Maps_GRP.Maps_Raster_1 "" MAP 0x1D2C7C STANDARD_GROUP_S32 0.0 ident -2147483648.0 2147483647.0
 /begin AXIS_DESCR COM_AXIS M_In_X.GRP_sint32_sint32_sint32.All_Maps_GRP.Maps_Raster_1 ident 10 -2147483648.0 2147483647.0 AXIS_PTS_REF distrib_X.GRP_sint32_sint32_sint32.All_Maps_GRP.Maps_Raster_1 /end AXIS_DESCR
 /begin AXIS_DESCR COM_AXIS M_In_Y.GRP_sint32_sint32_sint32.All_Maps_GRP.Maps_Raster_1 ident 10 -2147483648.0 2147483647.0 AXIS_PTS_REF distrib_Y.GRP_sint32_sint32_sint32.All_Maps_GRP.Maps_Raster_1 /end AXIS_DESCR
/end CHARACTERISTIC
/begin CHARACTERISTIC Two_D.GRP_sint32_sint32_sint32.All_Maps_GRP.Maps_Raster_2 "" MAP 0x1D4640 STANDARD_GROUP_S32 0.0 ident -2147483648.0 2147483647.0
 /begin AXIS_DESCR COM_AXIS M_In_X.GRP_sint32_sint32_sint32.All_Maps_GRP.Maps_Raster_2 ident 10 -2147483648.0 2147483647.0 AXIS_PTS_REF distrib_X.GRP_sint32_sint32_sint32.All_Maps_GRP.Maps_Raster_2 /end AXIS_DESCR
 /begin AXIS_DESCR COM_AXIS M_In_Y.GRP_sint32_sint32_sint32.All_Maps_GRP.Maps_Raster_2 ident 10 -2147483648.0 2147483647.0 AXIS_PTS_REF distrib_Y.GRP_sint32_sint32_sint32.All_Maps_GRP.Maps_Raster_2 /end AXIS_DESCR
/end CHARACTERISTIC
/begin CHARACTERISTIC Two_D.GRP_sint32_sint32_sint32.All_Maps_GRP.Maps_Raster_3 "" MAP 0x1D6004 STANDARD_GROUP_S32 0.0 ident -2147483648.0 2147483647.0
 /begin AXIS_DESCR COM_AXIS M_In_X.GRP_sint32_sint32_sint32.All_Maps_GRP.Maps_Raster_3 ident 10 -2147483648.0 2147483647.0 AXIS_PTS_REF distrib_X.GRP_sint32_sint32_sint32.All_Maps_GRP.Maps_Raster_3 /end AXIS_DESCR
 /begin AXIS_DESCR COM_AXIS M_In_Y.GRP_sint32_sint32_sint32.All_Maps_GRP.Maps_Raster_3 ident 10 -2147483648.0 2147483647.0 AXIS_PTS_REF distrib_Y.GRP_sint32_sint32_sint32.All_Maps_GRP.Maps_Raster_3 /end AXIS_DESCR
/end CHARACTERISTIC
/begin CHARACTERISTIC Two_D.GRP_sint8_sint8_sint8.All_Maps_GRP.Maps_Raster_1 "" MAP 0x1D2E72 STANDARD_GROUP_S8 0.0 ident -128.0 127.0
 /begin AXIS_DESCR COM_AXIS M_In_X.GRP_sint8_sint8_sint8.All_Maps_GRP.Maps_Raster_1 ident 10 -128.0 127.0 AXIS_PTS_REF distrib_X.GRP_sint8_sint8_sint8.All_Maps_GRP.Maps_Raster_1 /end AXIS_DESCR
 /begin AXIS_DESCR COM_AXIS M_In_Y.GRP_sint8_sint8_sint8.All_Maps_GRP.Maps_Raster_1 ident 10 -128.0 127.0 AXIS_PTS_REF distrib_Y.GRP_sint8_sint8_sint8.All_Maps_GRP.Maps_Raster_1 /end AXIS_DESCR
/end CHARACTERISTIC
/begin CHARACTERISTIC Two_D.GRP_sint8_sint8_sint8.All_Maps_GRP.Maps_Raster_2 "" MAP 0x1D4836 STANDARD_GROUP_S8 0.0 ident -128.0 127.0
 /begin AXIS_DESCR COM_AXIS M_In_X.GRP_sint8_sint8_sint8.All_Maps_GRP.Maps_Raster_2 ident 10 -128.0 127.0 AXIS_PTS_REF distrib_X.GRP_sint8_sint8_sint8.All_Maps_GRP.Maps_Raster_2 /end AXIS_DESCR
 /begin AXIS_DESCR COM_AXIS M_In_Y.GRP_sint8_sint8_sint8.All_Maps_GRP.Maps_Raster_2 ident 10 -128.0 127.0 AXIS_PTS_REF distrib_Y.GRP_sint8_sint8_sint8.All_Maps_GRP.Maps_Raster_2 /end AXIS_DESCR
/end CHARACTERISTIC
/begin CHARACTERISTIC Two_D.GRP_sint8_sint8_sint8.All_Maps_GRP.Maps_Raster_3 "" MAP 0x1D61FA STANDARD_GROUP_S8 0.0 ident -128.0 127.0
 /begin AXIS_DESCR COM_AXIS M_In_X.GRP_sint8_sint8_sint8.All_Maps_GRP.Maps_Raster_3 ident 10 -128.0 127.0 AXIS_PTS_REF distrib_X.GRP_sint8_sint8_sint8.All_Maps_GRP.Maps_Raster_3 /end AXIS_DESCR
 /begin AXIS_DESCR COM_AXIS M_In_Y.GRP_sint8_sint8_sint8.All_Maps_GRP.Maps_Raster_3 ident 10 -128.0 127.0 AXIS_PTS_REF distrib_Y.GRP_sint8_sint8_sint8.All_Maps_GRP.Maps_Raster_3 /end AXIS_DESCR
/end CHARACTERISTIC
/begin CHARACTERISTIC Two_D.GRP_uint16_uint16_uint16.All_Maps_GRP.Maps_Raster_1 "" MAP 0x1D2EFC STANDARD_GROUP_U16 0.0 ident 0.0 65535.0
 /begin AXIS_DESCR COM_AXIS M_In_X.GRP_uint16_uint16_uint16.All_Maps_GRP.Maps_Raster_1 ident 10 0.0 65535.0 AXIS_PTS_REF distrib_X.GRP_uint16_uint16_uint16.All_Maps_GRP.Maps_Raster_1 /end AXIS_DESCR
 /begin AXIS_DESCR COM_AXIS M_In_Y.GRP_uint16_uint16_uint16.All_Maps_GRP.Maps_Raster_1 ident 10 0.0 65535.0 AXIS_PTS_REF distrib_Y.GRP_uint16_uint16_uint16.All_Maps_GRP.Maps_Raster_1 /end AXIS_DESCR
/end CHARACTERISTIC
/begin CHARACTERISTIC Two_D.GRP_uint16_uint16_uint16.All_Maps_GRP.Maps_Raster_2 "" MAP 0x1D48C0 STANDARD_GROUP_U16 0.0 ident 0.0 65535.0
 /begin AXIS_DESCR COM_AXIS M_In_X.GRP_uint16_uint16_uint16.All_Maps_GRP.Maps_Raster_2 ident 10 0.0 65535.0 AXIS_PTS_REF distrib_X.GRP_uint16_uint16_uint16.All_Maps_GRP.Maps_Raster_2 /end AXIS_DESCR
 /begin AXIS_DESCR COM_AXIS M_In_Y.GRP_uint16_uint16_uint16.All_Maps_GRP.Maps_Raster_2 ident 10 0.0 65535.0 AXIS_PTS_REF distrib_Y.GRP_uint16_uint16_uint16.All_Maps_GRP.Maps_Raster_2 /end AXIS_DESCR
/end CHARACTERISTIC
/begin CHARACTERISTIC Two_D.GRP_uint16_uint16_uint16.All_Maps_GRP.Maps_Raster_3 "" MAP 0x1D6284 STANDARD_GROUP_U16 0.0 ident 0.0 65535.0
 /begin AXIS_DESCR COM_AXIS M_In_X.GRP_uint16_uint16_uint16.All_Maps_GRP.Maps_Raster_3 ident 10 0.0 65535.0 AXIS_PTS_REF distrib_X.GRP_uint16_uint16_uint16.All_Maps_GRP.Maps_Raster_3 /end AXIS_DESCR
 /begin AXIS_DESCR COM_AXIS M_In_Y.GRP_uint16_uint16_uint16.All_Maps_GRP.Maps_Raster_3 ident 10 0.0 65535.0 AXIS_PTS_REF distrib_Y.GRP_uint16_uint16_uint16.All_Maps_GRP.Maps_Raster_3 /end AXIS_DESCR
/end CHARACTERISTIC
/begin CHARACTERISTIC Two_D.GRP_uint32_uint32_uint32.All_Maps_GRP.Maps_Raster_1 "" MAP 0x1D3004 STANDARD_GROUP_U32 0.0 ident 0.0 4294967295.0
 /begin AXIS_DESCR COM_AXIS M_In_X.GRP_uint32_uint32_uint32.All_Maps_GRP.Maps_Raster_1 ident 10 0.0 4294967295.0 AXIS_PTS_REF distrib_X.GRP_uint32_uint32_uint32.All_Maps_GRP.Maps_Raster_1 /end AXIS_DESCR
 /begin AXIS_DESCR COM_AXIS M_In_Y.GRP_uint32_uint32_uint32.All_Maps_GRP.Maps_Raster_1 ident 10 0.0 4294967295.0 AXIS_PTS_REF distrib_Y.GRP_uint32_uint32_uint32.All_Maps_GRP.Maps_Raster_1 /end AXIS_DESCR
/end CHARACTERISTIC
/begin CHARACTERISTIC Two_D.GRP_uint32_uint32_uint32.All_Maps_GRP.Maps_Raster_2 "" MAP 0x1D49C8 STANDARD_GROUP_U32 0.0 ident 0.0 4294967295.0
 /begin AXIS_DESCR COM_AXIS M_In_X.GRP_uint32_uint32_uint32.All_Maps_GRP.Maps_Raster_2 ident 10 0.0 4294967295.0 AXIS_PTS_REF distrib_X.GRP_uint32_uint32_uint32.All_Maps_GRP.Maps_Raster_2 /end AXIS_DESCR
 /begin AXIS_DESCR COM_AXIS M_In_Y.GRP_uint32_uint32_uint32.All_Maps_GRP.Maps_Raster_2 ident 10 0.0 4294967295.0 AXIS_PTS_REF distrib_Y.GRP_uint32_uint32_uint32.All_Maps_GRP.Maps_Raster_2 /end AXIS_DESCR
/end CHARACTERISTIC
/begin CHARACTERISTIC Two_D.GRP_uint32_uint32_uint32.All_Maps_GRP.Maps_Raster_3 "" MAP 0x1D638C STANDARD_GROUP_U32 0.0 ident 0.0 4294967295.0
 /begin AXIS_DESCR COM_AXIS M_In_X.GRP_uint32_uint32_uint32.All_Maps_GRP.Maps_Raster_3 ident 10 0.0 4294967295.0 AXIS_PTS_REF distrib_X.GRP_uint32_uint32_uint32.All_Maps_GRP.Maps_Raster_3 /end AXIS_DESCR
 /begin AXIS_DESCR COM_AXIS M_In_Y.GRP_uint32_uint32_uint32.All_Maps_GRP.Maps_Raster_3 ident 10 0.0 4294967295.0 AXIS_PTS_REF distrib_Y.GRP_uint32_uint32_uint32.All_Maps_GRP.Maps_Raster_3 /end AXIS_DESCR
/end CHARACTERISTIC
/begin CHARACTERISTIC Two_D.GRP_uint8_uint8_uint8.All_Maps_GRP.Maps_Raster_1 "" MAP 0x1D31FA STANDARD_GROUP_U8 0.0 ident 0.0 255.0
 /begin AXIS_DESCR COM_AXIS M_In_X.GRP_uint8_uint8_uint8.All_Maps_GRP.Maps_Raster_1 ident 10 0.0 255.0 AXIS_PTS_REF distrib_X.GRP_uint8_uint8_uint8.All_Maps_GRP.Maps_Raster_1 /end AXIS_DESCR
 /begin AXIS_DESCR COM_AXIS M_In_Y.GRP_uint8_uint8_uint8.All_Maps_GRP.Maps_Raster_1 ident 10 0.0 255.0 AXIS_PTS_REF distrib_Y.GRP_uint8_uint8_uint8.All_Maps_GRP.Maps_Raster_1 /end AXIS_DESCR
/end CHARACTERISTIC
/begin CHARACTERISTIC Two_D.GRP_uint8_uint8_uint8.All_Maps_GRP.Maps_Raster_2 "" MAP 0x1D4BBE STANDARD_GROUP_U8 0.0 ident 0.0 255.0
 /begin AXIS_DESCR COM_AXIS M_In_X.GRP_uint8_uint8_uint8.All_Maps_GRP.Maps_Raster_2 ident 10 0.0 255.0 AXIS_PTS_REF distrib_X.GRP_uint8_uint8_uint8.All_Maps_GRP.Maps_Raster_2 /end AXIS_DESCR
 /begin AXIS_DESCR COM_AXIS M_In_Y.GRP_uint8_uint8_uint8.All_Maps_GRP.Maps_Raster_2 ident 10 0.0 255.0 AXIS_PTS_REF distrib_Y.GRP_uint8_uint8_uint8.All_Maps_GRP.Maps_Raster_2 /end AXIS_DESCR
/end CHARACTERISTIC
/begin CHARACTERISTIC Two_D.GRP_uint8_uint8_uint8.All_Maps_GRP.Maps_Raster_3 "" MAP 0x1D6582 STANDARD_GROUP_U8 0.0 ident 0.0 255.0
 /begin AXIS_DESCR COM_AXIS M_In_X.GRP_uint8_uint8_uint8.All_Maps_GRP.Maps_Raster_3 ident 10 0.0 255.0 AXIS_PTS_REF distrib_X.GRP_uint8_uint8_uint8.All_Maps_GRP.Maps_Raster_3 /end AXIS_DESCR
 /begin AXIS_DESCR COM_AXIS M_In_Y.GRP_uint8_uint8_uint8.All_Maps_GRP.Maps_Raster_3 ident 10 0.0 255.0 AXIS_PTS_REF distrib_Y.GRP_uint8_uint8_uint8.All_Maps_GRP.Maps_Raster_3 /end AXIS_DESCR
/end CHARACTERISTIC
/begin AXIS_PTS distrib_X.GRP_float32_float32_float32.All_Maps_GRP.Maps_Raster_1 "" 0x1D2B0C M_In_X.GRP_float32_float32_float32.All_Maps_GRP.Maps_Raster_1 STANDARD_DIST_R32 0.0 ident 10 -1.e+037 1.e+037 /end AXIS_PTS
/begin AXIS_PTS distrib_X.GRP_float32_float32_float32.All_Maps_GRP.Maps_Raster_2 "" 0x1D44D0 M_In_X.GRP_float32_float32_float32.All_Maps_GRP.Maps_Raster_2 STANDARD_DIST_R32 0.0 ident 10 -1.e+037 1.e+037 /end AXIS_PTS
/begin AXIS_PTS distrib_X.GRP_float32_float32_float32.All_Maps_GRP.Maps_Raster_3 "" 0x1D5E94 M_In_X.GRP_float32_float32_float32.All_Maps_GRP.Maps_Raster_3 STANDARD_DIST_R32 0.0 ident 10 -1.e+037 1.e+037 /end AXIS_PTS
/begin AXIS_PTS distrib_X.GRP_sint16_sint16_sint16.All_Maps_GRP.Maps_Raster_1 "" 0x1D2C3C M_In_X.GRP_sint16_sint16_sint16.All_Maps_GRP.Maps_Raster_1 STANDARD_DIST_S16 0.0 ident 10 -32768.0 32767.0 /end AXIS_PTS
/begin AXIS_PTS distrib_X.GRP_sint16_sint16_sint16.All_Maps_GRP.Maps_Raster_2 "" 0x1D4600 M_In_X.GRP_sint16_sint16_sint16.All_Maps_GRP.Maps_Raster_2 STANDARD_DIST_S16 0.0 ident 10 -32768.0 32767.0 /end AXIS_PTS
/begin AXIS_PTS distrib_X.GRP_sint16_sint16_sint16.All_Maps_GRP.Maps_Raster_3 "" 0x1D5FC4 M_In_X.GRP_sint16_sint16_sint16.All_Maps_GRP.Maps_Raster_3 STANDARD_DIST_S16 0.0 ident 10 -32768.0 32767.0 /end AXIS_PTS
/begin AXIS_PTS distrib_X.GRP_sint32_sint32_sint32.All_Maps_GRP.Maps_Raster_1 "" 0x1D2E0C M_In_X.GRP_sint32_sint32_sint32.All_Maps_GRP.Maps_Raster_1 STANDARD_DIST_S32 0.0 ident 10 -2147483648.0 2147483647.0 /end AXIS_PTS
/begin AXIS_PTS distrib_X.GRP_sint32_sint32_sint32.All_Maps_GRP.Maps_Raster_2 "" 0x1D47D0 M_In_X.GRP_sint32_sint32_sint32.All_Maps_GRP.Maps_Raster_2 STANDARD_DIST_S32 0.0 ident 10 -2147483648.0 2147483647.0 /end AXIS_PTS
/begin AXIS_PTS distrib_X.GRP_sint32_sint32_sint32.All_Maps_GRP.Maps_Raster_3 "" 0x1D6194 M_In_X.GRP_sint32_sint32_sint32.All_Maps_GRP.Maps_Raster_3 STANDARD_DIST_S32 0.0 ident 10 -2147483648.0 2147483647.0 /end AXIS_PTS
/begin AXIS_PTS distrib_X.GRP_sint8_sint8_sint8.All_Maps_GRP.Maps_Raster_1 "" 0x1D2ED6 M_In_X.GRP_sint8_sint8_sint8.All_Maps_GRP.Maps_Raster_1 STANDARD_DIST_S8 0.0 ident 10 -128.0 127.0 /end AXIS_PTS
/begin AXIS_PTS distrib_X.GRP_sint8_sint8_sint8.All_Maps_GRP.Maps_Raster_2 "" 0x1D489A M_In_X.GRP_sint8_sint8_sint8.All_Maps_GRP.Maps_Raster_2 STANDARD_DIST_S8 0.0 ident 10 -128.0 127.0 /end AXIS_PTS
/begin AXIS_PTS distrib_X.GRP_sint8_sint8_sint8.All_Maps_GRP.Maps_Raster_3 "" 0x1D625E M_In_X.GRP_sint8_sint8_sint8.All_Maps_GRP.Maps_Raster_3 STANDARD_DIST_S8 0.0 ident 10 -128.0 127.0 /end AXIS_PTS
/begin AXIS_PTS distrib_X.GRP_uint16_uint16_uint16.All_Maps_GRP.Maps_Raster_1 "" 0x1D2FC4 M_In_X.GRP_uint16_uint16_uint16.All_Maps_GRP.Maps_Raster_1 STANDARD_DIST_U16 0.0 ident 10 0.0 65535.0 /end AXIS_PTS
/begin AXIS_PTS distrib_X.GRP_uint16_uint16_uint16.All_Maps_GRP.Maps_Raster_2 "" 0x1D4988 M_In_X.GRP_uint16_uint16_uint16.All_Maps_GRP.Maps_Raster_2 STANDARD_DIST_U16 0.0 ident 10 0.0 65535.0 /end AXIS_PTS
/begin AXIS_PTS distrib_X.GRP_uint16_uint16_uint16.All_Maps_GRP.Maps_Raster_3 "" 0x1D634C M_In_X.GRP_uint16_uint16_uint16.All_Maps_GRP.Maps_Raster_3 STANDARD_DIST_U16 0.0 ident 10 0.0 65535.0 /end AXIS_PTS
/begin AXIS_PTS distrib_X.GRP_uint32_uint32_uint32.All_Maps_GRP.Maps_Raster_1 "" 0x1D3194 M_In_X.GRP_uint32_uint32_uint32.All_Maps_GRP.Maps_Raster_1 STANDARD_DIST_U32 0.0 ident 10 0.0 4294967295.0 /end AXIS_PTS
/begin AXIS_PTS distrib_X.GRP_uint32_uint32_uint32.All_Maps_GRP.Maps_Raster_2 "" 0x1D4B58 M_In_X.GRP_uint32_uint32_uint32.All_Maps_GRP.Maps_Raster_2 STANDARD_DIST_U32 0.0 ident 10 0.0 4294967295.0 /end AXIS_PTS
/begin AXIS_PTS distrib_X.GRP_uint32_uint32_uint32.All_Maps_GRP.Maps_Raster_3 "" 0x1D651C M_In_X.GRP_uint32_uint32_uint32.All_Maps_GRP.Maps_Raster_3 STANDARD_DIST_U32 0.0 ident 10 0.0 4294967295.0 /end AXIS_PTS
/begin AXIS_PTS distrib_X.GRP_uint8_uint8_uint8.All_Maps_GRP.Maps_Raster_1 "" 0x1D325E M_In_X.GRP_uint8_uint8_uint8.All_Maps_GRP.Maps_Raster_1 STANDARD_DIST_U8 0.0 ident 10 0.0 255.0 /end AXIS_PTS
/begin AXIS_PTS distrib_X.GRP_uint8_uint8_uint8.All_Maps_GRP.Maps_Raster_2 "" 0x1D4C22 M_In_X.GRP_uint8_uint8_uint8.All_Maps_GRP.Maps_Raster_2 STANDARD_DIST_U8 0.0 ident 10 0.0 255.0 /end AXIS_PTS
/begin AXIS_PTS distrib_X.GRP_uint8_uint8_uint8.All_Maps_GRP.Maps_Raster_3 "" 0x1D65E6 M_In_X.GRP_uint8_uint8_uint8.All_Maps_GRP.Maps_Raster_3 STANDARD_DIST_U8 0.0 ident 10 0.0 255.0 /end AXIS_PTS
/begin AXIS_PTS distrib_Y.GRP_float32_float32_float32.All_Maps_GRP.Maps_Raster_1 "" 0x1D2B38 M_In_Y.GRP_float32_float32_float32.All_Maps_GRP.Maps_Raster_1 STANDARD_DIST_R32 0.0 ident 10 -1.e+037 1.e+037 /end AXIS_PTS
/begin AXIS_PTS distrib_Y.GRP_float32_float32_float32.All_Maps_GRP.Maps_Raster_2 "" 0x1D44FC M_In_Y.GRP_float32_float32_float32.All_Maps_GRP.Maps_Raster_2 STANDARD_DIST_R32 0.0 ident 10 -1.e+037 1.e+037 /end AXIS_PTS
/begin AXIS_PTS distrib_Y.GRP_float32_float32_float32.All_Maps_GRP.Maps_Raster_3 "" 0x1D5EC0 M_In_Y.GRP_float32_float32_float32.All_Maps_GRP.Maps_Raster_3 STANDARD_DIST_R32 0.0 ident 10 -1.e+037 1.e+037 /end AXIS_PTS
/begin AXIS_PTS distrib_Y.GRP_sint16_sint16_sint16.All_Maps_GRP.Maps_Raster_1 "" 0x1D2C52 M_In_Y.GRP_sint16_sint16_sint16.All_Maps_GRP.Maps_Raster_1 STANDARD_DIST_S16 0.0 ident 10 -32768.0 32767.0 /end AXIS_PTS
/begin AXIS_PTS distrib_Y.GRP_sint16_sint16_sint16.All_Maps_GRP.Maps_Raster_2 "" 0x1D4616 M_In_Y.GRP_sint16_sint16_sint16.All_Maps_GRP.Maps_Raster_2 STANDARD_DIST_S16 0.0 ident 10 -32768.0 32767.0 /end AXIS_PTS
/begin AXIS_PTS distrib_Y.GRP_sint16_sint16_sint16.All_Maps_GRP.Maps_Raster_3 "" 0x1D5FDA M_In_Y.GRP_sint16_sint16_sint16.All_Maps_GRP.Maps_Raster_3 STANDARD_DIST_S16 0.0 ident 10 -32768.0 32767.0 /end AXIS_PTS
/begin AXIS_PTS distrib_Y.GRP_sint32_sint32_sint32.All_Maps_GRP.Maps_Raster_1 "" 0x1D2E38 M_In_Y.GRP_sint32_sint32_sint32.All_Maps_GRP.Maps_Raster_1 STANDARD_DIST_S32 0.0 ident 10 -2147483648.0 2147483647.0 /end AXIS_PTS
/begin AXIS_PTS distrib_Y.GRP_sint32_sint32_sint32.All_Maps_GRP.Maps_Raster_2 "" 0x1D47FC M_In_Y.GRP_sint32_sint32_sint32.All_Maps_GRP.Maps_Raster_2 STANDARD_DIST_S32 0.0 ident 10 -2147483648.0 2147483647.0 /end AXIS_PTS
/begin AXIS_PTS distrib_Y.GRP_sint32_sint32_sint32.All_Maps_GRP.Maps_Raster_3 "" 0x1D61C0 M_In_Y.GRP_sint32_sint32_sint32.All_Maps_GRP.Maps_Raster_3 STANDARD_DIST_S32 0.0 ident 10 -2147483648.0 2147483647.0 /end AXIS_PTS
/begin AXIS_PTS distrib_Y.GRP_sint8_sint8_sint8.All_Maps_GRP.Maps_Raster_1 "" 0x1D2EE1 M_In_Y.GRP_sint8_sint8_sint8.All_Maps_GRP.Maps_Raster_1 STANDARD_DIST_S8 0.0 ident 10 -128.0 127.0 /end AXIS_PTS
/begin AXIS_PTS distrib_Y.GRP_sint8_sint8_sint8.All_Maps_GRP.Maps_Raster_2 "" 0x1D48A5 M_In_Y.GRP_sint8_sint8_sint8.All_Maps_GRP.Maps_Raster_2 STANDARD_DIST_S8 0.0 ident 10 -128.0 127.0 /end AXIS_PTS
/begin AXIS_PTS distrib_Y.GRP_sint8_sint8_sint8.All_Maps_GRP.Maps_Raster_3 "" 0x1D6269 M_In_Y.GRP_sint8_sint8_sint8.All_Maps_GRP.Maps_Raster_3 STANDARD_DIST_S8 0.0 ident 10 -128.0 127.0 /end AXIS_PTS
/begin AXIS_PTS distrib_Y.GRP_uint16_uint16_uint16.All_Maps_GRP.Maps_Raster_1 "" 0x1D2FDA M_In_Y.GRP_uint16_uint16_uint16.All_Maps_GRP.Maps_Raster_1 STANDARD_DIST_U16 0.0 ident 10 0.0 65535.0 /end AXIS_PTS
/begin AXIS_PTS distrib_Y.GRP_uint16_uint16_uint16.All_Maps_GRP.Maps_Raster_2 "" 0x1D499E M_In_Y.GRP_uint16_uint16_uint16.All_Maps_GRP.Maps_Raster_2 STANDARD_DIST_U16 0.0 ident 10 0.0 65535.0 /end AXIS_PTS
/begin AXIS_PTS distrib_Y.GRP_uint16_uint16_uint16.All_Maps_GRP.Maps_Raster_3 "" 0x1D6362 M_In_Y.GRP_uint16_uint16_uint16.All_Maps_GRP.Maps_Raster_3 STANDARD_DIST_U16 0.0 ident 10 0.0 65535.0 /end AXIS_PTS
/begin AXIS_PTS distrib_Y.GRP_uint32_uint32_uint32.All_Maps_GRP.Maps_Raster_1 "" 0x1D31C0 M_In_Y.GRP_uint32_uint32_uint32.All_Maps_GRP.Maps_Raster_1 STANDARD_DIST_U32 0.0 ident 10 0.0 4294967295.0 /end AXIS_PTS
/begin AXIS_PTS distrib_Y.GRP_uint32_uint32_uint32.All_Maps_GRP.Maps_Raster_2 "" 0x1D4B84 M_In_Y.GRP_uint32_uint32_uint32.All_Maps_GRP.Maps_Raster_2 STANDARD_DIST_U32 0.0 ident 10 0.0 4294967295.0 /end AXIS_PTS
/begin AXIS_PTS distrib_Y.GRP_uint32_uint32_uint32.All_Maps_GRP.Maps_Raster_3 "" 0x1D6548 M_In_Y.GRP_uint32_uint32_uint32.All_Maps_GRP.Maps_Raster_3 STANDARD_DIST_U32 0.0 ident 10 0.0 4294967295.0 /end AXIS_PTS
/begin AXIS_PTS distrib_Y.GRP_uint8_uint8_uint8.All_Maps_GRP.Maps_Raster_1 "" 0x1D3269 M_In_Y.GRP_uint8_uint8_uint8.All_Maps_GRP.Maps_Raster_1 STANDARD_DIST_U8 0.0 ident 10 0.0 255.0 /end AXIS_PTS
/begin AXIS_PTS distrib_Y.GRP_uint8_uint8_uint8.All_Maps_GRP.Maps_Raster_2 "" 0x1D4C2D M_In_Y.GRP_uint8_uint8_uint8.All_Maps_GRP.Maps_Raster_2 STANDARD_DIST_U8 0.0 ident 10 0.0 255.0 /end AXIS_PTS
/begin AXIS_PTS distrib_Y.GRP_uint8_uint8_uint8.All_Maps_GRP.Maps_Raster_3 "" 0x1D65F1 M_In_Y.GRP_uint8_uint8_uint8.All_Maps_GRP.Maps_Raster_3 STANDARD_DIST_U8 0.0 ident 10 0.0 255.0 /end AXIS_PTS
/begin MEASUREMENT Calculated.FIX_float32_float32_float32.All_Maps_FIX.Maps_Raster_1 "" SBYTE ident 1 100 0 1 BIT_MASK 0x1 ECU_ADDRESS 0x7F8954 /end MEASUREMENT
/begin MEASUREMENT Calculated.FIX_float32_float32_float32.All_Maps_FIX.Maps_Raster_2 "" SBYTE ident 1 100 0 1 BIT_MASK 0x1 ECU_ADDRESS 0x7F8A2C /end MEASUREMENT
/begin MEASUREMENT Calculated.FIX_float32_float32_float32.All_Maps_FIX.Maps_Raster_3 "" SBYTE ident 1 100 0 1 BIT_MASK 0x1 ECU_ADDRESS 0x7F8B04 /end MEASUREMENT
/begin MEASUREMENT Calculated.FIX_sint16_sint16_sint16.All_Maps_FIX.Maps_Raster_1 "" UBYTE ident 1 100 0 1 BIT_MASK 0x1 ECU_ADDRESS 0x7F895E /end MEASUREMENT
/begin MEASUREMENT Calculated.FIX_sint16_sint16_sint16.All_Maps_FIX.Maps_Raster_2 "" UBYTE ident 1 100 0 1 BIT_MASK 0x1 ECU_ADDRESS 0x7F8A36 /end MEASUREMENT
/begin MEASUREMENT Calculated.FIX_sint16_sint16_sint16.All_Maps_FIX.Maps_Raster_3 "" UBYTE ident 1 100 0 1 BIT_MASK 0x1 ECU_ADDRESS 0x7F8B0E /end MEASUREMENT
/begin MEASUREMENT Calculated.FIX_sint32_sint32_sint32.All_Maps_FIX.Maps_Raster_1 "" UBYTE ident 1 100 0 1 BIT_MASK 0x1 ECU_ADDRESS 0x7F896C /end MEASUREMENT
/begin MEASUREMENT Calculated.FIX_sint32_sint32_sint32.All_Maps_FIX.Maps_Raster_2 "" UBYTE ident 1 100 0 1 BIT_MASK 0x1 ECU_ADDRESS 0x7F8A44 /end MEASUREMENT
/begin MEASUREMENT Calculated.FIX_sint32_sint32_sint32.All_Maps_FIX.Maps_Raster_3 "" UBYTE ident 1 100 0 1 BIT_MASK 0x1 ECU_ADDRESS 0x7F8B1C /end MEASUREMENT
/begin MEASUREMENT Calculated.FIX_sint8_sint8_sint8.All_Maps_FIX.Maps_Raster_1 "" UBYTE ident 1 100 0 1 BIT_MASK 0x1 ECU_ADDRESS 0x7F8970 /end MEASUREMENT
/begin MEASUREMENT Calculated.FIX_sint8_sint8_sint8.All_Maps_FIX.Maps_Raster_2 "" UBYTE ident 1 100 0 1 BIT_MASK 0x1 ECU_ADDRESS 0x7F8A48 /end MEASUREMENT
/begin MEASUREMENT Calculated.FIX_sint8_sint8_sint8.All_Maps_FIX.Maps_Raster_3 "" UBYTE ident 1 100 0 1 BIT_MASK 0x1 ECU_ADDRESS 0x7F8B20 /end MEASUREMENT
/begin MEASUREMENT Calculated.FIX_uint16_uint16_uint16.All_Maps_FIX.Maps_Raster_1 "" UBYTE ident 1 100 0 1 BIT_MASK 0x1 ECU_ADDRESS 0x7F897A /end MEASUREMENT
/begin MEASUREMENT Calculated.FIX_uint16_uint16_uint16.All_Maps_FIX.Maps_Raster_2 "" UBYTE ident 1 100 0 1 BIT_MASK 0x1 ECU_ADDRESS 0x7F8A52 /end MEASUREMENT
/begin MEASUREMENT Calculated.FIX_uint16_uint16_uint16.All_Maps_FIX.Maps_Raster_3 "" UBYTE ident 1 100 0 1 BIT_MASK 0x1 ECU_ADDRESS 0x7F8B2A /end MEASUREMENT
/begin MEASUREMENT Calculated.FIX_uint32_uint32_uint32.All_Maps_FIX.Maps_Raster_1 "" UBYTE ident 1 100 0 1 BIT_MASK 0x1 ECU_ADDRESS 0x7F8988 /end MEASUREMENT
/begin MEASUREMENT Calculated.FIX_uint32_uint32_uint32.All_Maps_FIX.Maps_Raster_2 "" UBYTE ident 1 100 0 1 BIT_MASK 0x1 ECU_ADDRESS 0x7F8A60 /end MEASUREMENT
/begin MEASUREMENT Calculated.FIX_uint32_uint32_uint32.All_Maps_FIX.Maps_Raster_3 "" UBYTE ident 1 100 0 1 BIT_MASK 0x1 ECU_ADDRESS 0x7F8B38 /end MEASUREMENT
/begin MEASUREMENT Calculated.FIX_uint8_uint8_uint8.All_Maps_FIX.Maps_Raster_1 "" UBYTE ident 1 100 0 1 BIT_MASK 0x1 ECU_ADDRESS 0x7F898C /end MEASUREMENT
/begin MEASUREMENT Calculated.FIX_uint8_uint8_uint8.All_Maps_FIX.Maps_Raster_2 "" UBYTE ident 1 100 0 1 BIT_MASK 0x1 ECU_ADDRESS 0x7F8A64 /end MEASUREMENT
/begin MEASUREMENT Calculated.FIX_uint8_uint8_uint8.All_Maps_FIX.Maps_Raster_3 "" UBYTE ident 1 100 0 1 BIT_MASK 0x1 ECU_ADDRESS 0x7F8B3C /end MEASUREMENT
/begin MEASUREMENT Calculated.GRP_float32_float32_float32.All_Maps_GRP.Maps_Raster_1 "" SBYTE ident 1 100 0 1 BIT_MASK 0x1 ECU_ADDRESS 0x7F899C /end MEASUREMENT
/begin MEASUREMENT Calculated.GRP_float32_float32_float32.All_Maps_GRP.Maps_Raster_2 "" SBYTE ident 1 100 0 1 BIT_MASK 0x1 ECU_ADDRESS 0x7F8A74 /end MEASUREMENT
/begin MEASUREMENT Calculated.GRP_float32_float32_float32.All_Maps_GRP.Maps_Raster_3 "" SBYTE ident 1 100 0 1 BIT_MASK 0x1 ECU_ADDRESS 0x7F8B4C /end MEASUREMENT
/begin MEASUREMENT Calculated.GRP_sint16_sint16_sint16.All_Maps_GRP.Maps_Raster_1 "" UBYTE ident 1 100 0 1 BIT_MASK 0x1 ECU_ADDRESS 0x7F89A6 /end MEASUREMENT
/begin MEASUREMENT Calculated.GRP_sint16_sint16_sint16.All_Maps_GRP.Maps_Raster_2 "" UBYTE ident 1 100 0 1 BIT_MASK 0x1 ECU_ADDRESS 0x7F8A7E /end MEASUREMENT
/begin MEASUREMENT Calculated.GRP_sint16_sint16_sint16.All_Maps_GRP.Maps_Raster_3 "" UBYTE ident 1 100 0 1 BIT_MASK 0x1 ECU_ADDRESS 0x7F8B56 /end MEASUREMENT
/begin MEASUREMENT Calculated.GRP_sint32_sint32_sint32.All_Maps_GRP.Maps_Raster_1 "" UBYTE ident 1 100 0 1 BIT_MASK 0x1 ECU_ADDRESS 0x7F89B4 /end MEASUREMENT
/begin MEASUREMENT Calculated.GRP_sint32_sint32_sint32.All_Maps_GRP.Maps_Raster_2 "" UBYTE ident 1 100 0 1 BIT_MASK 0x1 ECU_ADDRESS 0x7F8A8C /end MEASUREMENT
/begin MEASUREMENT Calculated.GRP_sint32_sint32_sint32.All_Maps_GRP.Maps_Raster_3 "" UBYTE ident 1 100 0 1 BIT_MASK 0x1 ECU_ADDRESS 0x7F8B64 /end MEASUREMENT
/begin MEASUREMENT Calculated.GRP_sint8_sint8_sint8.All_Maps_GRP.Maps_Raster_1 "" UBYTE ident 1 100 0 1 BIT_MASK 0x1 ECU_ADDRESS 0x7F89B8 /end MEASUREMENT
/begin MEASUREMENT Calculated.GRP_sint8_sint8_sint8.All_Maps_GRP.Maps_Raster_2 "" UBYTE ident 1 100 0 1 BIT_MASK 0x1 ECU_ADDRESS 0x7F8A90 /end MEASUREMENT
/begin MEASUREMENT Calculated.GRP_sint8_sint8_sint8.All_Maps_GRP.Maps_Raster_3 "" UBYTE ident 1 100 0 1 BIT_MASK 0x1 ECU_ADDRESS 0x7F8B68 /end MEASUREMENT
/begin MEASUREMENT Calculated.GRP_uint16_uint16_uint16.All_Maps_GRP.Maps_Raster_1 "" UBYTE ident 1 100 0 1 BIT_MASK 0x1 ECU_ADDRESS 0x7F89C2 /end MEASUREMENT
/begin MEASUREMENT Calculated.GRP_uint16_uint16_uint16.All_Maps_GRP.Maps_Raster_2 "" UBYTE ident 1 100 0 1 BIT_MASK 0x1 ECU_ADDRESS 0x7F8A9A /end MEASUREMENT
/begin MEASUREMENT Calculated.GRP_uint16_uint16_uint16.All_Maps_GRP.Maps_Raster_3 "" UBYTE ident 1 100 0 1 BIT_MASK 0x1 ECU_ADDRESS 0x7F8B72 /end MEASUREMENT
/begin MEASUREMENT Calculated.GRP_uint32_uint32_uint32.All_Maps_GRP.Maps_Raster_1 "" UBYTE ident 1 100 0 1 BIT_MASK 0x1 ECU_ADDRESS 0x7F89D0 /end MEASUREMENT
/begin MEASUREMENT Calculated.GRP_uint32_uint32_uint32.All_Maps_GRP.Maps_Raster_2 "" UBYTE ident 1 100 0 1 BIT_MASK 0x1 ECU_ADDRESS 0x7F8AA8 /end MEASUREMENT
/begin MEASUREMENT Calculated.GRP_uint32_uint32_uint32.All_Maps_GRP.Maps_Raster_3 "" UBYTE ident 1 100 0 1 BIT_MASK 0x1 ECU_ADDRESS 0x7F8B80 /end MEASUREMENT
/begin MEASUREMENT Calculated.GRP_uint8_uint8_uint8.All_Maps_GRP.Maps_Raster_1 "" UBYTE ident 1 100 0 1 BIT_MASK 0x1 ECU_ADDRESS 0x7F89D4 /end MEASUREMENT
/begin MEASUREMENT Calculated.GRP_uint8_uint8_uint8.All_Maps_GRP.Maps_Raster_2 "" UBYTE ident 1 100 0 1 BIT_MASK 0x1 ECU_ADDRESS 0x7F8AAC /end MEASUREMENT
/begin MEASUREMENT Calculated.GRP_uint8_uint8_uint8.All_Maps_GRP.Maps_Raster_3 "" UBYTE ident 1 100 0 1 BIT_MASK 0x1 ECU_ADDRESS 0x7F8B84 /end MEASUREMENT
/begin MEASUREMENT M_In_X.FIX_float32_float32_float32.All_Maps_FIX.Maps_Raster_1 "" FLOAT32_IEEE ident 1 100 -1.e+037 1.e+037 ECU_ADDRESS 0x7F8948 /end MEASUREMENT
/begin MEASUREMENT M_In_X.FIX_float32_float32_float32.All_Maps_FIX.Maps_Raster_2 "" FLOAT32_IEEE ident 1 100 -1.e+037 1.e+037 ECU_ADDRESS 0x7F8A20 /end MEASUREMENT
/begin MEASUREMENT M_In_X.FIX_float32_float32_float32.All_Maps_FIX.Maps_Raster_3 "" FLOAT32_IEEE ident 1 100 -1.e+037 1.e+037 ECU_ADDRESS 0x7F8AF8 /end MEASUREMENT
/begin MEASUREMENT M_In_X.FIX_sint16_sint16_sint16.All_Maps_FIX.Maps_Raster_1 "" SWORD ident 1 100 -32768.0 32767.0 ECU_ADDRESS 0x7F8958 /end MEASUREMENT
/begin MEASUREMENT M_In_X.FIX_sint16_sint16_sint16.All_Maps_FIX.Maps_Raster_2 "" SWORD ident 1 100 -32768.0 32767.0 ECU_ADDRESS 0x7F8A30 /end MEASUREMENT
/begin MEASUREMENT M_In_X.FIX_sint16_sint16_sint16.All_Maps_FIX.Maps_Raster_3 "" SWORD ident 1 100 -32768.0 32767.0 ECU_ADDRESS 0x7F8B08 /end MEASUREMENT
/begin MEASUREMENT M_In_X.FIX_sint32_sint32_sint32.All_Maps_FIX.Maps_Raster_1 "" SLONG ident 1 100 -2147483648.0 2147483647.0 ECU_ADDRESS 0x7F8960 /end MEASUREMENT
/begin MEASUREMENT M_In_X.FIX_sint32_sint32_sint32.All_Maps_FIX.Maps_Raster_2 "" SLONG ident 1 100 -2147483648.0 2147483647.0 ECU_ADDRESS 0x7F8A38 /end MEASUREMENT
/begin MEASUREMENT M_In_X.FIX_sint32_sint32_sint32.All_Maps_FIX.Maps_Raster_3 "" SLONG ident 1 100 -2147483648.0 2147483647.0 ECU_ADDRESS 0x7F8B10 /end MEASUREMENT
/begin MEASUREMENT M_In_X.FIX_sint8_sint8_sint8.All_Maps_FIX.Maps_Raster_1 "" SBYTE ident 1 100 -128.0 127.0 ECU_ADDRESS 0x7F8971 /end MEASUREMENT
/begin MEASUREMENT M_In_X.FIX_sint8_sint8_sint8.All_Maps_FIX.Maps_Raster_2 "" SBYTE ident 1 100 -128.0 127.0 ECU_ADDRESS 0x7F8A49 /end MEASUREMENT
/begin MEASUREMENT M_In_X.FIX_sint8_sint8_sint8.All_Maps_FIX.Maps_Raster_3 "" SBYTE ident 1 100 -128.0 127.0 ECU_ADDRESS 0x7F8B21 /end MEASUREMENT
/begin MEASUREMENT M_In_X.FIX_uint16_uint16_uint16.All_Maps_FIX.Maps_Raster_1 "" UWORD ident 1 100 0.0 65535.0 ECU_ADDRESS 0x7F8974 /end MEASUREMENT
/begin MEASUREMENT M_In_X.FIX_uint16_uint16_uint16.All_Maps_FIX.Maps_Raster_2 "" UWORD ident 1 100 0.0 65535.0 ECU_ADDRESS 0x7F8A4C /end MEASUREMENT
/begin MEASUREMENT M_In_X.FIX_uint16_uint16_uint16.All_Maps_FIX.Maps_Raster_3 "" UWORD ident 1 100 0.0 65535.0 ECU_ADDRESS 0x7F8B24 /end MEASUREMENT
/begin MEASUREMENT M_In_X.FIX_uint32_uint32_uint32.All_Maps_FIX.Maps_Raster_1 "" ULONG ident 1 100 0.0 4294967295.0 ECU_ADDRESS 0x7F897C /end MEASUREMENT
/begin MEASUREMENT M_In_X.FIX_uint32_uint32_uint32.All_Maps_FIX.Maps_Raster_2 "" ULONG ident 1 100 0.0 4294967295.0 ECU_ADDRESS 0x7F8A54 /end MEASUREMENT
/begin MEASUREMENT M_In_X.FIX_uint32_uint32_uint32.All_Maps_FIX.Maps_Raster_3 "" ULONG ident 1 100 0.0 4294967295.0 ECU_ADDRESS 0x7F8B2C /end MEASUREMENT
/begin MEASUREMENT M_In_X.FIX_uint8_uint8_uint8.All_Maps_FIX.Maps_Raster_1 "" UBYTE ident 1 100 0.0 255.0 ECU_ADDRESS 0x7F898D /end MEASUREMENT
/begin MEASUREMENT M_In_X.FIX_uint8_uint8_uint8.All_Maps_FIX.Maps_Raster_2 "" UBYTE ident 1 100 0.0 255.0 ECU_ADDRESS 0x7F8A65 /end MEASUREMENT
/begin MEASUREMENT M_In_X.FIX_uint8_uint8_uint8.All_Maps_FIX.Maps_Raster_3 "" UBYTE ident 1 100 0.0 255.0 ECU_ADDRESS 0x7F8B3D /end MEASUREMENT
/begin MEASUREMENT M_In_X.GRP_float32_float32_float32.All_Maps_GRP.Maps_Raster_1 "" FLOAT32_IEEE ident 1 100 -1.e+037 1.e+037 ECU_ADDRESS 0x7F8990 /end MEASUREMENT
/begin MEASUREMENT M_In_X.GRP_float32_float32_float32.All_Maps_GRP.Maps_Raster_2 "" FLOAT32_IEEE ident 1 100 -1.e+037 1.e+037 ECU_ADDRESS 0x7F8A68 /end MEASUREMENT
/begin MEASUREMENT M_In_X.GRP_float32_float32_float32.All_Maps_GRP.Maps_Raster_3 "" FLOAT32_IEEE ident 1 100 -1.e+037 1.e+037 ECU_ADDRESS 0x7F8B40 /end MEASUREMENT
/begin MEASUREMENT M_In_X.GRP_sint16_sint16_sint16.All_Maps_GRP.Maps_Raster_1 "" SWORD ident 1 100 -32768.0 32767.0 ECU_ADDRESS 0x7F89A0 /end MEASUREMENT
/begin MEASUREMENT M_In_X.GRP_sint16_sint16_sint16.All_Maps_GRP.Maps_Raster_2 "" SWORD ident 1 100 -32768.0 32767.0 ECU_ADDRESS 0x7F8A78 /end MEASUREMENT
/begin MEASUREMENT M_In_X.GRP_sint16_sint16_sint16.All_Maps_GRP.Maps_Raster_3 "" SWORD ident 1 100 -32768.0 32767.0 ECU_ADDRESS 0x7F8B50 /end MEASUREMENT
/begin MEASUREMENT M_In_X.GRP_sint32_sint32_sint32.All_Maps_GRP.Maps_Raster_1 "" SLONG ident 1 100 -2147483648.0 2147483647.0 ECU_ADDRESS 0x7F89A8 /end MEASUREMENT
/begin MEASUREMENT M_In_X.GRP_sint32_sint32_sint32.All_Maps_GRP.Maps_Raster_2 "" SLONG ident 1 100 -2147483648.0 2147483647.0 ECU_ADDRESS 0x7F8A80 /end MEASUREMENT
/begin MEASUREMENT M_In_X.GRP_sint32_sint32_sint32.All_Maps_GRP.Maps_Raster_3 "" SLONG ident 1 100 -2147483648.0 2147483647.0 ECU_ADDRESS 0x7F8B58 /end MEASUREMENT
/begin MEASUREMENT M_In_X.GRP_sint8_sint8_sint8.All_Maps_GRP.Maps_Raster_1 "" SBYTE ident 1 100 -128.0 127.0 ECU_ADDRESS 0x7F89B9 /end MEASUREMENT
/begin MEASUREMENT M_In_X.GRP_sint8_sint8_sint8.All_Maps_GRP.Maps_Raster_2 "" SBYTE ident 1 100 -128.0 127.0 ECU_ADDRESS 0x7F8A91 /end MEASUREMENT
/begin MEASUREMENT M_In_X.GRP_sint8_sint8_sint8.All_Maps_GRP.Maps_Raster_3 "" SBYTE ident 1 100 -128.0 127.0 ECU_ADDRESS 0x7F8B69 /end MEASUREMENT
/begin MEASUREMENT M_In_X.GRP_uint16_uint16_uint16.All_Maps_GRP.Maps_Raster_1 "" UWORD ident 1 100 0.0 65535.0 ECU_ADDRESS 0x7F89BC /end MEASUREMENT
/begin MEASUREMENT M_In_X.GRP_uint16_uint16_uint16.All_Maps_GRP.Maps_Raster_2 "" UWORD ident 1 100 0.0 65535.0 ECU_ADDRESS 0x7F8A94 /end MEASUREMENT
/begin MEASUREMENT M_In_X.GRP_uint16_uint16_uint16.All_Maps_GRP.Maps_Raster_3 "" UWORD ident 1 100 0.0 65535.0 ECU_ADDRESS 0x7F8B6C /end MEASUREMENT
/begin MEASUREMENT M_In_X.GRP_uint32_uint32_uint32.All_Maps_GRP.Maps_Raster_1 "" ULONG ident 1 100 0.0 4294967295.0 ECU_ADDRESS 0x7F89C4 /end MEASUREMENT
/begin MEASUREMENT M_In_X.GRP_uint32_uint32_uint32.All_Maps_GRP.Maps_Raster_2 "" ULONG ident 1 100 0.0 4294967295.0 ECU_ADDRESS 0x7F8A9C /end MEASUREMENT
/begin MEASUREMENT M_In_X.GRP_uint32_uint32_uint32.All_Maps_GRP.Maps_Raster_3 "" ULONG ident 1 100 0.0 4294967295.0 ECU_ADDRESS 0x7F8B74 /end MEASUREMENT
/begin MEASUREMENT M_In_X.GRP_uint8_uint8_uint8.All_Maps_GRP.Maps_Raster_1 "" UBYTE ident 1 100 0.0 255.0 ECU_ADDRESS 0x7F89D5 /end MEASUREMENT
/begin MEASUREMENT M_In_X.GRP_uint8_uint8_uint8.All_Maps_GRP.Maps_Raster_2 "" UBYTE ident 1 100 0.0 255.0 ECU_ADDRESS 0x7F8AAD /end MEASUREMENT
/begin MEASUREMENT M_In_X.GRP_uint8_uint8_uint8.All_Maps_GRP.Maps_Raster_3 "" UBYTE ident 1 100 0.0 255.0 ECU_ADDRESS 0x7F8B85 /end MEASUREMENT
/begin MEASUREMENT M_In_Y.FIX_float32_float32_float32.All_Maps_FIX.Maps_Raster_1 "" FLOAT32_IEEE ident 1 100 -1.e+037 1.e+037 ECU_ADDRESS 0x7F894C /end MEASUREMENT
/begin MEASUREMENT M_In_Y.FIX_float32_float32_float32.All_Maps_FIX.Maps_Raster_2 "" FLOAT32_IEEE ident 1 100 -1.e+037 1.e+037 ECU_ADDRESS 0x7F8A24 /end MEASUREMENT
/begin MEASUREMENT M_In_Y.FIX_float32_float32_float32.All_Maps_FIX.Maps_Raster_3 "" FLOAT32_IEEE ident 1 100 -1.e+037 1.e+037 ECU_ADDRESS 0x7F8AFC /end MEASUREMENT
/begin MEASUREMENT M_In_Y.FIX_sint16_sint16_sint16.All_Maps_FIX.Maps_Raster_1 "" SWORD ident 1 100 -32768.0 32767.0 ECU_ADDRESS 0x7F895A /end MEASUREMENT
/begin MEASUREMENT M_In_Y.FIX_sint16_sint16_sint16.All_Maps_FIX.Maps_Raster_2 "" SWORD ident 1 100 -32768.0 32767.0 ECU_ADDRESS 0x7F8A32 /end MEASUREMENT
/begin MEASUREMENT M_In_Y.FIX_sint16_sint16_sint16.All_Maps_FIX.Maps_Raster_3 "" SWORD ident 1 100 -32768.0 32767.0 ECU_ADDRESS 0x7F8B0A /end MEASUREMENT
/begin MEASUREMENT M_In_Y.FIX_sint32_sint32_sint32.All_Maps_FIX.Maps_Raster_1 "" SLONG ident 1 100 -2147483648.0 2147483647.0 ECU_ADDRESS 0x7F8964 /end MEASUREMENT
/begin MEASUREMENT M_In_Y.FIX_sint32_sint32_sint32.All_Maps_FIX.Maps_Raster_2 "" SLONG ident 1 100 -2147483648.0 2147483647.0 ECU_ADDRESS 0x7F8A3C /end MEASUREMENT
/begin MEASUREMENT M_In_Y.FIX_sint32_sint32_sint32.All_Maps_FIX.Maps_Raster_3 "" SLONG ident 1 100 -2147483648.0 2147483647.0 ECU_ADDRESS 0x7F8B14 /end MEASUREMENT
/begin MEASUREMENT M_In_Y.FIX_sint8_sint8_sint8.All_Maps_FIX.Maps_Raster_1 "" SBYTE ident 1 100 -128.0 127.0 ECU_ADDRESS 0x7F8972 /end MEASUREMENT
/begin MEASUREMENT M_In_Y.FIX_sint8_sint8_sint8.All_Maps_FIX.Maps_Raster_2 "" SBYTE ident 1 100 -128.0 127.0 ECU_ADDRESS 0x7F8A4A /end MEASUREMENT
/begin MEASUREMENT M_In_Y.FIX_sint8_sint8_sint8.All_Maps_FIX.Maps_Raster_3 "" SBYTE ident 1 100 -128.0 127.0 ECU_ADDRESS 0x7F8B22 /end MEASUREMENT
/begin MEASUREMENT M_In_Y.FIX_uint16_uint16_uint16.All_Maps_FIX.Maps_Raster_1 "" UWORD ident 1 100 0.0 65535.0 ECU_ADDRESS 0x7F8976 /end MEASUREMENT
/begin MEASUREMENT M_In_Y.FIX_uint16_uint16_uint16.All_Maps_FIX.Maps_Raster_2 "" UWORD ident 1 100 0.0 65535.0 ECU_ADDRESS 0x7F8A4E /end MEASUREMENT
/begin MEASUREMENT M_In_Y.FIX_uint16_uint16_uint16.All_Maps_FIX.Maps_Raster_3 "" UWORD ident 1 100 0.0 65535.0 ECU_ADDRESS 0x7F8B26 /end MEASUREMENT
/begin MEASUREMENT M_In_Y.FIX_uint32_uint32_uint32.All_Maps_FIX.Maps_Raster_1 "" ULONG ident 1 100 0.0 4294967295.0 ECU_ADDRESS 0x7F8980 /end MEASUREMENT
/begin MEASUREMENT M_In_Y.FIX_uint32_uint32_uint32.All_Maps_FIX.Maps_Raster_2 "" ULONG ident 1 100 0.0 4294967295.0 ECU_ADDRESS 0x7F8A58 /end MEASUREMENT
/begin MEASUREMENT M_In_Y.FIX_uint32_uint32_uint32.All_Maps_FIX.Maps_Raster_3 "" ULONG ident 1 100 0.0 4294967295.0 ECU_ADDRESS 0x7F8B30 /end MEASUREMENT
/begin MEASUREMENT M_In_Y.FIX_uint8_uint8_uint8.All_Maps_FIX.Maps_Raster_1 "" UBYTE ident 1 100 0.0 255.0 ECU_ADDRESS 0x7F898E /end MEASUREMENT
/begin MEASUREMENT M_In_Y.FIX_uint8_uint8_uint8.All_Maps_FIX.Maps_Raster_2 "" UBYTE ident 1 100 0.0 255.0 ECU_ADDRESS 0x7F8A66 /end MEASUREMENT
/begin MEASUREMENT M_In_Y.FIX_uint8_uint8_uint8.All_Maps_FIX.Maps_Raster_3 "" UBYTE ident 1 100 0.0 255.0 ECU_ADDRESS 0x7F8B3E /end MEASUREMENT
/begin MEASUREMENT M_In_Y.GRP_float32_float32_float32.All_Maps_GRP.Maps_Raster_1 "" FLOAT32_IEEE ident 1 100 -1.e+037 1.e+037 ECU_ADDRESS 0x7F8994 /end MEASUREMENT
/begin MEASUREMENT M_In_Y.GRP_float32_float32_float32.All_Maps_GRP.Maps_Raster_2 "" FLOAT32_IEEE ident 1 100 -1.e+037 1.e+037 ECU_ADDRESS 0x7F8A6C /end MEASUREMENT
/begin MEASUREMENT M_In_Y.GRP_float32_float32_float32.All_Maps_GRP.Maps_Raster_3 "" FLOAT32_IEEE ident 1 100 -1.e+037 1.e+037 ECU_ADDRESS 0x7F8B44 /end MEASUREMENT
/begin MEASUREMENT M_In_Y.GRP_sint16_sint16_sint16.All_Maps_GRP.Maps_Raster_1 "" SWORD ident 1 100 -32768.0 32767.0 ECU_ADDRESS 0x7F89A2 /end MEASUREMENT
/begin MEASUREMENT M_In_Y.GRP_sint16_sint16_sint16.All_Maps_GRP.Maps_Raster_2 "" SWORD ident 1 100 -32768.0 32767.0 ECU_ADDRESS 0x7F8A7A /end MEASUREMENT
/begin MEASUREMENT M_In_Y.GRP_sint16_sint16_sint16.All_Maps_GRP.Maps_Raster_3 "" SWORD ident 1 100 -32768.0 32767.0 ECU_ADDRESS 0x7F8B52 /end MEASUREMENT
/begin MEASUREMENT M_In_Y.GRP_sint32_sint32_sint32.All_Maps_GRP.Maps_Raster_1 "" SLONG ident 1 100 -2147483648.0 2147483647.0 ECU_ADDRESS 0x7F89AC /end MEASUREMENT
/begin MEASUREMENT M_In_Y.GRP_sint32_sint32_sint32.All_Maps_GRP.Maps_Raster_2 "" SLONG ident 1 100 -2147483648.0 2147483647.0 ECU_ADDRESS 0x7F8A84 /end MEASUREMENT
/begin MEASUREMENT M_In_Y.GRP_sint32_sint32_sint32.All_Maps_GRP.Maps_Raster_3 "" SLONG ident 1 100 -2147483648.0 2147483647.0 ECU_ADDRESS 0x7F8B5C /end MEASUREMENT
/begin MEASUREMENT M_In_Y.GRP_sint8_sint8_sint8.All_Maps_GRP.Maps_Raster_1 "" SBYTE ident 1 100 -128.0 127.0 ECU_ADDRESS 0x7F89BA /end MEASUREMENT
/begin MEASUREMENT M_In_Y.GRP_sint8_sint8_sint8.All_Maps_GRP.Maps_Raster_2 "" SBYTE ident 1 100 -128.0 127.0 ECU_ADDRESS 0x7F8A92 /end MEASUREMENT
/begin MEASUREMENT M_In_Y.GRP_sint8_sint8_sint8.All_Maps_GRP.Maps_Raster_3 "" SBYTE ident 1 100 -128.0 127.0 ECU_ADDRESS 0x7F8B6A /end MEASUREMENT
/begin MEASUREMENT M_In_Y.GRP_uint16_uint16_uint16.All_Maps_GRP.Maps_Raster_1 "" UWORD ident 1 100 0.0 65535.0 ECU_ADDRESS 0x7F89BE /end MEASUREMENT
/begin MEASUREMENT M_In_Y.GRP_uint16_uint16_uint16.All_Maps_GRP.Maps_Raster_2 "" UWORD ident 1 100 0.0 65535.0 ECU_ADDRESS 0x7F8A96 /end MEASUREMENT
/begin MEASUREMENT M_In_Y.GRP_uint16_uint16_uint16.All_Maps_GRP.Maps_Raster_3 "" UWORD ident 1 100 0.0 65535.0 ECU_ADDRESS 0x7F8B6E /end MEASUREMENT
/begin MEASUREMENT M_In_Y.GRP_uint32_uint32_uint32.All_Maps_GRP.Maps_Raster_1 "" ULONG ident 1 100 0.0 4294967295.0 ECU_ADDRESS 0x7F89C8 /end MEASUREMENT
/begin MEASUREMENT M_In_Y.GRP_uint32_uint32_uint32.All_Maps_GRP.Maps_Raster_2 "" ULONG ident 1 100 0.0 4294967295.0 ECU_ADDRESS 0x7F8AA0 /end MEASUREMENT
/begin MEASUREMENT M_In_Y.GRP_uint32_uint32_uint32.All_Maps_GRP.Maps_Raster_3 "" ULONG ident 1 100 0.0 4294967295.0 ECU_ADDRESS 0x7F8B78 /end MEASUREMENT
/begin MEASUREMENT M_In_Y.GRP_uint8_uint8_uint8.All_Maps_GRP.Maps_Raster_1 "" UBYTE ident 1 100 0.0 255.0 ECU_ADDRESS 0x7F89D6 /end MEASUREMENT
/begin MEASUREMENT M_In_Y.GRP_uint8_uint8_uint8.All_Maps_GRP.Maps_Raster_2 "" UBYTE ident 1 100 0.0 255.0 ECU_ADDRESS 0x7F8AAE /end MEASUREMENT
/begin MEASUREMENT M_In_Y.GRP_uint8_uint8_uint8.All_Maps_GRP.Maps_Raster_3 "" UBYTE ident 1 100 0.0 255.0 ECU_ADDRESS 0x7F8B86 /end MEASUREMENT
/begin MEASUREMENT M_out.FIX_float32_float32_float32.All_Maps_FIX.Maps_Raster_1 "" FLOAT32_IEEE ident 1 100 -1.e+037 1.e+037 ECU_ADDRESS 0x7F8950 /end MEASUREMENT
/begin MEASUREMENT M_out.FIX_float32_float32_float32.All_Maps_FIX.Maps_Raster_2 "" FLOAT32_IEEE ident 1 100 -1.e+037 1.e+037 ECU_ADDRESS 0x7F8A28 /end MEASUREMENT
/begin MEASUREMENT M_out.FIX_float32_float32_float32.All_Maps_FIX.Maps_Raster_3 "" FLOAT32_IEEE ident 1 100 -1.e+037 1.e+037 ECU_ADDRESS 0x7F8B00 /end MEASUREMENT
/begin MEASUREMENT M_out.FIX_sint16_sint16_sint16.All_Maps_FIX.Maps_Raster_1 "" SWORD ident 1 100 -32768.0 32767.0 ECU_ADDRESS 0x7F895C /end MEASUREMENT
/begin MEASUREMENT M_out.FIX_sint16_sint16_sint16.All_Maps_FIX.Maps_Raster_2 "" SWORD ident 1 100 -32768.0 32767.0 ECU_ADDRESS 0x7F8A34 /end MEASUREMENT
/begin MEASUREMENT M_out.FIX_sint16_sint16_sint16.All_Maps_FIX.Maps_Raster_3 "" SWORD ident 1 100 -32768.0 32767.0 ECU_ADDRESS 0x7F8B0C /end MEASUREMENT
/begin MEASUREMENT M_out.FIX_sint32_sint32_sint32.All_Maps_FIX.Maps_Raster_1 "" SLONG ident 1 100 -2147483648.0 2147483647.0 ECU_ADDRESS 0x7F8968 /end MEASUREMENT
/begin MEASUREMENT M_out.FIX_sint32_sint32_sint32.All_Maps_FIX.Maps_Raster_2 "" SLONG ident 1 100 -2147483648.0 2147483647.0 ECU_ADDRESS 0x7F8A40 /end MEASUREMENT
/begin MEASUREMENT M_out.FIX_sint32_sint32_sint32.All_Maps_FIX.Maps_Raster_3 "" SLONG ident 1 100 -2147483648.0 2147483647.0 ECU_ADDRESS 0x7F8B18 /end MEASUREMENT
/begin MEASUREMENT M_out.FIX_sint8_sint8_sint8.All_Maps_FIX.Maps_Raster_1 "" SBYTE ident 1 100 -128.0 127.0 ECU_ADDRESS 0x7F8973 /end MEASUREMENT
/begin MEASUREMENT M_out.FIX_sint8_sint8_sint8.All_Maps_FIX.Maps_Raster_2 "" SBYTE ident 1 100 -128.0 127.0 ECU_ADDRESS 0x7F8A4B /end MEASUREMENT
/begin MEASUREMENT M_out.FIX_sint8_sint8_sint8.All_Maps_FIX.Maps_Raster_3 "" SBYTE ident 1 100 -128.0 127.0 ECU_ADDRESS 0x7F8B23 /end MEASUREMENT
/begin MEASUREMENT M_out.FIX_uint16_uint16_uint16.All_Maps_FIX.Maps_Raster_1 "" UWORD ident 1 100 0.0 65535.0 ECU_ADDRESS 0x7F8978 /end MEASUREMENT
/begin MEASUREMENT M_out.FIX_uint16_uint16_uint16.All_Maps_FIX.Maps_Raster_2 "" UWORD ident 1 100 0.0 65535.0 ECU_ADDRESS 0x7F8A50 /end MEASUREMENT
/begin MEASUREMENT M_out.FIX_uint16_uint16_uint16.All_Maps_FIX.Maps_Raster_3 "" UWORD ident 1 100 0.0 65535.0 ECU_ADDRESS 0x7F8B28 /end MEASUREMENT
/begin MEASUREMENT M_out.FIX_uint32_uint32_uint32.All_Maps_FIX.Maps_Raster_1 "" ULONG ident 1 100 0.0 4294967295.0 ECU_ADDRESS 0x7F8984 /end MEASUREMENT
/begin MEASUREMENT M_out.FIX_uint32_uint32_uint32.All_Maps_FIX.Maps_Raster_2 "" ULONG ident 1 100 0.0 4294967295.0 ECU_ADDRESS 0x7F8A5C /end MEASUREMENT
/begin MEASUREMENT M_out.FIX_uint32_uint32_uint32.All_Maps_FIX.Maps_Raster_3 "" ULONG ident 1 100 0.0 4294967295.0 ECU_ADDRESS 0x7F8B34 /end MEASUREMENT
/begin MEASUREMENT M_out.FIX_uint8_uint8_uint8.All_Maps_FIX.Maps_Raster_1 "" UBYTE ident 1 100 0.0 255.0 ECU_ADDRESS 0x7F898F /end MEASUREMENT
/begin MEASUREMENT M_out.FIX_uint8_uint8_uint8.All_Maps_FIX.Maps_Raster_2 "" UBYTE ident 1 100 0.0 255.0 ECU_ADDRESS 0x7F8A67 /end MEASUREMENT
/begin MEASUREMENT M_out.FIX_uint8_uint8_uint8.All_Maps_FIX.Maps_Raster_3 "" UBYTE ident 1 100 0.0 255.0 ECU_ADDRESS 0x7F8B3F /end MEASUREMENT
/begin MEASUREMENT M_out.GRP_float32_float32_float32.All_Maps_GRP.Maps_Raster_1 "" FLOAT32_IEEE ident 1 100 -1.e+037 1.e+037 ECU_ADDRESS 0x7F8998 /end MEASUREMENT
/begin MEASUREMENT M_out.GRP_float32_float32_float32.All_Maps_GRP.Maps_Raster_2 "" FLOAT32_IEEE ident 1 100 -1.e+037 1.e+037 ECU_ADDRESS 0x7F8A70 /end MEASUREMENT
/begin MEASUREMENT M_out.GRP_float32_float32_float32.All_Maps_GRP.Maps_Raster_3 "" FLOAT32_IEEE ident 1 100 -1.e+037 1.e+037 ECU_ADDRESS 0x7F8B48 /end MEASUREMENT
/begin MEASUREMENT M_out.GRP_sint16_sint16_sint16.All_Maps_GRP.Maps_Raster_1 "" SWORD ident 1 100 -32768.0 32767.0 ECU_ADDRESS 0x7F89A4 /end MEASUREMENT
/begin MEASUREMENT M_out.GRP_sint16_sint16_sint16.All_Maps_GRP.Maps_Raster_2 "" SWORD ident 1 100 -32768.0 32767.0 ECU_ADDRESS 0x7F8A7C /end MEASUREMENT
/begin MEASUREMENT M_out.GRP_sint16_sint16_sint16.All_Maps_GRP.Maps_Raster_3 "" SWORD ident 1 100 -32768.0 32767.0 ECU_ADDRESS 0x7F8B54 /end MEASUREMENT
/begin MEASUREMENT M_out.GRP_sint32_sint32_sint32.All_Maps_GRP.Maps_Raster_1 "" SLONG ident 1 100 -2147483648.0 2147483647.0 ECU_ADDRESS 0x7F89B0 /end MEASUREMENT
/begin MEASUREMENT M_out.GRP_sint32_sint32_sint32.All_Maps_GRP.Maps_Raster_2 "" SLONG ident 1 100 -2147483648.0 2147483647.0 ECU_ADDRESS 0x7F8A88 /end MEASUREMENT
/begin MEASUREMENT M_out.GRP_sint32_sint32_sint32.All_Maps_GRP.Maps_Raster_3 "" SLONG ident 1 100 -2147483648.0 2147483647.0 ECU_ADDRESS 0x7F8B60 /end MEASUREMENT
/begin MEASUREMENT M_out.GRP_sint8_sint8_sint8.All_Maps_GRP.Maps_Raster_1 "" SBYTE ident 1 100 -128.0 127.0 ECU_ADDRESS 0x7F89BB /end MEASUREMENT
/begin MEASUREMENT M_out.GRP_sint8_sint8_sint8.All_Maps_GRP.Maps_Raster_2 "" SBYTE ident 1 100 -128.0 127.0 ECU_ADDRESS 0x7F8A93 /end MEASUREMENT
/begin MEASUREMENT M_out.GRP_sint8_sint8_sint8.All_Maps_GRP.Maps_Raster_3 "" SBYTE ident 1 100 -128.0 127.0 ECU_ADDRESS 0x7F8B6B /end MEASUREMENT
/begin MEASUREMENT M_out.GRP_uint16_uint16_uint16.All_Maps_GRP.Maps_Raster_1 "" UWORD ident 1 100 0.0 65535.0 ECU_ADDRESS 0x7F89C0 /end MEASUREMENT
/begin MEASUREMENT M_out.GRP_uint16_uint16_uint16.All_Maps_GRP.Maps_Raster_2 "" UWORD ident 1 100 0.0 65535.0 ECU_ADDRESS 0x7F8A98 /end MEASUREMENT
/begin MEASUREMENT M_out.GRP_uint16_uint16_uint16.All_Maps_GRP.Maps_Raster_3 "" UWORD ident 1 100 0.0 65535.0 ECU_ADDRESS 0x7F8B70 /end MEASUREMENT
/begin MEASUREMENT M_out.GRP_uint32_uint32_uint32.All_Maps_GRP.Maps_Raster_1 "" ULONG ident 1 100 0.0 4294967295.0 ECU_ADDRESS 0x7F89CC /end MEASUREMENT
/begin MEASUREMENT M_out.GRP_uint32_uint32_uint32.All_Maps_GRP.Maps_Raster_2 "" ULONG ident 1 100 0.0 4294967295.0 ECU_ADDRESS 0x7F8AA4 /end MEASUREMENT
/begin MEASUREMENT M_out.GRP_uint32_uint32_uint32.All_Maps_GRP.Maps_Raster_3 "" ULONG ident 1 100 0.0 4294967295.0 ECU_ADDRESS 0x7F8B7C /end MEASUREMENT
/begin MEASUREMENT M_out.GRP_uint8_uint8_uint8.All_Maps_GRP.Maps_Raster_1 "" UBYTE ident 1 100 0.0 255.0 ECU_ADDRESS 0x7F89D7 /end MEASUREMENT
/begin MEASUREMENT M_out.GRP_uint8_uint8_uint8.All_Maps_GRP.Maps_Raster_2 "" UBYTE ident 1 100 0.0 255.0 ECU_ADDRESS 0x7F8AAF /end MEASUREMENT
/begin MEASUREMENT M_out.GRP_uint8_uint8_uint8.All_Maps_GRP.Maps_Raster_3 "" UBYTE ident 1 100 0.0 255.0 ECU_ADDRESS 0x7F8B87 /end MEASUREMENT
/begin COMPU_METHOD ident "" RAT_FUNC "%12.4" "" COEFFS 0 1 0 0 0 1 /end COMPU_METHOD
/begin GROUP All_Maps_FIX.Maps_Raster_1 ""
 /begin REF_MEASUREMENT Calculated.FIX_float32_float32_float32.All_Maps_FIX.Maps_Raster_1 Calculated.FIX_sint16_sint16_sint16.All_Maps_FIX.Maps_Raster_1 Calculated.FIX_sint32_sint32_sint32.All_Maps_FIX.Maps_Raster_1 Calculated.FIX_sint8_sint8_sint8.All_Maps_FIX.Maps_Raster_1 Calculated.FIX_uint16_uint16_uint16.All_Maps_FIX.Maps_Raster_1 Calculated.FIX_uint32_uint32_uint32.All_Maps_FIX.Maps_Raster_1 Calculated.FIX_uint8_uint8_uint8.All_Maps_FIX.Maps_Raster_1 M_In_X.FIX_float32_float32_float32.All_Maps_FIX.Maps_Raster_1 M_In_X.FIX_sint16_sint16_sint16.All_Maps_FIX.Maps_Raster_1 M_In_X.FIX_sint32_sint32_sint32.All_Maps_FIX.Maps_Raster_1 M_In_X.FIX_sint8_sint8_sint8.All_Maps_FIX.Maps_Raster_1 M_In_X.FIX_uint16_uint16_uint16.All_Maps_FIX.Maps_Raster_1 M_In_X.FIX_uint32_uint32_uint32.All_Maps_FIX.Maps_Raster_1 M_In_X.FIX_uint8_uint8_uint8.All_Maps_FIX.Maps_Raster_1 M_In_Y.FIX_float32_float32_float32.All_Maps_FIX.Maps_Raster_1 M_In_Y.FIX_sint16_sint16_sint16.All_Maps_FIX.Maps_Raster_1 M_In_Y.FIX_sint32_sint32_sint32.All_Maps_FIX.Maps_Raster_1 M_In_Y.FIX_sint8_sint8_sint8.All_Maps_FIX.Maps_Raster_1 M_In_Y.FIX_uint16_uint16_uint16.All_Maps_FIX.Maps_Raster_1 M_In_Y.FIX_uint32_uint32_uint32.All_Maps_FIX.Maps_Raster_1 M_In_Y.FIX_uint8_uint8_uint8.All_Maps_FIX.Maps_Raster_1 M_out.FIX_float32_float32_float32.All_Maps_FIX.Maps_Raster_1 M_out.FIX_sint16_sint16_sint16.All_Maps_FIX.Maps_Raster_1 M_out.FIX_sint32_sint32_sint32.All_Maps_FIX.Maps_Raster_1 M_out.FIX_sint8_sint8_sint8.All_Maps_FIX.Maps_Raster_1 M_out.FIX_uint16_uint16_uint16.All_Maps_FIX.Maps_Raster_1 M_out.FIX_uint32_uint32_uint32.All_Maps_FIX.Maps_Raster_1 M_out.FIX_uint8_uint8_uint8.All_Maps_FIX.Maps_Raster_1 /end REF_MEASUREMENT
 /begin REF_CHARACTERISTIC P_Do_Active_Std.FIX_float32_float32_float32.All_Maps_FIX.Maps_Raster_1 P_Do_Active_Std.FIX_sint16_sint16_sint16.All_Maps_FIX.Maps_Raster_1 P_Do_Active_Std.FIX_sint32_sint32_sint32.All_Maps_FIX.Maps_Raster_1 P_Do_Active_Std.FIX_sint8_sint8_sint8.All_Maps_FIX.Maps_Raster_1 P_Do_Active_Std.FIX_uint16_uint16_uint16.All_Maps_FIX.Maps_Raster_1 P_Do_Active_Std.FIX_uint32_uint32_uint32.All_Maps_FIX.Maps_Raster_1 P_Do_Active_Std.FIX_uint8_uint8_uint8.All_Maps_FIX.Maps_Raster_1 P_Do_All_FIX_Maps.All_Maps_FIX.Maps_Raster_1 P_In_X.FIX_float32_float32_float32.All_Maps_FIX.Maps_Raster_1 P_In_X.FIX_sint16_sint16_sint16.All_Maps_FIX.Maps_Raster_1 P_In_X.FIX_sint32_sint32_sint32.All_Maps_FIX.Maps_Raster_1 P_In_X.FIX_sint8_sint8_sint8.All_Maps_FIX.Maps_Raster_1 P_In_X.FIX_uint16_uint16_uint16.All_Maps_FIX.Maps_Raster_1 P_In_X.FIX_uint32_uint32_uint32.All_Maps_FIX.Maps_Raster_1 P_In_X.FIX_uint8_uint8_uint8.All_Maps_FIX.Maps_Raster_1 P_In_Y.FIX_float32_float32_float32.All_Maps_FIX.Maps_Raster_1 P_In_Y.FIX_sint16_sint16_sint16.All_Maps_FIX.Maps_Raster_1 P_In_Y.FIX_sint32_sint32_sint32.All_Maps_FIX.Maps_Raster_1 P_In_Y.FIX_sint8_sint8_sint8.All_Maps_FIX.Maps_Raster_1 P_In_Y.FIX_uint16_uint16_uint16.All_Maps_FIX.Maps_Raster_1 P_In_Y.FIX_uint32_uint32_uint32.All_Maps_FIX.Maps_Raster_1 P_In_Y.FIX_uint8_uint8_uint8.All_Maps_FIX.Maps_Raster_1 Two_D.FIX_float32_float32_float32.All_Maps_FIX.Maps_Raster_1 Two_D.FIX_sint16_sint16_sint16.All_Maps_FIX.Maps_Raster_1 Two_D.FIX_sint32_sint32_sint32.All_Maps_FIX.Maps_Raster_1 Two_D.FIX_sint8_sint8_sint8.All_Maps_FIX.Maps_Raster_1 Two_D.FIX_uint16_uint16_uint16.All_Maps_FIX.Maps_Raster_1 Two_D.FIX_uint32_uint32_uint32.All_Maps_FIX.Maps_Raster_1 Two_D.FIX_uint8_uint8_uint8.All_Maps_FIX.Maps_Raster_1 /end REF_CHARACTERISTIC
 /begin SUB_GROUP FIX_float32_float32_float32.All_Maps_FIX.Maps_Raster_1 FIX_sint16_sint16_sint16.All_Maps_FIX.Maps_Raster_1 FIX_sint32_sint32_sint32.All_Maps_FIX.Maps_Raster_1 FIX_sint8_sint8_sint8.All_Maps_FIX.Maps_Raster_1 FIX_uint16_uint16_uint16.All_Maps_FIX.Maps_Raster_1 FIX_uint32_uint32_uint32.All_Maps_FIX.Maps_Raster_1 FIX_uint8_uint8_uint8.All_Maps_FIX.Maps_Raster_1 /end SUB_GROUP
/end GROUP
/begin GROUP All_Maps_FIX.Maps_Raster_2 ""
 /begin REF_MEASUREMENT Calculated.FIX_float32_float32_float32.All_Maps_FIX.Maps_Raster_2 Calculated.FIX_sint16_sint16_sint16.All_Maps_FIX.Maps_Raster_2 Calculated.FIX_sint32_sint32_sint32.All_Maps_FIX.Maps_Raster_2 Calculated.FIX_sint8_sint8_sint8.All_Maps_FIX.Maps_Raster_2 Calculated.FIX_uint16_uint16_uint16.All_Maps_FIX.Maps_Raster_2 Calculated.FIX_uint32_uint32_uint32.All_Maps_FIX.Maps_Raster_2 Calculated.FIX_uint8_uint8_uint8.All_Maps_FIX.Maps_Raster_2 M_In_X.FIX_float32_float32_float32.All_Maps_FIX.Maps_Raster_2 M_In_X.FIX_sint16_sint16_sint16.All_Maps_FIX.Maps_Raster_2 M_In_X.FIX_sint32_sint32_sint32.All_Maps_FIX.Maps_Raster_2 M_In_X.FIX_sint8_sint8_sint8.All_Maps_FIX.Maps_Raster_2 M_In_X.FIX_uint16_uint16_uint16.All_Maps_FIX.Maps_Raster_2 M_In_X.FIX_uint32_uint32_uint32.All_Maps_FIX.Maps_Raster_2 M_In_X.FIX_uint8_uint8_uint8.All_Maps_FIX.Maps_Raster_2 M_In_Y.FIX_float32_float32_float32.All_Maps_FIX.Maps_Raster_2 M_In_Y.FIX_sint16_sint16_sint16.All_Maps_FIX.Maps_Raster_2 M_In_Y.FIX_sint32_sint32_sint32.All_Maps_FIX.Maps_Raster_2 M_In_Y.FIX_sint8_sint8_sint8.All_Maps_FIX.Maps_Raster_2 M_In_Y.FIX_uint16_uint16_uint16.All_Maps_FIX.Maps_Raster_2 M_In_Y.FIX_uint32_uint32_uint32.All_Maps_FIX.Maps_Raster_2 M_In_Y.FIX_uint8_uint8_uint8.All_Maps_FIX.Maps_Raster_2 M_out.FIX_float32_float32_float32.All_Maps_FIX.Maps_Raster_2 M_out.FIX_sint16_sint16_sint16.All_Maps_FIX.Maps_Raster_2 M_out.FIX_sint32_sint32_sint32.All_Maps_FIX.Maps_Raster_2 M_out.FIX_sint8_sint8_sint8.All_Maps_FIX.Maps_Raster_2 M_out.FIX_uint16_uint16_uint16.All_Maps_FIX.Maps_Raster_2 M_out.FIX_uint32_uint32_uint32.All_Maps_FIX.Maps_Raster_2 M_out.FIX_uint8_uint8_uint8.All_Maps_FIX.Maps_Raster_2 /end REF_MEASUREMENT
 /begin REF_CHARACTERISTIC P_Do_Active_Std.FIX_float32_float32_float32.All_Maps_FIX.Maps_Raster_2 P_Do_Active_Std.FIX_sint16_sint16_sint16.All_Maps_FIX.Maps_Raster_2 P_Do_Active_Std.FIX_sint32_sint32_sint32.All_Maps_FIX.Maps_Raster_2 P_Do_Active_Std.FIX_sint8_sint8_sint8.All_Maps_FIX.Maps_Raster_2 P_Do_Active_Std.FIX_uint16_uint16_uint16.All_Maps_FIX.Maps_Raster_2 P_Do_Active_Std.FIX_uint32_uint32_uint32.All_Maps_FIX.Maps_Raster_2 P_Do_Active_Std.FIX_uint8_uint8_uint8.All_Maps_FIX.Maps_Raster_2 P_Do_All_FIX_Maps.All_Maps_FIX.Maps_Raster_2 P_In_X.FIX_float32_float32_float32.All_Maps_FIX.Maps_Raster_2 P_In_X.FIX_sint16_sint16_sint16.All_Maps_FIX.Maps_Raster_2 P_In_X.FIX_sint32_sint32_sint32.All_Maps_FIX.Maps_Raster_2 P_In_X.FIX_sint8_sint8_sint8.All_Maps_FIX.Maps_Raster_2 P_In_X.FIX_uint16_uint16_uint16.All_Maps_FIX.Maps_Raster_2 P_In_X.FIX_uint32_uint32_uint32.All_Maps_FIX.Maps_Raster_2 P_In_X.FIX_uint8_uint8_uint8.All_Maps_FIX.Maps_Raster_2 P_In_Y.FIX_float32_float32_float32.All_Maps_FIX.Maps_Raster_2 P_In_Y.FIX_sint16_sint16_sint16.All_Maps_FIX.Maps_Raster_2 P_In_Y.FIX_sint32_sint32_sint32.All_Maps_FIX.Maps_Raster_2 P_In_Y.FIX_sint8_sint8_sint8.All_Maps_FIX.Maps_Raster_2 P_In_Y.FIX_uint16_uint16_uint16.All_Maps_FIX.Maps_Raster_2 P_In_Y.FIX_uint32_uint32_uint32.All_Maps_FIX.Maps_Raster_2 P_In_Y.FIX_uint8_uint8_uint8.All_Maps_FIX.Maps_Raster_2 Two_D.FIX_float32_float32_float32.All_Maps_FIX.Maps_Raster_2 Two_D.FIX_sint16_sint16_sint16.All_Maps_FIX.Maps_Raster_2 Two_D.FIX_sint32_sint32_sint32.All_Maps_FIX.Maps_Raster_2 Two_D.FIX_sint8_sint8_sint8.All_Maps_FIX.Maps_Raster_2 Two_D.FIX_uint16_uint16_uint16.All_Maps_FIX.Maps_Raster_2 Two_D.FIX_uint32_uint32_uint32.All_Maps_FIX.Maps_Raster_2 Two_D.FIX_uint8_uint8_uint8.All_Maps_FIX.Maps_Raster_2 /end REF_CHARACTERISTIC
 /begin SUB_GROUP FIX_float32_float32_float32.All_Maps_FIX.Maps_Raster_2 FIX_sint16_sint16_sint16.All_Maps_FIX.Maps_Raster_2 FIX_sint32_sint32_sint32.All_Maps_FIX.Maps_Raster_2 FIX_sint8_sint8_sint8.All_Maps_FIX.Maps_Raster_2 FIX_uint16_uint16_uint16.All_Maps_FIX.Maps_Raster_2 FIX_uint32_uint32_uint32.All_Maps_FIX.Maps_Raster_2 FIX_uint8_uint8_uint8.All_Maps_FIX.Maps_Raster_2 /end SUB_GROUP
/end GROUP
/begin GROUP All_Maps_FIX.Maps_Raster_3 ""
 /begin REF_MEASUREMENT Calculated.FIX_float32_float32_float32.All_Maps_FIX.Maps_Raster_3 Calculated.FIX_sint16_sint16_sint16.All_Maps_FIX.Maps_Raster_3 Calculated.FIX_sint32_sint32_sint32.All_Maps_FIX.Maps_Raster_3 Calculated.FIX_sint8_sint8_sint8.All_Maps_FIX.Maps_Raster_3 Calculated.FIX_uint16_uint16_uint16.All_Maps_FIX.Maps_Raster_3 Calculated.FIX_uint32_uint32_uint32.All_Maps_FIX.Maps_Raster_3 Calculated.FIX_uint8_uint8_uint8.All_Maps_FIX.Maps_Raster_3 M_In_X.FIX_float32_float32_float32.All_Maps_FIX.Maps_Raster_3 M_In_X.FIX_sint16_sint16_sint16.All_Maps_FIX.Maps_Raster_3 M_In_X.FIX_sint32_sint32_sint32.All_Maps_FIX.Maps_Raster_3 M_In_X.FIX_sint8_sint8_sint8.All_Maps_FIX.Maps_Raster_3 M_In_X.FIX_uint16_uint16_uint16.All_Maps_FIX.Maps_Raster_3 M_In_X.FIX_uint32_uint32_uint32.All_Maps_FIX.Maps_Raster_3 M_In_X.FIX_uint8_uint8_uint8.All_Maps_FIX.Maps_Raster_3 M_In_Y.FIX_float32_float32_float32.All_Maps_FIX.Maps_Raster_3 M_In_Y.FIX_sint16_sint16_sint16.All_Maps_FIX.Maps_Raster_3 M_In_Y.FIX_sint32_sint32_sint32.All_Maps_FIX.Maps_Raster_3 M_In_Y.FIX_sint8_sint8_sint8.All_Maps_FIX.Maps_Raster_3 M_In_Y.FIX_uint16_uint16_uint16.All_Maps_FIX.Maps_Raster_3 M_In_Y.FIX_uint32_uint32_uint32.All_Maps_FIX.Maps_Raster_3 M_In_Y.FIX_uint8_uint8_uint8.All_Maps_FIX.Maps_Raster_3 M_out.FIX_float32_float32_float32.All_Maps_FIX.Maps_Raster_3 M_out.FIX_sint16_sint16_sint16.All_Maps_FIX.Maps_Raster_3 M_out.FIX_sint32_sint32_sint32.All_Maps_FIX.Maps_Raster_3 M_out.FIX_sint8_sint8_sint8.All_Maps_FIX.Maps_Raster_3 M_out.FIX_uint16_uint16_uint16.All_Maps_FIX.Maps_Raster_3 M_out.FIX_uint32_uint32_uint32.All_Maps_FIX.Maps_Raster_3 M_out.FIX_uint8_uint8_uint8.All_Maps_FIX.Maps_Raster_3 /end REF_MEASUREMENT
 /begin REF_CHARACTERISTIC P_Do_Active_Std.FIX_float32_float32_float32.All_Maps_FIX.Maps_Raster_3 P_Do_Active_Std.FIX_sint16_sint16_sint16.All_Maps_FIX.Maps_Raster_3 P_Do_Active_Std.FIX_sint32_sint32_sint32.All_Maps_FIX.Maps_Raster_3 P_Do_Active_Std.FIX_sint8_sint8_sint8.All_Maps_FIX.Maps_Raster_3 P_Do_Active_Std.FIX_uint16_uint16_uint16.All_Maps_FIX.Maps_Raster_3 P_Do_Active_Std.FIX_uint32_uint32_uint32.All_Maps_FIX.Maps_Raster_3 P_Do_Active_Std.FIX_uint8_uint8_uint8.All_Maps_FIX.Maps_Raster_3 P_Do_All_FIX_Maps.All_Maps_FIX.Maps_Raster_3 P_In_X.FIX_float32_float32_float32.All_Maps_FIX.Maps_Raster_3 P_In_X.FIX_sint16_sint16_sint16.All_Maps_FIX.Maps_Raster_3 P_In_X.FIX_sint32_sint32_sint32.All_Maps_FIX.Maps_Raster_3 P_In_X.FIX_sint8_sint8_sint8.All_Maps_FIX.Maps_Raster_3 P_In_X.FIX_uint16_uint16_uint16.All_Maps_FIX.Maps_Raster_3 P_In_X.FIX_uint32_uint32_uint32.All_Maps_FIX.Maps_Raster_3 P_In_X.FIX_uint8_uint8_uint8.All_Maps_FIX.Maps_Raster_3 P_In_Y.FIX_float32_float32_float32.All_Maps_FIX.Maps_Raster_3 P_In_Y.FIX_sint16_sint16_sint16.All_Maps_FIX.Maps_Raster_3 P_In_Y.FIX_sint32_sint32_sint32.All_Maps_FIX.Maps_Raster_3 P_In_Y.FIX_sint8_sint8_sint8.All_Maps_FIX.Maps_Raster_3 P_In_Y.FIX_uint16_uint16_uint16.All_Maps_FIX.Maps_Raster_3 P_In_Y.FIX_uint32_uint32_uint32.All_Maps_FIX.Maps_Raster_3 P_In_Y.FIX_uint8_uint8_uint8.All_Maps_FIX.Maps_Raster_3 Two_D.FIX_float32_float32_float32.All_Maps_FIX.Maps_Raster_3 Two_D.FIX_sint16_sint16_sint16.All_Maps_FIX.Maps_Raster_3 Two_D.FIX_sint32_sint32_sint32.All_Maps_FIX.Maps_Raster_3 Two_D.FIX_sint8_sint8_sint8.All_Maps_FIX.Maps_Raster_3 Two_D.FIX_uint16_uint16_uint16.All_Maps_FIX.Maps_Raster_3 Two_D.FIX_uint32_uint32_uint32.All_Maps_FIX.Maps_Raster_3 Two_D.FIX_uint8_uint8_uint8.All_Maps_FIX.Maps_Raster_3 /end REF_CHARACTERISTIC
 /begin SUB_GROUP FIX_float32_float32_float32.All_Maps_FIX.Maps_Raster_3 FIX_sint16_sint16_sint16.All_Maps_FIX.Maps_Raster_3 FIX_sint32_sint32_sint32.All_Maps_FIX.Maps_Raster_3 FIX_sint8_sint8_sint8.All_Maps_FIX.Maps_Raster_3 FIX_uint16_uint16_uint16.All_Maps_FIX.Maps_Raster_3 FIX_uint32_uint32_uint32.All_Maps_FIX.Maps_Raster_3 FIX_uint8_uint8_uint8.All_Maps_FIX.Maps_Raster_3 /end SUB_GROUP
/end GROUP
/begin GROUP All_Maps_GRP.Maps_Raster_1 ""
 /begin REF_MEASUREMENT Calculated.GRP_float32_float32_float32.All_Maps_GRP.Maps_Raster_1 Calculated.GRP_sint16_sint16_sint16.All_Maps_GRP.Maps_Raster_1 Calculated.GRP_sint32_sint32_sint32.All_Maps_GRP.Maps_Raster_1 Calculated.GRP_sint8_sint8_sint8.All_Maps_GRP.Maps_Raster_1 Calculated.GRP_uint16_uint16_uint16.All_Maps_GRP.Maps_Raster_1 Calculated.GRP_uint32_uint32_uint32.All_Maps_GRP.Maps_Raster_1 Calculated.GRP_uint8_uint8_uint8.All_Maps_GRP.Maps_Raster_1 M_In_X.GRP_float32_float32_float32.All_Maps_GRP.Maps_Raster_1 M_In_X.GRP_sint16_sint16_sint16.All_Maps_GRP.Maps_Raster_1 M_In_X.GRP_sint32_sint32_sint32.All_Maps_GRP.Maps_Raster_1 M_In_X.GRP_sint8_sint8_sint8.All_Maps_GRP.Maps_Raster_1 M_In_X.GRP_uint16_uint16_uint16.All_Maps_GRP.Maps_Raster_1 M_In_X.GRP_uint32_uint32_uint32.All_Maps_GRP.Maps_Raster_1 M_In_X.GRP_uint8_uint8_uint8.All_Maps_GRP.Maps_Raster_1 M_In_Y.GRP_float32_float32_float32.All_Maps_GRP.Maps_Raster_1 M_In_Y.GRP_sint16_sint16_sint16.All_Maps_GRP.Maps_Raster_1 M_In_Y.GRP_sint32_sint32_sint32.All_Maps_GRP.Maps_Raster_1 M_In_Y.GRP_sint8_sint8_sint8.All_Maps_GRP.Maps_Raster_1 M_In_Y.GRP_uint16_uint16_uint16.All_Maps_GRP.Maps_Raster_1 M_In_Y.GRP_uint32_uint32_uint32.All_Maps_GRP.Maps_Raster_1 M_In_Y.GRP_uint8_uint8_uint8.All_Maps_GRP.Maps_Raster_1 M_out.GRP_float32_float32_float32.All_Maps_GRP.Maps_Raster_1 M_out.GRP_sint16_sint16_sint16.All_Maps_GRP.Maps_Raster_1 M_out.GRP_sint32_sint32_sint32.All_Maps_GRP.Maps_Raster_1 M_out.GRP_sint8_sint8_sint8.All_Maps_GRP.Maps_Raster_1 M_out.GRP_uint16_uint16_uint16.All_Maps_GRP.Maps_Raster_1 M_out.GRP_uint32_uint32_uint32.All_Maps_GRP.Maps_Raster_1 M_out.GRP_uint8_uint8_uint8.All_Maps_GRP.Maps_Raster_1 /end REF_MEASUREMENT
 /begin REF_CHARACTERISTIC P_Do_Active_Grp.GRP_float32_float32_float32.All_Maps_GRP.Maps_Raster_1 P_Do_Active_Grp.GRP_sint16_sint16_sint16.All_Maps_GRP.Maps_Raster_1 P_Do_Active_Grp.GRP_sint32_sint32_sint32.All_Maps_GRP.Maps_Raster_1 P_Do_Active_Grp.GRP_sint8_sint8_sint8.All_Maps_GRP.Maps_Raster_1 P_Do_Active_Grp.GRP_uint16_uint16_uint16.All_Maps_GRP.Maps_Raster_1 P_Do_Active_Grp.GRP_uint32_uint32_uint32.All_Maps_GRP.Maps_Raster_1 P_Do_Active_Grp.GRP_uint8_uint8_uint8.All_Maps_GRP.Maps_Raster_1 P_Do_All_GRP_Maps.All_Maps_GRP.Maps_Raster_1 P_Do_GET.GRP_float32_float32_float32.All_Maps_GRP.Maps_Raster_1 P_Do_GET.GRP_sint16_sint16_sint16.All_Maps_GRP.Maps_Raster_1 P_Do_GET.GRP_sint32_sint32_sint32.All_Maps_GRP.Maps_Raster_1 P_Do_GET.GRP_sint8_sint8_sint8.All_Maps_GRP.Maps_Raster_1 P_Do_GET.GRP_uint16_uint16_uint16.All_Maps_GRP.Maps_Raster_1 P_Do_GET.GRP_uint32_uint32_uint32.All_Maps_GRP.Maps_Raster_1 P_Do_GET.GRP_uint8_uint8_uint8.All_Maps_GRP.Maps_Raster_1 P_Do_X_SET.GRP_float32_float32_float32.All_Maps_GRP.Maps_Raster_1 P_Do_X_SET.GRP_sint16_sint16_sint16.All_Maps_GRP.Maps_Raster_1 P_Do_X_SET.GRP_sint32_sint32_sint32.All_Maps_GRP.Maps_Raster_1 P_Do_X_SET.GRP_sint8_sint8_sint8.All_Maps_GRP.Maps_Raster_1 P_Do_X_SET.GRP_uint16_uint16_uint16.All_Maps_GRP.Maps_Raster_1 P_Do_X_SET.GRP_uint32_uint32_uint32.All_Maps_GRP.Maps_Raster_1 P_Do_X_SET.GRP_uint8_uint8_uint8.All_Maps_GRP.Maps_Raster_1 P_Do_Y_SET.GRP_float32_float32_float32.All_Maps_GRP.Maps_Raster_1 P_Do_Y_SET.GRP_sint16_sint16_sint16.All_Maps_GRP.Maps_Raster_1 P_Do_Y_SET.GRP_sint32_sint32_sint32.All_Maps_GRP.Maps_Raster_1 P_Do_Y_SET.GRP_sint8_sint8_sint8.All_Maps_GRP.Maps_Raster_1 P_Do_Y_SET.GRP_uint16_uint16_uint16.All_Maps_GRP.Maps_Raster_1 P_Do_Y_SET.GRP_uint32_uint32_uint32.All_Maps_GRP.Maps_Raster_1 P_Do_Y_SET.GRP_uint8_uint8_uint8.All_Maps_GRP.Maps_Raster_1 P_In_X.GRP_float32_float32_float32.All_Maps_GRP.Maps_Raster_1 P_In_X.GRP_sint16_sint16_sint16.All_Maps_GRP.Maps_Raster_1 P_In_X.GRP_sint32_sint32_sint32.All_Maps_GRP.Maps_Raster_1 P_In_X.GRP_sint8_sint8_sint8.All_Maps_GRP.Maps_Raster_1 P_In_X.GRP_uint16_uint16_uint16.All_Maps_GRP.Maps_Raster_1 P_In_X.GRP_uint32_uint32_uint32.All_Maps_GRP.Maps_Raster_1 P_In_X.GRP_uint8_uint8_uint8.All_Maps_GRP.Maps_Raster_1 P_In_Y.GRP_float32_float32_float32.All_Maps_GRP.Maps_Raster_1 P_In_Y.GRP_sint16_sint16_sint16.All_Maps_GRP.Maps_Raster_1 P_In_Y.GRP_sint32_sint32_sint32.All_Maps_GRP.Maps_Raster_1 P_In_Y.GRP_sint8_sint8_sint8.All_Maps_GRP.Maps_Raster_1 P_In_Y.GRP_uint16_uint16_uint16.All_Maps_GRP.Maps_Raster_1 P_In_Y.GRP_uint32_uint32_uint32.All_Maps_GRP.Maps_Raster_1 P_In_Y.GRP_uint8_uint8_uint8.All_Maps_GRP.Maps_Raster_1 Two_D.GRP_float32_float32_float32.All_Maps_GRP.Maps_Raster_1 Two_D.GRP_sint16_sint16_sint16.All_Maps_GRP.Maps_Raster_1 Two_D.GRP_sint32_sint32_sint32.All_Maps_GRP.Maps_Raster_1 Two_D.GRP_sint8_sint8_sint8.All_Maps_GRP.Maps_Raster_1 Two_D.GRP_uint16_uint16_uint16.All_Maps_GRP.Maps_Raster_1 Two_D.GRP_uint32_uint32_uint32.All_Maps_GRP.Maps_Raster_1 Two_D.GRP_uint8_uint8_uint8.All_Maps_GRP.Maps_Raster_1 /end REF_CHARACTERISTIC
 /begin SUB_GROUP GRP_float32_float32_float32.All_Maps_GRP.Maps_Raster_1 GRP_sint16_sint16_sint16.All_Maps_GRP.Maps_Raster_1 GRP_sint32_sint32_sint32.All_Maps_GRP.Maps_Raster_1 GRP_sint8_sint8_sint8.All_Maps_GRP.Maps_Raster_1 GRP_uint16_uint16_uint16.All_Maps_GRP.Maps_Raster_1 GRP_uint32_uint32_uint32.All_Maps_GRP.Maps_Raster_1 GRP_uint8_uint8_uint8.All_Maps_GRP.Maps_Raster_1 /end SUB_GROUP
/end GROUP
/begin GROUP All_Maps_GRP.Maps_Raster_2 ""
 /begin REF_MEASUREMENT Calculated.GRP_float32_float32_float32.All_Maps_GRP.Maps_Raster_2 Calculated.GRP_sint16_sint16_sint16.All_Maps_GRP.Maps_Raster_2 Calculated.GRP_sint32_sint32_sint32.All_Maps_GRP.Maps_Raster_2 Calculated.GRP_sint8_sint8_sint8.All_Maps_GRP.Maps_Raster_2 Calculated.GRP_uint16_uint16_uint16.All_Maps_GRP.Maps_Raster_2 Calculated.GRP_uint32_uint32_uint32.All_Maps_GRP.Maps_Raster_2 Calculated.GRP_uint8_uint8_uint8.All_Maps_GRP.Maps_Raster_2 M_In_X.GRP_float32_float32_float32.All_Maps_GRP.Maps_Raster_2 M_In_X.GRP_sint16_sint16_sint16.All_Maps_GRP.Maps_Raster_2 M_In_X.GRP_sint32_sint32_sint32.All_Maps_GRP.Maps_Raster_2 M_In_X.GRP_sint8_sint8_sint8.All_Maps_GRP.Maps_Raster_2 M_In_X.GRP_uint16_uint16_uint16.All_Maps_GRP.Maps_Raster_2 M_In_X.GRP_uint32_uint32_uint32.All_Maps_GRP.Maps_Raster_2 M_In_X.GRP_uint8_uint8_uint8.All_Maps_GRP.Maps_Raster_2 M_In_Y.GRP_float32_float32_float32.All_Maps_GRP.Maps_Raster_2 M_In_Y.GRP_sint16_sint16_sint16.All_Maps_GRP.Maps_Raster_2 M_In_Y.GRP_sint32_sint32_sint32.All_Maps_GRP.Maps_Raster_2 M_In_Y.GRP_sint8_sint8_sint8.All_Maps_GRP.Maps_Raster_2 M_In_Y.GRP_uint16_uint16_uint16.All_Maps_GRP.Maps_Raster_2 M_In_Y.GRP_uint32_uint32_uint32.All_Maps_GRP.Maps_Raster_2 M_In_Y.GRP_uint8_uint8_uint8.All_Maps_GRP.Maps_Raster_2 M_out.GRP_float32_float32_float32.All_Maps_GRP.Maps_Raster_2 M_out.GRP_sint16_sint16_sint16.All_Maps_GRP.Maps_Raster_2 M_out.GRP_sint32_sint32_sint32.All_Maps_GRP.Maps_Raster_2 M_out.GRP_sint8_sint8_sint8.All_Maps_GRP.Maps_Raster_2 M_out.GRP_uint16_uint16_uint16.All_Maps_GRP.Maps_Raster_2 M_out.GRP_uint32_uint32_uint32.All_Maps_GRP.Maps_Raster_2 M_out.GRP_uint8_uint8_uint8.All_Maps_GRP.Maps_Raster_2 /end REF_MEASUREMENT
 /begin REF_CHARACTERISTIC P_Do_Active_Grp.GRP_float32_float32_float32.All_Maps_GRP.Maps_Raster_2 P_Do_Active_Grp.GRP_sint16_sint16_sint16.All_Maps_GRP.Maps_Raster_2 P_Do_Active_Grp.GRP_sint32_sint32_sint32.All_Maps_GRP.Maps_Raster_2 P_Do_Active_Grp.GRP_sint8_sint8_sint8.All_Maps_GRP.Maps_Raster_2 P_Do_Active_Grp.GRP_uint16_uint16_uint16.All_Maps_GRP.Maps_Raster_2 P_Do_Active_Grp.GRP_uint32_uint32_uint32.All_Maps_GRP.Maps_Raster_2 P_Do_Active_Grp.GRP_uint8_uint8_uint8.All_Maps_GRP.Maps_Raster_2 P_Do_All_GRP_Maps.All_Maps_GRP.Maps_Raster_2 P_Do_GET.GRP_float32_float32_float32.All_Maps_GRP.Maps_Raster_2 P_Do_GET.GRP_sint16_sint16_sint16.All_Maps_GRP.Maps_Raster_2 P_Do_GET.GRP_sint32_sint32_sint32.All_Maps_GRP.Maps_Raster_2 P_Do_GET.GRP_sint8_sint8_sint8.All_Maps_GRP.Maps_Raster_2 P_Do_GET.GRP_uint16_uint16_uint16.All_Maps_GRP.Maps_Raster_2 P_Do_GET.GRP_uint32_uint32_uint32.All_Maps_GRP.Maps_Raster_2 P_Do_GET.GRP_uint8_uint8_uint8.All_Maps_GRP.Maps_Raster_2 P_Do_X_SET.GRP_float32_float32_float32.All_Maps_GRP.Maps_Raster_2 P_Do_X_SET.GRP_sint16_sint16_sint16.All_Maps_GRP.Maps_Raster_2 P_Do_X_SET.GRP_sint32_sint32_sint32.All_Maps_GRP.Maps_Raster_2 P_Do_X_SET.GRP_sint8_sint8_sint8.All_Maps_GRP.Maps_Raster_2 P_Do_X_SET.GRP_uint16_uint16_uint16.All_Maps_GRP.Maps_Raster_2 P_Do_X_SET.GRP_uint32_uint32_uint32.All_Maps_GRP.Maps_Raster_2 P_Do_X_SET.GRP_uint8_uint8_uint8.All_Maps_GRP.Maps_Raster_2 P_Do_Y_SET.GRP_float32_float32_float32.All_Maps_GRP.Maps_Raster_2 P_Do_Y_SET.GRP_sint16_sint16_sint16.All_Maps_GRP.Maps_Raster_2 P_Do_Y_SET.GRP_sint32_sint32_sint32.All_Maps_GRP.Maps_Raster_2 P_Do_Y_SET.GRP_sint8_sint8_sint8.All_Maps_GRP.Maps_Raster_2 P_Do_Y_SET.GRP_uint16_uint16_uint16.All_Maps_GRP.Maps_Raster_2 P_Do_Y_SET.GRP_uint32_uint32_uint32.All_Maps_GRP.Maps_Raster_2 P_Do_Y_SET.GRP_uint8_uint8_uint8.All_Maps_GRP.Maps_Raster_2 P_In_X.GRP_float32_float32_float32.All_Maps_GRP.Maps_Raster_2 P_In_X.GRP_sint16_sint16_sint16.All_Maps_GRP.Maps_Raster_2 P_In_X.GRP_sint32_sint32_sint32.All_Maps_GRP.Maps_Raster_2 P_In_X.GRP_sint8_sint8_sint8.All_Maps_GRP.Maps_Raster_2 P_In_X.GRP_uint16_uint16_uint16.All_Maps_GRP.Maps_Raster_2 P_In_X.GRP_uint32_uint32_uint32.All_Maps_GRP.Maps_Raster_2 P_In_X.GRP_uint8_uint8_uint8.All_Maps_GRP.Maps_Raster_2 P_In_Y.GRP_float32_float32_float32.All_Maps_GRP.Maps_Raster_2 P_In_Y.GRP_sint16_sint16_sint16.All_Maps_GRP.Maps_Raster_2 P_In_Y.GRP_sint32_sint32_sint32.All_Maps_GRP.Maps_Raster_2 P_In_Y.GRP_sint8_sint8_sint8.All_Maps_GRP.Maps_Raster_2 P_In_Y.GRP_uint16_uint16_uint16.All_Maps_GRP.Maps_Raster_2 P_In_Y.GRP_uint32_uint32_uint32.All_Maps_GRP.Maps_Raster_2 P_In_Y.GRP_uint8_uint8_uint8.All_Maps_GRP.Maps_Raster_2 Two_D.GRP_float32_float32_float32.All_Maps_GRP.Maps_Raster_2 Two_D.GRP_sint16_sint16_sint16.All_Maps_GRP.Maps_Raster_2 Two_D.GRP_sint32_sint32_sint32.All_Maps_GRP.Maps_Raster_2 Two_D.GRP_sint8_sint8_sint8.All_Maps_GRP.Maps_Raster_2 Two_D.GRP_uint16_uint16_uint16.All_Maps_GRP.Maps_Raster_2 Two_D.GRP_uint32_uint32_uint32.All_Maps_GRP.Maps_Raster_2 Two_D.GRP_uint8_uint8_uint8.All_Maps_GRP.Maps_Raster_2 /end REF_CHARACTERISTIC
 /begin SUB_GROUP GRP_float32_float32_float32.All_Maps_GRP.Maps_Raster_2 GRP_sint16_sint16_sint16.All_Maps_GRP.Maps_Raster_2 GRP_sint32_sint32_sint32.All_Maps_GRP.Maps_Raster_2 GRP_sint8_sint8_sint8.All_Maps_GRP.Maps_Raster_2 GRP_uint16_uint16_uint16.All_Maps_GRP.Maps_Raster_2 GRP_uint32_uint32_uint32.All_Maps_GRP.Maps_Raster_2 GRP_uint8_uint8_uint8.All_Maps_GRP.Maps_Raster_2 /end SUB_GROUP
/end GROUP
/begin GROUP All_Maps_GRP.Maps_Raster_3 ""
 /begin REF_MEASUREMENT Calculated.GRP_float32_float32_float32.All_Maps_GRP.Maps_Raster_3 Calculated.GRP_sint16_sint16_sint16.All_Maps_GRP.Maps_Raster_3 Calculated.GRP_sint32_sint32_sint32.All_Maps_GRP.Maps_Raster_3 Calculated.GRP_sint8_sint8_sint8.All_Maps_GRP.Maps_Raster_3 Calculated.GRP_uint16_uint16_uint16.All_Maps_GRP.Maps_Raster_3 Calculated.GRP_uint32_uint32_uint32.All_Maps_GRP.Maps_Raster_3 Calculated.GRP_uint8_uint8_uint8.All_Maps_GRP.Maps_Raster_3 M_In_X.GRP_float32_float32_float32.All_Maps_GRP.Maps_Raster_3 M_In_X.GRP_sint16_sint16_sint16.All_Maps_GRP.Maps_Raster_3 M_In_X.GRP_sint32_sint32_sint32.All_Maps_GRP.Maps_Raster_3 M_In_X.GRP_sint8_sint8_sint8.All_Maps_GRP.Maps_Raster_3 M_In_X.GRP_uint16_uint16_uint16.All_Maps_GRP.Maps_Raster_3 M_In_X.GRP_uint32_uint32_uint32.All_Maps_GRP.Maps_Raster_3 M_In_X.GRP_uint8_uint8_uint8.All_Maps_GRP.Maps_Raster_3 M_In_Y.GRP_float32_float32_float32.All_Maps_GRP.Maps_Raster_3 M_In_Y.GRP_sint16_sint16_sint16.All_Maps_GRP.Maps_Raster_3 M_In_Y.GRP_sint32_sint32_sint32.All_Maps_GRP.Maps_Raster_3 M_In_Y.GRP_sint8_sint8_sint8.All_Maps_GRP.Maps_Raster_3 M_In_Y.GRP_uint16_uint16_uint16.All_Maps_GRP.Maps_Raster_3 M_In_Y.GRP_uint32_uint32_uint32.All_Maps_GRP.Maps_Raster_3 M_In_Y.GRP_uint8_uint8_uint8.All_Maps_GRP.Maps_Raster_3 M_out.GRP_float32_float32_float32.All_Maps_GRP.Maps_Raster_3 M_out.GRP_sint16_sint16_sint16.All_Maps_GRP.Maps_Raster_3 M_out.GRP_sint32_sint32_sint32.All_Maps_GRP.Maps_Raster_3 M_out.GRP_sint8_sint8_sint8.All_Maps_GRP.Maps_Raster_3 M_out.GRP_uint16_uint16_uint16.All_Maps_GRP.Maps_Raster_3 M_out.GRP_uint32_uint32_uint32.All_Maps_GRP.Maps_Raster_3 M_out.GRP_uint8_uint8_uint8.All_Maps_GRP.Maps_Raster_3 /end REF_MEASUREMENT
 /begin REF_CHARACTERISTIC P_Do_Active_Grp.GRP_float32_float32_float32.All_Maps_GRP.Maps_Raster_3 P_Do_Active_Grp.GRP_sint16_sint16_sint16.All_Maps_GRP.Maps_Raster_3 P_Do_Active_Grp.GRP_sint32_sint32_sint32.All_Maps_GRP.Maps_Raster_3 P_Do_Active_Grp.GRP_sint8_sint8_sint8.All_Maps_GRP.Maps_Raster_3 P_Do_Active_Grp.GRP_uint16_uint16_uint16.All_Maps_GRP.Maps_Raster_3 P_Do_Active_Grp.GRP_uint32_uint32_uint32.All_Maps_GRP.Maps_Raster_3 P_Do_Active_Grp.GRP_uint8_uint8_uint8.All_Maps_GRP.Maps_Raster_3 P_Do_All_GRP_Maps.All_Maps_GRP.Maps_Raster_3 P_Do_GET.GRP_float32_float32_float32.All_Maps_GRP.Maps_Raster_3 P_Do_GET.GRP_sint16_sint16_sint16.All_Maps_GRP.Maps_Raster_3 P_Do_GET.GRP_sint32_sint32_sint32.All_Maps_GRP.Maps_Raster_3 P_Do_GET.GRP_sint8_sint8_sint8.All_Maps_GRP.Maps_Raster_3 P_Do_GET.GRP_uint16_uint16_uint16.All_Maps_GRP.Maps_Raster_3 P_Do_GET.GRP_uint32_uint32_uint32.All_Maps_GRP.Maps_Raster_3 P_Do_GET.GRP_uint8_uint8_uint8.All_Maps_GRP.Maps_Raster_3 P_Do_X_SET.GRP_float32_float32_float32.All_Maps_GRP.Maps_Raster_3 P_Do_X_SET.GRP_sint16_sint16_sint16.All_Maps_GRP.Maps_Raster_3 P_Do_X_SET.GRP_sint32_sint32_sint32.All_Maps_GRP.Maps_Raster_3 P_Do_X_SET.GRP_sint8_sint8_sint8.All_Maps_GRP.Maps_Raster_3 P_Do_X_SET.GRP_uint16_uint16_uint16.All_Maps_GRP.Maps_Raster_3 P_Do_X_SET.GRP_uint32_uint32_uint32.All_Maps_GRP.Maps_Raster_3 P_Do_X_SET.GRP_uint8_uint8_uint8.All_Maps_GRP.Maps_Raster_3 P_Do_Y_SET.GRP_float32_float32_float32.All_Maps_GRP.Maps_Raster_3 P_Do_Y_SET.GRP_sint16_sint16_sint16.All_Maps_GRP.Maps_Raster_3 P_Do_Y_SET.GRP_sint32_sint32_sint32.All_Maps_GRP.Maps_Raster_3 P_Do_Y_SET.GRP_sint8_sint8_sint8.All_Maps_GRP.Maps_Raster_3 P_Do_Y_SET.GRP_uint16_uint16_uint16.All_Maps_GRP.Maps_Raster_3 P_Do_Y_SET.GRP_uint32_uint32_uint32.All_Maps_GRP.Maps_Raster_3 P_Do_Y_SET.GRP_uint8_uint8_uint8.All_Maps_GRP.Maps_Raster_3 P_In_X.GRP_float32_float32_float32.All_Maps_GRP.Maps_Raster_3 P_In_X.GRP_sint16_sint16_sint16.All_Maps_GRP.Maps_Raster_3 P_In_X.GRP_sint32_sint32_sint32.All_Maps_GRP.Maps_Raster_3 P_In_X.GRP_sint8_sint8_sint8.All_Maps_GRP.Maps_Raster_3 P_In_X.GRP_uint16_uint16_uint16.All_Maps_GRP.Maps_Raster_3 P_In_X.GRP_uint32_uint32_uint32.All_Maps_GRP.Maps_Raster_3 P_In_X.GRP_uint8_uint8_uint8.All_Maps_GRP.Maps_Raster_3 P_In_Y.GRP_float32_float32_float32.All_Maps_GRP.Maps_Raster_3 P_In_Y.GRP_sint16_sint16_sint16.All_Maps_GRP.Maps_Raster_3 P_In_Y.GRP_sint32_sint32_sint32.All_Maps_GRP.Maps_Raster_3 P_In_Y.GRP_sint8_sint8_sint8.All_Maps_GRP.Maps_Raster_3 P_In_Y.GRP_uint16_uint16_uint16.All_Maps_GRP.Maps_Raster_3 P_In_Y.GRP_uint32_uint32_uint32.All_Maps_GRP.Maps_Raster_3 P_In_Y.GRP_uint8_uint8_uint8.All_Maps_GRP.Maps_Raster_3 Two_D.GRP_float32_float32_float32.All_Maps_GRP.Maps_Raster_3 Two_D.GRP_sint16_sint16_sint16.All_Maps_GRP.Maps_Raster_3 Two_D.GRP_sint32_sint32_sint32.All_Maps_GRP.Maps_Raster_3 Two_D.GRP_sint8_sint8_sint8.All_Maps_GRP.Maps_Raster_3 Two_D.GRP_uint16_uint16_uint16.All_Maps_GRP.Maps_Raster_3 Two_D.GRP_uint32_uint32_uint32.All_Maps_GRP.Maps_Raster_3 Two_D.GRP_uint8_uint8_uint8.All_Maps_GRP.Maps_Raster_3 /end REF_CHARACTERISTIC
 /begin SUB_GROUP GRP_float32_float32_float32.All_Maps_GRP.Maps_Raster_3 GRP_sint16_sint16_sint16.All_Maps_GRP.Maps_Raster_3 GRP_sint32_sint32_sint32.All_Maps_GRP.Maps_Raster_3 GRP_sint8_sint8_sint8.All_Maps_GRP.Maps_Raster_3 GRP_uint16_uint16_uint16.All_Maps_GRP.Maps_Raster_3 GRP_uint32_uint32_uint32.All_Maps_GRP.Maps_Raster_3 GRP_uint8_uint8_uint8.All_Maps_GRP.Maps_Raster_3 /end SUB_GROUP
/end GROUP
/begin GROUP FIX_float32_float32_float32.All_Maps_FIX.Maps_Raster_1 ""
 /begin REF_MEASUREMENT Calculated.FIX_float32_float32_float32.All_Maps_FIX.Maps_Raster_1 M_In_X.FIX_float32_float32_float32.All_Maps_FIX.Maps_Raster_1 M_In_Y.FIX_float32_float32_float32.All_Maps_FIX.Maps_Raster_1 M_out.FIX_float32_float32_float32.All_Maps_FIX.Maps_Raster_1 /end REF_MEASUREMENT
 /begin REF_CHARACTERISTIC P_Do_Active_Std.FIX_float32_float32_float32.All_Maps_FIX.Maps_Raster_1 P_In_X.FIX_float32_float32_float32.All_Maps_FIX.Maps_Raster_1 P_In_Y.FIX_float32_float32_float32.All_Maps_FIX.Maps_Raster_1 Two_D.FIX_float32_float32_float32.All_Maps_FIX.Maps_Raster_1 /end REF_CHARACTERISTIC
/end GROUP
/begin GROUP FIX_float32_float32_float32.All_Maps_FIX.Maps_Raster_2 ""
 /begin REF_MEASUREMENT Calculated.FIX_float32_float32_float32.All_Maps_FIX.Maps_Raster_2 M_In_X.FIX_float32_float32_float32.All_Maps_FIX.Maps_Raster_2 M_In_Y.FIX_float32_float32_float32.All_Maps_FIX.Maps_Raster_2 M_out.FIX_float32_float32_float32.All_Maps_FIX.Maps_Raster_2 /end REF_MEASUREMENT
 /begin REF_CHARACTERISTIC P_Do_Active_Std.FIX_float32_float32_float32.All_Maps_FIX.Maps_Raster_2 P_In_X.FIX_float32_float32_float32.All_Maps_FIX.Maps_Raster_2 P_In_Y.FIX_float32_float32_float32.All_Maps_FIX.Maps_Raster_2 Two_D.FIX_float32_float32_float32.All_Maps_FIX.Maps_Raster_2 /end REF_CHARACTERISTIC
/end GROUP
/begin GROUP FIX_float32_float32_float32.All_Maps_FIX.Maps_Raster_3 ""
 /begin REF_MEASUREMENT Calculated.FIX_float32_float32_float32.All_Maps_FIX.Maps_Raster_3 M_In_X.FIX_float32_float32_float32.All_Maps_FIX.Maps_Raster_3 M_In_Y.FIX_float32_float32_float32.All_Maps_FIX.Maps_Raster_3 M_out.FIX_float32_float32_float32.All_Maps_FIX.Maps_Raster_3 /end REF_MEASUREMENT
 /begin REF_CHARACTERISTIC P_Do_Active_Std.FIX_float32_float32_float32.All_Maps_FIX.Maps_Raster_3 P_In_X.FIX_float32_float32_float32.All_Maps_FIX.Maps_Raster_3 P_In_Y.FIX_float32_float32_float32.All_Maps_FIX.Maps_Raster_3 Two_D.FIX_float32_float32_float32.All_Maps_FIX.Maps_Raster_3 /end REF_CHARACTERISTIC
/end GROUP
/begin GROUP FIX_sint16_sint16_sint16.All_Maps_FIX.Maps_Raster_1 ""
 /begin REF_MEASUREMENT Calculated.FIX_sint16_sint16_sint16.All_Maps_FIX.Maps_Raster_1 M_In_X.FIX_sint16_sint16_sint16.All_Maps_FIX.Maps_Raster_1 M_In_Y.FIX_sint16_sint16_sint16.All_Maps_FIX.Maps_Raster_1 M_out.FIX_sint16_sint16_sint16.All_Maps_FIX.Maps_Raster_1 /end REF_MEASUREMENT
 /begin REF_CHARACTERISTIC P_Do_Active_Std.FIX_sint16_sint16_sint16.All_Maps_FIX.Maps_Raster_1 P_In_X.FIX_sint16_sint16_sint16.All_Maps_FIX.Maps_Raster_1 P_In_Y.FIX_sint16_sint16_sint16.All_Maps_FIX.Maps_Raster_1 Two_D.FIX_sint16_sint16_sint16.All_Maps_FIX.Maps_Raster_1 /end REF_CHARACTERISTIC
/end GROUP
/begin GROUP FIX_sint16_sint16_sint16.All_Maps_FIX.Maps_Raster_2 ""
 /begin REF_MEASUREMENT Calculated.FIX_sint16_sint16_sint16.All_Maps_FIX.Maps_Raster_2 M_In_X.FIX_sint16_sint16_sint16.All_Maps_FIX.Maps_Raster_2 M_In_Y.FIX_sint16_sint16_sint16.All_Maps_FIX.Maps_Raster_2 M_out.FIX_sint16_sint16_sint16.All_Maps_FIX.Maps_Raster_2 /end REF_MEASUREMENT
 /begin REF_CHARACTERISTIC P_Do_Active_Std.FIX_sint16_sint16_sint16.All_Maps_FIX.Maps_Raster_2 P_In_X.FIX_sint16_sint16_sint16.All_Maps_FIX.Maps_Raster_2 P_In_Y.FIX_sint16_sint16_sint16.All_Maps_FIX.Maps_Raster_2 Two_D.FIX_sint16_sint16_sint16.All_Maps_FIX.Maps_Raster_2 /end REF_CHARACTERISTIC
/end GROUP
/begin GROUP FIX_sint16_sint16_sint16.All_Maps_FIX.Maps_Raster_3 ""
 /begin REF_MEASUREMENT Calculated.FIX_sint16_sint16_sint16.All_Maps_FIX.Maps_Raster_3 M_In_X.FIX_sint16_sint16_sint16.All_Maps_FIX.Maps_Raster_3 M_In_Y.FIX_sint16_sint16_sint16.All_Maps_FIX.Maps_Raster_3 M_out.FIX_sint16_sint16_sint16.All_Maps_FIX.Maps_Raster_3 /end REF_MEASUREMENT
 /begin REF_CHARACTERISTIC P_Do_Active_Std.FIX_sint16_sint16_sint16.All_Maps_FIX.Maps_Raster_3 P_In_X.FIX_sint16_sint16_sint16.All_Maps_FIX.Maps_Raster_3 P_In_Y.FIX_sint16_sint16_sint16.All_Maps_FIX.Maps_Raster_3 Two_D.FIX_sint16_sint16_sint16.All_Maps_FIX.Maps_Raster_3 /end REF_CHARACTERISTIC
/end GROUP
/begin GROUP FIX_sint32_sint32_sint32.All_Maps_FIX.Maps_Raster_1 ""
 /begin REF_MEASUREMENT Calculated.FIX_sint32_sint32_sint32.All_Maps_FIX.Maps_Raster_1 M_In_X.FIX_sint32_sint32_sint32.All_Maps_FIX.Maps_Raster_1 M_In_Y.FIX_sint32_sint32_sint32.All_Maps_FIX.Maps_Raster_1 M_out.FIX_sint32_sint32_sint32.All_Maps_FIX.Maps_Raster_1 /end REF_MEASUREMENT
 /begin REF_CHARACTERISTIC P_Do_Active_Std.FIX_sint32_sint32_sint32.All_Maps_FIX.Maps_Raster_1 P_In_X.FIX_sint32_sint32_sint32.All_Maps_FIX.Maps_Raster_1 P_In_Y.FIX_sint32_sint32_sint32.All_Maps_FIX.Maps_Raster_1 Two_D.FIX_sint32_sint32_sint32.All_Maps_FIX.Maps_Raster_1 /end REF_CHARACTERISTIC
/end GROUP
/begin GROUP FIX_sint32_sint32_sint32.All_Maps_FIX.Maps_Raster_2 ""
 /begin REF_MEASUREMENT Calculated.FIX_sint32_sint32_sint32.All_Maps_FIX.Maps_Raster_2 M_In_X.FIX_sint32_sint32_sint32.All_Maps_FIX.Maps_Raster_2 M_In_Y.FIX_sint32_sint32_sint32.All_Maps_FIX.Maps_Raster_2 M_out.FIX_sint32_sint32_sint32.All_Maps_FIX.Maps_Raster_2 /end REF_MEASUREMENT
 /begin REF_CHARACTERISTIC P_Do_Active_Std.FIX_sint32_sint32_sint32.All_Maps_FIX.Maps_Raster_2 P_In_X.FIX_sint32_sint32_sint32.All_Maps_FIX.Maps_Raster_2 P_In_Y.FIX_sint32_sint32_sint32.All_Maps_FIX.Maps_Raster_2 Two_D.FIX_sint32_sint32_sint32.All_Maps_FIX.Maps_Raster_2 /end REF_CHARACTERISTIC
/end GROUP
/begin GROUP FIX_sint32_sint32_sint32.All_Maps_FIX.Maps_Raster_3 ""
 /begin REF_MEASUREMENT Calculated.FIX_sint32_sint32_sint32.All_Maps_FIX.Maps_Raster_3 M_In_X.FIX_sint32_sint32_sint32.All_Maps_FIX.Maps_Raster_3 M_In_Y.FIX_sint32_sint32_sint32.All_Maps_FIX.Maps_Raster_3 M_out.FIX_sint32_sint32_sint32.All_Maps_FIX.Maps_Raster_3 /end REF_MEASUREMENT
 /begin REF_CHARACTERISTIC P_Do_Active_Std.FIX_sint32_sint32_sint32.All_Maps_FIX.Maps_Raster_3 P_In_X.FIX_sint32_sint32_sint32.All_Maps_FIX.Maps_Raster_3 P_In_Y.FIX_sint32_sint32_sint32.All_Maps_FIX.Maps_Raster_3 Two_D.FIX_sint32_sint32_sint32.All_Maps_FIX.Maps_Raster_3 /end REF_CHARACTERISTIC
/end GROUP
/begin GROUP FIX_sint8_sint8_sint8.All_Maps_FIX.Maps_Raster_1 ""
 /begin REF_MEASUREMENT Calculated.FIX_sint8_sint8_sint8.All_Maps_FIX.Maps_Raster_1 M_In_X.FIX_sint8_sint8_sint8.All_Maps_FIX.Maps_Raster_1 M_In_Y.FIX_sint8_sint8_sint8.All_Maps_FIX.Maps_Raster_1 M_out.FIX_sint8_sint8_sint8.All_Maps_FIX.Maps_Raster_1 /end REF_MEASUREMENT
 /begin REF_CHARACTERISTIC P_Do_Active_Std.FIX_sint8_sint8_sint8.All_Maps_FIX.Maps_Raster_1 P_In_X.FIX_sint8_sint8_sint8.All_Maps_FIX.Maps_Raster_1 P_In_Y.FIX_sint8_sint8_sint8.All_Maps_FIX.Maps_Raster_1 Two_D.FIX_sint8_sint8_sint8.All_Maps_FIX.Maps_Raster_1 /end REF_CHARACTERISTIC
/end GROUP
/begin GROUP FIX_sint8_sint8_sint8.All_Maps_FIX.Maps_Raster_2 ""
 /begin REF_MEASUREMENT Calculated.FIX_sint8_sint8_sint8.All_Maps_FIX.Maps_Raster_2 M_In_X.FIX_sint8_sint8_sint8.All_Maps_FIX.Maps_Raster_2 M_In_Y.FIX_sint8_sint8_sint8.All_Maps_FIX.Maps_Raster_2 M_out.FIX_sint8_sint8_sint8.All_Maps_FIX.Maps_Raster_2 /end REF_MEASUREMENT
 /begin REF_CHARACTERISTIC P_Do_Active_Std.FIX_sint8_sint8_sint8.All_Maps_FIX.Maps_Raster_2 P_In_X.FIX_sint8_sint8_sint8.All_Maps_FIX.Maps_Raster_2 P_In_Y.FIX_sint8_sint8_sint8.All_Maps_FIX.Maps_Raster_2 Two_D.FIX_sint8_sint8_sint8.All_Maps_FIX.Maps_Raster_2 /end REF_CHARACTERISTIC
/end GROUP
/begin GROUP FIX_sint8_sint8_sint8.All_Maps_FIX.Maps_Raster_3 ""
 /begin REF_MEASUREMENT Calculated.FIX_sint8_sint8_sint8.All_Maps_FIX.Maps_Raster_3 M_In_X.FIX_sint8_sint8_sint8.All_Maps_FIX.Maps_Raster_3 M_In_Y.FIX_sint8_sint8_sint8.All_Maps_FIX.Maps_Raster_3 M_out.FIX_sint8_sint8_sint8.All_Maps_FIX.Maps_Raster_3 /end REF_MEASUREMENT
 /begin REF_CHARACTERISTIC P_Do_Active_Std.FIX_sint8_sint8_sint8.All_Maps_FIX.Maps_Raster_3 P_In_X.FIX_sint8_sint8_sint8.All_Maps_FIX.Maps_Raster_3 P_In_Y.FIX_sint8_sint8_sint8.All_Maps_FIX.Maps_Raster_3 Two_D.FIX_sint8_sint8_sint8.All_Maps_FIX.Maps_Raster_3 /end REF_CHARACTERISTIC
/end GROUP
/begin GROUP FIX_uint16_uint16_uint16.All_Maps_FIX.Maps_Raster_1 ""
 /begin REF_MEASUREMENT Calculated.FIX_uint16_uint16_uint16.All_Maps_FIX.Maps_Raster_1 M_In_X.FIX_uint16_uint16_uint16.All_Maps_FIX.Maps_Raster_1 M_In_Y.FIX_uint16_uint16_uint16.All_Maps_FIX.Maps_Raster_1 M_out.FIX_uint16_uint16_uint16.All_Maps_FIX.Maps_Raster_1 /end REF_MEASUREMENT
 /begin REF_CHARACTERISTIC P_Do_Active_Std.FIX_uint16_uint16_uint16.All_Maps_FIX.Maps_Raster_1 P_In_X.FIX_uint16_uint16_uint16.All_Maps_FIX.Maps_Raster_1 P_In_Y.FIX_uint16_uint16_uint16.All_Maps_FIX.Maps_Raster_1 Two_D.FIX_uint16_uint16_uint16.All_Maps_FIX.Maps_Raster_1 /end REF_CHARACTERISTIC
/end GROUP
/begin GROUP FIX_uint16_uint16_uint16.All_Maps_FIX.Maps_Raster_2 ""
 /begin REF_MEASUREMENT Calculated.FIX_uint16_uint16_uint16.All_Maps_FIX.Maps_Raster_2 M_In_X.FIX_uint16_uint16_uint16.All_Maps_FIX.Maps_Raster_2 M_In_Y.FIX_uint16_uint16_uint16.All_Maps_FIX.Maps_Raster_2 M_out.FIX_uint16_uint16_uint16.All_Maps_FIX.Maps_Raster_2 /end REF_MEASUREMENT
 /begin REF_CHARACTERISTIC P_Do_Active_Std.FIX_uint16_uint16_uint16.All_Maps_FIX.Maps_Raster_2 P_In_X.FIX_uint16_uint16_uint16.All_Maps_FIX.Maps_Raster_2 P_In_Y.FIX_uint16_uint16_uint16.All_Maps_FIX.Maps_Raster_2 Two_D.FIX_uint16_uint16_uint16.All_Maps_FIX.Maps_Raster_2 /end REF_CHARACTERISTIC
/end GROUP
/begin GROUP FIX_uint16_uint16_uint16.All_Maps_FIX.Maps_Raster_3 ""
 /begin REF_MEASUREMENT Calculated.FIX_uint16_uint16_uint16.All_Maps_FIX.Maps_Raster_3 M_In_X.FIX_uint16_uint16_uint16.All_Maps_FIX.Maps_Raster_3 M_In_Y.FIX_uint16_uint16_uint16.All_Maps_FIX.Maps_Raster_3 M_out.FIX_uint16_uint16_uint16.All_Maps_FIX.Maps_Raster_3 /end REF_MEASUREMENT
 /begin REF_CHARACTERISTIC P_Do_Active_Std.FIX_uint16_uint16_uint16.All_Maps_FIX.Maps_Raster_3 P_In_X.FIX_uint16_uint16_uint16.All_Maps_FIX.Maps_Raster_3 P_In_Y.FIX_uint16_uint16_uint16.All_Maps_FIX.Maps_Raster_3 Two_D.FIX_uint16_uint16_uint16.All_Maps_FIX.Maps_Raster_3 /end REF_CHARACTERISTIC
/end GROUP
/begin GROUP FIX_uint32_uint32_uint32.All_Maps_FIX.Maps_Raster_1 ""
 /begin REF_MEASUREMENT Calculated.FIX_uint32_uint32_uint32.All_Maps_FIX.Maps_Raster_1 M_In_X.FIX_uint32_uint32_uint32.All_Maps_FIX.Maps_Raster_1 M_In_Y.FIX_uint32_uint32_uint32.All_Maps_FIX.Maps_Raster_1 M_out.FIX_uint32_uint32_uint32.All_Maps_FIX.Maps_Raster_1 /end REF_MEASUREMENT
 /begin REF_CHARACTERISTIC P_Do_Active_Std.FIX_uint32_uint32_uint32.All_Maps_FIX.Maps_Raster_1 P_In_X.FIX_uint32_uint32_uint32.All_Maps_FIX.Maps_Raster_1 P_In_Y.FIX_uint32_uint32_uint32.All_Maps_FIX.Maps_Raster_1 Two_D.FIX_uint32_uint32_uint32.All_Maps_FIX.Maps_Raster_1 /end REF_CHARACTERISTIC
/end GROUP
/begin GROUP FIX_uint32_uint32_uint32.All_Maps_FIX.Maps_Raster_2 ""
 /begin REF_MEASUREMENT Calculated.FIX_uint32_uint32_uint32.All_Maps_FIX.Maps_Raster_2 M_In_X.FIX_uint32_uint32_uint32.All_Maps_FIX.Maps_Raster_2 M_In_Y.FIX_uint32_uint32_uint32.All_Maps_FIX.Maps_Raster_2 M_out.FIX_uint32_uint32_uint32.All_Maps_FIX.Maps_Raster_2 /end REF_MEASUREMENT
 /begin REF_CHARACTERISTIC P_Do_Active_Std.FIX_uint32_uint32_uint32.All_Maps_FIX.Maps_Raster_2 P_In_X.FIX_uint32_uint32_uint32.All_Maps_FIX.Maps_Raster_2 P_In_Y.FIX_uint32_uint32_uint32.All_Maps_FIX.Maps_Raster_2 Two_D.FIX_uint32_uint32_uint32.All_Maps_FIX.Maps_Raster_2 /end REF_CHARACTERISTIC
/end GROUP
/begin GROUP FIX_uint32_uint32_uint32.All_Maps_FIX.Maps_Raster_3 ""
 /begin REF_MEASUREMENT Calculated.FIX_uint32_uint32_uint32.All_Maps_FIX.Maps_Raster_3 M_In_X.FIX_uint32_uint32_uint32.All_Maps_FIX.Maps_Raster_3 M_In_Y.FIX_uint32_uint32_uint32.All_Maps_FIX.Maps_Raster_3 M_out.FIX_uint32_uint32_uint32.All_Maps_FIX.Maps_Raster_3 /end REF_MEASUREMENT
 /begin REF_CHARACTERISTIC P_Do_Active_Std.FIX_uint32_uint32_uint32.All_Maps_FIX.Maps_Raster_3 P_In_X.FIX_uint32_uint32_uint32.All_Maps_FIX.Maps_Raster_3 P_In_Y.FIX_uint32_uint32_uint32.All_Maps_FIX.Maps_Raster_3 Two_D.FIX_uint32_uint32_uint32.All_Maps_FIX.Maps_Raster_3 /end REF_CHARACTERISTIC
/end GROUP
/begin GROUP FIX_uint8_uint8_uint8.All_Maps_FIX.Maps_Raster_1 ""
 /begin REF_MEASUREMENT Calculated.FIX_uint8_uint8_uint8.All_Maps_FIX.Maps_Raster_1 M_In_X.FIX_uint8_uint8_uint8.All_Maps_FIX.Maps_Raster_1 M_In_Y.FIX_uint8_uint8_uint8.All_Maps_FIX.Maps_Raster_1 M_out.FIX_uint8_uint8_uint8.All_Maps_FIX.Maps_Raster_1 /end REF_MEASUREMENT
 /begin REF_CHARACTERISTIC P_Do_Active_Std.FIX_uint8_uint8_uint8.All_Maps_FIX.Maps_Raster_1 P_In_X.FIX_uint8_uint8_uint8.All_Maps_FIX.Maps_Raster_1 P_In_Y.FIX_uint8_uint8_uint8.All_Maps_FIX.Maps_Raster_1 Two_D.FIX_uint8_uint8_uint8.All_Maps_FIX.Maps_Raster_1 /end REF_CHARACTERISTIC
/end GROUP
/begin GROUP FIX_uint8_uint8_uint8.All_Maps_FIX.Maps_Raster_2 ""
 /begin REF_MEASUREMENT Calculated.FIX_uint8_uint8_uint8.All_Maps_FIX.Maps_Raster_2 M_In_X.FIX_uint8_uint8_uint8.All_Maps_FIX.Maps_Raster_2 M_In_Y.FIX_uint8_uint8_uint8.All_Maps_FIX.Maps_Raster_2 M_out.FIX_uint8_uint8_uint8.All_Maps_FIX.Maps_Raster_2 /end REF_MEASUREMENT
 /begin REF_CHARACTERISTIC P_Do_Active_Std.FIX_uint8_uint8_uint8.All_Maps_FIX.Maps_Raster_2 P_In_X.FIX_uint8_uint8_uint8.All_Maps_FIX.Maps_Raster_2 P_In_Y.FIX_uint8_uint8_uint8.All_Maps_FIX.Maps_Raster_2 Two_D.FIX_uint8_uint8_uint8.All_Maps_FIX.Maps_Raster_2 /end REF_CHARACTERISTIC
/end GROUP
/begin GROUP FIX_uint8_uint8_uint8.All_Maps_FIX.Maps_Raster_3 ""
 /begin REF_MEASUREMENT Calculated.FIX_uint8_uint8_uint8.All_Maps_FIX.Maps_Raster_3 M_In_X.FIX_uint8_uint8_uint8.All_Maps_FIX.Maps_Raster_3 M_In_Y.FIX_uint8_uint8_uint8.All_Maps_FIX.Maps_Raster_3 M_out.FIX_uint8_uint8_uint8.All_Maps_FIX.Maps_Raster_3 /end REF_MEASUREMENT
 /begin REF_CHARACTERISTIC P_Do_Active_Std.FIX_uint8_uint8_uint8.All_Maps_FIX.Maps_Raster_3 P_In_X.FIX_uint8_uint8_uint8.All_Maps_FIX.Maps_Raster_3 P_In_Y.FIX_uint8_uint8_uint8.All_Maps_FIX.Maps_Raster_3 Two_D.FIX_uint8_uint8_uint8.All_Maps_FIX.Maps_Raster_3 /end REF_CHARACTERISTIC
/end GROUP
/begin GROUP GRP_float32_float32_float32.All_Maps_GRP.Maps_Raster_1 ""
 /begin REF_MEASUREMENT Calculated.GRP_float32_float32_float32.All_Maps_GRP.Maps_Raster_1 M_In_X.GRP_float32_float32_float32.All_Maps_GRP.Maps_Raster_1 M_In_Y.GRP_float32_float32_float32.All_Maps_GRP.Maps_Raster_1 M_out.GRP_float32_float32_float32.All_Maps_GRP.Maps_Raster_1 /end REF_MEASUREMENT
 /begin REF_CHARACTERISTIC P_Do_Active_Grp.GRP_float32_float32_float32.All_Maps_GRP.Maps_Raster_1 P_Do_GET.GRP_float32_float32_float32.All_Maps_GRP.Maps_Raster_1 P_Do_X_SET.GRP_float32_float32_float32.All_Maps_GRP.Maps_Raster_1 P_Do_Y_SET.GRP_float32_float32_float32.All_Maps_GRP.Maps_Raster_1 P_In_X.GRP_float32_float32_float32.All_Maps_GRP.Maps_Raster_1 P_In_Y.GRP_float32_float32_float32.All_Maps_GRP.Maps_Raster_1 Two_D.GRP_float32_float32_float32.All_Maps_GRP.Maps_Raster_1 /end REF_CHARACTERISTIC
/end GROUP
/begin GROUP GRP_float32_float32_float32.All_Maps_GRP.Maps_Raster_2 ""
 /begin REF_MEASUREMENT Calculated.GRP_float32_float32_float32.All_Maps_GRP.Maps_Raster_2 M_In_X.GRP_float32_float32_float32.All_Maps_GRP.Maps_Raster_2 M_In_Y.GRP_float32_float32_float32.All_Maps_GRP.Maps_Raster_2 M_out.GRP_float32_float32_float32.All_Maps_GRP.Maps_Raster_2 /end REF_MEASUREMENT
 /begin REF_CHARACTERISTIC P_Do_Active_Grp.GRP_float32_float32_float32.All_Maps_GRP.Maps_Raster_2 P_Do_GET.GRP_float32_float32_float32.All_Maps_GRP.Maps_Raster_2 P_Do_X_SET.GRP_float32_float32_float32.All_Maps_GRP.Maps_Raster_2 P_Do_Y_SET.GRP_float32_float32_float32.All_Maps_GRP.Maps_Raster_2 P_In_X.GRP_float32_float32_float32.All_Maps_GRP.Maps_Raster_2 P_In_Y.GRP_float32_float32_float32.All_Maps_GRP.Maps_Raster_2 Two_D.GRP_float32_float32_float32.All_Maps_GRP.Maps_Raster_2 /end REF_CHARACTERISTIC
/end GROUP
/begin GROUP GRP_float32_float32_float32.All_Maps_GRP.Maps_Raster_3 ""
 /begin REF_MEASUREMENT Calculated.GRP_float32_float32_float32.All_Maps_GRP.Maps_Raster_3 M_In_X.GRP_float32_float32_float32.All_Maps_GRP.Maps_Raster_3 M_In_Y.GRP_float32_float32_float32.All_Maps_GRP.Maps_Raster_3 M_out.GRP_float32_float32_float32.All_Maps_GRP.Maps_Raster_3 /end REF_MEASUREMENT
 /begin REF_CHARACTERISTIC P_Do_Active_Grp.GRP_float32_float32_float32.All_Maps_GRP.Maps_Raster_3 P_Do_GET.GRP_float32_float32_float32.All_Maps_GRP.Maps_Raster_3 P_Do_X_SET.GRP_float32_float32_float32.All_Maps_GRP.Maps_Raster_3 P_Do_Y_SET.GRP_float32_float32_float32.All_Maps_GRP.Maps_Raster_3 P_In_X.GRP_float32_float32_float32.All_Maps_GRP.Maps_Raster_3 P_In_Y.GRP_float32_float32_float32.All_Maps_GRP.Maps_Raster_3 Two_D.GRP_float32_float32_float32.All_Maps_GRP.Maps_Raster_3 /end REF_CHARACTERISTIC
/end GROUP
/begin GROUP GRP_sint16_sint16_sint16.All_Maps_GRP.Maps_Raster_1 ""
 /begin REF_MEASUREMENT Calculated.GRP_sint16_sint16_sint16.All_Maps_GRP.Maps_Raster_1 M_In_X.GRP_sint16_sint16_sint16.All_Maps_GRP.Maps_Raster_1 M_In_Y.GRP_sint16_sint16_sint16.All_Maps_GRP.Maps_Raster_1 M_out.GRP_sint16_sint16_sint16.All_Maps_GRP.Maps_Raster_1 /end REF_MEASUREMENT
 /begin REF_CHARACTERISTIC P_Do_Active_Grp.GRP_sint16_sint16_sint16.All_Maps_GRP.Maps_Raster_1 P_Do_GET.GRP_sint16_sint16_sint16.All_Maps_GRP.Maps_Raster_1 P_Do_X_SET.GRP_sint16_sint16_sint16.All_Maps_GRP.Maps_Raster_1 P_Do_Y_SET.GRP_sint16_sint16_sint16.All_Maps_GRP.Maps_Raster_1 P_In_X.GRP_sint16_sint16_sint16.All_Maps_GRP.Maps_Raster_1 P_In_Y.GRP_sint16_sint16_sint16.All_Maps_GRP.Maps_Raster_1 Two_D.GRP_sint16_sint16_sint16.All_Maps_GRP.Maps_Raster_1 /end REF_CHARACTERISTIC
/end GROUP
/begin GROUP GRP_sint16_sint16_sint16.All_Maps_GRP.Maps_Raster_2 ""
 /begin REF_MEASUREMENT Calculated.GRP_sint16_sint16_sint16.All_Maps_GRP.Maps_Raster_2 M_In_X.GRP_sint16_sint16_sint16.All_Maps_GRP.Maps_Raster_2 M_In_Y.GRP_sint16_sint16_sint16.All_Maps_GRP.Maps_Raster_2 M_out.GRP_sint16_sint16_sint16.All_Maps_GRP.Maps_Raster_2 /end REF_MEASUREMENT
 /begin REF_CHARACTERISTIC P_Do_Active_Grp.GRP_sint16_sint16_sint16.All_Maps_GRP.Maps_Raster_2 P_Do_GET.GRP_sint16_sint16_sint16.All_Maps_GRP.Maps_Raster_2 P_Do_X_SET.GRP_sint16_sint16_sint16.All_Maps_GRP.Maps_Raster_2 P_Do_Y_SET.GRP_sint16_sint16_sint16.All_Maps_GRP.Maps_Raster_2 P_In_X.GRP_sint16_sint16_sint16.All_Maps_GRP.Maps_Raster_2 P_In_Y.GRP_sint16_sint16_sint16.All_Maps_GRP.Maps_Raster_2 Two_D.GRP_sint16_sint16_sint16.All_Maps_GRP.Maps_Raster_2 /end REF_CHARACTERISTIC
/end GROUP
/begin GROUP GRP_sint16_sint16_sint16.All_Maps_GRP.Maps_Raster_3 ""
 /begin REF_MEASUREMENT Calculated.GRP_sint16_sint16_sint16.All_Maps_GRP.Maps_Raster_3 M_In_X.GRP_sint16_sint16_sint16.All_Maps_GRP.Maps_Raster_3 M_In_Y.GRP_sint16_sint16_sint16.All_Maps_GRP.Maps_Raster_3 M_out.GRP_sint16_sint16_sint16.All_Maps_GRP.Maps_Raster_3 /end REF_MEASUREMENT
 /begin REF_CHARACTERISTIC P_Do_Active_Grp.GRP_sint16_sint16_sint16.All_Maps_GRP.Maps_Raster_3 P_Do_GET.GRP_sint16_sint16_sint16.All_Maps_GRP.Maps_Raster_3 P_Do_X_SET.GRP_sint16_sint16_sint16.All_Maps_GRP.Maps_Raster_3 P_Do_Y_SET.GRP_sint16_sint16_sint16.All_Maps_GRP.Maps_Raster_3 P_In_X.GRP_sint16_sint16_sint16.All_Maps_GRP.Maps_Raster_3 P_In_Y.GRP_sint16_sint16_sint16.All_Maps_GRP.Maps_Raster_3 Two_D.GRP_sint16_sint16_sint16.All_Maps_GRP.Maps_Raster_3 /end REF_CHARACTERISTIC
/end GROUP
/begin GROUP GRP_sint32_sint32_sint32.All_Maps_GRP.Maps_Raster_1 ""
 /begin REF_MEASUREMENT Calculated.GRP_sint32_sint32_sint32.All_Maps_GRP.Maps_Raster_1 M_In_X.GRP_sint32_sint32_sint32.All_Maps_GRP.Maps_Raster_1 M_In_Y.GRP_sint32_sint32_sint32.All_Maps_GRP.Maps_Raster_1 M_out.GRP_sint32_sint32_sint32.All_Maps_GRP.Maps_Raster_1 /end REF_MEASUREMENT
 /begin REF_CHARACTERISTIC P_Do_Active_Grp.GRP_sint32_sint32_sint32.All_Maps_GRP.Maps_Raster_1 P_Do_GET.GRP_sint32_sint32_sint32.All_Maps_GRP.Maps_Raster_1 P_Do_X_SET.GRP_sint32_sint32_sint32.All_Maps_GRP.Maps_Raster_1 P_Do_Y_SET.GRP_sint32_sint32_sint32.All_Maps_GRP.Maps_Raster_1 P_In_X.GRP_sint32_sint32_sint32.All_Maps_GRP.Maps_Raster_1 P_In_Y.GRP_sint32_sint32_sint32.All_Maps_GRP.Maps_Raster_1 Two_D.GRP_sint32_sint32_sint32.All_Maps_GRP.Maps_Raster_1 /end REF_CHARACTERISTIC
/end GROUP
/begin GROUP GRP_sint32_sint32_sint32.All_Maps_GRP.Maps_Raster_2 ""
 /begin REF_MEASUREMENT Calculated.GRP_sint32_sint32_sint32.All_Maps_GRP.Maps_Raster_2 M_In_X.GRP_sint32_sint32_sint32.All_Maps_GRP.Maps_Raster_2 M_In_Y.GRP_sint32_sint32_sint32.All_Maps_GRP.Maps_Raster_2 M_out.GRP_sint32_sint32_sint32.All_Maps_GRP.Maps_Raster_2 /end REF_MEASUREMENT
 /begin REF_CHARACTERISTIC P_Do_Active_Grp.GRP_sint32_sint32_sint32.All_Maps_GRP.Maps_Raster_2 P_Do_GET.GRP_sint32_sint32_sint32.All_Maps_GRP.Maps_Raster_2 P_Do_X_SET.GRP_sint32_sint32_sint32.All_Maps_GRP.Maps_Raster_2 P_Do_Y_SET.GRP_sint32_sint32_sint32.All_Maps_GRP.Maps_Raster_2 P_In_X.GRP_sint32_sint32_sint32.All_Maps_GRP.Maps_Raster_2 P_In_Y.GRP_sint32_sint32_sint32.All_Maps_GRP.Maps_Raster_2 Two_D.GRP_sint32_sint32_sint32.All_Maps_GRP.Maps_Raster_2 /end REF_CHARACTERISTIC
/end GROUP
/begin GROUP GRP_sint32_sint32_sint32.All_Maps_GRP.Maps_Raster_3 ""
 /begin REF_MEASUREMENT Calculated.GRP_sint32_sint32_sint32.All_Maps_GRP.Maps_Raster_3 M_In_X.GRP_sint32_sint32_sint32.All_Maps_GRP.Maps_Raster_3 M_In_Y.GRP_sint32_sint32_sint32.All_Maps_GRP.Maps_Raster_3 M_out.GRP_sint32_sint32_sint32.All_Maps_GRP.Maps_Raster_3 /end REF_MEASUREMENT
 /begin REF_CHARACTERISTIC P_Do_Active_Grp.GRP_sint32_sint32_sint32.All_Maps_GRP.Maps_Raster_3 P_Do_GET.GRP_sint32_sint32_sint32.All_Maps_GRP.Maps_Raster_3 P_Do_X_SET.GRP_sint32_sint32_sint32.All_Maps_GRP.Maps_Raster_3 P_Do_Y_SET.GRP_sint32_sint32_sint32.All_Maps_GRP.Maps_Raster_3 P_In_X.GRP_sint32_sint32_sint32.All_Maps_GRP.Maps_Raster_3 P_In_Y.GRP_sint32_sint32_sint32.All_Maps_GRP.Maps_Raster_3 Two_D.GRP_sint32_sint32_sint32.All_Maps_GRP.Maps_Raster_3 /end REF_CHARACTERISTIC
/end GROUP
/begin GROUP GRP_sint8_sint8_sint8.All_Maps_GRP.Maps_Raster_1 ""
 /begin REF_MEASUREMENT Calculated.GRP_sint8_sint8_sint8.All_Maps_GRP.Maps_Raster_1 M_In_X.GRP_sint8_sint8_sint8.All_Maps_GRP.Maps_Raster_1 M_In_Y.GRP_sint8_sint8_sint8.All_Maps_GRP.Maps_Raster_1 M_out.GRP_sint8_sint8_sint8.All_Maps_GRP.Maps_Raster_1 /end REF_MEASUREMENT
 /begin REF_CHARACTERISTIC P_Do_Active_Grp.GRP_sint8_sint8_sint8.All_Maps_GRP.Maps_Raster_1 P_Do_GET.GRP_sint8_sint8_sint8.All_Maps_GRP.Maps_Raster_1 P_Do_X_SET.GRP_sint8_sint8_sint8.All_Maps_GRP.Maps_Raster_1 P_Do_Y_SET.GRP_sint8_sint8_sint8.All_Maps_GRP.Maps_Raster_1 P_In_X.GRP_sint8_sint8_sint8.All_Maps_GRP.Maps_Raster_1 P_In_Y.GRP_sint8_sint8_sint8.All_Maps_GRP.Maps_Raster_1 Two_D.GRP_sint8_sint8_sint8.All_Maps_GRP.Maps_Raster_1 /end REF_CHARACTERISTIC
/end GROUP
/begin GROUP GRP_sint8_sint8_sint8.All_Maps_GRP.Maps_Raster_2 ""
 /begin REF_MEASUREMENT Calculated.GRP_sint8_sint8_sint8.All_Maps_GRP.Maps_Raster_2 M_In_X.GRP_sint8_sint8_sint8.All_Maps_GRP.Maps_Raster_2 M_In_Y.GRP_sint8_sint8_sint8.All_Maps_GRP.Maps_Raster_2 M_out.GRP_sint8_sint8_sint8.All_Maps_GRP.Maps_Raster_2 /end REF_MEASUREMENT
 /begin REF_CHARACTERISTIC P_Do_Active_Grp.GRP_sint8_sint8_sint8.All_Maps_GRP.Maps_Raster_2 P_Do_GET.GRP_sint8_sint8_sint8.All_Maps_GRP.Maps_Raster_2 P_Do_X_SET.GRP_sint8_sint8_sint8.All_Maps_GRP.Maps_Raster_2 P_Do_Y_SET.GRP_sint8_sint8_sint8.All_Maps_GRP.Maps_Raster_2 P_In_X.GRP_sint8_sint8_sint8.All_Maps_GRP.Maps_Raster_2 P_In_Y.GRP_sint8_sint8_sint8.All_Maps_GRP.Maps_Raster_2 Two_D.GRP_sint8_sint8_sint8.All_Maps_GRP.Maps_Raster_2 /end REF_CHARACTERISTIC
/end GROUP
/begin GROUP GRP_sint8_sint8_sint8.All_Maps_GRP.Maps_Raster_3 ""
 /begin REF_MEASUREMENT Calculated.GRP_sint8_sint8_sint8.All_Maps_GRP.Maps_Raster_3 M_In_X.GRP_sint8_sint8_sint8.All_Maps_GRP.Maps_Raster_3 M_In_Y.GRP_sint8_sint8_sint8.All_Maps_GRP.Maps_Raster_3 M_out.GRP_sint8_sint8_sint8.All_Maps_GRP.Maps_Raster_3 /end REF_MEASUREMENT
 /begin REF_CHARACTERISTIC P_Do_Active_Grp.GRP_sint8_sint8_sint8.All_Maps_GRP.Maps_Raster_3 P_Do_GET.GRP_sint8_sint8_sint8.All_Maps_GRP.Maps_Raster_3 P_Do_X_SET.GRP_sint8_sint8_sint8.All_Maps_GRP.Maps_Raster_3 P_Do_Y_SET.GRP_sint8_sint8_sint8.All_Maps_GRP.Maps_Raster_3 P_In_X.GRP_sint8_sint8_sint8.All_Maps_GRP.Maps_Raster_3 P_In_Y.GRP_sint8_sint8_sint8.All_Maps_GRP.Maps_Raster_3 Two_D.GRP_sint8_sint8_sint8.All_Maps_GRP.Maps_Raster_3 /end REF_CHARACTERISTIC
/end GROUP
/begin GROUP GRP_uint16_uint16_uint16.All_Maps_GRP.Maps_Raster_1 ""
 /begin REF_MEASUREMENT Calculated.GRP_uint16_uint16_uint16.All_Maps_GRP.Maps_Raster_1 M_In_X.GRP_uint16_uint16_uint16.All_Maps_GRP.Maps_Raster_1 M_In_Y.GRP_uint16_uint16_uint16.All_Maps_GRP.Maps_Raster_1 M_out.GRP_uint16_uint16_uint16.All_Maps_GRP.Maps_Raster_1 /end REF_MEASUREMENT
 /begin REF_CHARACTERISTIC P_Do_Active_Grp.GRP_uint16_uint16_uint16.All_Maps_GRP.Maps_Raster_1 P_Do_GET.GRP_uint16_uint16_uint16.All_Maps_GRP.Maps_Raster_1 P_Do_X_SET.GRP_uint16_uint16_uint16.All_Maps_GRP.Maps_Raster_1 P_Do_Y_SET.GRP_uint16_uint16_uint16.All_Maps_GRP.Maps_Raster_1 P_In_X.GRP_uint16_uint16_uint16.All_Maps_GRP.Maps_Raster_1 P_In_Y.GRP_uint16_uint16_uint16.All_Maps_GRP.Maps_Raster_1 Two_D.GRP_uint16_uint16_uint16.All_Maps_GRP.Maps_Raster_1 /end REF_CHARACTERISTIC
/end GROUP
/begin GROUP GRP_uint16_uint16_uint16.All_Maps_GRP.Maps_Raster_2 ""
 /begin REF_MEASUREMENT Calculated.GRP_uint16_uint16_uint16.All_Maps_GRP.Maps_Raster_2 M_In_X.GRP_uint16_uint16_uint16.All_Maps_GRP.Maps_Raster_2 M_In_Y.GRP_uint16_uint16_uint16.All_Maps_GRP.Maps_Raster_2 M_out.GRP_uint16_uint16_uint16.All_Maps_GRP.Maps_Raster_2 /end REF_MEASUREMENT
 /begin REF_CHARACTERISTIC P_Do_Active_Grp.GRP_uint16_uint16_uint16.All_Maps_GRP.Maps_Raster_2 P_Do_GET.GRP_uint16_uint16_uint16.All_Maps_GRP.Maps_Raster_2 P_Do_X_SET.GRP_uint16_uint16_uint16.All_Maps_GRP.Maps_Raster_2 P_Do_Y_SET.GRP_uint16_uint16_uint16.All_Maps_GRP.Maps_Raster_2 P_In_X.GRP_uint16_uint16_uint16.All_Maps_GRP.Maps_Raster_2 P_In_Y.GRP_uint16_uint16_uint16.All_Maps_GRP.Maps_Raster_2 Two_D.GRP_uint16_uint16_uint16.All_Maps_GRP.Maps_Raster_2 /end REF_CHARACTERISTIC
/end GROUP
/begin GROUP GRP_uint16_uint16_uint16.All_Maps_GRP.Maps_Raster_3 ""
 /begin REF_MEASUREMENT Calculated.GRP_uint16_uint16_uint16.All_Maps_GRP.Maps_Raster_3 M_In_X.GRP_uint16_uint16_uint16.All_Maps_GRP.Maps_Raster_3 M_In_Y.GRP_uint16_uint16_uint16.All_Maps_GRP.Maps_Raster_3 M_out.GRP_uint16_uint16_uint16.All_Maps_GRP.Maps_Raster_3 /end REF_MEASUREMENT
 /begin REF_CHARACTERISTIC P_Do_Active_Grp.GRP_uint16_uint16_uint16.All_Maps_GRP.Maps_Raster_3 P_Do_GET.GRP_uint16_uint16_uint16.All_Maps_GRP.Maps_Raster_3 P_Do_X_SET.GRP_uint16_uint16_uint16.All_Maps_GRP.Maps_Raster_3 P_Do_Y_SET.GRP_uint16_uint16_uint16.All_Maps_GRP.Maps_Raster_3 P_In_X.GRP_uint16_uint16_uint16.All_Maps_GRP.Maps_Raster_3 P_In_Y.GRP_uint16_uint16_uint16.All_Maps_GRP.Maps_Raster_3 Two_D.GRP_uint16_uint16_uint16.All_Maps_GRP.Maps_Raster_3 /end REF_CHARACTERISTIC
/end GROUP
/begin GROUP GRP_uint32_uint32_uint32.All_Maps_GRP.Maps_Raster_1 ""
 /begin REF_MEASUREMENT Calculated.GRP_uint32_uint32_uint32.All_Maps_GRP.Maps_Raster_1 M_In_X.GRP_uint32_uint32_uint32.All_Maps_GRP.Maps_Raster_1 M_In_Y.GRP_uint32_uint32_uint32.All_Maps_GRP.Maps_Raster_1 M_out.GRP_uint32_uint32_uint32.All_Maps_GRP.Maps_Raster_1 /end REF_MEASUREMENT
 /begin REF_CHARACTERISTIC P_Do_Active_Grp.GRP_uint32_uint32_uint32.All_Maps_GRP.Maps_Raster_1 P_Do_GET.GRP_uint32_uint32_uint32.All_Maps_GRP.Maps_Raster_1 P_Do_X_SET.GRP_uint32_uint32_uint32.All_Maps_GRP.Maps_Raster_1 P_Do_Y_SET.GRP_uint32_uint32_uint32.All_Maps_GRP.Maps_Raster_1 P_In_X.GRP_uint32_uint32_uint32.All_Maps_GRP.Maps_Raster_1 P_In_Y.GRP_uint32_uint32_uint32.All_Maps_GRP.Maps_Raster_1 Two_D.GRP_uint32_uint32_uint32.All_Maps_GRP.Maps_Raster_1 /end REF_CHARACTERISTIC
/end GROUP
/begin GROUP GRP_uint32_uint32_uint32.All_Maps_GRP.Maps_Raster_2 ""
 /begin REF_MEASUREMENT Calculated.GRP_uint32_uint32_uint32.All_Maps_GRP.Maps_Raster_2 M_In_X.GRP_uint32_uint32_uint32.All_Maps_GRP.Maps_Raster_2 M_In_Y.GRP_uint32_uint32_uint32.All_Maps_GRP.Maps_Raster_2 M_out.GRP_uint32_uint32_uint32.All_Maps_GRP.Maps_Raster_2 /end REF_MEASUREMENT
 /begin REF_CHARACTERISTIC P_Do_Active_Grp.GRP_uint32_uint32_uint32.All_Maps_GRP.Maps_Raster_2 P_Do_GET.GRP_uint32_uint32_uint32.All_Maps_GRP.Maps_Raster_2 P_Do_X_SET.GRP_uint32_uint32_uint32.All_Maps_GRP.Maps_Raster_2 P_Do_Y_SET.GRP_uint32_uint32_uint32.All_Maps_GRP.Maps_Raster_2 P_In_X.GRP_uint32_uint32_uint32.All_Maps_GRP.Maps_Raster_2 P_In_Y.GRP_uint32_uint32_uint32.All_Maps_GRP.Maps_Raster_2 Two_D.GRP_uint32_uint32_uint32.All_Maps_GRP.Maps_Raster_2 /end REF_CHARACTERISTIC
/end GROUP
/begin GROUP GRP_uint32_uint32_uint32.All_Maps_GRP.Maps_Raster_3 ""
 /begin REF_MEASUREMENT Calculated.GRP_uint32_uint32_uint32.All_Maps_GRP.Maps_Raster_3 M_In_X.GRP_uint32_uint32_uint32.All_Maps_GRP.Maps_Raster_3 M_In_Y.GRP_uint32_uint32_uint32.All_Maps_GRP.Maps_Raster_3 M_out.GRP_uint32_uint32_uint32.All_Maps_GRP.Maps_Raster_3 /end REF_MEASUREMENT
 /begin REF_CHARACTERISTIC P_Do_Active_Grp.GRP_uint32_uint32_uint32.All_Maps_GRP.Maps_Raster_3 P_Do_GET.GRP_uint32_uint32_uint32.All_Maps_GRP.Maps_Raster_3 P_Do_X_SET.GRP_uint32_uint32_uint32.All_Maps_GRP.Maps_Raster_3 P_Do_Y_SET.GRP_uint32_uint32_uint32.All_Maps_GRP.Maps_Raster_3 P_In_X.GRP_uint32_uint32_uint32.All_Maps_GRP.Maps_Raster_3 P_In_Y.GRP_uint32_uint32_uint32.All_Maps_GRP.Maps_Raster_3 Two_D.GRP_uint32_uint32_uint32.All_Maps_GRP.Maps_Raster_3 /end REF_CHARACTERISTIC
/end GROUP
/begin GROUP GRP_uint8_uint8_uint8.All_Maps_GRP.Maps_Raster_1 ""
 /begin REF_MEASUREMENT Calculated.GRP_uint8_uint8_uint8.All_Maps_GRP.Maps_Raster_1 M_In_X.GRP_uint8_uint8_uint8.All_Maps_GRP.Maps_Raster_1 M_In_Y.GRP_uint8_uint8_uint8.All_Maps_GRP.Maps_Raster_1 M_out.GRP_uint8_uint8_uint8.All_Maps_GRP.Maps_Raster_1 /end REF_MEASUREMENT
 /begin REF_CHARACTERISTIC P_Do_Active_Grp.GRP_uint8_uint8_uint8.All_Maps_GRP.Maps_Raster_1 P_Do_GET.GRP_uint8_uint8_uint8.All_Maps_GRP.Maps_Raster_1 P_Do_X_SET.GRP_uint8_uint8_uint8.All_Maps_GRP.Maps_Raster_1 P_Do_Y_SET.GRP_uint8_uint8_uint8.All_Maps_GRP.Maps_Raster_1 P_In_X.GRP_uint8_uint8_uint8.All_Maps_GRP.Maps_Raster_1 P_In_Y.GRP_uint8_uint8_uint8.All_Maps_GRP.Maps_Raster_1 Two_D.GRP_uint8_uint8_uint8.All_Maps_GRP.Maps_Raster_1 /end REF_CHARACTERISTIC
/end GROUP
/begin GROUP GRP_uint8_uint8_uint8.All_Maps_GRP.Maps_Raster_2 ""
 /begin REF_MEASUREMENT Calculated.GRP_uint8_uint8_uint8.All_Maps_GRP.Maps_Raster_2 M_In_X.GRP_uint8_uint8_uint8.All_Maps_GRP.Maps_Raster_2 M_In_Y.GRP_uint8_uint8_uint8.All_Maps_GRP.Maps_Raster_2 M_out.GRP_uint8_uint8_uint8.All_Maps_GRP.Maps_Raster_2 /end REF_MEASUREMENT
 /begin REF_CHARACTERISTIC P_Do_Active_Grp.GRP_uint8_uint8_uint8.All_Maps_GRP.Maps_Raster_2 P_Do_GET.GRP_uint8_uint8_uint8.All_Maps_GRP.Maps_Raster_2 P_Do_X_SET.GRP_uint8_uint8_uint8.All_Maps_GRP.Maps_Raster_2 P_Do_Y_SET.GRP_uint8_uint8_uint8.All_Maps_GRP.Maps_Raster_2 P_In_X.GRP_uint8_uint8_uint8.All_Maps_GRP.Maps_Raster_2 P_In_Y.GRP_uint8_uint8_uint8.All_Maps_GRP.Maps_Raster_2 Two_D.GRP_uint8_uint8_uint8.All_Maps_GRP.Maps_Raster_2 /end REF_CHARACTERISTIC
/end GROUP
/begin GROUP GRP_uint8_uint8_uint8.All_Maps_GRP.Maps_Raster_3 ""
 /begin REF_MEASUREMENT Calculated.GRP_uint8_uint8_uint8.All_Maps_GRP.Maps_Raster_3 M_In_X.GRP_uint8_uint8_uint8.All_Maps_GRP.Maps_Raster_3 M_In_Y.GRP_uint8_uint8_uint8.All_Maps_GRP.Maps_Raster_3 M_out.GRP_uint8_uint8_uint8.All_Maps_GRP.Maps_Raster_3 /end REF_MEASUREMENT
 /begin REF_CHARACTERISTIC P_Do_Active_Grp.GRP_uint8_uint8_uint8.All_Maps_GRP.Maps_Raster_3 P_Do_GET.GRP_uint8_uint8_uint8.All_Maps_GRP.Maps_Raster_3 P_Do_X_SET.GRP_uint8_uint8_uint8.All_Maps_GRP.Maps_Raster_3 P_Do_Y_SET.GRP_uint8_uint8_uint8.All_Maps_GRP.Maps_Raster_3 P_In_X.GRP_uint8_uint8_uint8.All_Maps_GRP.Maps_Raster_3 P_In_Y.GRP_uint8_uint8_uint8.All_Maps_GRP.Maps_Raster_3 Two_D.GRP_uint8_uint8_uint8.All_Maps_GRP.Maps_Raster_3 /end REF_CHARACTERISTIC
/end GROUP
/begin GROUP Maps_Raster_1 "" ROOT
 /begin REF_MEASUREMENT Calculated.FIX_float32_float32_float32.All_Maps_FIX.Maps_Raster_1 Calculated.FIX_sint16_sint16_sint16.All_Maps_FIX.Maps_Raster_1 Calculated.FIX_sint32_sint32_sint32.All_Maps_FIX.Maps_Raster_1 Calculated.FIX_sint8_sint8_sint8.All_Maps_FIX.Maps_Raster_1 Calculated.FIX_uint16_uint16_uint16.All_Maps_FIX.Maps_Raster_1 Calculated.FIX_uint32_uint32_uint32.All_Maps_FIX.Maps_Raster_1 Calculated.FIX_uint8_uint8_uint8.All_Maps_FIX.Maps_Raster_1 Calculated.GRP_float32_float32_float32.All_Maps_GRP.Maps_Raster_1 Calculated.GRP_sint16_sint16_sint16.All_Maps_GRP.Maps_Raster_1 Calculated.GRP_sint32_sint32_sint32.All_Maps_GRP.Maps_Raster_1 Calculated.GRP_sint8_sint8_sint8.All_Maps_GRP.Maps_Raster_1 Calculated.GRP_uint16_uint16_uint16.All_Maps_GRP.Maps_Raster_1 Calculated.GRP_uint32_uint32_uint32.All_Maps_GRP.Maps_Raster_1 Calculated.GRP_uint8_uint8_uint8.All_Maps_GRP.Maps_Raster_1 M_In_X.FIX_float32_float32_float32.All_Maps_FIX.Maps_Raster_1 M_In_X.FIX_sint16_sint16_sint16.All_Maps_FIX.Maps_Raster_1 M_In_X.FIX_sint32_sint32_sint32.All_Maps_FIX.Maps_Raster_1 M_In_X.FIX_sint8_sint8_sint8.All_Maps_FIX.Maps_Raster_1 M_In_X.FIX_uint16_uint16_uint16.All_Maps_FIX.Maps_Raster_1 M_In_X.FIX_uint32_uint32_uint32.All_Maps_FIX.Maps_Raster_1 M_In_X.FIX_uint8_uint8_uint8.All_Maps_FIX.Maps_Raster_1 M_In_X.GRP_float32_float32_float32.All_Maps_GRP.Maps_Raster_1 M_In_X.GRP_sint16_sint16_sint16.All_Maps_GRP.Maps_Raster_1 M_In_X.GRP_sint32_sint32_sint32.All_Maps_GRP.Maps_Raster_1 M_In_X.GRP_sint8_sint8_sint8.All_Maps_GRP.Maps_Raster_1 M_In_X.GRP_uint16_uint16_uint16.All_Maps_GRP.Maps_Raster_1 M_In_X.GRP_uint32_uint32_uint32.All_Maps_GRP.Maps_Raster_1 M_In_X.GRP_uint8_uint8_uint8.All_Maps_GRP.Maps_Raster_1 M_In_Y.FIX_float32_float32_float32.All_Maps_FIX.Maps_Raster_1 M_In_Y.FIX_sint16_sint16_sint16.All_Maps_FIX.Maps_Raster_1 M_In_Y.FIX_sint32_sint32_sint32.All_Maps_FIX.Maps_Raster_1 M_In_Y.FIX_sint8_sint8_sint8.All_Maps_FIX.Maps_Raster_1 M_In_Y.FIX_uint16_uint16_uint16.All_Maps_FIX.Maps_Raster_1 M_In_Y.FIX_uint32_uint32_uint32.All_Maps_FIX.Maps_Raster_1 M_In_Y.FIX_uint8_uint8_uint8.All_Maps_FIX.Maps_Raster_1 M_In_Y.GRP_float32_float32_float32.All_Maps_GRP.Maps_Raster_1 M_In_Y.GRP_sint16_sint16_sint16.All_Maps_GRP.Maps_Raster_1 M_In_Y.GRP_sint32_sint32_sint32.All_Maps_GRP.Maps_Raster_1 M_In_Y.GRP_sint8_sint8_sint8.All_Maps_GRP.Maps_Raster_1 M_In_Y.GRP_uint16_uint16_uint16.All_Maps_GRP.Maps_Raster_1 M_In_Y.GRP_uint32_uint32_uint32.All_Maps_GRP.Maps_Raster_1 M_In_Y.GRP_uint8_uint8_uint8.All_Maps_GRP.Maps_Raster_1 M_out.FIX_float32_float32_float32.All_Maps_FIX.Maps_Raster_1 M_out.FIX_sint16_sint16_sint16.All_Maps_FIX.Maps_Raster_1 M_out.FIX_sint32_sint32_sint32.All_Maps_FIX.Maps_Raster_1 M_out.FIX_sint8_sint8_sint8.All_Maps_FIX.Maps_Raster_1 M_out.FIX_uint16_uint16_uint16.All_Maps_FIX.Maps_Raster_1 M_out.FIX_uint32_uint32_uint32.All_Maps_FIX.Maps_Raster_1 M_out.FIX_uint8_uint8_uint8.All_Maps_FIX.Maps_Raster_1 M_out.GRP_float32_float32_float32.All_Maps_GRP.Maps_Raster_1 M_out.GRP_sint16_sint16_sint16.All_Maps_GRP.Maps_Raster_1 M_out.GRP_sint32_sint32_sint32.All_Maps_GRP.Maps_Raster_1 M_out.GRP_sint8_sint8_sint8.All_Maps_GRP.Maps_Raster_1 M_out.GRP_uint16_uint16_uint16.All_Maps_GRP.Maps_Raster_1 M_out.GRP_uint32_uint32_uint32.All_Maps_GRP.Maps_Raster_1 M_out.GRP_uint8_uint8_uint8.All_Maps_GRP.Maps_Raster_1 /end REF_MEASUREMENT
 /begin REF_CHARACTERISTIC P_Do_Active_Grp.GRP_float32_float32_float32.All_Maps_GRP.Maps_Raster_1 P_Do_Active_Grp.GRP_sint16_sint16_sint16.All_Maps_GRP.Maps_Raster_1 P_Do_Active_Grp.GRP_sint32_sint32_sint32.All_Maps_GRP.Maps_Raster_1 P_Do_Active_Grp.GRP_sint8_sint8_sint8.All_Maps_GRP.Maps_Raster_1 P_Do_Active_Grp.GRP_uint16_uint16_uint16.All_Maps_GRP.Maps_Raster_1 P_Do_Active_Grp.GRP_uint32_uint32_uint32.All_Maps_GRP.Maps_Raster_1 P_Do_Active_Grp.GRP_uint8_uint8_uint8.All_Maps_GRP.Maps_Raster_1 P_Do_Active_Std.FIX_float32_float32_float32.All_Maps_FIX.Maps_Raster_1 P_Do_Active_Std.FIX_sint16_sint16_sint16.All_Maps_FIX.Maps_Raster_1 P_Do_Active_Std.FIX_sint32_sint32_sint32.All_Maps_FIX.Maps_Raster_1 P_Do_Active_Std.FIX_sint8_sint8_sint8.All_Maps_FIX.Maps_Raster_1 P_Do_Active_Std.FIX_uint16_uint16_uint16.All_Maps_FIX.Maps_Raster_1 P_Do_Active_Std.FIX_uint32_uint32_uint32.All_Maps_FIX.Maps_Raster_1 P_Do_Active_Std.FIX_uint8_uint8_uint8.All_Maps_FIX.Maps_Raster_1 P_Do_All_FIX_Maps.All_Maps_FIX.Maps_Raster_1 P_Do_All_GRP_Maps.All_Maps_GRP.Maps_Raster_1 P_Do_GET.GRP_float32_float32_float32.All_Maps_GRP.Maps_Raster_1 P_Do_GET.GRP_sint16_sint16_sint16.All_Maps_GRP.Maps_Raster_1 P_Do_GET.GRP_sint32_sint32_sint32.All_Maps_GRP.Maps_Raster_1 P_Do_GET.GRP_sint8_sint8_sint8.All_Maps_GRP.Maps_Raster_1 P_Do_GET.GRP_uint16_uint16_uint16.All_Maps_GRP.Maps_Raster_1 P_Do_GET.GRP_uint32_uint32_uint32.All_Maps_GRP.Maps_Raster_1 P_Do_GET.GRP_uint8_uint8_uint8.All_Maps_GRP.Maps_Raster_1 P_Do_X_SET.GRP_float32_float32_float32.All_Maps_GRP.Maps_Raster_1 P_Do_X_SET.GRP_sint16_sint16_sint16.All_Maps_GRP.Maps_Raster_1 P_Do_X_SET.GRP_sint32_sint32_sint32.All_Maps_GRP.Maps_Raster_1 P_Do_X_SET.GRP_sint8_sint8_sint8.All_Maps_GRP.Maps_Raster_1 P_Do_X_SET.GRP_uint16_uint16_uint16.All_Maps_GRP.Maps_Raster_1 P_Do_X_SET.GRP_uint32_uint32_uint32.All_Maps_GRP.Maps_Raster_1 P_Do_X_SET.GRP_uint8_uint8_uint8.All_Maps_GRP.Maps_Raster_1 P_Do_Y_SET.GRP_float32_float32_float32.All_Maps_GRP.Maps_Raster_1 P_Do_Y_SET.GRP_sint16_sint16_sint16.All_Maps_GRP.Maps_Raster_1 P_Do_Y_SET.GRP_sint32_sint32_sint32.All_Maps_GRP.Maps_Raster_1 P_Do_Y_SET.GRP_sint8_sint8_sint8.All_Maps_GRP.Maps_Raster_1 P_Do_Y_SET.GRP_uint16_uint16_uint16.All_Maps_GRP.Maps_Raster_1 P_Do_Y_SET.GRP_uint32_uint32_uint32.All_Maps_GRP.Maps_Raster_1 P_Do_Y_SET.GRP_uint8_uint8_uint8.All_Maps_GRP.Maps_Raster_1 P_In_X.FIX_float32_float32_float32.All_Maps_FIX.Maps_Raster_1 P_In_X.FIX_sint16_sint16_sint16.All_Maps_FIX.Maps_Raster_1 P_In_X.FIX_sint32_sint32_sint32.All_Maps_FIX.Maps_Raster_1 P_In_X.FIX_sint8_sint8_sint8.All_Maps_FIX.Maps_Raster_1 P_In_X.FIX_uint16_uint16_uint16.All_Maps_FIX.Maps_Raster_1 P_In_X.FIX_uint32_uint32_uint32.All_Maps_FIX.Maps_Raster_1 P_In_X.FIX_uint8_uint8_uint8.All_Maps_FIX.Maps_Raster_1 P_In_X.GRP_float32_float32_float32.All_Maps_GRP.Maps_Raster_1 P_In_X.GRP_sint16_sint16_sint16.All_Maps_GRP.Maps_Raster_1 P_In_X.GRP_sint32_sint32_sint32.All_Maps_GRP.Maps_Raster_1 P_In_X.GRP_sint8_sint8_sint8.All_Maps_GRP.Maps_Raster_1 P_In_X.GRP_uint16_uint16_uint16.All_Maps_GRP.Maps_Raster_1 P_In_X.GRP_uint32_uint32_uint32.All_Maps_GRP.Maps_Raster_1 P_In_X.GRP_uint8_uint8_uint8.All_Maps_GRP.Maps_Raster_1 P_In_Y.FIX_float32_float32_float32.All_Maps_FIX.Maps_Raster_1 P_In_Y.FIX_sint16_sint16_sint16.All_Maps_FIX.Maps_Raster_1 P_In_Y.FIX_sint32_sint32_sint32.All_Maps_FIX.Maps_Raster_1 P_In_Y.FIX_sint8_sint8_sint8.All_Maps_FIX.Maps_Raster_1 P_In_Y.FIX_uint16_uint16_uint16.All_Maps_FIX.Maps_Raster_1 P_In_Y.FIX_uint32_uint32_uint32.All_Maps_FIX.Maps_Raster_1 P_In_Y.FIX_uint8_uint8_uint8.All_Maps_FIX.Maps_Raster_1 P_In_Y.GRP_float32_float32_float32.All_Maps_GRP.Maps_Raster_1 P_In_Y.GRP_sint16_sint16_sint16.All_Maps_GRP.Maps_Raster_1 P_In_Y.GRP_sint32_sint32_sint32.All_Maps_GRP.Maps_Raster_1 P_In_Y.GRP_sint8_sint8_sint8.All_Maps_GRP.Maps_Raster_1 P_In_Y.GRP_uint16_uint16_uint16.All_Maps_GRP.Maps_Raster_1 P_In_Y.GRP_uint32_uint32_uint32.All_Maps_GRP.Maps_Raster_1 P_In_Y.GRP_uint8_uint8_uint8.All_Maps_GRP.Maps_Raster_1 Two_D.FIX_float32_float32_float32.All_Maps_FIX.Maps_Raster_1 Two_D.FIX_sint16_sint16_sint16.All_Maps_FIX.Maps_Raster_1 Two_D.FIX_sint32_sint32_sint32.All_Maps_FIX.Maps_Raster_1 Two_D.FIX_sint8_sint8_sint8.All_Maps_FIX.Maps_Raster_1 Two_D.FIX_uint16_uint16_uint16.All_Maps_FIX.Maps_Raster_1 Two_D.FIX_uint32_uint32_uint32.All_Maps_FIX.Maps_Raster_1 Two_D.FIX_uint8_uint8_uint8.All_Maps_FIX.Maps_Raster_1 Two_D.GRP_float32_float32_float32.All_Maps_GRP.Maps_Raster_1 Two_D.GRP_sint16_sint16_sint16.All_Maps_GRP.Maps_Raster_1 Two_D.GRP_sint32_sint32_sint32.All_Maps_GRP.Maps_Raster_1 Two_D.GRP_sint8_sint8_sint8.All_Maps_GRP.Maps_Raster_1 Two_D.GRP_uint16_uint16_uint16.All_Maps_GRP.Maps_Raster_1 Two_D.GRP_uint32_uint32_uint32.All_Maps_GRP.Maps_Raster_1 Two_D.GRP_uint8_uint8_uint8.All_Maps_GRP.Maps_Raster_1 /end REF_CHARACTERISTIC
/end GROUP
/begin GROUP Maps_Raster_2 "" ROOT
 /begin REF_MEASUREMENT Calculated.FIX_float32_float32_float32.All_Maps_FIX.Maps_Raster_2 Calculated.FIX_sint16_sint16_sint16.All_Maps_FIX.Maps_Raster_2 Calculated.FIX_sint32_sint32_sint32.All_Maps_FIX.Maps_Raster_2 Calculated.FIX_sint8_sint8_sint8.All_Maps_FIX.Maps_Raster_2 Calculated.FIX_uint16_uint16_uint16.All_Maps_FIX.Maps_Raster_2 Calculated.FIX_uint32_uint32_uint32.All_Maps_FIX.Maps_Raster_2 Calculated.FIX_uint8_uint8_uint8.All_Maps_FIX.Maps_Raster_2 Calculated.GRP_float32_float32_float32.All_Maps_GRP.Maps_Raster_2 Calculated.GRP_sint16_sint16_sint16.All_Maps_GRP.Maps_Raster_2 Calculated.GRP_sint32_sint32_sint32.All_Maps_GRP.Maps_Raster_2 Calculated.GRP_sint8_sint8_sint8.All_Maps_GRP.Maps_Raster_2 Calculated.GRP_uint16_uint16_uint16.All_Maps_GRP.Maps_Raster_2 Calculated.GRP_uint32_uint32_uint32.All_Maps_GRP.Maps_Raster_2 Calculated.GRP_uint8_uint8_uint8.All_Maps_GRP.Maps_Raster_2 M_In_X.FIX_float32_float32_float32.All_Maps_FIX.Maps_Raster_2 M_In_X.FIX_sint16_sint16_sint16.All_Maps_FIX.Maps_Raster_2 M_In_X.FIX_sint32_sint32_sint32.All_Maps_FIX.Maps_Raster_2 M_In_X.FIX_sint8_sint8_sint8.All_Maps_FIX.Maps_Raster_2 M_In_X.FIX_uint16_uint16_uint16.All_Maps_FIX.Maps_Raster_2 M_In_X.FIX_uint32_uint32_uint32.All_Maps_FIX.Maps_Raster_2 M_In_X.FIX_uint8_uint8_uint8.All_Maps_FIX.Maps_Raster_2 M_In_X.GRP_float32_float32_float32.All_Maps_GRP.Maps_Raster_2 M_In_X.GRP_sint16_sint16_sint16.All_Maps_GRP.Maps_Raster_2 M_In_X.GRP_sint32_sint32_sint32.All_Maps_GRP.Maps_Raster_2 M_In_X.GRP_sint8_sint8_sint8.All_Maps_GRP.Maps_Raster_2 M_In_X.GRP_uint16_uint16_uint16.All_Maps_GRP.Maps_Raster_2 M_In_X.GRP_uint32_uint32_uint32.All_Maps_GRP.Maps_Raster_2 M_In_X.GRP_uint8_uint8_uint8.All_Maps_GRP.Maps_Raster_2 M_In_Y.FIX_float32_float32_float32.All_Maps_FIX.Maps_Raster_2 M_In_Y.FIX_sint16_sint16_sint16.All_Maps_FIX.Maps_Raster_2 M_In_Y.FIX_sint32_sint32_sint32.All_Maps_FIX.Maps_Raster_2 M_In_Y.FIX_sint8_sint8_sint8.All_Maps_FIX.Maps_Raster_2 M_In_Y.FIX_uint16_uint16_uint16.All_Maps_FIX.Maps_Raster_2 M_In_Y.FIX_uint32_uint32_uint32.All_Maps_FIX.Maps_Raster_2 M_In_Y.FIX_uint8_uint8_uint8.All_Maps_FIX.Maps_Raster_2 M_In_Y.GRP_float32_float32_float32.All_Maps_GRP.Maps_Raster_2 M_In_Y.GRP_sint16_sint16_sint16.All_Maps_GRP.Maps_Raster_2 M_In_Y.GRP_sint32_sint32_sint32.All_Maps_GRP.Maps_Raster_2 M_In_Y.GRP_sint8_sint8_sint8.All_Maps_GRP.Maps_Raster_2 M_In_Y.GRP_uint16_uint16_uint16.All_Maps_GRP.Maps_Raster_2 M_In_Y.GRP_uint32_uint32_uint32.All_Maps_GRP.Maps_Raster_2 M_In_Y.GRP_uint8_uint8_uint8.All_Maps_GRP.Maps_Raster_2 M_out.FIX_float32_float32_float32.All_Maps_FIX.Maps_Raster_2 M_out.FIX_sint16_sint16_sint16.All_Maps_FIX.Maps_Raster_2 M_out.FIX_sint32_sint32_sint32.All_Maps_FIX.Maps_Raster_2 M_out.FIX_sint8_sint8_sint8.All_Maps_FIX.Maps_Raster_2 M_out.FIX_uint16_uint16_uint16.All_Maps_FIX.Maps_Raster_2 M_out.FIX_uint32_uint32_uint32.All_Maps_FIX.Maps_Raster_2 M_out.FIX_uint8_uint8_uint8.All_Maps_FIX.Maps_Raster_2 M_out.GRP_float32_float32_float32.All_Maps_GRP.Maps_Raster_2 M_out.GRP_sint16_sint16_sint16.All_Maps_GRP.Maps_Raster_2 M_out.GRP_sint32_sint32_sint32.All_Maps_GRP.Maps_Raster_2 M_out.GRP_sint8_sint8_sint8.All_Maps_GRP.Maps_Raster_2 M_out.GRP_uint16_uint16_uint16.All_Maps_GRP.Maps_Raster_2 M_out.GRP_uint32_uint32_uint32.All_Maps_GRP.Maps_Raster_2 M_out.GRP_uint8_uint8_uint8.All_Maps_GRP.Maps_Raster_2 /end REF_MEASUREMENT
 /begin REF_CHARACTERISTIC P_Do_Active_Grp.GRP_float32_float32_float32.All_Maps_GRP.Maps_Raster_2 P_Do_Active_Grp.GRP_sint16_sint16_sint16.All_Maps_GRP.Maps_Raster_2 P_Do_Active_Grp.GRP_sint32_sint32_sint32.All_Maps_GRP.Maps_Raster_2 P_Do_Active_Grp.GRP_sint8_sint8_sint8.All_Maps_GRP.Maps_Raster_2 P_Do_Active_Grp.GRP_uint16_uint16_uint16.All_Maps_GRP.Maps_Raster_2 P_Do_Active_Grp.GRP_uint32_uint32_uint32.All_Maps_GRP.Maps_Raster_2 P_Do_Active_Grp.GRP_uint8_uint8_uint8.All_Maps_GRP.Maps_Raster_2 P_Do_Active_Std.FIX_float32_float32_float32.All_Maps_FIX.Maps_Raster_2 P_Do_Active_Std.FIX_sint16_sint16_sint16.All_Maps_FIX.Maps_Raster_2 P_Do_Active_Std.FIX_sint32_sint32_sint32.All_Maps_FIX.Maps_Raster_2 P_Do_Active_Std.FIX_sint8_sint8_sint8.All_Maps_FIX.Maps_Raster_2 P_Do_Active_Std.FIX_uint16_uint16_uint16.All_Maps_FIX.Maps_Raster_2 P_Do_Active_Std.FIX_uint32_uint32_uint32.All_Maps_FIX.Maps_Raster_2 P_Do_Active_Std.FIX_uint8_uint8_uint8.All_Maps_FIX.Maps_Raster_2 P_Do_All_FIX_Maps.All_Maps_FIX.Maps_Raster_2 P_Do_All_GRP_Maps.All_Maps_GRP.Maps_Raster_2 P_Do_GET.GRP_float32_float32_float32.All_Maps_GRP.Maps_Raster_2 P_Do_GET.GRP_sint16_sint16_sint16.All_Maps_GRP.Maps_Raster_2 P_Do_GET.GRP_sint32_sint32_sint32.All_Maps_GRP.Maps_Raster_2 P_Do_GET.GRP_sint8_sint8_sint8.All_Maps_GRP.Maps_Raster_2 P_Do_GET.GRP_uint16_uint16_uint16.All_Maps_GRP.Maps_Raster_2 P_Do_GET.GRP_uint32_uint32_uint32.All_Maps_GRP.Maps_Raster_2 P_Do_GET.GRP_uint8_uint8_uint8.All_Maps_GRP.Maps_Raster_2 P_Do_X_SET.GRP_float32_float32_float32.All_Maps_GRP.Maps_Raster_2 P_Do_X_SET.GRP_sint16_sint16_sint16.All_Maps_GRP.Maps_Raster_2 P_Do_X_SET.GRP_sint32_sint32_sint32.All_Maps_GRP.Maps_Raster_2 P_Do_X_SET.GRP_sint8_sint8_sint8.All_Maps_GRP.Maps_Raster_2 P_Do_X_SET.GRP_uint16_uint16_uint16.All_Maps_GRP.Maps_Raster_2 P_Do_X_SET.GRP_uint32_uint32_uint32.All_Maps_GRP.Maps_Raster_2 P_Do_X_SET.GRP_uint8_uint8_uint8.All_Maps_GRP.Maps_Raster_2 P_Do_Y_SET.GRP_float32_float32_float32.All_Maps_GRP.Maps_Raster_2 P_Do_Y_SET.GRP_sint16_sint16_sint16.All_Maps_GRP.Maps_Raster_2 P_Do_Y_SET.GRP_sint32_sint32_sint32.All_Maps_GRP.Maps_Raster_2 P_Do_Y_SET.GRP_sint8_sint8_sint8.All_Maps_GRP.Maps_Raster_2 P_Do_Y_SET.GRP_uint16_uint16_uint16.All_Maps_GRP.Maps_Raster_2 P_Do_Y_SET.GRP_uint32_uint32_uint32.All_Maps_GRP.Maps_Raster_2 P_Do_Y_SET.GRP_uint8_uint8_uint8.All_Maps_GRP.Maps_Raster_2 P_In_X.FIX_float32_float32_float32.All_Maps_FIX.Maps_Raster_2 P_In_X.FIX_sint16_sint16_sint16.All_Maps_FIX.Maps_Raster_2 P_In_X.FIX_sint32_sint32_sint32.All_Maps_FIX.Maps_Raster_2 P_In_X.FIX_sint8_sint8_sint8.All_Maps_FIX.Maps_Raster_2 P_In_X.FIX_uint16_uint16_uint16.All_Maps_FIX.Maps_Raster_2 P_In_X.FIX_uint32_uint32_uint32.All_Maps_FIX.Maps_Raster_2 P_In_X.FIX_uint8_uint8_uint8.All_Maps_FIX.Maps_Raster_2 P_In_X.GRP_float32_float32_float32.All_Maps_GRP.Maps_Raster_2 P_In_X.GRP_sint16_sint16_sint16.All_Maps_GRP.Maps_Raster_2 P_In_X.GRP_sint32_sint32_sint32.All_Maps_GRP.Maps_Raster_2 P_In_X.GRP_sint8_sint8_sint8.All_Maps_GRP.Maps_Raster_2 P_In_X.GRP_uint16_uint16_uint16.All_Maps_GRP.Maps_Raster_2 P_In_X.GRP_uint32_uint32_uint32.All_Maps_GRP.Maps_Raster_2 P_In_X.GRP_uint8_uint8_uint8.All_Maps_GRP.Maps_Raster_2 P_In_Y.FIX_float32_float32_float32.All_Maps_FIX.Maps_Raster_2 P_In_Y.FIX_sint16_sint16_sint16.All_Maps_FIX.Maps_Raster_2 P_In_Y.FIX_sint32_sint32_sint32.All_Maps_FIX.Maps_Raster_2 P_In_Y.FIX_sint8_sint8_sint8.All_Maps_FIX.Maps_Raster_2 P_In_Y.FIX_uint16_uint16_uint16.All_Maps_FIX.Maps_Raster_2 P_In_Y.FIX_uint32_uint32_uint32.All_Maps_FIX.Maps_Raster_2 P_In_Y.FIX_uint8_uint8_uint8.All_Maps_FIX.Maps_Raster_2 P_In_Y.GRP_float32_float32_float32.All_Maps_GRP.Maps_Raster_2 P_In_Y.GRP_sint16_sint16_sint16.All_Maps_GRP.Maps_Raster_2 P_In_Y.GRP_sint32_sint32_sint32.All_Maps_GRP.Maps_Raster_2 P_In_Y.GRP_sint8_sint8_sint8.All_Maps_GRP.Maps_Raster_2 P_In_Y.GRP_uint16_uint16_uint16.All_Maps_GRP.Maps_Raster_2 P_In_Y.GRP_uint32_uint32_uint32.All_Maps_GRP.Maps_Raster_2 P_In_Y.GRP_uint8_uint8_uint8.All_Maps_GRP.Maps_Raster_2 Two_D.FIX_float32_float32_float32.All_Maps_FIX.Maps_Raster_2 Two_D.FIX_sint16_sint16_sint16.All_Maps_FIX.Maps_Raster_2 Two_D.FIX_sint32_sint32_sint32.All_Maps_FIX.Maps_Raster_2 Two_D.FIX_sint8_sint8_sint8.All_Maps_FIX.Maps_Raster_2 Two_D.FIX_uint16_uint16_uint16.All_Maps_FIX.Maps_Raster_2 Two_D.FIX_uint32_uint32_uint32.All_Maps_FIX.Maps_Raster_2 Two_D.FIX_uint8_uint8_uint8.All_Maps_FIX.Maps_Raster_2 Two_D.GRP_float32_float32_float32.All_Maps_GRP.Maps_Raster_2 Two_D.GRP_sint16_sint16_sint16.All_Maps_GRP.Maps_Raster_2 Two_D.GRP_sint32_sint32_sint32.All_Maps_GRP.Maps_Raster_2 Two_D.GRP_sint8_sint8_sint8.All_Maps_GRP.Maps_Raster_2 Two_D.GRP_uint16_uint16_uint16.All_Maps_GRP.Maps_Raster_2 Two_D.GRP_uint32_uint32_uint32.All_Maps_GRP.Maps_Raster_2 Two_D.GRP_uint8_uint8_uint8.All_Maps_GRP.Maps_Raster_2 /end REF_CHARACTERISTIC
/end GROUP
/begin GROUP Maps_Raster_3 "" ROOT
 /begin REF_MEASUREMENT Calculated.FIX_float32_float32_float32.All_Maps_FIX.Maps_Raster_3 Calculated.FIX_sint16_sint16_sint16.All_Maps_FIX.Maps_Raster_3 Calculated.FIX_sint32_sint32_sint32.All_Maps_FIX.Maps_Raster_3 Calculated.FIX_sint8_sint8_sint8.All_Maps_FIX.Maps_Raster_3 Calculated.FIX_uint16_uint16_uint16.All_Maps_FIX.Maps_Raster_3 Calculated.FIX_uint32_uint32_uint32.All_Maps_FIX.Maps_Raster_3 Calculated.FIX_uint8_uint8_uint8.All_Maps_FIX.Maps_Raster_3 Calculated.GRP_float32_float32_float32.All_Maps_GRP.Maps_Raster_3 Calculated.GRP_sint16_sint16_sint16.All_Maps_GRP.Maps_Raster_3 Calculated.GRP_sint32_sint32_sint32.All_Maps_GRP.Maps_Raster_3 Calculated.GRP_sint8_sint8_sint8.All_Maps_GRP.Maps_Raster_3 Calculated.GRP_uint16_uint16_uint16.All_Maps_GRP.Maps_Raster_3 Calculated.GRP_uint32_uint32_uint32.All_Maps_GRP.Maps_Raster_3 Calculated.GRP_uint8_uint8_uint8.All_Maps_GRP.Maps_Raster_3 M_In_X.FIX_float32_float32_float32.All_Maps_FIX.Maps_Raster_3 M_In_X.FIX_sint16_sint16_sint16.All_Maps_FIX.Maps_Raster_3 M_In_X.FIX_sint32_sint32_sint32.All_Maps_FIX.Maps_Raster_3 M_In_X.FIX_sint8_sint8_sint8.All_Maps_FIX.Maps_Raster_3 M_In_X.FIX_uint16_uint16_uint16.All_Maps_FIX.Maps_Raster_3 M_In_X.FIX_uint32_uint32_uint32.All_Maps_FIX.Maps_Raster_3 M_In_X.FIX_uint8_uint8_uint8.All_Maps_FIX.Maps_Raster_3 M_In_X.GRP_float32_float32_float32.All_Maps_GRP.Maps_Raster_3 M_In_X.GRP_sint16_sint16_sint16.All_Maps_GRP.Maps_Raster_3 M_In_X.GRP_sint32_sint32_sint32.All_Maps_GRP.Maps_Raster_3 M_In_X.GRP_sint8_sint8_sint8.All_Maps_GRP.Maps_Raster_3 M_In_X.GRP_uint16_uint16_uint16.All_Maps_GRP.Maps_Raster_3 M_In_X.GRP_uint32_uint32_uint32.All_Maps_GRP.Maps_Raster_3 M_In_X.GRP_uint8_uint8_uint8.All_Maps_GRP.Maps_Raster_3 M_In_Y.FIX_float32_float32_float32.All_Maps_FIX.Maps_Raster_3 M_In_Y.FIX_sint16_sint16_sint16.All_Maps_FIX.Maps_Raster_3 M_In_Y.FIX_sint32_sint32_sint32.All_Maps_FIX.Maps_Raster_3 M_In_Y.FIX_sint8_sint8_sint8.All_Maps_FIX.Maps_Raster_3 M_In_Y.FIX_uint16_uint16_uint16.All_Maps_FIX.Maps_Raster_3 M_In_Y.FIX_uint32_uint32_uint32.All_Maps_FIX.Maps_Raster_3 M_In_Y.FIX_uint8_uint8_uint8.All_Maps_FIX.Maps_Raster_3 M_In_Y.GRP_float32_float32_float32.All_Maps_GRP.Maps_Raster_3 M_In_Y.GRP_sint16_sint16_sint16.All_Maps_GRP.Maps_Raster_3 M_In_Y.GRP_sint32_sint32_sint32.All_Maps_GRP.Maps_Raster_3 M_In_Y.GRP_sint8_sint8_sint8.All_Maps_GRP.Maps_Raster_3 M_In_Y.GRP_uint16_uint16_uint16.All_Maps_GRP.Maps_Raster_3 M_In_Y.GRP_uint32_uint32_uint32.All_Maps_GRP.Maps_Raster_3 M_In_Y.GRP_uint8_uint8_uint8.All_Maps_GRP.Maps_Raster_3 M_out.FIX_float32_float32_float32.All_Maps_FIX.Maps_Raster_3 M_out.FIX_sint16_sint16_sint16.All_Maps_FIX.Maps_Raster_3 M_out.FIX_sint32_sint32_sint32.All_Maps_FIX.Maps_Raster_3 M_out.FIX_sint8_sint8_sint8.All_Maps_FIX.Maps_Raster_3 M_out.FIX_uint16_uint16_uint16.All_Maps_FIX.Maps_Raster_3 M_out.FIX_uint32_uint32_uint32.All_Maps_FIX.Maps_Raster_3 M_out.FIX_uint8_uint8_uint8.All_Maps_FIX.Maps_Raster_3 M_out.GRP_float32_float32_float32.All_Maps_GRP.Maps_Raster_3 M_out.GRP_sint16_sint16_sint16.All_Maps_GRP.Maps_Raster_3 M_out.GRP_sint32_sint32_sint32.All_Maps_GRP.Maps_Raster_3 M_out.GRP_sint8_sint8_sint8.All_Maps_GRP.Maps_Raster_3 M_out.GRP_uint16_uint16_uint16.All_Maps_GRP.Maps_Raster_3 M_out.GRP_uint32_uint32_uint32.All_Maps_GRP.Maps_Raster_3 M_out.GRP_uint8_uint8_uint8.All_Maps_GRP.Maps_Raster_3 /end REF_MEASUREMENT
 /begin REF_CHARACTERISTIC P_Do_Active_Grp.GRP_float32_float32_float32.All_Maps_GRP.Maps_Raster_3 P_Do_Active_Grp.GRP_sint16_sint16_sint16.All_Maps_GRP.Maps_Raster_3 P_Do_Active_Grp.GRP_sint32_sint32_sint32.All_Maps_GRP.Maps_Raster_3 P_Do_Active_Grp.GRP_sint8_sint8_sint8.All_Maps_GRP.Maps_Raster_3 P_Do_Active_Grp.GRP_uint16_uint16_uint16.All_Maps_GRP.Maps_Raster_3 P_Do_Active_Grp.GRP_uint32_uint32_uint32.All_Maps_GRP.Maps_Raster_3 P_Do_Active_Grp.GRP_uint8_uint8_uint8.All_Maps_GRP.Maps_Raster_3 P_Do_Active_Std.FIX_float32_float32_float32.All_Maps_FIX.Maps_Raster_3 P_Do_Active_Std.FIX_sint16_sint16_sint16.All_Maps_FIX.Maps_Raster_3 P_Do_Active_Std.FIX_sint32_sint32_sint32.All_Maps_FIX.Maps_Raster_3 P_Do_Active_Std.FIX_sint8_sint8_sint8.All_Maps_FIX.Maps_Raster_3 P_Do_Active_Std.FIX_uint16_uint16_uint16.All_Maps_FIX.Maps_Raster_3 P_Do_Active_Std.FIX_uint32_uint32_uint32.All_Maps_FIX.Maps_Raster_3 P_Do_Active_Std.FIX_uint8_uint8_uint8.All_Maps_FIX.Maps_Raster_3 P_Do_All_FIX_Maps.All_Maps_FIX.Maps_Raster_3 P_Do_All_GRP_Maps.All_Maps_GRP.Maps_Raster_3 P_Do_GET.GRP_float32_float32_float32.All_Maps_GRP.Maps_Raster_3 P_Do_GET.GRP_sint16_sint16_sint16.All_Maps_GRP.Maps_Raster_3 P_Do_GET.GRP_sint32_sint32_sint32.All_Maps_GRP.Maps_Raster_3 P_Do_GET.GRP_sint8_sint8_sint8.All_Maps_GRP.Maps_Raster_3 P_Do_GET.GRP_uint16_uint16_uint16.All_Maps_GRP.Maps_Raster_3 P_Do_GET.GRP_uint32_uint32_uint32.All_Maps_GRP.Maps_Raster_3 P_Do_GET.GRP_uint8_uint8_uint8.All_Maps_GRP.Maps_Raster_3 P_Do_X_SET.GRP_float32_float32_float32.All_Maps_GRP.Maps_Raster_3 P_Do_X_SET.GRP_sint16_sint16_sint16.All_Maps_GRP.Maps_Raster_3 P_Do_X_SET.GRP_sint32_sint32_sint32.All_Maps_GRP.Maps_Raster_3 P_Do_X_SET.GRP_sint8_sint8_sint8.All_Maps_GRP.Maps_Raster_3 P_Do_X_SET.GRP_uint16_uint16_uint16.All_Maps_GRP.Maps_Raster_3 P_Do_X_SET.GRP_uint32_uint32_uint32.All_Maps_GRP.Maps_Raster_3 P_Do_X_SET.GRP_uint8_uint8_uint8.All_Maps_GRP.Maps_Raster_3 P_Do_Y_SET.GRP_float32_float32_float32.All_Maps_GRP.Maps_Raster_3 P_Do_Y_SET.GRP_sint16_sint16_sint16.All_Maps_GRP.Maps_Raster_3 P_Do_Y_SET.GRP_sint32_sint32_sint32.All_Maps_GRP.Maps_Raster_3 P_Do_Y_SET.GRP_sint8_sint8_sint8.All_Maps_GRP.Maps_Raster_3 P_Do_Y_SET.GRP_uint16_uint16_uint16.All_Maps_GRP.Maps_Raster_3 P_Do_Y_SET.GRP_uint32_uint32_uint32.All_Maps_GRP.Maps_Raster_3 P_Do_Y_SET.GRP_uint8_uint8_uint8.All_Maps_GRP.Maps_Raster_3 P_In_X.FIX_float32_float32_float32.All_Maps_FIX.Maps_Raster_3 P_In_X.FIX_sint16_sint16_sint16.All_Maps_FIX.Maps_Raster_3 P_In_X.FIX_sint32_sint32_sint32.All_Maps_FIX.Maps_Raster_3 P_In_X.FIX_sint8_sint8_sint8.All_Maps_FIX.Maps_Raster_3 P_In_X.FIX_uint16_uint16_uint16.All_Maps_FIX.Maps_Raster_3 P_In_X.FIX_uint32_uint32_uint32.All_Maps_FIX.Maps_Raster_3 P_In_X.FIX_uint8_uint8_uint8.All_Maps_FIX.Maps_Raster_3 P_In_X.GRP_float32_float32_float32.All_Maps_GRP.Maps_Raster_3 P_In_X.GRP_sint16_sint16_sint16.All_Maps_GRP.Maps_Raster_3 P_In_X.GRP_sint32_sint32_sint32.All_Maps_GRP.Maps_Raster_3 P_In_X.GRP_sint8_sint8_sint8.All_Maps_GRP.Maps_Raster_3 P_In_X.GRP_uint16_uint16_uint16.All_Maps_GRP.Maps_Raster_3 P_In_X.GRP_uint32_uint32_uint32.All_Maps_GRP.Maps_Raster_3 P_In_X.GRP_uint8_uint8_uint8.All_Maps_GRP.Maps_Raster_3 P_In_Y.FIX_float32_float32_float32.All_Maps_FIX.Maps_Raster_3 P_In_Y.FIX_sint16_sint16_sint16.All_Maps_FIX.Maps_Raster_3 P_In_Y.FIX_sint32_sint32_sint32.All_Maps_FIX.Maps_Raster_3 P_In_Y.FIX_sint8_sint8_sint8.All_Maps_FIX.Maps_Raster_3 P_In_Y.FIX_uint16_uint16_uint16.All_Maps_FIX.Maps_Raster_3 P_In_Y.FIX_uint32_uint32_uint32.All_Maps_FIX.Maps_Raster_3 P_In_Y.FIX_uint8_uint8_uint8.All_Maps_FIX.Maps_Raster_3 P_In_Y.GRP_float32_float32_float32.All_Maps_GRP.Maps_Raster_3 P_In_Y.GRP_sint16_sint16_sint16.All_Maps_GRP.Maps_Raster_3 P_In_Y.GRP_sint32_sint32_sint32.All_Maps_GRP.Maps_Raster_3 P_In_Y.GRP_sint8_sint8_sint8.All_Maps_GRP.Maps_Raster_3 P_In_Y.GRP_uint16_uint16_uint16.All_Maps_GRP.Maps_Raster_3 P_In_Y.GRP_uint32_uint32_uint32.All_Maps_GRP.Maps_Raster_3 P_In_Y.GRP_uint8_uint8_uint8.All_Maps_GRP.Maps_Raster_3 Two_D.FIX_float32_float32_float32.All_Maps_FIX.Maps_Raster_3 Two_D.FIX_sint16_sint16_sint16.All_Maps_FIX.Maps_Raster_3 Two_D.FIX_sint32_sint32_sint32.All_Maps_FIX.Maps_Raster_3 Two_D.FIX_sint8_sint8_sint8.All_Maps_FIX.Maps_Raster_3 Two_D.FIX_uint16_uint16_uint16.All_Maps_FIX.Maps_Raster_3 Two_D.FIX_uint32_uint32_uint32.All_Maps_FIX.Maps_Raster_3 Two_D.FIX_uint8_uint8_uint8.All_Maps_FIX.Maps_Raster_3 Two_D.GRP_float32_float32_float32.All_Maps_GRP.Maps_Raster_3 Two_D.GRP_sint16_sint16_sint16.All_Maps_GRP.Maps_Raster_3 Two_D.GRP_sint32_sint32_sint32.All_Maps_GRP.Maps_Raster_3 Two_D.GRP_sint8_sint8_sint8.All_Maps_GRP.Maps_Raster_3 Two_D.GRP_uint16_uint16_uint16.All_Maps_GRP.Maps_Raster_3 Two_D.GRP_uint32_uint32_uint32.All_Maps_GRP.Maps_Raster_3 Two_D.GRP_uint8_uint8_uint8.All_Maps_GRP.Maps_Raster_3 /end REF_CHARACTERISTIC
/end GROUP
/begin RECORD_LAYOUT STANDARD_DIST_R32 AXIS_PTS_X 2 FLOAT32_IEEE INDEX_INCR DIRECT NO_AXIS_PTS_X 1 UWORD /end RECORD_LAYOUT
/begin RECORD_LAYOUT STANDARD_DIST_S16 AXIS_PTS_X 2 SWORD INDEX_INCR DIRECT NO_AXIS_PTS_X 1 UWORD /end RECORD_LAYOUT
/begin RECORD_LAYOUT STANDARD_DIST_S32 AXIS_PTS_X 2 SLONG INDEX_INCR DIRECT NO_AXIS_PTS_X 1 UWORD /end RECORD_LAYOUT
/begin RECORD_LAYOUT STANDARD_DIST_S8 AXIS_PTS_X 2 SBYTE INDEX_INCR DIRECT NO_AXIS_PTS_X 1 UBYTE /end RECORD_LAYOUT
/begin RECORD_LAYOUT STANDARD_DIST_U16 AXIS_PTS_X 2 UWORD INDEX_INCR DIRECT NO_AXIS_PTS_X 1 UWORD /end RECORD_LAYOUT
/begin RECORD_LAYOUT STANDARD_DIST_U32 AXIS_PTS_X 2 ULONG INDEX_INCR DIRECT NO_AXIS_PTS_X 1 UWORD /end RECORD_LAYOUT
/begin RECORD_LAYOUT STANDARD_DIST_U8 AXIS_PTS_X 2 UBYTE INDEX_INCR DIRECT NO_AXIS_PTS_X 1 UBYTE /end RECORD_LAYOUT
/begin RECORD_LAYOUT STANDARD_FIXED_R32 FNC_VALUES 1 FLOAT32_IEEE COLUMN_DIR DIRECT /end RECORD_LAYOUT
/begin RECORD_LAYOUT STANDARD_FIXED_S16 FNC_VALUES 1 SWORD COLUMN_DIR DIRECT /end RECORD_LAYOUT
/begin RECORD_LAYOUT STANDARD_FIXED_S32 FNC_VALUES 1 SLONG COLUMN_DIR DIRECT /end RECORD_LAYOUT
/begin RECORD_LAYOUT STANDARD_FIXED_S8 FNC_VALUES 1 SBYTE COLUMN_DIR DIRECT /end RECORD_LAYOUT
/begin RECORD_LAYOUT STANDARD_FIXED_U16 FNC_VALUES 1 UWORD COLUMN_DIR DIRECT /end RECORD_LAYOUT
/begin RECORD_LAYOUT STANDARD_FIXED_U32 FNC_VALUES 1 ULONG COLUMN_DIR DIRECT /end RECORD_LAYOUT
/begin RECORD_LAYOUT STANDARD_FIXED_U8 FNC_VALUES 1 UBYTE COLUMN_DIR DIRECT /end RECORD_LAYOUT
/begin RECORD_LAYOUT STANDARD_GROUP_R32 FNC_VALUES 1 FLOAT32_IEEE COLUMN_DIR DIRECT /end RECORD_LAYOUT
/begin RECORD_LAYOUT STANDARD_GROUP_S16 FNC_VALUES 1 SWORD COLUMN_DIR DIRECT /end RECORD_LAYOUT
/begin RECORD_LAYOUT STANDARD_GROUP_S32 FNC_VALUES 1 SLONG COLUMN_DIR DIRECT /end RECORD_LAYOUT
/begin RECORD_LAYOUT STANDARD_GROUP_S8 FNC_VALUES 1 SBYTE COLUMN_DIR DIRECT /end RECORD_LAYOUT
/begin RECORD_LAYOUT STANDARD_GROUP_U16 FNC_VALUES 1 UWORD COLUMN_DIR DIRECT /end RECORD_LAYOUT
/begin RECORD_LAYOUT STANDARD_GROUP_U32 FNC_VALUES 1 ULONG COLUMN_DIR DIRECT /end RECORD_LAYOUT
/begin RECORD_LAYOUT STANDARD_GROUP_U8 FNC_VALUES 1 UBYTE COLUMN_DIR DIRECT /end RECORD_LAYOUT
/begin RECORD_LAYOUT STANDARD_VALUE_R32 FNC_VALUES 1 FLOAT32_IEEE COLUMN_DIR DIRECT /end RECORD_LAYOUT
/begin RECORD_LAYOUT STANDARD_VALUE_S16 FNC_VALUES 1 SWORD COLUMN_DIR DIRECT /end RECORD_LAYOUT
/begin RECORD_LAYOUT STANDARD_VALUE_S32 FNC_VALUES 1 SLONG COLUMN_DIR DIRECT /end RECORD_LAYOUT
/begin RECORD_LAYOUT STANDARD_VALUE_S8 FNC_VALUES 1 SBYTE COLUMN_DIR DIRECT /end RECORD_LAYOUT
/begin RECORD_LAYOUT STANDARD_VALUE_U16 FNC_VALUES 1 UWORD COLUMN_DIR DIRECT /end RECORD_LAYOUT
/begin RECORD_LAYOUT STANDARD_VALUE_U32 FNC_VALUES 1 ULONG COLUMN_DIR DIRECT /end RECORD_LAYOUT
/begin RECORD_LAYOUT STANDARD_VALUE_U8 FNC_VALUES 1 UBYTE COLUMN_DIR DIRECT /end RECORD_LAYOUT
/end MODULE
/end PROJECT

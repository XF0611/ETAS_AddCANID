ASAP2_VERSION 1 40
/begin PROJECT ECU_Base_Prj_CAN3Mon_UdsFlashing "Generated by ETAS from Project ECU_Base_Prj_CAN3Mon_UdsFlashing"
/begin HEADER "" VERSION "000" PROJECT_NO ASD /end HEADER
/begin MODULE ECU_Base_Prj_CAN3Mon_UdsFlashing "Generated by ETAS from Project ECU_Base_Prj_CAN3Mon_UdsFlashing"
/begin MOD_COMMON "2009-04-06 10:39:06	create by ETASHexVirtualAddressTableHeaderV2" BYTE_ORDER MSB_FIRST ALIGNMENT_BYTE 1 ALIGNMENT_WORD 2 ALIGNMENT_LONG 4 ALIGNMENT_FLOAT32_IEEE 4 ALIGNMENT_FLOAT64_IEEE 8 /end MOD_COMMON
/begin CHARACTERISTIC calc_loops_16.Curve_Module "" VALUE 0x1D0CE4 STANDARD_VALUE_U16 0.0 ident 0 65535 /end CHARACTERISTIC
/begin CHARACTERISTIC calc_loops_32.Curve_Module "" VALUE 0x1D0CE6 STANDARD_VALUE_U16 0.0 ident 0 65535 /end CHARACTERISTIC
/begin CHARACTERISTIC curve_table.Curve_Calc_32.Curve_Module "" CURVE 0x1D0AA4 STANDARD_CURVE_U32U16 0.0 ident 0.0 65535.0
 /begin AXIS_DESCR STD_AXIS input_array.Curve_Calc_32.Curve_Module ident 10 0.0 4294967295.0 /end AXIS_DESCR
/end CHARACTERISTIC
/begin CHARACTERISTIC curve_table.Curve_Calc_real32.Curve_Module "" CURVE 0x1D0A48 STANDARD_CURVE_R32R32 0.0 ident -1.e+037 1.e+037
 /begin AXIS_DESCR STD_AXIS input_array.Curve_Calc_real32.Curve_Module ident 10 -1.e+037 1.e+037 /end AXIS_DESCR
/end CHARACTERISTIC
/begin CHARACTERISTIC EBYP_BitOff_OS01_En.Distab13_12T "" VALUE 0x1D1898 STANDARD_VALUE_U8 0.0 ident 0 7 /end CHARACTERISTIC
/begin CHARACTERISTIC EBYP_BitOff_OS01_V.Distab13_12T "" VALUE 0x1D1899 STANDARD_VALUE_U8 0.0 ident 0 7 /end CHARACTERISTIC
/begin CHARACTERISTIC EBYP_BitOff_OS02_En.Distab13_12T "" VALUE 0x1D189A STANDARD_VALUE_U8 0.0 ident 0 7 /end CHARACTERISTIC
/begin CHARACTERISTIC EBYP_BitOff_OS02_V.Distab13_12T "" VALUE 0x1D189B STANDARD_VALUE_U8 0.0 ident 0 7 /end CHARACTERISTIC
/begin CHARACTERISTIC EBYP_BitOff_OS03.Distab13_12T "" VALUE 0x1D189C STANDARD_VALUE_U8 0.0 ident 0 7 /end CHARACTERISTIC
/begin CHARACTERISTIC EBYP_BitOff_OS04.Distab13_12T "" VALUE 0x1D189D STANDARD_VALUE_U8 0.0 ident 0 7 /end CHARACTERISTIC
/begin CHARACTERISTIC EBYP_BitOff_OS05a.Distab13_12T "" VALUE 0x1D189E STANDARD_VALUE_U8 0.0 ident 0 7 /end CHARACTERISTIC
/begin CHARACTERISTIC EBYP_BitOff_OS05b.Distab13_12T "" VALUE 0x1D189F STANDARD_VALUE_U8 0.0 ident 0 7 /end CHARACTERISTIC
/begin CHARACTERISTIC EBYP_BitOff_OS05c.Distab13_12T "" VALUE 0x1D18A0 STANDARD_VALUE_U8 0.0 ident 0 7 /end CHARACTERISTIC
/begin CHARACTERISTIC EBYP_BitOff_OS06.Distab13_12T "" VALUE 0x1D18A1 STANDARD_VALUE_U8 0.0 ident 0 7 /end CHARACTERISTIC
/begin CHARACTERISTIC EBYP_BitOff_OS07.Distab13_12T "" VALUE 0x1D18A2 STANDARD_VALUE_U8 0.0 ident 0 7 /end CHARACTERISTIC
/begin CHARACTERISTIC EBYP_BitOff_OS08.Distab13_12T "" VALUE 0x1D18A3 STANDARD_VALUE_U8 0.0 ident 0 7 /end CHARACTERISTIC
/begin CHARACTERISTIC EBYP_BitOff_OS09.Distab13_12T "" VALUE 0x1D18A4 STANDARD_VALUE_U8 0.0 ident 0 7 /end CHARACTERISTIC
/begin CHARACTERISTIC EBYP_BitOff_OS10.Distab13_12T "" VALUE 0x1D18A5 STANDARD_VALUE_U8 0.0 ident 0 7 /end CHARACTERISTIC
/begin CHARACTERISTIC EBYP_BitOff_OS11.Distab13_12T "" VALUE 0x1D18A6 STANDARD_VALUE_U8 0.0 ident 0 7 /end CHARACTERISTIC
/begin CHARACTERISTIC EBYP_BitOff_OS12.Distab13_12T "" VALUE 0x1D18A7 STANDARD_VALUE_U8 0.0 ident 0 7 /end CHARACTERISTIC
/begin CHARACTERISTIC EBYP_BitOff_OS13.Distab13_12T "" VALUE 0x1D18A8 STANDARD_VALUE_U8 0.0 ident 0 7 /end CHARACTERISTIC
/begin CHARACTERISTIC EBYP_BitOff_OS14.Distab13_12T "" VALUE 0x1D18A9 STANDARD_VALUE_U8 0.0 ident 0 7 /end CHARACTERISTIC
/begin CHARACTERISTIC EBYP_BitOff_OS15.Distab13_12T "" VALUE 0x1D18AA STANDARD_VALUE_U8 0.0 ident 0 7 /end CHARACTERISTIC
/begin CHARACTERISTIC EBYP_BitOff_OSMR.Distab13_12T "" VALUE 0x1D18AB STANDARD_VALUE_U8 0.0 ident 0 7 /end CHARACTERISTIC
/begin CHARACTERISTIC EBYP_Off_OIC01_Dcyc.Distab13_12T "" VALUE 0x1D18AC STANDARD_VALUE_U8 0.0 ident 0 255 /end CHARACTERISTIC
/begin CHARACTERISTIC EBYP_Off_OIC02_Dcyc.Distab13_12T "" VALUE 0x1D18AD STANDARD_VALUE_U8 0.0 ident 0 255 /end CHARACTERISTIC
/begin CHARACTERISTIC EBYP_Off_OPI01_Dcyc.Distab13_12T "" VALUE 0x1D18AE STANDARD_VALUE_U8 0.0 ident 0 255 /end CHARACTERISTIC
/begin CHARACTERISTIC EBYP_Off_OPI02_Dcyc.Distab13_12T "" VALUE 0x1D18AF STANDARD_VALUE_U8 0.0 ident 0 255 /end CHARACTERISTIC
/begin CHARACTERISTIC EBYP_Off_OPI03_Dcyc.Distab13_12T "" VALUE 0x1D18B0 STANDARD_VALUE_U8 0.0 ident 0 255 /end CHARACTERISTIC
/begin CHARACTERISTIC EBYP_Off_OPI04_Dcyc.Distab13_12T "" VALUE 0x1D18B1 STANDARD_VALUE_U8 0.0 ident 0 255 /end CHARACTERISTIC
/begin CHARACTERISTIC EBYP_Off_OPI05_Dcyc.Distab13_12T "" VALUE 0x1D18B2 STANDARD_VALUE_U8 0.0 ident 0 255 /end CHARACTERISTIC
/begin CHARACTERISTIC EBYP_Off_OPI06_Dcyc.Distab13_12T "" VALUE 0x1D18B3 STANDARD_VALUE_U8 0.0 ident 0 255 /end CHARACTERISTIC
/begin CHARACTERISTIC EBYP_Off_OPI07_Dcyc.Distab13_12T "" VALUE 0x1D18B4 STANDARD_VALUE_U8 0.0 ident 0 255 /end CHARACTERISTIC
/begin CHARACTERISTIC EBYP_Off_OS01_En.Distab13_12T "" VALUE 0x1D18B5 STANDARD_VALUE_U8 0.0 ident 0 255 /end CHARACTERISTIC
/begin CHARACTERISTIC EBYP_Off_OS01_S_Dcyc.Distab13_12T "" VALUE 0x1D18B6 STANDARD_VALUE_U8 0.0 ident 0 255 /end CHARACTERISTIC
/begin CHARACTERISTIC EBYP_Off_OS01_V.Distab13_12T "" VALUE 0x1D18B7 STANDARD_VALUE_U8 0.0 ident 0 255 /end CHARACTERISTIC
/begin CHARACTERISTIC EBYP_Off_OS02_En.Distab13_12T "" VALUE 0x1D18B8 STANDARD_VALUE_U8 0.0 ident 0 255 /end CHARACTERISTIC
/begin CHARACTERISTIC EBYP_Off_OS02_S_Dcyc.Distab13_12T "" VALUE 0x1D18B9 STANDARD_VALUE_U8 0.0 ident 0 255 /end CHARACTERISTIC
/begin CHARACTERISTIC EBYP_Off_OS02_V.Distab13_12T "" VALUE 0x1D18BA STANDARD_VALUE_U8 0.0 ident 0 255 /end CHARACTERISTIC
/begin CHARACTERISTIC EBYP_Off_OS03.Distab13_12T "" VALUE 0x1D18BB STANDARD_VALUE_U8 0.0 ident 0 255 /end CHARACTERISTIC
/begin CHARACTERISTIC EBYP_Off_OS04.Distab13_12T "" VALUE 0x1D18BC STANDARD_VALUE_U8 0.0 ident 0 255 /end CHARACTERISTIC
/begin CHARACTERISTIC EBYP_Off_OS05a.Distab13_12T "" VALUE 0x1D18BD STANDARD_VALUE_U8 0.0 ident 0 255 /end CHARACTERISTIC
/begin CHARACTERISTIC EBYP_Off_OS05b.Distab13_12T "" VALUE 0x1D18BE STANDARD_VALUE_U8 0.0 ident 0 255 /end CHARACTERISTIC
/begin CHARACTERISTIC EBYP_Off_OS05c.Distab13_12T "" VALUE 0x1D18BF STANDARD_VALUE_U8 0.0 ident 0 255 /end CHARACTERISTIC
/begin CHARACTERISTIC EBYP_Off_OS06.Distab13_12T "" VALUE 0x1D18C0 STANDARD_VALUE_U8 0.0 ident 0 255 /end CHARACTERISTIC
/begin CHARACTERISTIC EBYP_Off_OS07.Distab13_12T "" VALUE 0x1D18C1 STANDARD_VALUE_U8 0.0 ident 0 255 /end CHARACTERISTIC
/begin CHARACTERISTIC EBYP_Off_OS08.Distab13_12T "" VALUE 0x1D18C2 STANDARD_VALUE_U8 0.0 ident 0 255 /end CHARACTERISTIC
/begin CHARACTERISTIC EBYP_Off_OS09.Distab13_12T "" VALUE 0x1D18C3 STANDARD_VALUE_U8 0.0 ident 0 255 /end CHARACTERISTIC
/begin CHARACTERISTIC EBYP_Off_OS10.Distab13_12T "" VALUE 0x1D18C4 STANDARD_VALUE_U8 0.0 ident 0 255 /end CHARACTERISTIC
/begin CHARACTERISTIC EBYP_Off_OS11.Distab13_12T "" VALUE 0x1D18C5 STANDARD_VALUE_U8 0.0 ident 0 255 /end CHARACTERISTIC
/begin CHARACTERISTIC EBYP_Off_OS12.Distab13_12T "" VALUE 0x1D18C6 STANDARD_VALUE_U8 0.0 ident 0 255 /end CHARACTERISTIC
/begin CHARACTERISTIC EBYP_Off_OS13.Distab13_12T "" VALUE 0x1D18C7 STANDARD_VALUE_U8 0.0 ident 0 255 /end CHARACTERISTIC
/begin CHARACTERISTIC EBYP_Off_OS14.Distab13_12T "" VALUE 0x1D18C8 STANDARD_VALUE_U8 0.0 ident 0 255 /end CHARACTERISTIC
/begin CHARACTERISTIC EBYP_Off_OS15.Distab13_12T "" VALUE 0x1D18C9 STANDARD_VALUE_U8 0.0 ident 0 255 /end CHARACTERISTIC
/begin CHARACTERISTIC EBYP_Off_OSMR.Distab13_12T "" VALUE 0x1D18CA STANDARD_VALUE_U8 0.0 ident 0 255 /end CHARACTERISTIC
/begin CHARACTERISTIC KL_Direct_fl32.Curve_Mod "" CURVE 0x1D0BC8 STANDARD_CURVE_R64R64 0.0 ident -1.e+037 1.e+037
 /begin AXIS_DESCR STD_AXIS M_In_KL_Direct_fl32.Curve_Mod ident 8 -1.e+037 1.e+037 /end AXIS_DESCR
/end CHARACTERISTIC
/begin CHARACTERISTIC KL1_Distr_fl32_Distrib1.Curve_Mod "" CURVE 0x1D0B08 STANDARD_GROUP_R64 0.0 ident -1.e+037 1.e+037
 /begin AXIS_DESCR COM_AXIS M_In_fl32_Distrib1.Curve_Mod ident 8 -1.e+037 1.e+037 AXIS_PTS_REF Distrib1.Curve_Mod /end AXIS_DESCR
/end CHARACTERISTIC
/begin CHARACTERISTIC KL2_Distr_fl32_Distrib1.Curve_Mod "" CURVE 0x1D0B48 STANDARD_GROUP_R64 0.0 ident -1.e+037 1.e+037
 /begin AXIS_DESCR COM_AXIS M_In_fl32_Distrib1.Curve_Mod ident 8 -1.e+037 1.e+037 AXIS_PTS_REF Distrib1.Curve_Mod /end AXIS_DESCR
/end CHARACTERISTIC
/begin CHARACTERISTIC KL3_Distr_fl32_Distrib2.Curve_Mod "" CURVE 0x1D0B88 STANDARD_GROUP_R64 0.0 ident -1.e+037 1.e+037
 /begin AXIS_DESCR COM_AXIS M_In_fl32_Distrib2.Curve_Mod ident 8 -1.e+037 1.e+037 AXIS_PTS_REF Distrib2.Curve_Mod /end AXIS_DESCR
/end CHARACTERISTIC
/begin CHARACTERISTIC nr_of_cells.Curve_Calc_32.Curve_Module "" VALUE 0x1D0AA0 STANDARD_VALUE_U8 0.0 ident 0 255 /end CHARACTERISTIC
/begin CHARACTERISTIC nr_of_cells.Curve_Calc_real32.Curve_Module "" VALUE 0x1D0A44 STANDARD_VALUE_U8 0.0 ident 0 255 /end CHARACTERISTIC
/begin CHARACTERISTIC P_AML1_1_3P2R_Compatibility.Distab13_12T "True = 3Measurement +2 Bypass Raster Compatible to AML 1.1 and Triggermode  1 (MAC2/ES1200/ES1201) " VALUE 0x1D18CB STANDARD_VALUE_U8 0.0 ident 0 1 BIT_MASK 0x1 /end CHARACTERISTIC
/begin CHARACTERISTIC P_Byp_Roundtrip_Timeout_Time.Distab13_12T "" VALUE 0x1D1894 STANDARD_VALUE_U32 0.0 TickType2ms 0.0 1227133.512857143 /end CHARACTERISTIC
/begin CHARACTERISTIC p_DiagBSmax_u8.DiagKwpUds "" VALUE 0x1D1891 STANDARD_VALUE_U8 0.0 ident 0 255 /end CHARACTERISTIC
/begin CHARACTERISTIC p_DiagSTmin_u8.DiagKwpUds "" VALUE 0x1D1890 STANDARD_VALUE_U8 0.0 ident 0 255 /end CHARACTERISTIC
/begin CHARACTERISTIC P_Do_Curves.Curves_Raster_1 "" VALUE 0x1D0CF0 STANDARD_VALUE_U8 0.0 ident 0 1 BIT_MASK 0x1 /end CHARACTERISTIC
/begin CHARACTERISTIC P_Do_Curves.Curves_Raster_2 "" VALUE 0x1D10D0 STANDARD_VALUE_U8 0.0 ident 0 1 BIT_MASK 0x1 /end CHARACTERISTIC
/begin CHARACTERISTIC P_Do_Curves.Curves_Raster_3 "" VALUE 0x1D14B0 STANDARD_VALUE_U8 0.0 ident 0 1 BIT_MASK 0x1 /end CHARACTERISTIC
/begin CHARACTERISTIC P_Do_TRG_Without_Distab.Distab13_12T "" VALUE 0x1D18CC STANDARD_VALUE_U8 0.0 ident 0 1 BIT_MASK 0x1 /end CHARACTERISTIC
/begin CHARACTERISTIC P_Enable.Dist_B01.Distab13_12T "" VALUE 0x1D18DC STANDARD_VALUE_U8 0.0 ident 0 1 BIT_MASK 0x1 /end CHARACTERISTIC
/begin CHARACTERISTIC P_Enable.Dist_B02.Distab13_12T "" VALUE 0x1D18F4 STANDARD_VALUE_U8 0.0 ident 0 1 BIT_MASK 0x1 /end CHARACTERISTIC
/begin CHARACTERISTIC P_Enable.Dist_B03.Distab13_12T "" VALUE 0x1D190C STANDARD_VALUE_U8 0.0 ident 0 1 BIT_MASK 0x1 /end CHARACTERISTIC
/begin CHARACTERISTIC P_Enable.Dist_B04.Distab13_12T "" VALUE 0x1D1924 STANDARD_VALUE_U8 0.0 ident 0 1 BIT_MASK 0x1 /end CHARACTERISTIC
/begin CHARACTERISTIC P_Enable.Dist_R01.Distab13_12T "" VALUE 0x1D193C STANDARD_VALUE_U8 0.0 ident 0 1 BIT_MASK 0x1 /end CHARACTERISTIC
/begin CHARACTERISTIC P_Enable.Dist_R02.Distab13_12T "" VALUE 0x1D194C STANDARD_VALUE_U8 0.0 ident 0 1 BIT_MASK 0x1 /end CHARACTERISTIC
/begin CHARACTERISTIC P_Enable.Dist_R03.Distab13_12T "" VALUE 0x1D195C STANDARD_VALUE_U8 0.0 ident 0 1 BIT_MASK 0x1 /end CHARACTERISTIC
/begin CHARACTERISTIC P_Enable.Dist_R04.Distab13_12T "" VALUE 0x1D196C STANDARD_VALUE_U8 0.0 ident 0 1 BIT_MASK 0x1 /end CHARACTERISTIC
/begin CHARACTERISTIC P_Enable.Dist_R05.Distab13_12T "" VALUE 0x1D197C STANDARD_VALUE_U8 0.0 ident 0 1 BIT_MASK 0x1 /end CHARACTERISTIC
/begin CHARACTERISTIC P_Enable.Dist_R06.Distab13_12T "" VALUE 0x1D198C STANDARD_VALUE_U8 0.0 ident 0 1 BIT_MASK 0x1 /end CHARACTERISTIC
/begin CHARACTERISTIC P_Enable.Dist_R07.Distab13_12T "" VALUE 0x1D199C STANDARD_VALUE_U8 0.0 ident 0 1 BIT_MASK 0x1 /end CHARACTERISTIC
/begin CHARACTERISTIC P_Enable.Dist_R08.Distab13_12T "" VALUE 0x1D19AC STANDARD_VALUE_U8 0.0 ident 0 1 BIT_MASK 0x1 /end CHARACTERISTIC
/begin CHARACTERISTIC P_Enable.Dist_R09.Distab13_12T "" VALUE 0x1D19BC STANDARD_VALUE_U8 0.0 ident 0 1 BIT_MASK 0x1 /end CHARACTERISTIC
/begin CHARACTERISTIC P_Enable.Dist_R10.Distab13_12T "" VALUE 0x1D19CC STANDARD_VALUE_U8 0.0 ident 0 1 BIT_MASK 0x1 /end CHARACTERISTIC
/begin CHARACTERISTIC P_Enable.Dist_R11.Distab13_12T "" VALUE 0x1D19DC STANDARD_VALUE_U8 0.0 ident 0 1 BIT_MASK 0x1 /end CHARACTERISTIC
/begin CHARACTERISTIC P_Enable.Dist_R12.Distab13_12T "" VALUE 0x1D19EC STANDARD_VALUE_U8 0.0 ident 0 1 BIT_MASK 0x1 /end CHARACTERISTIC
/begin CHARACTERISTIC P_Enable_ETK.Distab13_12T "" VALUE 0x1D18CD STANDARD_VALUE_U8 0.0 ident 0 1 BIT_MASK 0x1 /end CHARACTERISTIC
/begin CHARACTERISTIC P_In_fl32_Distrib1.Curve_Mod "" VALUE 0x1D0AF8 STANDARD_VALUE_R64 0.0 ident -1.e+037 1.e+037 /end CHARACTERISTIC
/begin CHARACTERISTIC P_In_fl32_Distrib2.Curve_Mod "" VALUE 0x1D0B00 STANDARD_VALUE_R64 0.0 ident -1.e+037 1.e+037 /end CHARACTERISTIC
/begin CHARACTERISTIC P_In_KL_Direct_fl32.Curve_Mod "" VALUE 0x1D0AF0 STANDARD_VALUE_R64 0.0 ident -1.e+037 1.e+037 /end CHARACTERISTIC
/begin CHARACTERISTIC p_ResetTimer_b.EV0_Roundtrip.XCP_SHELL "" VALUE 0x1D9A84 STANDARD_VALUE_U8 0.0 ident 0 1 BIT_MASK 0x1 /end CHARACTERISTIC
/begin CHARACTERISTIC p_ResetTimer_b.EV0_Rx.XCP_SHELL "" VALUE 0x1D9A90 STANDARD_VALUE_U8 0.0 ident 0 1 BIT_MASK 0x1 /end CHARACTERISTIC
/begin CHARACTERISTIC p_ResetTimer_b.EV0_Sample.XCP_SHELL "" VALUE 0x1D9AA0 STANDARD_VALUE_U8 0.0 ident 0 1 BIT_MASK 0x1 /end CHARACTERISTIC
/begin CHARACTERISTIC p_ResetTimer_b.EV0_Stim.XCP_SHELL "" VALUE 0x1D9AAC STANDARD_VALUE_U8 0.0 ident 0 1 BIT_MASK 0x1 /end CHARACTERISTIC
/begin CHARACTERISTIC p_ResetTimer_b.EV0_Tx.XCP_SHELL "" VALUE 0x1D9AB8 STANDARD_VALUE_U8 0.0 ident 0 1 BIT_MASK 0x1 /end CHARACTERISTIC
/begin CHARACTERISTIC P_TRG_Direct.Dist_B01.Distab13_12T "" VALUE 0x1D18DE STANDARD_VALUE_U8 0.0 ident 0 1 BIT_MASK 0x1 /end CHARACTERISTIC
/begin CHARACTERISTIC P_TRG_Direct.Dist_B02.Distab13_12T "" VALUE 0x1D18F6 STANDARD_VALUE_U8 0.0 ident 0 1 BIT_MASK 0x1 /end CHARACTERISTIC
/begin CHARACTERISTIC P_TRG_Direct.Dist_B03.Distab13_12T "" VALUE 0x1D190E STANDARD_VALUE_U8 0.0 ident 0 1 BIT_MASK 0x1 /end CHARACTERISTIC
/begin CHARACTERISTIC P_TRG_Direct.Dist_B04.Distab13_12T "" VALUE 0x1D1926 STANDARD_VALUE_U8 0.0 ident 0 1 BIT_MASK 0x1 /end CHARACTERISTIC
/begin CHARACTERISTIC P_TRG_Direct.Dist_R01.Distab13_12T "" VALUE 0x1D193E STANDARD_VALUE_U8 0.0 ident 0 1 BIT_MASK 0x1 /end CHARACTERISTIC
/begin CHARACTERISTIC P_TRG_Direct.Dist_R02.Distab13_12T "" VALUE 0x1D194E STANDARD_VALUE_U8 0.0 ident 0 1 BIT_MASK 0x1 /end CHARACTERISTIC
/begin CHARACTERISTIC P_TRG_Direct.Dist_R03.Distab13_12T "" VALUE 0x1D195E STANDARD_VALUE_U8 0.0 ident 0 1 BIT_MASK 0x1 /end CHARACTERISTIC
/begin CHARACTERISTIC P_TRG_Direct.Dist_R04.Distab13_12T "" VALUE 0x1D196E STANDARD_VALUE_U8 0.0 ident 0 1 BIT_MASK 0x1 /end CHARACTERISTIC
/begin CHARACTERISTIC P_TRG_Direct.Dist_R05.Distab13_12T "" VALUE 0x1D197E STANDARD_VALUE_U8 0.0 ident 0 1 BIT_MASK 0x1 /end CHARACTERISTIC
/begin CHARACTERISTIC P_TRG_Direct.Dist_R06.Distab13_12T "" VALUE 0x1D198E STANDARD_VALUE_U8 0.0 ident 0 1 BIT_MASK 0x1 /end CHARACTERISTIC
/begin CHARACTERISTIC P_TRG_Direct.Dist_R07.Distab13_12T "" VALUE 0x1D199E STANDARD_VALUE_U8 0.0 ident 0 1 BIT_MASK 0x1 /end CHARACTERISTIC
/begin CHARACTERISTIC P_TRG_Direct.Dist_R08.Distab13_12T "" VALUE 0x1D19AE STANDARD_VALUE_U8 0.0 ident 0 1 BIT_MASK 0x1 /end CHARACTERISTIC
/begin CHARACTERISTIC P_TRG_Direct.Dist_R09.Distab13_12T "" VALUE 0x1D19BE STANDARD_VALUE_U8 0.0 ident 0 1 BIT_MASK 0x1 /end CHARACTERISTIC
/begin CHARACTERISTIC P_TRG_Direct.Dist_R10.Distab13_12T "" VALUE 0x1D19CE STANDARD_VALUE_U8 0.0 ident 0 1 BIT_MASK 0x1 /end CHARACTERISTIC
/begin CHARACTERISTIC P_TRG_Direct.Dist_R11.Distab13_12T "" VALUE 0x1D19DE STANDARD_VALUE_U8 0.0 ident 0 1 BIT_MASK 0x1 /end CHARACTERISTIC
/begin CHARACTERISTIC P_TRG_Direct.Dist_R12.Distab13_12T "" VALUE 0x1D19EE STANDARD_VALUE_U8 0.0 ident 0 1 BIT_MASK 0x1 /end CHARACTERISTIC
/begin CHARACTERISTIC P_TRG_Nr.Dist_B01.Distab13_12T "" VALUE 0x1D18DF STANDARD_VALUE_U8 0.0 ident 0 15 /end CHARACTERISTIC
/begin CHARACTERISTIC P_TRG_Nr.Dist_B02.Distab13_12T "" VALUE 0x1D18F7 STANDARD_VALUE_U8 0.0 ident 0 15 /end CHARACTERISTIC
/begin CHARACTERISTIC P_TRG_Nr.Dist_B03.Distab13_12T "" VALUE 0x1D190F STANDARD_VALUE_U8 0.0 ident 0 15 /end CHARACTERISTIC
/begin CHARACTERISTIC P_TRG_Nr.Dist_B04.Distab13_12T "" VALUE 0x1D1927 STANDARD_VALUE_U8 0.0 ident 0 15 /end CHARACTERISTIC
/begin CHARACTERISTIC P_TRG_Nr.Dist_R01.Distab13_12T "" VALUE 0x1D193F STANDARD_VALUE_U8 0.0 ident 0 15 /end CHARACTERISTIC
/begin CHARACTERISTIC P_TRG_Nr.Dist_R02.Distab13_12T "" VALUE 0x1D194F STANDARD_VALUE_U8 0.0 ident 0 15 /end CHARACTERISTIC
/begin CHARACTERISTIC P_TRG_Nr.Dist_R03.Distab13_12T "" VALUE 0x1D195F STANDARD_VALUE_U8 0.0 ident 0 15 /end CHARACTERISTIC
/begin CHARACTERISTIC P_TRG_Nr.Dist_R04.Distab13_12T "" VALUE 0x1D196F STANDARD_VALUE_U8 0.0 ident 0 15 /end CHARACTERISTIC
/begin CHARACTERISTIC P_TRG_Nr.Dist_R05.Distab13_12T "" VALUE 0x1D197F STANDARD_VALUE_U8 0.0 ident 0 15 /end CHARACTERISTIC
/begin CHARACTERISTIC P_TRG_Nr.Dist_R06.Distab13_12T "" VALUE 0x1D198F STANDARD_VALUE_U8 0.0 ident 0 15 /end CHARACTERISTIC
/begin CHARACTERISTIC P_TRG_Nr.Dist_R07.Distab13_12T "" VALUE 0x1D199F STANDARD_VALUE_U8 0.0 ident 0 15 /end CHARACTERISTIC
/begin CHARACTERISTIC P_TRG_Nr.Dist_R08.Distab13_12T "" VALUE 0x1D19AF STANDARD_VALUE_U8 0.0 ident 0 15 /end CHARACTERISTIC
/begin CHARACTERISTIC P_TRG_Nr.Dist_R09.Distab13_12T "" VALUE 0x1D19BF STANDARD_VALUE_U8 0.0 ident 0 15 /end CHARACTERISTIC
/begin CHARACTERISTIC P_TRG_Nr.Dist_R10.Distab13_12T "" VALUE 0x1D19CF STANDARD_VALUE_U8 0.0 ident 0 15 /end CHARACTERISTIC
/begin CHARACTERISTIC P_TRG_Nr.Dist_R11.Distab13_12T "" VALUE 0x1D19DF STANDARD_VALUE_U8 0.0 ident 0 15 /end CHARACTERISTIC
/begin CHARACTERISTIC P_TRG_Nr.Dist_R12.Distab13_12T "" VALUE 0x1D19EF STANDARD_VALUE_U8 0.0 ident 0 15 /end CHARACTERISTIC
/begin CHARACTERISTIC P_TRG_Val.Dist_B01.Distab13_12T "" VALUE 0x1D18D8 STANDARD_VALUE_U32 0.0 ident 0 4294967295 /end CHARACTERISTIC
/begin CHARACTERISTIC P_TRG_Val.Dist_B02.Distab13_12T "" VALUE 0x1D18F0 STANDARD_VALUE_U32 0.0 ident 0 4294967295 /end CHARACTERISTIC
/begin CHARACTERISTIC P_TRG_Val.Dist_B03.Distab13_12T "" VALUE 0x1D1908 STANDARD_VALUE_U32 0.0 ident 0 4294967295 /end CHARACTERISTIC
/begin CHARACTERISTIC P_TRG_Val.Dist_B04.Distab13_12T "" VALUE 0x1D1920 STANDARD_VALUE_U32 0.0 ident 0 4294967295 /end CHARACTERISTIC
/begin CHARACTERISTIC P_TRG_Val.Dist_R01.Distab13_12T "" VALUE 0x1D1938 STANDARD_VALUE_U32 0.0 ident 0 4294967295 /end CHARACTERISTIC
/begin CHARACTERISTIC P_TRG_Val.Dist_R02.Distab13_12T "" VALUE 0x1D1948 STANDARD_VALUE_U32 0.0 ident 0 4294967295 /end CHARACTERISTIC
/begin CHARACTERISTIC P_TRG_Val.Dist_R03.Distab13_12T "" VALUE 0x1D1958 STANDARD_VALUE_U32 0.0 ident 0 4294967295 /end CHARACTERISTIC
/begin CHARACTERISTIC P_TRG_Val.Dist_R04.Distab13_12T "" VALUE 0x1D1968 STANDARD_VALUE_U32 0.0 ident 0 4294967295 /end CHARACTERISTIC
/begin CHARACTERISTIC P_TRG_Val.Dist_R05.Distab13_12T "" VALUE 0x1D1978 STANDARD_VALUE_U32 0.0 ident 0 4294967295 /end CHARACTERISTIC
/begin CHARACTERISTIC P_TRG_Val.Dist_R06.Distab13_12T "" VALUE 0x1D1988 STANDARD_VALUE_U32 0.0 ident 0 4294967295 /end CHARACTERISTIC
/begin CHARACTERISTIC P_TRG_Val.Dist_R07.Distab13_12T "" VALUE 0x1D1998 STANDARD_VALUE_U32 0.0 ident 0 4294967295 /end CHARACTERISTIC
/begin CHARACTERISTIC P_TRG_Val.Dist_R08.Distab13_12T "" VALUE 0x1D19A8 STANDARD_VALUE_U32 0.0 ident 0 4294967295 /end CHARACTERISTIC
/begin CHARACTERISTIC P_TRG_Val.Dist_R09.Distab13_12T "" VALUE 0x1D19B8 STANDARD_VALUE_U32 0.0 ident 0 4294967295 /end CHARACTERISTIC
/begin CHARACTERISTIC P_TRG_Val.Dist_R10.Distab13_12T "" VALUE 0x1D19C8 STANDARD_VALUE_U32 0.0 ident 0 4294967295 /end CHARACTERISTIC
/begin CHARACTERISTIC P_TRG_Val.Dist_R11.Distab13_12T "" VALUE 0x1D19D8 STANDARD_VALUE_U32 0.0 ident 0 4294967295 /end CHARACTERISTIC
/begin CHARACTERISTIC P_TRG_Val.Dist_R12.Distab13_12T "" VALUE 0x1D19E8 STANDARD_VALUE_U32 0.0 ident 0 4294967295 /end CHARACTERISTIC
/begin CHARACTERISTIC P_TRGID_Nr.Dist_B01.Distab13_12T "" VALUE 0x1D18DD STANDARD_VALUE_U8 0.0 ident 0 31 /end CHARACTERISTIC
/begin CHARACTERISTIC P_TRGID_Nr.Dist_B02.Distab13_12T "" VALUE 0x1D18F5 STANDARD_VALUE_U8 0.0 ident 0 31 /end CHARACTERISTIC
/begin CHARACTERISTIC P_TRGID_Nr.Dist_B03.Distab13_12T "" VALUE 0x1D190D STANDARD_VALUE_U8 0.0 ident 0 31 /end CHARACTERISTIC
/begin CHARACTERISTIC P_TRGID_Nr.Dist_B04.Distab13_12T "" VALUE 0x1D1925 STANDARD_VALUE_U8 0.0 ident 0 31 /end CHARACTERISTIC
/begin CHARACTERISTIC P_TRGID_Nr.Dist_R01.Distab13_12T "" VALUE 0x1D193D STANDARD_VALUE_U8 0.0 ident 0 31 /end CHARACTERISTIC
/begin CHARACTERISTIC P_TRGID_Nr.Dist_R02.Distab13_12T "" VALUE 0x1D194D STANDARD_VALUE_U8 0.0 ident 0 31 /end CHARACTERISTIC
/begin CHARACTERISTIC P_TRGID_Nr.Dist_R03.Distab13_12T "" VALUE 0x1D195D STANDARD_VALUE_U8 0.0 ident 0 31 /end CHARACTERISTIC
/begin CHARACTERISTIC P_TRGID_Nr.Dist_R04.Distab13_12T "" VALUE 0x1D196D STANDARD_VALUE_U8 0.0 ident 0 31 /end CHARACTERISTIC
/begin CHARACTERISTIC P_TRGID_Nr.Dist_R05.Distab13_12T "" VALUE 0x1D197D STANDARD_VALUE_U8 0.0 ident 0 31 /end CHARACTERISTIC
/begin CHARACTERISTIC P_TRGID_Nr.Dist_R06.Distab13_12T "" VALUE 0x1D198D STANDARD_VALUE_U8 0.0 ident 0 31 /end CHARACTERISTIC
/begin CHARACTERISTIC P_TRGID_Nr.Dist_R07.Distab13_12T "" VALUE 0x1D199D STANDARD_VALUE_U8 0.0 ident 0 31 /end CHARACTERISTIC
/begin CHARACTERISTIC P_TRGID_Nr.Dist_R08.Distab13_12T "" VALUE 0x1D19AD STANDARD_VALUE_U8 0.0 ident 0 31 /end CHARACTERISTIC
/begin CHARACTERISTIC P_TRGID_Nr.Dist_R09.Distab13_12T "" VALUE 0x1D19BD STANDARD_VALUE_U8 0.0 ident 0 31 /end CHARACTERISTIC
/begin CHARACTERISTIC P_TRGID_Nr.Dist_R10.Distab13_12T "" VALUE 0x1D19CD STANDARD_VALUE_U8 0.0 ident 0 31 /end CHARACTERISTIC
/begin CHARACTERISTIC P_TRGID_Nr.Dist_R11.Distab13_12T "" VALUE 0x1D19DD STANDARD_VALUE_U8 0.0 ident 0 31 /end CHARACTERISTIC
/begin CHARACTERISTIC P_TRGID_Nr.Dist_R12.Distab13_12T "" VALUE 0x1D19ED STANDARD_VALUE_U8 0.0 ident 0 31 /end CHARACTERISTIC
/begin CHARACTERISTIC P_TRGID_Val.Dist_B01.Distab13_12T "" VALUE 0x1D18D4 STANDARD_VALUE_U32 0.0 ident 0 4294967295 /end CHARACTERISTIC
/begin CHARACTERISTIC P_TRGID_Val.Dist_B02.Distab13_12T "" VALUE 0x1D18EC STANDARD_VALUE_U32 0.0 ident 0 4294967295 /end CHARACTERISTIC
/begin CHARACTERISTIC P_TRGID_Val.Dist_B03.Distab13_12T "" VALUE 0x1D1904 STANDARD_VALUE_U32 0.0 ident 0 4294967295 /end CHARACTERISTIC
/begin CHARACTERISTIC P_TRGID_Val.Dist_B04.Distab13_12T "" VALUE 0x1D191C STANDARD_VALUE_U32 0.0 ident 0 4294967295 /end CHARACTERISTIC
/begin CHARACTERISTIC P_TRGID_Val.Dist_R01.Distab13_12T "" VALUE 0x1D1934 STANDARD_VALUE_U32 0.0 ident 0 4294967295 /end CHARACTERISTIC
/begin CHARACTERISTIC P_TRGID_Val.Dist_R02.Distab13_12T "" VALUE 0x1D1944 STANDARD_VALUE_U32 0.0 ident 0 4294967295 /end CHARACTERISTIC
/begin CHARACTERISTIC P_TRGID_Val.Dist_R03.Distab13_12T "" VALUE 0x1D1954 STANDARD_VALUE_U32 0.0 ident 0 4294967295 /end CHARACTERISTIC
/begin CHARACTERISTIC P_TRGID_Val.Dist_R04.Distab13_12T "" VALUE 0x1D1964 STANDARD_VALUE_U32 0.0 ident 0 4294967295 /end CHARACTERISTIC
/begin CHARACTERISTIC P_TRGID_Val.Dist_R05.Distab13_12T "" VALUE 0x1D1974 STANDARD_VALUE_U32 0.0 ident 0 4294967295 /end CHARACTERISTIC
/begin CHARACTERISTIC P_TRGID_Val.Dist_R06.Distab13_12T "" VALUE 0x1D1984 STANDARD_VALUE_U32 0.0 ident 0 4294967295 /end CHARACTERISTIC
/begin CHARACTERISTIC P_TRGID_Val.Dist_R07.Distab13_12T "" VALUE 0x1D1994 STANDARD_VALUE_U32 0.0 ident 0 4294967295 /end CHARACTERISTIC
/begin CHARACTERISTIC P_TRGID_Val.Dist_R08.Distab13_12T "" VALUE 0x1D19A4 STANDARD_VALUE_U32 0.0 ident 0 4294967295 /end CHARACTERISTIC
/begin CHARACTERISTIC P_TRGID_Val.Dist_R09.Distab13_12T "" VALUE 0x1D19B4 STANDARD_VALUE_U32 0.0 ident 0 4294967295 /end CHARACTERISTIC
/begin CHARACTERISTIC P_TRGID_Val.Dist_R10.Distab13_12T "" VALUE 0x1D19C4 STANDARD_VALUE_U32 0.0 ident 0 4294967295 /end CHARACTERISTIC
/begin CHARACTERISTIC P_TRGID_Val.Dist_R11.Distab13_12T "" VALUE 0x1D19D4 STANDARD_VALUE_U32 0.0 ident 0 4294967295 /end CHARACTERISTIC
/begin CHARACTERISTIC P_TRGID_Val.Dist_R12.Distab13_12T "" VALUE 0x1D19E4 STANDARD_VALUE_U32 0.0 ident 0 4294967295 /end CHARACTERISTIC
/begin CHARACTERISTIC P_Wait_Bypass_Roundtrip.Distab13_12T "" VALUE 0x1D18CE STANDARD_VALUE_U8 0.0 ident 0 1 BIT_MASK 0x1 /end CHARACTERISTIC
/begin CHARACTERISTIC PageSwitch_On.Curve_Module "" VALUE 0x1D0CE8 STANDARD_VALUE_S8 0.0 ident 0 1 BIT_MASK 0x1 /end CHARACTERISTIC
/begin CHARACTERISTIC testPara.Curve_Module "" VALUE 0x1D0CE9 STANDARD_VALUE_U8 0.0 ident 0 255 /end CHARACTERISTIC
/begin CHARACTERISTIC TST_OIC01_Dcyc.Distab13_12T "" VALUE 0x1D19F0 STANDARD_VALUE_U16 0.0 TPU_Dcyc 0.0 100.0 /end CHARACTERISTIC
/begin CHARACTERISTIC TST_OIC02_Dcyc.Distab13_12T "" VALUE 0x1D19F2 STANDARD_VALUE_U16 0.0 TPU_Dcyc 0.0 100.0 /end CHARACTERISTIC
/begin CHARACTERISTIC TST_OPI01_Dcyc.Distab13_12T "" VALUE 0x1D19FA STANDARD_VALUE_U16 0.0 TPU_Dcyc 0.0 100.0 /end CHARACTERISTIC
/begin CHARACTERISTIC TST_OPI02_Dcyc.Distab13_12T "" VALUE 0x1D1A20 STANDARD_VALUE_U16 0.0 TPU_Dcyc 0.0 100.0 /end CHARACTERISTIC
/begin CHARACTERISTIC TST_OPI03_Dcyc.Distab13_12T "" VALUE 0x1D1A14 STANDARD_VALUE_U16 0.0 TPU_Dcyc 0.0 100.0 /end CHARACTERISTIC
/begin CHARACTERISTIC TST_OPI04_Dcyc.Distab13_12T "" VALUE 0x1D1A1A STANDARD_VALUE_U16 0.0 TPU_Dcyc 0.0 100.0 /end CHARACTERISTIC
/begin CHARACTERISTIC TST_OPI05_Dcyc.Distab13_12T "" VALUE 0x1D1A24 STANDARD_VALUE_U16 0.0 TPU_Dcyc 0.0 100.0 /end CHARACTERISTIC
/begin CHARACTERISTIC TST_OPI06_Dcyc.Distab13_12T "" VALUE 0x1D19F4 STANDARD_VALUE_U16 0.0 TPU_Dcyc 0.0 100.0 /end CHARACTERISTIC
/begin CHARACTERISTIC TST_OPI07_Dcyc.Distab13_12T "" VALUE 0x1D1A04 STANDARD_VALUE_U16 0.0 TPU_Dcyc 0.0 100.0 /end CHARACTERISTIC
/begin CHARACTERISTIC TST_OPI08_Dcyc.Distab13_12T "" VALUE 0x1D1A18 STANDARD_VALUE_U16 0.0 TPU_Dcyc 0.0 100.0 /end CHARACTERISTIC
/begin CHARACTERISTIC TST_OPI09_Dcyc.Distab13_12T "" VALUE 0x1D1A16 STANDARD_VALUE_U16 0.0 TPU_Dcyc 0.0 100.0 /end CHARACTERISTIC
/begin CHARACTERISTIC TST_OPI10_Dcyc.Distab13_12T "" VALUE 0x1D19F6 STANDARD_VALUE_U16 0.0 TPU_Dcyc 0.0 100.0 /end CHARACTERISTIC
/begin CHARACTERISTIC TST_OPI11_Dcyc.Distab13_12T "" VALUE 0x1D1A0A STANDARD_VALUE_U16 0.0 TPU_Dcyc 0.0 100.0 /end CHARACTERISTIC
/begin CHARACTERISTIC TST_OS_MR.Distab13_12T "" VALUE 0x1D19FC STANDARD_VALUE_U8 0.0 ident 0 1 BIT_MASK 0x1 /end CHARACTERISTIC
/begin CHARACTERISTIC TST_OS01_En.Distab13_12T "" VALUE 0x1D1A1E STANDARD_VALUE_U8 0.0 ident 0 1 BIT_MASK 0x1 /end CHARACTERISTIC
/begin CHARACTERISTIC TST_OS01_S_Dcyc.Distab13_12T "" VALUE 0x1D1A00 STANDARD_VALUE_U16 0.0 TPU_Dcyc 0.0 100.0 /end CHARACTERISTIC
/begin CHARACTERISTIC TST_OS01_V.Distab13_12T "" VALUE 0x1D1A07 STANDARD_VALUE_U8 0.0 ident 0 1 BIT_MASK 0x1 /end CHARACTERISTIC
/begin CHARACTERISTIC TST_OS02_En.Distab13_12T "" VALUE 0x1D1A03 STANDARD_VALUE_U8 0.0 ident 0 1 BIT_MASK 0x1 /end CHARACTERISTIC
/begin CHARACTERISTIC TST_OS02_S_Dcyc.Distab13_12T "" VALUE 0x1D1A0E STANDARD_VALUE_U16 0.0 TPU_Dcyc 0.0 100.0 /end CHARACTERISTIC
/begin CHARACTERISTIC TST_OS02_V.Distab13_12T "" VALUE 0x1D1A06 STANDARD_VALUE_U8 0.0 ident 0 1 BIT_MASK 0x1 /end CHARACTERISTIC
/begin CHARACTERISTIC TST_OS03.Distab13_12T "" VALUE 0x1D1A1D STANDARD_VALUE_U8 0.0 ident 0 1 BIT_MASK 0x1 /end CHARACTERISTIC
/begin CHARACTERISTIC TST_OS04.Distab13_12T "" VALUE 0x1D1A26 STANDARD_VALUE_U8 0.0 ident 0 1 BIT_MASK 0x1 /end CHARACTERISTIC
/begin CHARACTERISTIC TST_OS05a.Distab13_12T "" VALUE 0x1D1A0D STANDARD_VALUE_U8 0.0 ident 0 1 BIT_MASK 0x1 /end CHARACTERISTIC
/begin CHARACTERISTIC TST_OS05b.Distab13_12T "" VALUE 0x1D19FF STANDARD_VALUE_U8 0.0 ident 0 1 BIT_MASK 0x1 /end CHARACTERISTIC
/begin CHARACTERISTIC TST_OS05c.Distab13_12T "" VALUE 0x1D1A10 STANDARD_VALUE_U8 0.0 ident 0 1 BIT_MASK 0x1 /end CHARACTERISTIC
/begin CHARACTERISTIC TST_OS06.Distab13_12T "" VALUE 0x1D1A1C STANDARD_VALUE_U8 0.0 ident 0 1 BIT_MASK 0x1 /end CHARACTERISTIC
/begin CHARACTERISTIC TST_OS07.Distab13_12T "" VALUE 0x1D1A02 STANDARD_VALUE_U8 0.0 ident 0 1 BIT_MASK 0x1 /end CHARACTERISTIC
/begin CHARACTERISTIC TST_OS08.Distab13_12T "" VALUE 0x1D1A12 STANDARD_VALUE_U8 0.0 ident 0 1 BIT_MASK 0x1 /end CHARACTERISTIC
/begin CHARACTERISTIC TST_OS09.Distab13_12T "" VALUE 0x1D1A0C STANDARD_VALUE_U8 0.0 ident 0 1 BIT_MASK 0x1 /end CHARACTERISTIC
/begin CHARACTERISTIC TST_OS10.Distab13_12T "" VALUE 0x1D1A08 STANDARD_VALUE_U8 0.0 ident 0 1 BIT_MASK 0x1 /end CHARACTERISTIC
/begin CHARACTERISTIC TST_OS11.Distab13_12T "" VALUE 0x1D19FD STANDARD_VALUE_U8 0.0 ident 0 1 BIT_MASK 0x1 /end CHARACTERISTIC
/begin CHARACTERISTIC TST_OS12.Distab13_12T "" VALUE 0x1D19FE STANDARD_VALUE_U8 0.0 ident 0 1 BIT_MASK 0x1 /end CHARACTERISTIC
/begin CHARACTERISTIC TST_OS13.Distab13_12T "" VALUE 0x1D1A22 STANDARD_VALUE_U8 0.0 ident 0 1 BIT_MASK 0x1 /end CHARACTERISTIC
/begin CHARACTERISTIC TST_OS14.Distab13_12T "" VALUE 0x1D19F8 STANDARD_VALUE_U8 0.0 ident 0 1 BIT_MASK 0x1 /end CHARACTERISTIC
/begin CHARACTERISTIC TST_OS15.Distab13_12T "" VALUE 0x1D1A11 STANDARD_VALUE_U8 0.0 ident 0 1 BIT_MASK 0x1 /end CHARACTERISTIC
/begin AXIS_PTS Distrib1.Curve_Mod "" 0x1D0C50 M_In_fl32_Distrib1.Curve_Mod STANDARD_DIST_R64 0.0 ident 8 -1.e+037 1.e+037 /end AXIS_PTS
/begin AXIS_PTS Distrib2.Curve_Mod "" 0x1D0C98 M_In_fl32_Distrib2.Curve_Mod STANDARD_DIST_R64 0.0 ident 8 -1.e+037 1.e+037 /end AXIS_PTS
/begin MEASUREMENT Active.Dist_B01.Distab13_12T "" UBYTE ident 1 100 0 255 ECU_ADDRESS 0x7F87D6 /end MEASUREMENT
/begin MEASUREMENT Active.Dist_B02.Distab13_12T "" UBYTE ident 1 100 0 255 ECU_ADDRESS 0x7F87FA /end MEASUREMENT
/begin MEASUREMENT Active.Dist_B03.Distab13_12T "" UBYTE ident 1 100 0 255 ECU_ADDRESS 0x7F881E /end MEASUREMENT
/begin MEASUREMENT Active.Dist_B04.Distab13_12T "" UBYTE ident 1 100 0 255 ECU_ADDRESS 0x7F8842 /end MEASUREMENT
/begin MEASUREMENT Active.Dist_R01.Distab13_12T "" UBYTE ident 1 100 0 255 ECU_ADDRESS 0x7F8866 /end MEASUREMENT
/begin MEASUREMENT Active.Dist_R02.Distab13_12T "" UBYTE ident 1 100 0 255 ECU_ADDRESS 0x7F886E /end MEASUREMENT
/begin MEASUREMENT Active.Dist_R03.Distab13_12T "" UBYTE ident 1 100 0 255 ECU_ADDRESS 0x7F8876 /end MEASUREMENT
/begin MEASUREMENT Active.Dist_R04.Distab13_12T "" UBYTE ident 1 100 0 255 ECU_ADDRESS 0x7F887E /end MEASUREMENT
/begin MEASUREMENT Active.Dist_R05.Distab13_12T "" UBYTE ident 1 100 0 255 ECU_ADDRESS 0x7F8886 /end MEASUREMENT
/begin MEASUREMENT Active.Dist_R06.Distab13_12T "" UBYTE ident 1 100 0 255 ECU_ADDRESS 0x7F888E /end MEASUREMENT
/begin MEASUREMENT Active.Dist_R07.Distab13_12T "" UBYTE ident 1 100 0 255 ECU_ADDRESS 0x7F8896 /end MEASUREMENT
/begin MEASUREMENT Active.Dist_R08.Distab13_12T "" UBYTE ident 1 100 0 255 ECU_ADDRESS 0x7F889E /end MEASUREMENT
/begin MEASUREMENT Active.Dist_R09.Distab13_12T "" UBYTE ident 1 100 0 255 ECU_ADDRESS 0x7F88A6 /end MEASUREMENT
/begin MEASUREMENT Active.Dist_R10.Distab13_12T "" UBYTE ident 1 100 0 255 ECU_ADDRESS 0x7F88AE /end MEASUREMENT
/begin MEASUREMENT Active.Dist_R11.Distab13_12T "" UBYTE ident 1 100 0 255 ECU_ADDRESS 0x7F88B6 /end MEASUREMENT
/begin MEASUREMENT Active.Dist_R12.Distab13_12T "" UBYTE ident 1 100 0 255 ECU_ADDRESS 0x7F88BE /end MEASUREMENT
/begin MEASUREMENT cell_nr.Curve_Calc_32.Curve_Module "" UBYTE ident 1 100 0 255 ECU_ADDRESS 0x7F85EE /end MEASUREMENT
/begin MEASUREMENT cell_nr.Curve_Calc_real32.Curve_Module "" UBYTE ident 1 100 0 255 ECU_ADDRESS 0x7F85C0 /end MEASUREMENT
/begin MEASUREMENT Counter.Dist_B01.Distab13_12T "" UBYTE ident 1 100 0 255 ECU_ADDRESS 0x7F87D7 /end MEASUREMENT
/begin MEASUREMENT Counter.Dist_B02.Distab13_12T "" UBYTE ident 1 100 0 255 ECU_ADDRESS 0x7F87FB /end MEASUREMENT
/begin MEASUREMENT Counter.Dist_B03.Distab13_12T "" UBYTE ident 1 100 0 255 ECU_ADDRESS 0x7F881F /end MEASUREMENT
/begin MEASUREMENT Counter.Dist_B04.Distab13_12T "" UBYTE ident 1 100 0 255 ECU_ADDRESS 0x7F8843 /end MEASUREMENT
/begin MEASUREMENT curve_out.Curve_Calc_32.Curve_Module "" UWORD ident 1 100 0.0 65535.0 ECU_ADDRESS 0x7F85EC /end MEASUREMENT
/begin MEASUREMENT curve_out.Curve_Calc_real32.Curve_Module "" FLOAT32_IEEE ident 1 100 -1.e+037 1.e+037 ECU_ADDRESS 0x7F8594 /end MEASUREMENT
/begin MEASUREMENT fl32_01.E_fl32.R01_B "" FLOAT32_IEEE ident 1 100 -9.999999999999998e+036 9.999999999999998e+036 ECU_ADDRESS 0x821790 /end MEASUREMENT
/begin MEASUREMENT fl32_01.E_fl32.R02_B "" FLOAT32_IEEE ident 1 100 -9.999999999999998e+036 9.999999999999998e+036 ECU_ADDRESS 0x821860 /end MEASUREMENT
/begin MEASUREMENT fl32_01.E_fl32.R03_B "" FLOAT32_IEEE ident 1 100 -9.999999999999998e+036 9.999999999999998e+036 ECU_ADDRESS 0x821930 /end MEASUREMENT
/begin MEASUREMENT fl32_01.E_fl32.R04_B "" FLOAT32_IEEE ident 1 100 -9.999999999999998e+036 9.999999999999998e+036 ECU_ADDRESS 0x821A00 /end MEASUREMENT
/begin MEASUREMENT fl32_02.E_fl32.R01_B "" FLOAT32_IEEE ident 1 100 -9.999999999999998e+036 9.999999999999998e+036 ECU_ADDRESS 0x821794 /end MEASUREMENT
/begin MEASUREMENT fl32_02.E_fl32.R02_B "" FLOAT32_IEEE ident 1 100 -9.999999999999998e+036 9.999999999999998e+036 ECU_ADDRESS 0x821864 /end MEASUREMENT
/begin MEASUREMENT fl32_02.E_fl32.R03_B "" FLOAT32_IEEE ident 1 100 -9.999999999999998e+036 9.999999999999998e+036 ECU_ADDRESS 0x821934 /end MEASUREMENT
/begin MEASUREMENT fl32_02.E_fl32.R04_B "" FLOAT32_IEEE ident 1 100 -9.999999999999998e+036 9.999999999999998e+036 ECU_ADDRESS 0x821A04 /end MEASUREMENT
/begin MEASUREMENT fl32_03.E_fl32.R01_B "" FLOAT32_IEEE ident 1 100 -9.999999999999998e+036 9.999999999999998e+036 ECU_ADDRESS 0x821798 /end MEASUREMENT
/begin MEASUREMENT fl32_03.E_fl32.R02_B "" FLOAT32_IEEE ident 1 100 -9.999999999999998e+036 9.999999999999998e+036 ECU_ADDRESS 0x821868 /end MEASUREMENT
/begin MEASUREMENT fl32_03.E_fl32.R03_B "" FLOAT32_IEEE ident 1 100 -9.999999999999998e+036 9.999999999999998e+036 ECU_ADDRESS 0x821938 /end MEASUREMENT
/begin MEASUREMENT fl32_03.E_fl32.R04_B "" FLOAT32_IEEE ident 1 100 -9.999999999999998e+036 9.999999999999998e+036 ECU_ADDRESS 0x821A08 /end MEASUREMENT
/begin MEASUREMENT fl32_04.E_fl32.R01_B "" FLOAT32_IEEE ident 1 100 -9.999999999999998e+036 9.999999999999998e+036 ECU_ADDRESS 0x82179C /end MEASUREMENT
/begin MEASUREMENT fl32_04.E_fl32.R02_B "" FLOAT32_IEEE ident 1 100 -9.999999999999998e+036 9.999999999999998e+036 ECU_ADDRESS 0x82186C /end MEASUREMENT
/begin MEASUREMENT fl32_04.E_fl32.R03_B "" FLOAT32_IEEE ident 1 100 -9.999999999999998e+036 9.999999999999998e+036 ECU_ADDRESS 0x82193C /end MEASUREMENT
/begin MEASUREMENT fl32_04.E_fl32.R04_B "" FLOAT32_IEEE ident 1 100 -9.999999999999998e+036 9.999999999999998e+036 ECU_ADDRESS 0x821A0C /end MEASUREMENT
/begin MEASUREMENT fl32_05.E_fl32.R01_B "" FLOAT32_IEEE ident 1 100 -9.999999999999998e+036 9.999999999999998e+036 ECU_ADDRESS 0x8217A0 /end MEASUREMENT
/begin MEASUREMENT fl32_05.E_fl32.R02_B "" FLOAT32_IEEE ident 1 100 -9.999999999999998e+036 9.999999999999998e+036 ECU_ADDRESS 0x821870 /end MEASUREMENT
/begin MEASUREMENT fl32_05.E_fl32.R03_B "" FLOAT32_IEEE ident 1 100 -9.999999999999998e+036 9.999999999999998e+036 ECU_ADDRESS 0x821940 /end MEASUREMENT
/begin MEASUREMENT fl32_05.E_fl32.R04_B "" FLOAT32_IEEE ident 1 100 -9.999999999999998e+036 9.999999999999998e+036 ECU_ADDRESS 0x821A10 /end MEASUREMENT
/begin MEASUREMENT fl32_06.E_fl32.R01_B "" FLOAT32_IEEE ident 1 100 -9.999999999999998e+036 9.999999999999998e+036 ECU_ADDRESS 0x8217A4 /end MEASUREMENT
/begin MEASUREMENT fl32_06.E_fl32.R02_B "" FLOAT32_IEEE ident 1 100 -9.999999999999998e+036 9.999999999999998e+036 ECU_ADDRESS 0x821874 /end MEASUREMENT
/begin MEASUREMENT fl32_06.E_fl32.R03_B "" FLOAT32_IEEE ident 1 100 -9.999999999999998e+036 9.999999999999998e+036 ECU_ADDRESS 0x821944 /end MEASUREMENT
/begin MEASUREMENT fl32_06.E_fl32.R04_B "" FLOAT32_IEEE ident 1 100 -9.999999999999998e+036 9.999999999999998e+036 ECU_ADDRESS 0x821A14 /end MEASUREMENT
/begin MEASUREMENT fl32_07.E_fl32.R01_B "" FLOAT32_IEEE ident 1 100 -9.999999999999998e+036 9.999999999999998e+036 ECU_ADDRESS 0x8217A8 /end MEASUREMENT
/begin MEASUREMENT fl32_07.E_fl32.R02_B "" FLOAT32_IEEE ident 1 100 -9.999999999999998e+036 9.999999999999998e+036 ECU_ADDRESS 0x821878 /end MEASUREMENT
/begin MEASUREMENT fl32_07.E_fl32.R03_B "" FLOAT32_IEEE ident 1 100 -9.999999999999998e+036 9.999999999999998e+036 ECU_ADDRESS 0x821948 /end MEASUREMENT
/begin MEASUREMENT fl32_07.E_fl32.R04_B "" FLOAT32_IEEE ident 1 100 -9.999999999999998e+036 9.999999999999998e+036 ECU_ADDRESS 0x821A18 /end MEASUREMENT
/begin MEASUREMENT fl32_08.E_fl32.R01_B "" FLOAT32_IEEE ident 1 100 -9.999999999999998e+036 9.999999999999998e+036 ECU_ADDRESS 0x8217AC /end MEASUREMENT
/begin MEASUREMENT fl32_08.E_fl32.R02_B "" FLOAT32_IEEE ident 1 100 -9.999999999999998e+036 9.999999999999998e+036 ECU_ADDRESS 0x82187C /end MEASUREMENT
/begin MEASUREMENT fl32_08.E_fl32.R03_B "" FLOAT32_IEEE ident 1 100 -9.999999999999998e+036 9.999999999999998e+036 ECU_ADDRESS 0x82194C /end MEASUREMENT
/begin MEASUREMENT fl32_08.E_fl32.R04_B "" FLOAT32_IEEE ident 1 100 -9.999999999999998e+036 9.999999999999998e+036 ECU_ADDRESS 0x821A1C /end MEASUREMENT
/begin MEASUREMENT fl64_01.E_fl64.R01_B "" FLOAT64_IEEE ident 1 100 -1.e+037 1.e+037 ECU_ADDRESS 0x8217B0 /end MEASUREMENT
/begin MEASUREMENT fl64_01.E_fl64.R02_B "" FLOAT64_IEEE ident 1 100 -1.e+037 1.e+037 ECU_ADDRESS 0x821880 /end MEASUREMENT
/begin MEASUREMENT fl64_01.E_fl64.R03_B "" FLOAT64_IEEE ident 1 100 -1.e+037 1.e+037 ECU_ADDRESS 0x821950 /end MEASUREMENT
/begin MEASUREMENT fl64_01.E_fl64.R04_B "" FLOAT64_IEEE ident 1 100 -1.e+037 1.e+037 ECU_ADDRESS 0x821A20 /end MEASUREMENT
/begin MEASUREMENT fl64_02.E_fl64.R01_B "" FLOAT64_IEEE ident 1 100 -1.e+037 1.e+037 ECU_ADDRESS 0x8217B8 /end MEASUREMENT
/begin MEASUREMENT fl64_02.E_fl64.R02_B "" FLOAT64_IEEE ident 1 100 -1.e+037 1.e+037 ECU_ADDRESS 0x821888 /end MEASUREMENT
/begin MEASUREMENT fl64_02.E_fl64.R03_B "" FLOAT64_IEEE ident 1 100 -1.e+037 1.e+037 ECU_ADDRESS 0x821958 /end MEASUREMENT
/begin MEASUREMENT fl64_02.E_fl64.R04_B "" FLOAT64_IEEE ident 1 100 -1.e+037 1.e+037 ECU_ADDRESS 0x821A28 /end MEASUREMENT
/begin MEASUREMENT fl64_03.E_fl64.R01_B "" FLOAT64_IEEE ident 1 100 -1.e+037 1.e+037 ECU_ADDRESS 0x8217C0 /end MEASUREMENT
/begin MEASUREMENT fl64_03.E_fl64.R02_B "" FLOAT64_IEEE ident 1 100 -1.e+037 1.e+037 ECU_ADDRESS 0x821890 /end MEASUREMENT
/begin MEASUREMENT fl64_03.E_fl64.R03_B "" FLOAT64_IEEE ident 1 100 -1.e+037 1.e+037 ECU_ADDRESS 0x821960 /end MEASUREMENT
/begin MEASUREMENT fl64_03.E_fl64.R04_B "" FLOAT64_IEEE ident 1 100 -1.e+037 1.e+037 ECU_ADDRESS 0x821A30 /end MEASUREMENT
/begin MEASUREMENT fl64_04.E_fl64.R01_B "" FLOAT64_IEEE ident 1 100 -1.e+037 1.e+037 ECU_ADDRESS 0x8217C8 /end MEASUREMENT
/begin MEASUREMENT fl64_04.E_fl64.R02_B "" FLOAT64_IEEE ident 1 100 -1.e+037 1.e+037 ECU_ADDRESS 0x821898 /end MEASUREMENT
/begin MEASUREMENT fl64_04.E_fl64.R03_B "" FLOAT64_IEEE ident 1 100 -1.e+037 1.e+037 ECU_ADDRESS 0x821968 /end MEASUREMENT
/begin MEASUREMENT fl64_04.E_fl64.R04_B "" FLOAT64_IEEE ident 1 100 -1.e+037 1.e+037 ECU_ADDRESS 0x821A38 /end MEASUREMENT
/begin MEASUREMENT fl64_05.E_fl64.R01_B "" FLOAT64_IEEE ident 1 100 -1.e+037 1.e+037 ECU_ADDRESS 0x8217D0 /end MEASUREMENT
/begin MEASUREMENT fl64_05.E_fl64.R02_B "" FLOAT64_IEEE ident 1 100 -1.e+037 1.e+037 ECU_ADDRESS 0x8218A0 /end MEASUREMENT
/begin MEASUREMENT fl64_05.E_fl64.R03_B "" FLOAT64_IEEE ident 1 100 -1.e+037 1.e+037 ECU_ADDRESS 0x821970 /end MEASUREMENT
/begin MEASUREMENT fl64_05.E_fl64.R04_B "" FLOAT64_IEEE ident 1 100 -1.e+037 1.e+037 ECU_ADDRESS 0x821A40 /end MEASUREMENT
/begin MEASUREMENT fl64_06.E_fl64.R01_B "" FLOAT64_IEEE ident 1 100 -1.e+037 1.e+037 ECU_ADDRESS 0x8217D8 /end MEASUREMENT
/begin MEASUREMENT fl64_06.E_fl64.R02_B "" FLOAT64_IEEE ident 1 100 -1.e+037 1.e+037 ECU_ADDRESS 0x8218A8 /end MEASUREMENT
/begin MEASUREMENT fl64_06.E_fl64.R03_B "" FLOAT64_IEEE ident 1 100 -1.e+037 1.e+037 ECU_ADDRESS 0x821978 /end MEASUREMENT
/begin MEASUREMENT fl64_06.E_fl64.R04_B "" FLOAT64_IEEE ident 1 100 -1.e+037 1.e+037 ECU_ADDRESS 0x821A48 /end MEASUREMENT
/begin MEASUREMENT fl64_07.E_fl64.R01_B "" FLOAT64_IEEE ident 1 100 -1.e+037 1.e+037 ECU_ADDRESS 0x8217E0 /end MEASUREMENT
/begin MEASUREMENT fl64_07.E_fl64.R02_B "" FLOAT64_IEEE ident 1 100 -1.e+037 1.e+037 ECU_ADDRESS 0x8218B0 /end MEASUREMENT
/begin MEASUREMENT fl64_07.E_fl64.R03_B "" FLOAT64_IEEE ident 1 100 -1.e+037 1.e+037 ECU_ADDRESS 0x821980 /end MEASUREMENT
/begin MEASUREMENT fl64_07.E_fl64.R04_B "" FLOAT64_IEEE ident 1 100 -1.e+037 1.e+037 ECU_ADDRESS 0x821A50 /end MEASUREMENT
/begin MEASUREMENT fl64_08.E_fl64.R01_B "" FLOAT64_IEEE ident 1 100 -1.e+037 1.e+037 ECU_ADDRESS 0x8217E8 /end MEASUREMENT
/begin MEASUREMENT fl64_08.E_fl64.R02_B "" FLOAT64_IEEE ident 1 100 -1.e+037 1.e+037 ECU_ADDRESS 0x8218B8 /end MEASUREMENT
/begin MEASUREMENT fl64_08.E_fl64.R03_B "" FLOAT64_IEEE ident 1 100 -1.e+037 1.e+037 ECU_ADDRESS 0x821988 /end MEASUREMENT
/begin MEASUREMENT fl64_08.E_fl64.R04_B "" FLOAT64_IEEE ident 1 100 -1.e+037 1.e+037 ECU_ADDRESS 0x821A58 /end MEASUREMENT
/begin MEASUREMENT FSW_OIC01_Dcyc.Distab13_12T "" UWORD TPU_Dcyc 1 100 0.0 100.0 ECU_ADDRESS 0x821588 /end MEASUREMENT
/begin MEASUREMENT FSW_OIC02_Dcyc.Distab13_12T "" UWORD TPU_Dcyc 1 100 0.0 100.0 ECU_ADDRESS 0x82158A /end MEASUREMENT
/begin MEASUREMENT FSW_OPI01_Dcyc.Distab13_12T "" UWORD TPU_Dcyc 1 100 0.0 100.0 ECU_ADDRESS 0x82158C /end MEASUREMENT
/begin MEASUREMENT FSW_OPI02_Dcyc.Distab13_12T "" UWORD TPU_Dcyc 1 100 0.0 100.0 ECU_ADDRESS 0x82158E /end MEASUREMENT
/begin MEASUREMENT FSW_OPI03_Dcyc.Distab13_12T "" UWORD TPU_Dcyc 1 100 0.0 100.0 ECU_ADDRESS 0x821590 /end MEASUREMENT
/begin MEASUREMENT FSW_OPI04_Dcyc.Distab13_12T "" UWORD TPU_Dcyc 1 100 0.0 100.0 ECU_ADDRESS 0x821592 /end MEASUREMENT
/begin MEASUREMENT FSW_OPI05_Dcyc.Distab13_12T "" UWORD TPU_Dcyc 1 100 0.0 100.0 ECU_ADDRESS 0x821594 /end MEASUREMENT
/begin MEASUREMENT FSW_OPI06_Dcyc.Distab13_12T "" UWORD TPU_Dcyc 1 100 0.0 100.0 ECU_ADDRESS 0x821596 /end MEASUREMENT
/begin MEASUREMENT FSW_OPI07_Dcyc.Distab13_12T "" UWORD TPU_Dcyc 1 100 0.0 100.0 ECU_ADDRESS 0x821598 /end MEASUREMENT
/begin MEASUREMENT FSW_OPI08_Dcyc.Distab13_12T "" UWORD TPU_Dcyc 1 100 0.0 100.0 ECU_ADDRESS 0x82159A /end MEASUREMENT
/begin MEASUREMENT FSW_OPI09_Dcyc.Distab13_12T "" UWORD TPU_Dcyc 1 100 0.0 100.0 ECU_ADDRESS 0x82159C /end MEASUREMENT
/begin MEASUREMENT FSW_OPI10_Dcyc.Distab13_12T "" UWORD TPU_Dcyc 1 100 0.0 100.0 ECU_ADDRESS 0x82159E /end MEASUREMENT
/begin MEASUREMENT FSW_OPI11_Dcyc.Distab13_12T "" UWORD TPU_Dcyc 1 100 0.0 100.0 ECU_ADDRESS 0x8215A0 /end MEASUREMENT
/begin MEASUREMENT FSW_OS_MR.Distab13_12T "" UBYTE ident 1 100 0 1 BIT_MASK 0x1 ECU_ADDRESS 0x8215B9 /end MEASUREMENT
/begin MEASUREMENT FSW_OS01_En.Distab13_12T "" UBYTE ident 1 100 0 1 BIT_MASK 0x1 ECU_ADDRESS 0x8215A6 /end MEASUREMENT
/begin MEASUREMENT FSW_OS01_S_Dcyc.Distab13_12T "" UWORD TPU_Dcyc 1 100 0.0 100.0 ECU_ADDRESS 0x8215A2 /end MEASUREMENT
/begin MEASUREMENT FSW_OS01_V.Distab13_12T "" UBYTE ident 1 100 0 1 BIT_MASK 0x1 ECU_ADDRESS 0x8215A7 /end MEASUREMENT
/begin MEASUREMENT FSW_OS02_En.Distab13_12T "" UBYTE ident 1 100 0 1 BIT_MASK 0x1 ECU_ADDRESS 0x8215A8 /end MEASUREMENT
/begin MEASUREMENT FSW_OS02_S_Dcyc.Distab13_12T "" UWORD TPU_Dcyc 1 100 0.0 100.0 ECU_ADDRESS 0x8215A4 /end MEASUREMENT
/begin MEASUREMENT FSW_OS02_V.Distab13_12T "" UBYTE ident 1 100 0 1 BIT_MASK 0x1 ECU_ADDRESS 0x8215A9 /end MEASUREMENT
/begin MEASUREMENT FSW_OS03.Distab13_12T "" UBYTE ident 1 100 0 1 BIT_MASK 0x1 ECU_ADDRESS 0x8215AA /end MEASUREMENT
/begin MEASUREMENT FSW_OS04.Distab13_12T "" UBYTE ident 1 100 0 1 BIT_MASK 0x1 ECU_ADDRESS 0x8215AB /end MEASUREMENT
/begin MEASUREMENT FSW_OS05a.Distab13_12T "" UBYTE ident 1 100 0 1 BIT_MASK 0x1 ECU_ADDRESS 0x8215AC /end MEASUREMENT
/begin MEASUREMENT FSW_OS05b.Distab13_12T "" UBYTE ident 1 100 0 1 BIT_MASK 0x1 ECU_ADDRESS 0x8215AD /end MEASUREMENT
/begin MEASUREMENT FSW_OS05c.Distab13_12T "" UBYTE ident 1 100 0 1 BIT_MASK 0x1 ECU_ADDRESS 0x8215AE /end MEASUREMENT
/begin MEASUREMENT FSW_OS06.Distab13_12T "" UBYTE ident 1 100 0 1 BIT_MASK 0x1 ECU_ADDRESS 0x8215AF /end MEASUREMENT
/begin MEASUREMENT FSW_OS07.Distab13_12T "" UBYTE ident 1 100 0 1 BIT_MASK 0x1 ECU_ADDRESS 0x8215B0 /end MEASUREMENT
/begin MEASUREMENT FSW_OS08.Distab13_12T "" UBYTE ident 1 100 0 1 BIT_MASK 0x1 ECU_ADDRESS 0x8215B1 /end MEASUREMENT
/begin MEASUREMENT FSW_OS09.Distab13_12T "" UBYTE ident 1 100 0 1 BIT_MASK 0x1 ECU_ADDRESS 0x8215B2 /end MEASUREMENT
/begin MEASUREMENT FSW_OS10.Distab13_12T "" UBYTE ident 1 100 0 1 BIT_MASK 0x1 ECU_ADDRESS 0x8215B3 /end MEASUREMENT
/begin MEASUREMENT FSW_OS11.Distab13_12T "" UBYTE ident 1 100 0 1 BIT_MASK 0x1 ECU_ADDRESS 0x8215B4 /end MEASUREMENT
/begin MEASUREMENT FSW_OS12.Distab13_12T "" UBYTE ident 1 100 0 1 BIT_MASK 0x1 ECU_ADDRESS 0x8215B5 /end MEASUREMENT
/begin MEASUREMENT FSW_OS13.Distab13_12T "" UBYTE ident 1 100 0 1 BIT_MASK 0x1 ECU_ADDRESS 0x8215B6 /end MEASUREMENT
/begin MEASUREMENT FSW_OS14.Distab13_12T "" UBYTE ident 1 100 0 1 BIT_MASK 0x1 ECU_ADDRESS 0x8215B7 /end MEASUREMENT
/begin MEASUREMENT FSW_OS15.Distab13_12T "" UBYTE ident 1 100 0 1 BIT_MASK 0x1 ECU_ADDRESS 0x8215B8 /end MEASUREMENT
/begin MEASUREMENT g_DiagBSmax_u8.DiagKwpUds "" UBYTE ident 1 100 0 255 ECU_ADDRESS 0x7F87D0 /end MEASUREMENT
/begin MEASUREMENT g_DiagSTmin_u8.DiagKwpUds "" UBYTE ident 1 100 0 255 ECU_ADDRESS 0x7FB0E0 /end MEASUREMENT
/begin MEASUREMENT input_array.Curve_Calc_32.Curve_Module "" ULONG ident 1 100 0.0 4294967295.0 ECU_ADDRESS 0x7F85C4 MATRIX_DIM 10 1 1 /end MEASUREMENT
/begin MEASUREMENT input_array.Curve_Calc_real32.Curve_Module "" FLOAT32_IEEE ident 1 100 -1.e+037 1.e+037 ECU_ADDRESS 0x7F8598 MATRIX_DIM 10 1 1 /end MEASUREMENT
/begin MEASUREMENT is_started.Time_Calc.Curve_Module "" UBYTE ident 1 100 0 1 ECU_ADDRESS 0x7F861C MATRIX_DIM 3 1 1 /end MEASUREMENT
/begin MEASUREMENT l_ResetTimer_b.EV0_Roundtrip.XCP_SHELL "" UBYTE ident 1 100 0 1 BIT_MASK 0x1 ECU_ADDRESS 0x7F926C /end MEASUREMENT
/begin MEASUREMENT l_ResetTimer_b.EV0_Rx.XCP_SHELL "" UBYTE ident 1 100 0 1 BIT_MASK 0x1 ECU_ADDRESS 0x7F9288 /end MEASUREMENT
/begin MEASUREMENT l_ResetTimer_b.EV0_Sample.XCP_SHELL "" UBYTE ident 1 100 0 1 BIT_MASK 0x1 ECU_ADDRESS 0x7F92AC /end MEASUREMENT
/begin MEASUREMENT l_ResetTimer_b.EV0_Stim.XCP_SHELL "" UBYTE ident 1 100 0 1 BIT_MASK 0x1 ECU_ADDRESS 0x7F92C4 /end MEASUREMENT
/begin MEASUREMENT l_ResetTimer_b.EV0_Tx.XCP_SHELL "" UBYTE ident 1 100 0 1 BIT_MASK 0x1 ECU_ADDRESS 0x7F92E0 /end MEASUREMENT
/begin MEASUREMENT l_StartTicks_u32.EV0_Roundtrip.XCP_SHELL "" ULONG ident 1 100 0 4294967295 ECU_ADDRESS 0x7F9264 /end MEASUREMENT
/begin MEASUREMENT l_StartTicks_u32.EV0_Rx.XCP_SHELL "" ULONG ident 1 100 0 4294967295 ECU_ADDRESS 0x7F927C /end MEASUREMENT
/begin MEASUREMENT l_StartTicks_u32.EV0_Sample.XCP_SHELL "" ULONG ident 1 100 0 4294967295 ECU_ADDRESS 0x7F92A4 /end MEASUREMENT
/begin MEASUREMENT l_StartTicks_u32.EV0_Stim.XCP_SHELL "" ULONG ident 1 100 0 4294967295 ECU_ADDRESS 0x7F92BC /end MEASUREMENT
/begin MEASUREMENT l_StartTicks_u32.EV0_Tx.XCP_SHELL "" ULONG ident 1 100 0 4294967295 ECU_ADDRESS 0x7F92D4 /end MEASUREMENT
/begin MEASUREMENT l_StopTicks_u32.EV0_Roundtrip.XCP_SHELL "" ULONG ident 1 100 0 4294967295 ECU_ADDRESS 0x7F9268 /end MEASUREMENT
/begin MEASUREMENT l_StopTicks_u32.EV0_Rx.XCP_SHELL "" ULONG ident 1 100 0 4294967295 ECU_ADDRESS 0x7F9280 /end MEASUREMENT
/begin MEASUREMENT l_StopTicks_u32.EV0_Sample.XCP_SHELL "" ULONG ident 1 100 0 4294967295 ECU_ADDRESS 0x7F92A8 /end MEASUREMENT
/begin MEASUREMENT l_StopTicks_u32.EV0_Stim.XCP_SHELL "" ULONG ident 1 100 0 4294967295 ECU_ADDRESS 0x7F92C0 /end MEASUREMENT
/begin MEASUREMENT l_StopTicks_u32.EV0_Tx.XCP_SHELL "" ULONG ident 1 100 0 4294967295 ECU_ADDRESS 0x7F92D8 /end MEASUREMENT
/begin MEASUREMENT l_Timeout_b.EV0_Roundtrip.XCP_SHELL "" UBYTE ident 1 100 0 1 BIT_MASK 0x1 ECU_ADDRESS 0x7F926D /end MEASUREMENT
/begin MEASUREMENT l_Timeout_b.EV0_Rx.XCP_SHELL "" UBYTE ident 1 100 0 1 BIT_MASK 0x1 ECU_ADDRESS 0x7F9289 /end MEASUREMENT
/begin MEASUREMENT l_Timeout_b.EV0_Sample.XCP_SHELL "" UBYTE ident 1 100 0 1 BIT_MASK 0x1 ECU_ADDRESS 0x7F92AD /end MEASUREMENT
/begin MEASUREMENT l_Timeout_b.EV0_Stim.XCP_SHELL "" UBYTE ident 1 100 0 1 BIT_MASK 0x1 ECU_ADDRESS 0x7F92C5 /end MEASUREMENT
/begin MEASUREMENT l_Timeout_b.EV0_Tx.XCP_SHELL "" UBYTE ident 1 100 0 1 BIT_MASK 0x1 ECU_ADDRESS 0x7F92E1 /end MEASUREMENT
/begin MEASUREMENT l_TimeSum_u32.EV0_Rx.XCP_SHELL "" ULONG TickType2ms 1 100 0.0 1227133.512857143 ECU_ADDRESS 0x7F9284 /end MEASUREMENT
/begin MEASUREMENT l_TimeSum_u32.EV0_Tx.XCP_SHELL "" ULONG TickType2ms 1 100 0.0 1227133.512857143 ECU_ADDRESS 0x7F92DC /end MEASUREMENT
/begin MEASUREMENT loop_counter.Curve_Module "" UWORD ident 1 100 0 65535 ECU_ADDRESS 0x7F85F0 /end MEASUREMENT
/begin MEASUREMENT M_In_fl32_Distrib1.Curve_Mod "" FLOAT64_IEEE ident 1 100 -1.e+037 1.e+037 ECU_ADDRESS 0x7FB0B0 /end MEASUREMENT
/begin MEASUREMENT M_In_fl32_Distrib2.Curve_Mod "" FLOAT64_IEEE ident 1 100 -1.e+037 1.e+037 ECU_ADDRESS 0x7FB0B8 /end MEASUREMENT
/begin MEASUREMENT M_In_KL_Direct_fl32.Curve_Mod "" FLOAT64_IEEE ident 1 100 -1.e+037 1.e+037 ECU_ADDRESS 0x7FB0A8 /end MEASUREMENT
/begin MEASUREMENT M_Out_KL_Direct_fl32.Curve_Mod "" FLOAT64_IEEE ident 1 100 -1.e+037 1.e+037 ECU_ADDRESS 0x7FB0D8 /end MEASUREMENT
/begin MEASUREMENT M_Out_KL1_Distr_fl32_Distrib1.Curve_Mod "" FLOAT64_IEEE ident 1 100 -1.e+037 1.e+037 ECU_ADDRESS 0x7FB0C0 /end MEASUREMENT
/begin MEASUREMENT M_Out_KL2_Distr_fl32_Distrib1.Curve_Mod "" FLOAT64_IEEE ident 1 100 -1.e+037 1.e+037 ECU_ADDRESS 0x7FB0C8 /end MEASUREMENT
/begin MEASUREMENT M_Out_KL3_Distr_fl32_Distrib2.Curve_Mod "" FLOAT64_IEEE ident 1 100 -1.e+037 1.e+037 ECU_ADDRESS 0x7FB0D0 /end MEASUREMENT
/begin MEASUREMENT Max.Distab.Dist_B01.Distab13_12T "" ULONG TickType2ms 1 100 0.0 1227133.512857143 ECU_ADDRESS 0x7F87E0 /end MEASUREMENT
/begin MEASUREMENT Max.Distab.Dist_B02.Distab13_12T "" ULONG TickType2ms 1 100 0.0 1227133.512857143 ECU_ADDRESS 0x7F8804 /end MEASUREMENT
/begin MEASUREMENT Max.Distab.Dist_B03.Distab13_12T "" ULONG TickType2ms 1 100 0.0 1227133.512857143 ECU_ADDRESS 0x7F8828 /end MEASUREMENT
/begin MEASUREMENT Max.Distab.Dist_B04.Distab13_12T "" ULONG TickType2ms 1 100 0.0 1227133.512857143 ECU_ADDRESS 0x7F884C /end MEASUREMENT
/begin MEASUREMENT Max.MIN_MAX_Tick2Time.EV0_Roundtrip.XCP_SHELL "" ULONG TickType2ms 1 100 0.0 1227133.512857143 ECU_ADDRESS 0x7F9270 /end MEASUREMENT
/begin MEASUREMENT Max.MIN_MAX_Tick2Time.EV0_Sample.XCP_SHELL "" ULONG TickType2ms 1 100 0.0 1227133.512857143 ECU_ADDRESS 0x7F92B0 /end MEASUREMENT
/begin MEASUREMENT Max.MIN_MAX_Tick2Time.EV0_Stim.XCP_SHELL "" ULONG TickType2ms 1 100 0.0 1227133.512857143 ECU_ADDRESS 0x7F92C8 /end MEASUREMENT
/begin MEASUREMENT Max.Roundtrip.Dist_B01.Distab13_12T "" ULONG TickType2ms 1 100 0.0 1227133.512857143 ECU_ADDRESS 0x7F87EC /end MEASUREMENT
/begin MEASUREMENT Max.Roundtrip.Dist_B02.Distab13_12T "" ULONG TickType2ms 1 100 0.0 1227133.512857143 ECU_ADDRESS 0x7F8810 /end MEASUREMENT
/begin MEASUREMENT Max.Roundtrip.Dist_B03.Distab13_12T "" ULONG TickType2ms 1 100 0.0 1227133.512857143 ECU_ADDRESS 0x7F8834 /end MEASUREMENT
/begin MEASUREMENT Max.Roundtrip.Dist_B04.Distab13_12T "" ULONG TickType2ms 1 100 0.0 1227133.512857143 ECU_ADDRESS 0x7F8858 /end MEASUREMENT
/begin MEASUREMENT Max.Time.EV0_Rx.XCP_SHELL "" ULONG TickType2ms 1 100 0.0 1227133.512857143 ECU_ADDRESS 0x7F928C /end MEASUREMENT
/begin MEASUREMENT Max.Time.EV0_Tx.XCP_SHELL "" ULONG TickType2ms 1 100 0.0 1227133.512857143 ECU_ADDRESS 0x7F92E4 /end MEASUREMENT
/begin MEASUREMENT Max.TimeSum.EV0_Rx.XCP_SHELL "" ULONG TickType2ms 1 100 0.0 1227133.512857143 ECU_ADDRESS 0x7F9298 /end MEASUREMENT
/begin MEASUREMENT Max.TimeSum.EV0_Tx.XCP_SHELL "" ULONG TickType2ms 1 100 0.0 1227133.512857143 ECU_ADDRESS 0x7F92F0 /end MEASUREMENT
/begin MEASUREMENT Min.Distab.Dist_B01.Distab13_12T "" ULONG TickType2ms 1 100 0.0 1227133.512857143 ECU_ADDRESS 0x7F87E4 /end MEASUREMENT
/begin MEASUREMENT Min.Distab.Dist_B02.Distab13_12T "" ULONG TickType2ms 1 100 0.0 1227133.512857143 ECU_ADDRESS 0x7F8808 /end MEASUREMENT
/begin MEASUREMENT Min.Distab.Dist_B03.Distab13_12T "" ULONG TickType2ms 1 100 0.0 1227133.512857143 ECU_ADDRESS 0x7F882C /end MEASUREMENT
/begin MEASUREMENT Min.Distab.Dist_B04.Distab13_12T "" ULONG TickType2ms 1 100 0.0 1227133.512857143 ECU_ADDRESS 0x7F8850 /end MEASUREMENT
/begin MEASUREMENT Min.MIN_MAX_Tick2Time.EV0_Roundtrip.XCP_SHELL "" ULONG TickType2ms 1 100 0.0 1227133.512857143 ECU_ADDRESS 0x7F9274 /end MEASUREMENT
/begin MEASUREMENT Min.MIN_MAX_Tick2Time.EV0_Sample.XCP_SHELL "" ULONG TickType2ms 1 100 0.0 1227133.512857143 ECU_ADDRESS 0x7F92B4 /end MEASUREMENT
/begin MEASUREMENT Min.MIN_MAX_Tick2Time.EV0_Stim.XCP_SHELL "" ULONG TickType2ms 1 100 0.0 1227133.512857143 ECU_ADDRESS 0x7F92CC /end MEASUREMENT
/begin MEASUREMENT Min.Roundtrip.Dist_B01.Distab13_12T "" ULONG TickType2ms 1 100 0.0 1227133.512857143 ECU_ADDRESS 0x7F87F0 /end MEASUREMENT
/begin MEASUREMENT Min.Roundtrip.Dist_B02.Distab13_12T "" ULONG TickType2ms 1 100 0.0 1227133.512857143 ECU_ADDRESS 0x7F8814 /end MEASUREMENT
/begin MEASUREMENT Min.Roundtrip.Dist_B03.Distab13_12T "" ULONG TickType2ms 1 100 0.0 1227133.512857143 ECU_ADDRESS 0x7F8838 /end MEASUREMENT
/begin MEASUREMENT Min.Roundtrip.Dist_B04.Distab13_12T "" ULONG TickType2ms 1 100 0.0 1227133.512857143 ECU_ADDRESS 0x7F885C /end MEASUREMENT
/begin MEASUREMENT Min.Time.EV0_Rx.XCP_SHELL "" ULONG TickType2ms 1 100 0.0 1227133.512857143 ECU_ADDRESS 0x7F9290 /end MEASUREMENT
/begin MEASUREMENT Min.Time.EV0_Tx.XCP_SHELL "" ULONG TickType2ms 1 100 0.0 1227133.512857143 ECU_ADDRESS 0x7F92E8 /end MEASUREMENT
/begin MEASUREMENT Min.TimeSum.EV0_Rx.XCP_SHELL "" ULONG TickType2ms 1 100 0.0 1227133.512857143 ECU_ADDRESS 0x7F929C /end MEASUREMENT
/begin MEASUREMENT Min.TimeSum.EV0_Tx.XCP_SHELL "" ULONG TickType2ms 1 100 0.0 1227133.512857143 ECU_ADDRESS 0x7F92F4 /end MEASUREMENT
/begin MEASUREMENT NrBytes_Total.Dist_B01.Distab13_12T "" UWORD ident 1 100 0 65535 ECU_ADDRESS 0x7F87D4 /end MEASUREMENT
/begin MEASUREMENT NrBytes_Total.Dist_B02.Distab13_12T "" UWORD ident 1 100 0 65535 ECU_ADDRESS 0x7F87F8 /end MEASUREMENT
/begin MEASUREMENT NrBytes_Total.Dist_B03.Distab13_12T "" UWORD ident 1 100 0 65535 ECU_ADDRESS 0x7F881C /end MEASUREMENT
/begin MEASUREMENT NrBytes_Total.Dist_B04.Distab13_12T "" UWORD ident 1 100 0 65535 ECU_ADDRESS 0x7F8840 /end MEASUREMENT
/begin MEASUREMENT NrBytes_Total.Dist_R01.Distab13_12T "" UWORD ident 1 100 0 1024 ECU_ADDRESS 0x7F8864 /end MEASUREMENT
/begin MEASUREMENT NrBytes_Total.Dist_R02.Distab13_12T "" UWORD ident 1 100 0 1024 ECU_ADDRESS 0x7F886C /end MEASUREMENT
/begin MEASUREMENT NrBytes_Total.Dist_R03.Distab13_12T "" UWORD ident 1 100 0 1024 ECU_ADDRESS 0x7F8874 /end MEASUREMENT
/begin MEASUREMENT NrBytes_Total.Dist_R04.Distab13_12T "" UWORD ident 1 100 0 1024 ECU_ADDRESS 0x7F887C /end MEASUREMENT
/begin MEASUREMENT NrBytes_Total.Dist_R05.Distab13_12T "" UWORD ident 1 100 0 1024 ECU_ADDRESS 0x7F8884 /end MEASUREMENT
/begin MEASUREMENT NrBytes_Total.Dist_R06.Distab13_12T "" UWORD ident 1 100 0 1024 ECU_ADDRESS 0x7F888C /end MEASUREMENT
/begin MEASUREMENT NrBytes_Total.Dist_R07.Distab13_12T "" UWORD ident 1 100 0 1024 ECU_ADDRESS 0x7F8894 /end MEASUREMENT
/begin MEASUREMENT NrBytes_Total.Dist_R08.Distab13_12T "" UWORD ident 1 100 0 1024 ECU_ADDRESS 0x7F889C /end MEASUREMENT
/begin MEASUREMENT NrBytes_Total.Dist_R09.Distab13_12T "" UWORD ident 1 100 0 1024 ECU_ADDRESS 0x7F88A4 /end MEASUREMENT
/begin MEASUREMENT NrBytes_Total.Dist_R10.Distab13_12T "" UWORD ident 1 100 0 1024 ECU_ADDRESS 0x7F88AC /end MEASUREMENT
/begin MEASUREMENT NrBytes_Total.Dist_R11.Distab13_12T "" UWORD ident 1 100 0 1024 ECU_ADDRESS 0x7F88B4 /end MEASUREMENT
/begin MEASUREMENT NrBytes_Total.Dist_R12.Distab13_12T "" UWORD ident 1 100 0 1024 ECU_ADDRESS 0x7F88BC /end MEASUREMENT
/begin MEASUREMENT NrVar_1Byte.Dist_B01.Distab13_12T "" UBYTE ident 1 100 0 255 ECU_ADDRESS 0x7F87D8 /end MEASUREMENT
/begin MEASUREMENT NrVar_1Byte.Dist_B02.Distab13_12T "" UBYTE ident 1 100 0 255 ECU_ADDRESS 0x7F87FC /end MEASUREMENT
/begin MEASUREMENT NrVar_1Byte.Dist_B03.Distab13_12T "" UBYTE ident 1 100 0 255 ECU_ADDRESS 0x7F8820 /end MEASUREMENT
/begin MEASUREMENT NrVar_1Byte.Dist_B04.Distab13_12T "" UBYTE ident 1 100 0 255 ECU_ADDRESS 0x7F8844 /end MEASUREMENT
/begin MEASUREMENT NrVar_1Byte.Dist_R01.Distab13_12T "" UBYTE ident 1 100 0 255 ECU_ADDRESS 0x7F8867 /end MEASUREMENT
/begin MEASUREMENT NrVar_1Byte.Dist_R02.Distab13_12T "" UBYTE ident 1 100 0 255 ECU_ADDRESS 0x7F886F /end MEASUREMENT
/begin MEASUREMENT NrVar_1Byte.Dist_R03.Distab13_12T "" UBYTE ident 1 100 0 255 ECU_ADDRESS 0x7F8877 /end MEASUREMENT
/begin MEASUREMENT NrVar_1Byte.Dist_R04.Distab13_12T "" UBYTE ident 1 100 0 255 ECU_ADDRESS 0x7F887F /end MEASUREMENT
/begin MEASUREMENT NrVar_1Byte.Dist_R05.Distab13_12T "" UBYTE ident 1 100 0 255 ECU_ADDRESS 0x7F8887 /end MEASUREMENT
/begin MEASUREMENT NrVar_1Byte.Dist_R06.Distab13_12T "" UBYTE ident 1 100 0 255 ECU_ADDRESS 0x7F888F /end MEASUREMENT
/begin MEASUREMENT NrVar_1Byte.Dist_R07.Distab13_12T "" UBYTE ident 1 100 0 255 ECU_ADDRESS 0x7F8897 /end MEASUREMENT
/begin MEASUREMENT NrVar_1Byte.Dist_R08.Distab13_12T "" UBYTE ident 1 100 0 255 ECU_ADDRESS 0x7F889F /end MEASUREMENT
/begin MEASUREMENT NrVar_1Byte.Dist_R09.Distab13_12T "" UBYTE ident 1 100 0 255 ECU_ADDRESS 0x7F88A7 /end MEASUREMENT
/begin MEASUREMENT NrVar_1Byte.Dist_R10.Distab13_12T "" UBYTE ident 1 100 0 255 ECU_ADDRESS 0x7F88AF /end MEASUREMENT
/begin MEASUREMENT NrVar_1Byte.Dist_R11.Distab13_12T "" UBYTE ident 1 100 0 255 ECU_ADDRESS 0x7F88B7 /end MEASUREMENT
/begin MEASUREMENT NrVar_1Byte.Dist_R12.Distab13_12T "" UBYTE ident 1 100 0 255 ECU_ADDRESS 0x7F88BF /end MEASUREMENT
/begin MEASUREMENT NrVar_2Byte.Dist_B01.Distab13_12T "" UBYTE ident 1 100 0 255 ECU_ADDRESS 0x7F87D9 /end MEASUREMENT
/begin MEASUREMENT NrVar_2Byte.Dist_B02.Distab13_12T "" UBYTE ident 1 100 0 255 ECU_ADDRESS 0x7F87FD /end MEASUREMENT
/begin MEASUREMENT NrVar_2Byte.Dist_B03.Distab13_12T "" UBYTE ident 1 100 0 255 ECU_ADDRESS 0x7F8821 /end MEASUREMENT
/begin MEASUREMENT NrVar_2Byte.Dist_B04.Distab13_12T "" UBYTE ident 1 100 0 255 ECU_ADDRESS 0x7F8845 /end MEASUREMENT
/begin MEASUREMENT NrVar_2Byte.Dist_R01.Distab13_12T "" UBYTE ident 1 100 0 255 ECU_ADDRESS 0x7F8868 /end MEASUREMENT
/begin MEASUREMENT NrVar_2Byte.Dist_R02.Distab13_12T "" UBYTE ident 1 100 0 255 ECU_ADDRESS 0x7F8870 /end MEASUREMENT
/begin MEASUREMENT NrVar_2Byte.Dist_R03.Distab13_12T "" UBYTE ident 1 100 0 255 ECU_ADDRESS 0x7F8878 /end MEASUREMENT
/begin MEASUREMENT NrVar_2Byte.Dist_R04.Distab13_12T "" UBYTE ident 1 100 0 255 ECU_ADDRESS 0x7F8880 /end MEASUREMENT
/begin MEASUREMENT NrVar_2Byte.Dist_R05.Distab13_12T "" UBYTE ident 1 100 0 255 ECU_ADDRESS 0x7F8888 /end MEASUREMENT
/begin MEASUREMENT NrVar_2Byte.Dist_R06.Distab13_12T "" UBYTE ident 1 100 0 255 ECU_ADDRESS 0x7F8890 /end MEASUREMENT
/begin MEASUREMENT NrVar_2Byte.Dist_R07.Distab13_12T "" UBYTE ident 1 100 0 255 ECU_ADDRESS 0x7F8898 /end MEASUREMENT
/begin MEASUREMENT NrVar_2Byte.Dist_R08.Distab13_12T "" UBYTE ident 1 100 0 255 ECU_ADDRESS 0x7F88A0 /end MEASUREMENT
/begin MEASUREMENT NrVar_2Byte.Dist_R09.Distab13_12T "" UBYTE ident 1 100 0 255 ECU_ADDRESS 0x7F88A8 /end MEASUREMENT
/begin MEASUREMENT NrVar_2Byte.Dist_R10.Distab13_12T "" UBYTE ident 1 100 0 255 ECU_ADDRESS 0x7F88B0 /end MEASUREMENT
/begin MEASUREMENT NrVar_2Byte.Dist_R11.Distab13_12T "" UBYTE ident 1 100 0 255 ECU_ADDRESS 0x7F88B8 /end MEASUREMENT
/begin MEASUREMENT NrVar_2Byte.Dist_R12.Distab13_12T "" UBYTE ident 1 100 0 255 ECU_ADDRESS 0x7F88C0 /end MEASUREMENT
/begin MEASUREMENT NrVar_4Byte.Dist_B01.Distab13_12T "" UBYTE ident 1 100 0 255 ECU_ADDRESS 0x7F87DA /end MEASUREMENT
/begin MEASUREMENT NrVar_4Byte.Dist_B02.Distab13_12T "" UBYTE ident 1 100 0 255 ECU_ADDRESS 0x7F87FE /end MEASUREMENT
/begin MEASUREMENT NrVar_4Byte.Dist_B03.Distab13_12T "" UBYTE ident 1 100 0 255 ECU_ADDRESS 0x7F8822 /end MEASUREMENT
/begin MEASUREMENT NrVar_4Byte.Dist_B04.Distab13_12T "" UBYTE ident 1 100 0 255 ECU_ADDRESS 0x7F8846 /end MEASUREMENT
/begin MEASUREMENT NrVar_4Byte.Dist_R01.Distab13_12T "" UBYTE ident 1 100 0 255 ECU_ADDRESS 0x7F8869 /end MEASUREMENT
/begin MEASUREMENT NrVar_4Byte.Dist_R02.Distab13_12T "" UBYTE ident 1 100 0 255 ECU_ADDRESS 0x7F8871 /end MEASUREMENT
/begin MEASUREMENT NrVar_4Byte.Dist_R03.Distab13_12T "" UBYTE ident 1 100 0 255 ECU_ADDRESS 0x7F8879 /end MEASUREMENT
/begin MEASUREMENT NrVar_4Byte.Dist_R04.Distab13_12T "" UBYTE ident 1 100 0 255 ECU_ADDRESS 0x7F8881 /end MEASUREMENT
/begin MEASUREMENT NrVar_4Byte.Dist_R05.Distab13_12T "" UBYTE ident 1 100 0 255 ECU_ADDRESS 0x7F8889 /end MEASUREMENT
/begin MEASUREMENT NrVar_4Byte.Dist_R06.Distab13_12T "" UBYTE ident 1 100 0 255 ECU_ADDRESS 0x7F8891 /end MEASUREMENT
/begin MEASUREMENT NrVar_4Byte.Dist_R07.Distab13_12T "" UBYTE ident 1 100 0 255 ECU_ADDRESS 0x7F8899 /end MEASUREMENT
/begin MEASUREMENT NrVar_4Byte.Dist_R08.Distab13_12T "" UBYTE ident 1 100 0 255 ECU_ADDRESS 0x7F88A1 /end MEASUREMENT
/begin MEASUREMENT NrVar_4Byte.Dist_R09.Distab13_12T "" UBYTE ident 1 100 0 255 ECU_ADDRESS 0x7F88A9 /end MEASUREMENT
/begin MEASUREMENT NrVar_4Byte.Dist_R10.Distab13_12T "" UBYTE ident 1 100 0 255 ECU_ADDRESS 0x7F88B1 /end MEASUREMENT
/begin MEASUREMENT NrVar_4Byte.Dist_R11.Distab13_12T "" UBYTE ident 1 100 0 255 ECU_ADDRESS 0x7F88B9 /end MEASUREMENT
/begin MEASUREMENT NrVar_4Byte.Dist_R12.Distab13_12T "" UBYTE ident 1 100 0 255 ECU_ADDRESS 0x7F88C1 /end MEASUREMENT
/begin MEASUREMENT NrVar_8Byte.Dist_B01.Distab13_12T "" UBYTE ident 1 100 0 255 ECU_ADDRESS 0x7F87DB /end MEASUREMENT
/begin MEASUREMENT NrVar_8Byte.Dist_B02.Distab13_12T "" UBYTE ident 1 100 0 255 ECU_ADDRESS 0x7F87FF /end MEASUREMENT
/begin MEASUREMENT NrVar_8Byte.Dist_B03.Distab13_12T "" UBYTE ident 1 100 0 255 ECU_ADDRESS 0x7F8823 /end MEASUREMENT
/begin MEASUREMENT NrVar_8Byte.Dist_B04.Distab13_12T "" UBYTE ident 1 100 0 255 ECU_ADDRESS 0x7F8847 /end MEASUREMENT
/begin MEASUREMENT NrVar_8Byte.Dist_R01.Distab13_12T "" UBYTE ident 1 100 0 255 ECU_ADDRESS 0x7F886A /end MEASUREMENT
/begin MEASUREMENT NrVar_8Byte.Dist_R02.Distab13_12T "" UBYTE ident 1 100 0 255 ECU_ADDRESS 0x7F8872 /end MEASUREMENT
/begin MEASUREMENT NrVar_8Byte.Dist_R03.Distab13_12T "" UBYTE ident 1 100 0 255 ECU_ADDRESS 0x7F887A /end MEASUREMENT
/begin MEASUREMENT NrVar_8Byte.Dist_R04.Distab13_12T "" UBYTE ident 1 100 0 255 ECU_ADDRESS 0x7F8882 /end MEASUREMENT
/begin MEASUREMENT NrVar_8Byte.Dist_R05.Distab13_12T "" UBYTE ident 1 100 0 255 ECU_ADDRESS 0x7F888A /end MEASUREMENT
/begin MEASUREMENT NrVar_8Byte.Dist_R06.Distab13_12T "" UBYTE ident 1 100 0 255 ECU_ADDRESS 0x7F8892 /end MEASUREMENT
/begin MEASUREMENT NrVar_8Byte.Dist_R07.Distab13_12T "" UBYTE ident 1 100 0 255 ECU_ADDRESS 0x7F889A /end MEASUREMENT
/begin MEASUREMENT NrVar_8Byte.Dist_R08.Distab13_12T "" UBYTE ident 1 100 0 255 ECU_ADDRESS 0x7F88A2 /end MEASUREMENT
/begin MEASUREMENT NrVar_8Byte.Dist_R09.Distab13_12T "" UBYTE ident 1 100 0 255 ECU_ADDRESS 0x7F88AA /end MEASUREMENT
/begin MEASUREMENT NrVar_8Byte.Dist_R10.Distab13_12T "" UBYTE ident 1 100 0 255 ECU_ADDRESS 0x7F88B2 /end MEASUREMENT
/begin MEASUREMENT NrVar_8Byte.Dist_R11.Distab13_12T "" UBYTE ident 1 100 0 255 ECU_ADDRESS 0x7F88BA /end MEASUREMENT
/begin MEASUREMENT NrVar_8Byte.Dist_R12.Distab13_12T "" UBYTE ident 1 100 0 255 ECU_ADDRESS 0x7F88C2 /end MEASUREMENT
/begin MEASUREMENT Result.Dist_B01.Distab13_12T "" UBYTE ident 1 100 0 255 ECU_ADDRESS 0x7F87DC /end MEASUREMENT
/begin MEASUREMENT Result.Dist_B02.Distab13_12T "" UBYTE ident 1 100 0 255 ECU_ADDRESS 0x7F8800 /end MEASUREMENT
/begin MEASUREMENT Result.Dist_B03.Distab13_12T "" UBYTE ident 1 100 0 255 ECU_ADDRESS 0x7F8824 /end MEASUREMENT
/begin MEASUREMENT Result.Dist_B04.Distab13_12T "" UBYTE ident 1 100 0 255 ECU_ADDRESS 0x7F8848 /end MEASUREMENT
/begin MEASUREMENT Result.Dist_R01.Distab13_12T "" UBYTE ident 1 100 0 255 ECU_ADDRESS 0x7F886B /end MEASUREMENT
/begin MEASUREMENT Result.Dist_R02.Distab13_12T "" UBYTE ident 1 100 0 255 ECU_ADDRESS 0x7F8873 /end MEASUREMENT
/begin MEASUREMENT Result.Dist_R03.Distab13_12T "" UBYTE ident 1 100 0 255 ECU_ADDRESS 0x7F887B /end MEASUREMENT
/begin MEASUREMENT Result.Dist_R04.Distab13_12T "" UBYTE ident 1 100 0 255 ECU_ADDRESS 0x7F8883 /end MEASUREMENT
/begin MEASUREMENT Result.Dist_R05.Distab13_12T "" UBYTE ident 1 100 0 255 ECU_ADDRESS 0x7F888B /end MEASUREMENT
/begin MEASUREMENT Result.Dist_R06.Distab13_12T "" UBYTE ident 1 100 0 255 ECU_ADDRESS 0x7F8893 /end MEASUREMENT
/begin MEASUREMENT Result.Dist_R07.Distab13_12T "" UBYTE ident 1 100 0 255 ECU_ADDRESS 0x7F889B /end MEASUREMENT
/begin MEASUREMENT Result.Dist_R08.Distab13_12T "" UBYTE ident 1 100 0 255 ECU_ADDRESS 0x7F88A3 /end MEASUREMENT
/begin MEASUREMENT Result.Dist_R09.Distab13_12T "" UBYTE ident 1 100 0 255 ECU_ADDRESS 0x7F88AB /end MEASUREMENT
/begin MEASUREMENT Result.Dist_R10.Distab13_12T "" UBYTE ident 1 100 0 255 ECU_ADDRESS 0x7F88B3 /end MEASUREMENT
/begin MEASUREMENT Result.Dist_R11.Distab13_12T "" UBYTE ident 1 100 0 255 ECU_ADDRESS 0x7F88BB /end MEASUREMENT
/begin MEASUREMENT Result.Dist_R12.Distab13_12T "" UBYTE ident 1 100 0 255 ECU_ADDRESS 0x7F88C3 /end MEASUREMENT
/begin MEASUREMENT Result.Time_Calc.Curve_Module "" ULONG TickType2ms 1 100 0.1428571428571429 600000.0 ECU_ADDRESS 0x7F85F8 MATRIX_DIM 3 1 1 /end MEASUREMENT
/begin MEASUREMENT sint16_01.E_sint16.R01 "" SWORD ident 1 100 -32768 32767 ECU_ADDRESS 0x821660 DISPLAY_IDENTIFIER sint16_01.E_sint16.R01_DISP_ID_R01 /end MEASUREMENT
/begin MEASUREMENT sint16_01.E_sint16.R02 "" SWORD ident 1 100 -32768 32767 ECU_ADDRESS 0x821830 DISPLAY_IDENTIFIER sint16_01.E_sint16.R02_DISP_ID_R02 /end MEASUREMENT
/begin MEASUREMENT sint16_01.E_sint16.R03 "" SWORD ident 1 100 -32768 32767 ECU_ADDRESS 0x821900 DISPLAY_IDENTIFIER sint16_01.E_sint16.R03_DISP_ID_R03 /end MEASUREMENT
/begin MEASUREMENT sint16_01.E_sint16.R04 "" SWORD ident 1 100 -32768 32767 ECU_ADDRESS 0x8219D0 /end MEASUREMENT
/begin MEASUREMENT sint16_01.E_sint16.R05 "" SWORD ident 1 100 -32768 32767 ECU_ADDRESS 0x821AA0 /end MEASUREMENT
/begin MEASUREMENT sint16_01.E_sint16.R06 "" SWORD ident 1 100 -32768 32767 ECU_ADDRESS 0x821AD0 /end MEASUREMENT
/begin MEASUREMENT sint16_01.E_sint16.R07 "" SWORD ident 1 100 -32768 32767 ECU_ADDRESS 0x821B00 /end MEASUREMENT
/begin MEASUREMENT sint16_01.E_sint16.R08 "" SWORD ident 1 100 -32768 32767 ECU_ADDRESS 0x821B30 /end MEASUREMENT
/begin MEASUREMENT sint16_01.E_sint16.R09 "" SWORD ident 1 100 -32768 32767 ECU_ADDRESS 0x821B60 /end MEASUREMENT
/begin MEASUREMENT sint16_01.E_sint16.R10 "" SWORD ident 1 100 -32768 32767 ECU_ADDRESS 0x821B90 /end MEASUREMENT
/begin MEASUREMENT sint16_01.E_sint16.R11 "" SWORD ident 1 100 -32768 32767 ECU_ADDRESS 0x821BC0 /end MEASUREMENT
/begin MEASUREMENT sint16_01.E_sint16.R12 "" SWORD ident 1 100 -32768 32767 ECU_ADDRESS 0x821BF0 /end MEASUREMENT
/begin MEASUREMENT sint16_01.E_sint16.R13 "" SWORD ident 1 100 -32768 32767 ECU_ADDRESS 0x821C20 /end MEASUREMENT
/begin MEASUREMENT sint16_01.E_sint16.R14 "" SWORD ident 1 100 -32768 32767 ECU_ADDRESS 0x821C50 /end MEASUREMENT
/begin MEASUREMENT sint16_01.E_sint16.R15 "" SWORD ident 1 100 -32768 32767 ECU_ADDRESS 0x821C80 /end MEASUREMENT
/begin MEASUREMENT sint16_01.E_sint16_1.R01_16bit "" SWORD ident 1 100 -32768 32767 ECU_ADDRESS 0x821690 /end MEASUREMENT
/begin MEASUREMENT sint16_01.E_sint16_2.R01_16bit "" SWORD ident 1 100 -32768 32767 ECU_ADDRESS 0x8216A0 /end MEASUREMENT
/begin MEASUREMENT sint16_01.E_sint16_3.R01_16bit "" SWORD ident 1 100 -32768 32767 ECU_ADDRESS 0x8216B0 /end MEASUREMENT
/begin MEASUREMENT sint16_01.E_sint16_4.R01_16bit "" SWORD ident 1 100 -32768 32767 ECU_ADDRESS 0x8216C0 /end MEASUREMENT
/begin MEASUREMENT sint16_02.E_sint16.R01 "" SWORD ident 1 100 -32768 32767 ECU_ADDRESS 0x821662 DISPLAY_IDENTIFIER sint16_02.E_sint16.R01_DISP_ID_R01 /end MEASUREMENT
/begin MEASUREMENT sint16_02.E_sint16.R02 "" SWORD ident 1 100 -32768 32767 ECU_ADDRESS 0x821832 DISPLAY_IDENTIFIER sint16_02.E_sint16.R02_DISP_ID_R02 /end MEASUREMENT
/begin MEASUREMENT sint16_02.E_sint16.R03 "" SWORD ident 1 100 -32768 32767 ECU_ADDRESS 0x821902 DISPLAY_IDENTIFIER sint16_02.E_sint16.R03_DISP_ID_R03 /end MEASUREMENT
/begin MEASUREMENT sint16_02.E_sint16.R04 "" SWORD ident 1 100 -32768 32767 ECU_ADDRESS 0x8219D2 /end MEASUREMENT
/begin MEASUREMENT sint16_02.E_sint16.R05 "" SWORD ident 1 100 -32768 32767 ECU_ADDRESS 0x821AA2 /end MEASUREMENT
/begin MEASUREMENT sint16_02.E_sint16.R06 "" SWORD ident 1 100 -32768 32767 ECU_ADDRESS 0x821AD2 /end MEASUREMENT
/begin MEASUREMENT sint16_02.E_sint16.R07 "" SWORD ident 1 100 -32768 32767 ECU_ADDRESS 0x821B02 /end MEASUREMENT
/begin MEASUREMENT sint16_02.E_sint16.R08 "" SWORD ident 1 100 -32768 32767 ECU_ADDRESS 0x821B32 /end MEASUREMENT
/begin MEASUREMENT sint16_02.E_sint16.R09 "" SWORD ident 1 100 -32768 32767 ECU_ADDRESS 0x821B62 /end MEASUREMENT
/begin MEASUREMENT sint16_02.E_sint16.R10 "" SWORD ident 1 100 -32768 32767 ECU_ADDRESS 0x821B92 /end MEASUREMENT
/begin MEASUREMENT sint16_02.E_sint16.R11 "" SWORD ident 1 100 -32768 32767 ECU_ADDRESS 0x821BC2 /end MEASUREMENT
/begin MEASUREMENT sint16_02.E_sint16.R12 "" SWORD ident 1 100 -32768 32767 ECU_ADDRESS 0x821BF2 /end MEASUREMENT
/begin MEASUREMENT sint16_02.E_sint16.R13 "" SWORD ident 1 100 -32768 32767 ECU_ADDRESS 0x821C22 /end MEASUREMENT
/begin MEASUREMENT sint16_02.E_sint16.R14 "" SWORD ident 1 100 -32768 32767 ECU_ADDRESS 0x821C52 /end MEASUREMENT
/begin MEASUREMENT sint16_02.E_sint16.R15 "" SWORD ident 1 100 -32768 32767 ECU_ADDRESS 0x821C82 /end MEASUREMENT
/begin MEASUREMENT sint16_02.E_sint16_1.R01_16bit "" SWORD ident 1 100 -32768 32767 ECU_ADDRESS 0x821692 /end MEASUREMENT
/begin MEASUREMENT sint16_02.E_sint16_2.R01_16bit "" SWORD ident 1 100 -32768 32767 ECU_ADDRESS 0x8216A2 /end MEASUREMENT
/begin MEASUREMENT sint16_02.E_sint16_3.R01_16bit "" SWORD ident 1 100 -32768 32767 ECU_ADDRESS 0x8216B2 /end MEASUREMENT
/begin MEASUREMENT sint16_02.E_sint16_4.R01_16bit "" SWORD ident 1 100 -32768 32767 ECU_ADDRESS 0x8216C2 /end MEASUREMENT
/begin MEASUREMENT sint16_03.E_sint16.R01 "" SWORD ident 1 100 -32768 32767 ECU_ADDRESS 0x821664 DISPLAY_IDENTIFIER sint16_03.E_sint16.R01_DISP_ID_R01 /end MEASUREMENT
/begin MEASUREMENT sint16_03.E_sint16.R02 "" SWORD ident 1 100 -32768 32767 ECU_ADDRESS 0x821834 DISPLAY_IDENTIFIER sint16_03.E_sint16.R02_DISP_ID_R02 /end MEASUREMENT
/begin MEASUREMENT sint16_03.E_sint16.R03 "" SWORD ident 1 100 -32768 32767 ECU_ADDRESS 0x821904 DISPLAY_IDENTIFIER sint16_03.E_sint16.R03_DISP_ID_R03 /end MEASUREMENT
/begin MEASUREMENT sint16_03.E_sint16.R04 "" SWORD ident 1 100 -32768 32767 ECU_ADDRESS 0x8219D4 /end MEASUREMENT
/begin MEASUREMENT sint16_03.E_sint16.R05 "" SWORD ident 1 100 -32768 32767 ECU_ADDRESS 0x821AA4 /end MEASUREMENT
/begin MEASUREMENT sint16_03.E_sint16.R06 "" SWORD ident 1 100 -32768 32767 ECU_ADDRESS 0x821AD4 /end MEASUREMENT
/begin MEASUREMENT sint16_03.E_sint16.R07 "" SWORD ident 1 100 -32768 32767 ECU_ADDRESS 0x821B04 /end MEASUREMENT
/begin MEASUREMENT sint16_03.E_sint16.R08 "" SWORD ident 1 100 -32768 32767 ECU_ADDRESS 0x821B34 /end MEASUREMENT
/begin MEASUREMENT sint16_03.E_sint16.R09 "" SWORD ident 1 100 -32768 32767 ECU_ADDRESS 0x821B64 /end MEASUREMENT
/begin MEASUREMENT sint16_03.E_sint16.R10 "" SWORD ident 1 100 -32768 32767 ECU_ADDRESS 0x821B94 /end MEASUREMENT
/begin MEASUREMENT sint16_03.E_sint16.R11 "" SWORD ident 1 100 -32768 32767 ECU_ADDRESS 0x821BC4 /end MEASUREMENT
/begin MEASUREMENT sint16_03.E_sint16.R12 "" SWORD ident 1 100 -32768 32767 ECU_ADDRESS 0x821BF4 /end MEASUREMENT
/begin MEASUREMENT sint16_03.E_sint16.R13 "" SWORD ident 1 100 -32768 32767 ECU_ADDRESS 0x821C24 /end MEASUREMENT
/begin MEASUREMENT sint16_03.E_sint16.R14 "" SWORD ident 1 100 -32768 32767 ECU_ADDRESS 0x821C54 /end MEASUREMENT
/begin MEASUREMENT sint16_03.E_sint16.R15 "" SWORD ident 1 100 -32768 32767 ECU_ADDRESS 0x821C84 /end MEASUREMENT
/begin MEASUREMENT sint16_03.E_sint16_1.R01_16bit "" SWORD ident 1 100 -32768 32767 ECU_ADDRESS 0x821694 /end MEASUREMENT
/begin MEASUREMENT sint16_03.E_sint16_2.R01_16bit "" SWORD ident 1 100 -32768 32767 ECU_ADDRESS 0x8216A4 /end MEASUREMENT
/begin MEASUREMENT sint16_03.E_sint16_3.R01_16bit "" SWORD ident 1 100 -32768 32767 ECU_ADDRESS 0x8216B4 /end MEASUREMENT
/begin MEASUREMENT sint16_03.E_sint16_4.R01_16bit "" SWORD ident 1 100 -32768 32767 ECU_ADDRESS 0x8216C4 /end MEASUREMENT
/begin MEASUREMENT sint16_04.E_sint16.R01 "" SWORD ident 1 100 -32768 32767 ECU_ADDRESS 0x821666 DISPLAY_IDENTIFIER sint16_04.E_sint16.R01_DISP_ID_R01 /end MEASUREMENT
/begin MEASUREMENT sint16_04.E_sint16.R02 "" SWORD ident 1 100 -32768 32767 ECU_ADDRESS 0x821836 DISPLAY_IDENTIFIER sint16_04.E_sint16.R02_DISP_ID_R02 /end MEASUREMENT
/begin MEASUREMENT sint16_04.E_sint16.R03 "" SWORD ident 1 100 -32768 32767 ECU_ADDRESS 0x821906 DISPLAY_IDENTIFIER sint16_04.E_sint16.R03_DISP_ID_R03 /end MEASUREMENT
/begin MEASUREMENT sint16_04.E_sint16.R04 "" SWORD ident 1 100 -32768 32767 ECU_ADDRESS 0x8219D6 /end MEASUREMENT
/begin MEASUREMENT sint16_04.E_sint16.R05 "" SWORD ident 1 100 -32768 32767 ECU_ADDRESS 0x821AA6 /end MEASUREMENT
/begin MEASUREMENT sint16_04.E_sint16.R06 "" SWORD ident 1 100 -32768 32767 ECU_ADDRESS 0x821AD6 /end MEASUREMENT
/begin MEASUREMENT sint16_04.E_sint16.R07 "" SWORD ident 1 100 -32768 32767 ECU_ADDRESS 0x821B06 /end MEASUREMENT
/begin MEASUREMENT sint16_04.E_sint16.R08 "" SWORD ident 1 100 -32768 32767 ECU_ADDRESS 0x821B36 /end MEASUREMENT
/begin MEASUREMENT sint16_04.E_sint16.R09 "" SWORD ident 1 100 -32768 32767 ECU_ADDRESS 0x821B66 /end MEASUREMENT
/begin MEASUREMENT sint16_04.E_sint16.R10 "" SWORD ident 1 100 -32768 32767 ECU_ADDRESS 0x821B96 /end MEASUREMENT
/begin MEASUREMENT sint16_04.E_sint16.R11 "" SWORD ident 1 100 -32768 32767 ECU_ADDRESS 0x821BC6 /end MEASUREMENT
/begin MEASUREMENT sint16_04.E_sint16.R12 "" SWORD ident 1 100 -32768 32767 ECU_ADDRESS 0x821BF6 /end MEASUREMENT
/begin MEASUREMENT sint16_04.E_sint16.R13 "" SWORD ident 1 100 -32768 32767 ECU_ADDRESS 0x821C26 /end MEASUREMENT
/begin MEASUREMENT sint16_04.E_sint16.R14 "" SWORD ident 1 100 -32768 32767 ECU_ADDRESS 0x821C56 /end MEASUREMENT
/begin MEASUREMENT sint16_04.E_sint16.R15 "" SWORD ident 1 100 -32768 32767 ECU_ADDRESS 0x821C86 /end MEASUREMENT
/begin MEASUREMENT sint16_04.E_sint16_1.R01_16bit "" SWORD ident 1 100 -32768 32767 ECU_ADDRESS 0x821696 /end MEASUREMENT
/begin MEASUREMENT sint16_04.E_sint16_2.R01_16bit "" SWORD ident 1 100 -32768 32767 ECU_ADDRESS 0x8216A6 /end MEASUREMENT
/begin MEASUREMENT sint16_04.E_sint16_3.R01_16bit "" SWORD ident 1 100 -32768 32767 ECU_ADDRESS 0x8216B6 /end MEASUREMENT
/begin MEASUREMENT sint16_04.E_sint16_4.R01_16bit "" SWORD ident 1 100 -32768 32767 ECU_ADDRESS 0x8216C6 /end MEASUREMENT
/begin MEASUREMENT sint16_05.E_sint16.R01 "" SWORD ident 1 100 -32768 32767 ECU_ADDRESS 0x821668 DISPLAY_IDENTIFIER sint16_05.E_sint16.R01_DISP_ID_R01 /end MEASUREMENT
/begin MEASUREMENT sint16_05.E_sint16.R02 "" SWORD ident 1 100 -32768 32767 ECU_ADDRESS 0x821838 DISPLAY_IDENTIFIER sint16_05.E_sint16.R02_DISP_ID_R02 /end MEASUREMENT
/begin MEASUREMENT sint16_05.E_sint16.R03 "" SWORD ident 1 100 -32768 32767 ECU_ADDRESS 0x821908 DISPLAY_IDENTIFIER sint16_05.E_sint16.R03_DISP_ID_R03 /end MEASUREMENT
/begin MEASUREMENT sint16_05.E_sint16.R04 "" SWORD ident 1 100 -32768 32767 ECU_ADDRESS 0x8219D8 /end MEASUREMENT
/begin MEASUREMENT sint16_05.E_sint16.R05 "" SWORD ident 1 100 -32768 32767 ECU_ADDRESS 0x821AA8 /end MEASUREMENT
/begin MEASUREMENT sint16_05.E_sint16.R06 "" SWORD ident 1 100 -32768 32767 ECU_ADDRESS 0x821AD8 /end MEASUREMENT
/begin MEASUREMENT sint16_05.E_sint16.R07 "" SWORD ident 1 100 -32768 32767 ECU_ADDRESS 0x821B08 /end MEASUREMENT
/begin MEASUREMENT sint16_05.E_sint16.R08 "" SWORD ident 1 100 -32768 32767 ECU_ADDRESS 0x821B38 /end MEASUREMENT
/begin MEASUREMENT sint16_05.E_sint16.R09 "" SWORD ident 1 100 -32768 32767 ECU_ADDRESS 0x821B68 /end MEASUREMENT
/begin MEASUREMENT sint16_05.E_sint16.R10 "" SWORD ident 1 100 -32768 32767 ECU_ADDRESS 0x821B98 /end MEASUREMENT
/begin MEASUREMENT sint16_05.E_sint16.R11 "" SWORD ident 1 100 -32768 32767 ECU_ADDRESS 0x821BC8 /end MEASUREMENT
/begin MEASUREMENT sint16_05.E_sint16.R12 "" SWORD ident 1 100 -32768 32767 ECU_ADDRESS 0x821BF8 /end MEASUREMENT
/begin MEASUREMENT sint16_05.E_sint16.R13 "" SWORD ident 1 100 -32768 32767 ECU_ADDRESS 0x821C28 /end MEASUREMENT
/begin MEASUREMENT sint16_05.E_sint16.R14 "" SWORD ident 1 100 -32768 32767 ECU_ADDRESS 0x821C58 /end MEASUREMENT
/begin MEASUREMENT sint16_05.E_sint16.R15 "" SWORD ident 1 100 -32768 32767 ECU_ADDRESS 0x821C88 /end MEASUREMENT
/begin MEASUREMENT sint16_05.E_sint16_1.R01_16bit "" SWORD ident 1 100 -32768 32767 ECU_ADDRESS 0x821698 /end MEASUREMENT
/begin MEASUREMENT sint16_05.E_sint16_2.R01_16bit "" SWORD ident 1 100 -32768 32767 ECU_ADDRESS 0x8216A8 /end MEASUREMENT
/begin MEASUREMENT sint16_05.E_sint16_3.R01_16bit "" SWORD ident 1 100 -32768 32767 ECU_ADDRESS 0x8216B8 /end MEASUREMENT
/begin MEASUREMENT sint16_05.E_sint16_4.R01_16bit "" SWORD ident 1 100 -32768 32767 ECU_ADDRESS 0x8216C8 /end MEASUREMENT
/begin MEASUREMENT sint16_06.E_sint16.R01 "" SWORD ident 1 100 -32768 32767 ECU_ADDRESS 0x82166A DISPLAY_IDENTIFIER sint16_06.E_sint16.R01_DISP_ID_R01 /end MEASUREMENT
/begin MEASUREMENT sint16_06.E_sint16.R02 "" SWORD ident 1 100 -32768 32767 ECU_ADDRESS 0x82183A DISPLAY_IDENTIFIER sint16_06.E_sint16.R02_DISP_ID_R02 /end MEASUREMENT
/begin MEASUREMENT sint16_06.E_sint16.R03 "" SWORD ident 1 100 -32768 32767 ECU_ADDRESS 0x82190A DISPLAY_IDENTIFIER sint16_06.E_sint16.R03_DISP_ID_R03 /end MEASUREMENT
/begin MEASUREMENT sint16_06.E_sint16.R04 "" SWORD ident 1 100 -32768 32767 ECU_ADDRESS 0x8219DA /end MEASUREMENT
/begin MEASUREMENT sint16_06.E_sint16.R05 "" SWORD ident 1 100 -32768 32767 ECU_ADDRESS 0x821AAA /end MEASUREMENT
/begin MEASUREMENT sint16_06.E_sint16.R06 "" SWORD ident 1 100 -32768 32767 ECU_ADDRESS 0x821ADA /end MEASUREMENT
/begin MEASUREMENT sint16_06.E_sint16.R07 "" SWORD ident 1 100 -32768 32767 ECU_ADDRESS 0x821B0A /end MEASUREMENT
/begin MEASUREMENT sint16_06.E_sint16.R08 "" SWORD ident 1 100 -32768 32767 ECU_ADDRESS 0x821B3A /end MEASUREMENT
/begin MEASUREMENT sint16_06.E_sint16.R09 "" SWORD ident 1 100 -32768 32767 ECU_ADDRESS 0x821B6A /end MEASUREMENT
/begin MEASUREMENT sint16_06.E_sint16.R10 "" SWORD ident 1 100 -32768 32767 ECU_ADDRESS 0x821B9A /end MEASUREMENT
/begin MEASUREMENT sint16_06.E_sint16.R11 "" SWORD ident 1 100 -32768 32767 ECU_ADDRESS 0x821BCA /end MEASUREMENT
/begin MEASUREMENT sint16_06.E_sint16.R12 "" SWORD ident 1 100 -32768 32767 ECU_ADDRESS 0x821BFA /end MEASUREMENT
/begin MEASUREMENT sint16_06.E_sint16.R13 "" SWORD ident 1 100 -32768 32767 ECU_ADDRESS 0x821C2A /end MEASUREMENT
/begin MEASUREMENT sint16_06.E_sint16.R14 "" SWORD ident 1 100 -32768 32767 ECU_ADDRESS 0x821C5A /end MEASUREMENT
/begin MEASUREMENT sint16_06.E_sint16.R15 "" SWORD ident 1 100 -32768 32767 ECU_ADDRESS 0x821C8A /end MEASUREMENT
/begin MEASUREMENT sint16_06.E_sint16_1.R01_16bit "" SWORD ident 1 100 -32768 32767 ECU_ADDRESS 0x82169A /end MEASUREMENT
/begin MEASUREMENT sint16_06.E_sint16_2.R01_16bit "" SWORD ident 1 100 -32768 32767 ECU_ADDRESS 0x8216AA /end MEASUREMENT
/begin MEASUREMENT sint16_06.E_sint16_3.R01_16bit "" SWORD ident 1 100 -32768 32767 ECU_ADDRESS 0x8216BA /end MEASUREMENT
/begin MEASUREMENT sint16_06.E_sint16_4.R01_16bit "" SWORD ident 1 100 -32768 32767 ECU_ADDRESS 0x8216CA /end MEASUREMENT
/begin MEASUREMENT sint16_07.E_sint16.R01 "" SWORD ident 1 100 -32768 32767 ECU_ADDRESS 0x82166C DISPLAY_IDENTIFIER sint16_07.E_sint16.R01_DISP_ID_R01 /end MEASUREMENT
/begin MEASUREMENT sint16_07.E_sint16.R02 "" SWORD ident 1 100 -32768 32767 ECU_ADDRESS 0x82183C DISPLAY_IDENTIFIER sint16_07.E_sint16.R02_DISP_ID_R02 /end MEASUREMENT
/begin MEASUREMENT sint16_07.E_sint16.R03 "" SWORD ident 1 100 -32768 32767 ECU_ADDRESS 0x82190C DISPLAY_IDENTIFIER sint16_07.E_sint16.R03_DISP_ID_R03 /end MEASUREMENT
/begin MEASUREMENT sint16_07.E_sint16.R04 "" SWORD ident 1 100 -32768 32767 ECU_ADDRESS 0x8219DC /end MEASUREMENT
/begin MEASUREMENT sint16_07.E_sint16.R05 "" SWORD ident 1 100 -32768 32767 ECU_ADDRESS 0x821AAC /end MEASUREMENT
/begin MEASUREMENT sint16_07.E_sint16.R06 "" SWORD ident 1 100 -32768 32767 ECU_ADDRESS 0x821ADC /end MEASUREMENT
/begin MEASUREMENT sint16_07.E_sint16.R07 "" SWORD ident 1 100 -32768 32767 ECU_ADDRESS 0x821B0C /end MEASUREMENT
/begin MEASUREMENT sint16_07.E_sint16.R08 "" SWORD ident 1 100 -32768 32767 ECU_ADDRESS 0x821B3C /end MEASUREMENT
/begin MEASUREMENT sint16_07.E_sint16.R09 "" SWORD ident 1 100 -32768 32767 ECU_ADDRESS 0x821B6C /end MEASUREMENT
/begin MEASUREMENT sint16_07.E_sint16.R10 "" SWORD ident 1 100 -32768 32767 ECU_ADDRESS 0x821B9C /end MEASUREMENT
/begin MEASUREMENT sint16_07.E_sint16.R11 "" SWORD ident 1 100 -32768 32767 ECU_ADDRESS 0x821BCC /end MEASUREMENT
/begin MEASUREMENT sint16_07.E_sint16.R12 "" SWORD ident 1 100 -32768 32767 ECU_ADDRESS 0x821BFC /end MEASUREMENT
/begin MEASUREMENT sint16_07.E_sint16.R13 "" SWORD ident 1 100 -32768 32767 ECU_ADDRESS 0x821C2C /end MEASUREMENT
/begin MEASUREMENT sint16_07.E_sint16.R14 "" SWORD ident 1 100 -32768 32767 ECU_ADDRESS 0x821C5C /end MEASUREMENT
/begin MEASUREMENT sint16_07.E_sint16.R15 "" SWORD ident 1 100 -32768 32767 ECU_ADDRESS 0x821C8C /end MEASUREMENT
/begin MEASUREMENT sint16_07.E_sint16_1.R01_16bit "" SWORD ident 1 100 -32768 32767 ECU_ADDRESS 0x82169C /end MEASUREMENT
/begin MEASUREMENT sint16_07.E_sint16_2.R01_16bit "" SWORD ident 1 100 -32768 32767 ECU_ADDRESS 0x8216AC /end MEASUREMENT
/begin MEASUREMENT sint16_07.E_sint16_3.R01_16bit "" SWORD ident 1 100 -32768 32767 ECU_ADDRESS 0x8216BC /end MEASUREMENT
/begin MEASUREMENT sint16_07.E_sint16_4.R01_16bit "" SWORD ident 1 100 -32768 32767 ECU_ADDRESS 0x8216CC /end MEASUREMENT
/begin MEASUREMENT sint16_08.E_sint16.R01 "" SWORD ident 1 100 -32768 32767 ECU_ADDRESS 0x82166E DISPLAY_IDENTIFIER sint16_08.E_sint16.R01_DISP_ID_R01 /end MEASUREMENT
/begin MEASUREMENT sint16_08.E_sint16.R02 "" SWORD ident 1 100 -32768 32767 ECU_ADDRESS 0x82183E DISPLAY_IDENTIFIER sint16_08.E_sint16.R02_DISP_ID_R02 /end MEASUREMENT
/begin MEASUREMENT sint16_08.E_sint16.R03 "" SWORD ident 1 100 -32768 32767 ECU_ADDRESS 0x82190E DISPLAY_IDENTIFIER sint16_08.E_sint16.R03_DISP_ID_R03 /end MEASUREMENT
/begin MEASUREMENT sint16_08.E_sint16.R04 "" SWORD ident 1 100 -32768 32767 ECU_ADDRESS 0x8219DE /end MEASUREMENT
/begin MEASUREMENT sint16_08.E_sint16.R05 "" SWORD ident 1 100 -32768 32767 ECU_ADDRESS 0x821AAE /end MEASUREMENT
/begin MEASUREMENT sint16_08.E_sint16.R06 "" SWORD ident 1 100 -32768 32767 ECU_ADDRESS 0x821ADE /end MEASUREMENT
/begin MEASUREMENT sint16_08.E_sint16.R07 "" SWORD ident 1 100 -32768 32767 ECU_ADDRESS 0x821B0E /end MEASUREMENT
/begin MEASUREMENT sint16_08.E_sint16.R08 "" SWORD ident 1 100 -32768 32767 ECU_ADDRESS 0x821B3E /end MEASUREMENT
/begin MEASUREMENT sint16_08.E_sint16.R09 "" SWORD ident 1 100 -32768 32767 ECU_ADDRESS 0x821B6E /end MEASUREMENT
/begin MEASUREMENT sint16_08.E_sint16.R10 "" SWORD ident 1 100 -32768 32767 ECU_ADDRESS 0x821B9E /end MEASUREMENT
/begin MEASUREMENT sint16_08.E_sint16.R11 "" SWORD ident 1 100 -32768 32767 ECU_ADDRESS 0x821BCE /end MEASUREMENT
/begin MEASUREMENT sint16_08.E_sint16.R12 "" SWORD ident 1 100 -32768 32767 ECU_ADDRESS 0x821BFE /end MEASUREMENT
/begin MEASUREMENT sint16_08.E_sint16.R13 "" SWORD ident 1 100 -32768 32767 ECU_ADDRESS 0x821C2E /end MEASUREMENT
/begin MEASUREMENT sint16_08.E_sint16.R14 "" SWORD ident 1 100 -32768 32767 ECU_ADDRESS 0x821C5E /end MEASUREMENT
/begin MEASUREMENT sint16_08.E_sint16.R15 "" SWORD ident 1 100 -32768 32767 ECU_ADDRESS 0x821C8E /end MEASUREMENT
/begin MEASUREMENT sint16_08.E_sint16_1.R01_16bit "" SWORD ident 1 100 -32768 32767 ECU_ADDRESS 0x82169E /end MEASUREMENT
/begin MEASUREMENT sint16_08.E_sint16_2.R01_16bit "" SWORD ident 1 100 -32768 32767 ECU_ADDRESS 0x8216AE /end MEASUREMENT
/begin MEASUREMENT sint16_08.E_sint16_3.R01_16bit "" SWORD ident 1 100 -32768 32767 ECU_ADDRESS 0x8216BE /end MEASUREMENT
/begin MEASUREMENT sint16_08.E_sint16_4.R01_16bit "" SWORD ident 1 100 -32768 32767 ECU_ADDRESS 0x8216CE /end MEASUREMENT
/begin MEASUREMENT sint32_01.E_sint32.R01_B "" SLONG ident 1 100 -2147483648 2147483647 ECU_ADDRESS 0x8217F0 /end MEASUREMENT
/begin MEASUREMENT sint32_01.E_sint32.R02_B "" SLONG ident 1 100 -2147483648 2147483647 ECU_ADDRESS 0x8218C0 /end MEASUREMENT
/begin MEASUREMENT sint32_01.E_sint32.R03_B "" SLONG ident 1 100 -2147483648 2147483647 ECU_ADDRESS 0x821990 /end MEASUREMENT
/begin MEASUREMENT sint32_01.E_sint32.R04_B "" SLONG ident 1 100 -2147483648 2147483647 ECU_ADDRESS 0x821A60 /end MEASUREMENT
/begin MEASUREMENT sint32_02.E_sint32.R01_B "" SLONG ident 1 100 -2147483648 2147483647 ECU_ADDRESS 0x8217F4 /end MEASUREMENT
/begin MEASUREMENT sint32_02.E_sint32.R02_B "" SLONG ident 1 100 -2147483648 2147483647 ECU_ADDRESS 0x8218C4 /end MEASUREMENT
/begin MEASUREMENT sint32_02.E_sint32.R03_B "" SLONG ident 1 100 -2147483648 2147483647 ECU_ADDRESS 0x821994 /end MEASUREMENT
/begin MEASUREMENT sint32_02.E_sint32.R04_B "" SLONG ident 1 100 -2147483648 2147483647 ECU_ADDRESS 0x821A64 /end MEASUREMENT
/begin MEASUREMENT sint32_03.E_sint32.R01_B "" SLONG ident 1 100 -2147483648 2147483647 ECU_ADDRESS 0x8217F8 /end MEASUREMENT
/begin MEASUREMENT sint32_03.E_sint32.R02_B "" SLONG ident 1 100 -2147483648 2147483647 ECU_ADDRESS 0x8218C8 /end MEASUREMENT
/begin MEASUREMENT sint32_03.E_sint32.R03_B "" SLONG ident 1 100 -2147483648 2147483647 ECU_ADDRESS 0x821998 /end MEASUREMENT
/begin MEASUREMENT sint32_03.E_sint32.R04_B "" SLONG ident 1 100 -2147483648 2147483647 ECU_ADDRESS 0x821A68 /end MEASUREMENT
/begin MEASUREMENT sint32_04.E_sint32.R01_B "" SLONG ident 1 100 -2147483648 2147483647 ECU_ADDRESS 0x8217FC /end MEASUREMENT
/begin MEASUREMENT sint32_04.E_sint32.R02_B "" SLONG ident 1 100 -2147483648 2147483647 ECU_ADDRESS 0x8218CC /end MEASUREMENT
/begin MEASUREMENT sint32_04.E_sint32.R03_B "" SLONG ident 1 100 -2147483648 2147483647 ECU_ADDRESS 0x82199C /end MEASUREMENT
/begin MEASUREMENT sint32_04.E_sint32.R04_B "" SLONG ident 1 100 -2147483648 2147483647 ECU_ADDRESS 0x821A6C /end MEASUREMENT
/begin MEASUREMENT sint32_05.E_sint32.R01_B "" SLONG ident 1 100 -2147483648 2147483647 ECU_ADDRESS 0x821800 /end MEASUREMENT
/begin MEASUREMENT sint32_05.E_sint32.R02_B "" SLONG ident 1 100 -2147483648 2147483647 ECU_ADDRESS 0x8218D0 /end MEASUREMENT
/begin MEASUREMENT sint32_05.E_sint32.R03_B "" SLONG ident 1 100 -2147483648 2147483647 ECU_ADDRESS 0x8219A0 /end MEASUREMENT
/begin MEASUREMENT sint32_05.E_sint32.R04_B "" SLONG ident 1 100 -2147483648 2147483647 ECU_ADDRESS 0x821A70 /end MEASUREMENT
/begin MEASUREMENT sint32_06.E_sint32.R01_B "" SLONG ident 1 100 -2147483648 2147483647 ECU_ADDRESS 0x821804 /end MEASUREMENT
/begin MEASUREMENT sint32_06.E_sint32.R02_B "" SLONG ident 1 100 -2147483648 2147483647 ECU_ADDRESS 0x8218D4 /end MEASUREMENT
/begin MEASUREMENT sint32_06.E_sint32.R03_B "" SLONG ident 1 100 -2147483648 2147483647 ECU_ADDRESS 0x8219A4 /end MEASUREMENT
/begin MEASUREMENT sint32_06.E_sint32.R04_B "" SLONG ident 1 100 -2147483648 2147483647 ECU_ADDRESS 0x821A74 /end MEASUREMENT
/begin MEASUREMENT sint32_07.E_sint32.R01_B "" SLONG ident 1 100 -2147483648 2147483647 ECU_ADDRESS 0x821808 /end MEASUREMENT
/begin MEASUREMENT sint32_07.E_sint32.R02_B "" SLONG ident 1 100 -2147483648 2147483647 ECU_ADDRESS 0x8218D8 /end MEASUREMENT
/begin MEASUREMENT sint32_07.E_sint32.R03_B "" SLONG ident 1 100 -2147483648 2147483647 ECU_ADDRESS 0x8219A8 /end MEASUREMENT
/begin MEASUREMENT sint32_07.E_sint32.R04_B "" SLONG ident 1 100 -2147483648 2147483647 ECU_ADDRESS 0x821A78 /end MEASUREMENT
/begin MEASUREMENT sint32_08.E_sint32.R01_B "" SLONG ident 1 100 -2147483648 2147483647 ECU_ADDRESS 0x82180C /end MEASUREMENT
/begin MEASUREMENT sint32_08.E_sint32.R02_B "" SLONG ident 1 100 -2147483648 2147483647 ECU_ADDRESS 0x8218DC /end MEASUREMENT
/begin MEASUREMENT sint32_08.E_sint32.R03_B "" SLONG ident 1 100 -2147483648 2147483647 ECU_ADDRESS 0x8219AC /end MEASUREMENT
/begin MEASUREMENT sint32_08.E_sint32.R04_B "" SLONG ident 1 100 -2147483648 2147483647 ECU_ADDRESS 0x821A7C /end MEASUREMENT
/begin MEASUREMENT sint8_01.E_sint8.R01 "" SBYTE ident 1 100 -128 127 ECU_ADDRESS 0x821670 DISPLAY_IDENTIFIER sint8_01.E_sint8.R01_DISP_ID_R01 /end MEASUREMENT
/begin MEASUREMENT sint8_01.E_sint8.R02 "" SBYTE ident 1 100 -128 127 ECU_ADDRESS 0x821840 DISPLAY_IDENTIFIER sint8_01.E_sint8.R02_DISP_ID_R02 /end MEASUREMENT
/begin MEASUREMENT sint8_01.E_sint8.R03 "" SBYTE ident 1 100 -128 127 ECU_ADDRESS 0x821910 DISPLAY_IDENTIFIER sint8_01.E_sint8.R03_DISP_ID_R03 /end MEASUREMENT
/begin MEASUREMENT sint8_01.E_sint8.R04 "" SBYTE ident 1 100 -128 127 ECU_ADDRESS 0x8219E0 /end MEASUREMENT
/begin MEASUREMENT sint8_01.E_sint8.R05 "" SBYTE ident 1 100 -128 127 ECU_ADDRESS 0x821AB0 /end MEASUREMENT
/begin MEASUREMENT sint8_01.E_sint8.R06 "" SBYTE ident 1 100 -128 127 ECU_ADDRESS 0x821AE0 /end MEASUREMENT
/begin MEASUREMENT sint8_01.E_sint8.R07 "" SBYTE ident 1 100 -128 127 ECU_ADDRESS 0x821B10 /end MEASUREMENT
/begin MEASUREMENT sint8_01.E_sint8.R08 "" SBYTE ident 1 100 -128 127 ECU_ADDRESS 0x821B40 /end MEASUREMENT
/begin MEASUREMENT sint8_01.E_sint8.R09 "" SBYTE ident 1 100 -128 127 ECU_ADDRESS 0x821B70 /end MEASUREMENT
/begin MEASUREMENT sint8_01.E_sint8.R10 "" SBYTE ident 1 100 -128 127 ECU_ADDRESS 0x821BA0 /end MEASUREMENT
/begin MEASUREMENT sint8_01.E_sint8.R11 "" SBYTE ident 1 100 -128 127 ECU_ADDRESS 0x821BD0 /end MEASUREMENT
/begin MEASUREMENT sint8_01.E_sint8.R12 "" SBYTE ident 1 100 -128 127 ECU_ADDRESS 0x821C00 /end MEASUREMENT
/begin MEASUREMENT sint8_01.E_sint8.R13 "" SBYTE ident 1 100 -128 127 ECU_ADDRESS 0x821C30 /end MEASUREMENT
/begin MEASUREMENT sint8_01.E_sint8.R14 "" SBYTE ident 1 100 -128 127 ECU_ADDRESS 0x821C60 /end MEASUREMENT
/begin MEASUREMENT sint8_01.E_sint8.R15 "" SBYTE ident 1 100 -128 127 ECU_ADDRESS 0x821C90 /end MEASUREMENT
/begin MEASUREMENT sint8_01.E_sint8.R16 "" SBYTE ident 1 100 -128 127 ECU_ADDRESS 0x821CB0 /end MEASUREMENT
/begin MEASUREMENT sint8_01.E_sint8_1.R01_8bit "" SBYTE ident 1 100 -128 127 ECU_ADDRESS 0x821710 /end MEASUREMENT
/begin MEASUREMENT sint8_01.E_sint8_2.R01_8bit "" SBYTE ident 1 100 -128 127 ECU_ADDRESS 0x821718 /end MEASUREMENT
/begin MEASUREMENT sint8_01.E_sint8_3.R01_8bit "" SBYTE ident 1 100 -128 127 ECU_ADDRESS 0x821720 /end MEASUREMENT
/begin MEASUREMENT sint8_01.E_sint8_4.R01_8bit "" SBYTE ident 1 100 -128 127 ECU_ADDRESS 0x821728 /end MEASUREMENT
/begin MEASUREMENT sint8_01.E_sint8_5.R01_8bit "" SBYTE ident 1 100 -128 127 ECU_ADDRESS 0x821730 /end MEASUREMENT
/begin MEASUREMENT sint8_01.E_sint8_6.R01_8bit "" SBYTE ident 1 100 -128 127 ECU_ADDRESS 0x821738 /end MEASUREMENT
/begin MEASUREMENT sint8_01.E_sint8_7.R01_8bit "" SBYTE ident 1 100 -128 127 ECU_ADDRESS 0x821740 /end MEASUREMENT
/begin MEASUREMENT sint8_01.E_sint8_8.R01_8bit "" SBYTE ident 1 100 -128 127 ECU_ADDRESS 0x821748 /end MEASUREMENT
/begin MEASUREMENT sint8_02.E_sint8.R01 "" SBYTE ident 1 100 -128 127 ECU_ADDRESS 0x821671 DISPLAY_IDENTIFIER sint8_02.E_sint8.R01_DISP_ID_R01 /end MEASUREMENT
/begin MEASUREMENT sint8_02.E_sint8.R02 "" SBYTE ident 1 100 -128 127 ECU_ADDRESS 0x821841 DISPLAY_IDENTIFIER sint8_02.E_sint8.R02_DISP_ID_R02 /end MEASUREMENT
/begin MEASUREMENT sint8_02.E_sint8.R03 "" SBYTE ident 1 100 -128 127 ECU_ADDRESS 0x821911 DISPLAY_IDENTIFIER sint8_02.E_sint8.R03_DISP_ID_R03 /end MEASUREMENT
/begin MEASUREMENT sint8_02.E_sint8.R04 "" SBYTE ident 1 100 -128 127 ECU_ADDRESS 0x8219E1 /end MEASUREMENT
/begin MEASUREMENT sint8_02.E_sint8.R05 "" SBYTE ident 1 100 -128 127 ECU_ADDRESS 0x821AB1 /end MEASUREMENT
/begin MEASUREMENT sint8_02.E_sint8.R06 "" SBYTE ident 1 100 -128 127 ECU_ADDRESS 0x821AE1 /end MEASUREMENT
/begin MEASUREMENT sint8_02.E_sint8.R07 "" SBYTE ident 1 100 -128 127 ECU_ADDRESS 0x821B11 /end MEASUREMENT
/begin MEASUREMENT sint8_02.E_sint8.R08 "" SBYTE ident 1 100 -128 127 ECU_ADDRESS 0x821B41 /end MEASUREMENT
/begin MEASUREMENT sint8_02.E_sint8.R09 "" SBYTE ident 1 100 -128 127 ECU_ADDRESS 0x821B71 /end MEASUREMENT
/begin MEASUREMENT sint8_02.E_sint8.R10 "" SBYTE ident 1 100 -128 127 ECU_ADDRESS 0x821BA1 /end MEASUREMENT
/begin MEASUREMENT sint8_02.E_sint8.R11 "" SBYTE ident 1 100 -128 127 ECU_ADDRESS 0x821BD1 /end MEASUREMENT
/begin MEASUREMENT sint8_02.E_sint8.R12 "" SBYTE ident 1 100 -128 127 ECU_ADDRESS 0x821C01 /end MEASUREMENT
/begin MEASUREMENT sint8_02.E_sint8.R13 "" SBYTE ident 1 100 -128 127 ECU_ADDRESS 0x821C31 /end MEASUREMENT
/begin MEASUREMENT sint8_02.E_sint8.R14 "" SBYTE ident 1 100 -128 127 ECU_ADDRESS 0x821C61 /end MEASUREMENT
/begin MEASUREMENT sint8_02.E_sint8.R15 "" SBYTE ident 1 100 -128 127 ECU_ADDRESS 0x821C91 /end MEASUREMENT
/begin MEASUREMENT sint8_02.E_sint8.R16 "" SBYTE ident 1 100 -128 127 ECU_ADDRESS 0x821CB1 /end MEASUREMENT
/begin MEASUREMENT sint8_02.E_sint8_1.R01_8bit "" SBYTE ident 1 100 -128 127 ECU_ADDRESS 0x821711 /end MEASUREMENT
/begin MEASUREMENT sint8_02.E_sint8_2.R01_8bit "" SBYTE ident 1 100 -128 127 ECU_ADDRESS 0x821719 /end MEASUREMENT
/begin MEASUREMENT sint8_02.E_sint8_3.R01_8bit "" SBYTE ident 1 100 -128 127 ECU_ADDRESS 0x821721 /end MEASUREMENT
/begin MEASUREMENT sint8_02.E_sint8_4.R01_8bit "" SBYTE ident 1 100 -128 127 ECU_ADDRESS 0x821729 /end MEASUREMENT
/begin MEASUREMENT sint8_02.E_sint8_5.R01_8bit "" SBYTE ident 1 100 -128 127 ECU_ADDRESS 0x821731 /end MEASUREMENT
/begin MEASUREMENT sint8_02.E_sint8_6.R01_8bit "" SBYTE ident 1 100 -128 127 ECU_ADDRESS 0x821739 /end MEASUREMENT
/begin MEASUREMENT sint8_02.E_sint8_7.R01_8bit "" SBYTE ident 1 100 -128 127 ECU_ADDRESS 0x821741 /end MEASUREMENT
/begin MEASUREMENT sint8_02.E_sint8_8.R01_8bit "" SBYTE ident 1 100 -128 127 ECU_ADDRESS 0x821749 /end MEASUREMENT
/begin MEASUREMENT sint8_03.E_sint8.R01 "" SBYTE ident 1 100 -128 127 ECU_ADDRESS 0x821672 DISPLAY_IDENTIFIER sint8_03.E_sint8.R01_DISP_ID_R01 /end MEASUREMENT
/begin MEASUREMENT sint8_03.E_sint8.R02 "" SBYTE ident 1 100 -128 127 ECU_ADDRESS 0x821842 DISPLAY_IDENTIFIER sint8_03.E_sint8.R02_DISP_ID_R02 /end MEASUREMENT
/begin MEASUREMENT sint8_03.E_sint8.R03 "" SBYTE ident 1 100 -128 127 ECU_ADDRESS 0x821912 DISPLAY_IDENTIFIER sint8_03.E_sint8.R03_DISP_ID_R03 /end MEASUREMENT
/begin MEASUREMENT sint8_03.E_sint8.R04 "" SBYTE ident 1 100 -128 127 ECU_ADDRESS 0x8219E2 /end MEASUREMENT
/begin MEASUREMENT sint8_03.E_sint8.R05 "" SBYTE ident 1 100 -128 127 ECU_ADDRESS 0x821AB2 /end MEASUREMENT
/begin MEASUREMENT sint8_03.E_sint8.R06 "" SBYTE ident 1 100 -128 127 ECU_ADDRESS 0x821AE2 /end MEASUREMENT
/begin MEASUREMENT sint8_03.E_sint8.R07 "" SBYTE ident 1 100 -128 127 ECU_ADDRESS 0x821B12 /end MEASUREMENT
/begin MEASUREMENT sint8_03.E_sint8.R08 "" SBYTE ident 1 100 -128 127 ECU_ADDRESS 0x821B42 /end MEASUREMENT
/begin MEASUREMENT sint8_03.E_sint8.R09 "" SBYTE ident 1 100 -128 127 ECU_ADDRESS 0x821B72 /end MEASUREMENT
/begin MEASUREMENT sint8_03.E_sint8.R10 "" SBYTE ident 1 100 -128 127 ECU_ADDRESS 0x821BA2 /end MEASUREMENT
/begin MEASUREMENT sint8_03.E_sint8.R11 "" SBYTE ident 1 100 -128 127 ECU_ADDRESS 0x821BD2 /end MEASUREMENT
/begin MEASUREMENT sint8_03.E_sint8.R12 "" SBYTE ident 1 100 -128 127 ECU_ADDRESS 0x821C02 /end MEASUREMENT
/begin MEASUREMENT sint8_03.E_sint8.R13 "" SBYTE ident 1 100 -128 127 ECU_ADDRESS 0x821C32 /end MEASUREMENT
/begin MEASUREMENT sint8_03.E_sint8.R14 "" SBYTE ident 1 100 -128 127 ECU_ADDRESS 0x821C62 /end MEASUREMENT
/begin MEASUREMENT sint8_03.E_sint8.R15 "" SBYTE ident 1 100 -128 127 ECU_ADDRESS 0x821C92 /end MEASUREMENT
/begin MEASUREMENT sint8_03.E_sint8.R16 "" SBYTE ident 1 100 -128 127 ECU_ADDRESS 0x821CB2 /end MEASUREMENT
/begin MEASUREMENT sint8_03.E_sint8_1.R01_8bit "" SBYTE ident 1 100 -128 127 ECU_ADDRESS 0x821712 /end MEASUREMENT
/begin MEASUREMENT sint8_03.E_sint8_2.R01_8bit "" SBYTE ident 1 100 -128 127 ECU_ADDRESS 0x82171A /end MEASUREMENT
/begin MEASUREMENT sint8_03.E_sint8_3.R01_8bit "" SBYTE ident 1 100 -128 127 ECU_ADDRESS 0x821722 /end MEASUREMENT
/begin MEASUREMENT sint8_03.E_sint8_4.R01_8bit "" SBYTE ident 1 100 -128 127 ECU_ADDRESS 0x82172A /end MEASUREMENT
/begin MEASUREMENT sint8_03.E_sint8_5.R01_8bit "" SBYTE ident 1 100 -128 127 ECU_ADDRESS 0x821732 /end MEASUREMENT
/begin MEASUREMENT sint8_03.E_sint8_6.R01_8bit "" SBYTE ident 1 100 -128 127 ECU_ADDRESS 0x82173A /end MEASUREMENT
/begin MEASUREMENT sint8_03.E_sint8_7.R01_8bit "" SBYTE ident 1 100 -128 127 ECU_ADDRESS 0x821742 /end MEASUREMENT
/begin MEASUREMENT sint8_03.E_sint8_8.R01_8bit "" SBYTE ident 1 100 -128 127 ECU_ADDRESS 0x82174A /end MEASUREMENT
/begin MEASUREMENT sint8_04.E_sint8.R01 "" SBYTE ident 1 100 -128 127 ECU_ADDRESS 0x821673 DISPLAY_IDENTIFIER sint8_04.E_sint8.R01_DISP_ID_R01 /end MEASUREMENT
/begin MEASUREMENT sint8_04.E_sint8.R02 "" SBYTE ident 1 100 -128 127 ECU_ADDRESS 0x821843 DISPLAY_IDENTIFIER sint8_04.E_sint8.R02_DISP_ID_R02 /end MEASUREMENT
/begin MEASUREMENT sint8_04.E_sint8.R03 "" SBYTE ident 1 100 -128 127 ECU_ADDRESS 0x821913 DISPLAY_IDENTIFIER sint8_04.E_sint8.R03_DISP_ID_R03 /end MEASUREMENT
/begin MEASUREMENT sint8_04.E_sint8.R04 "" SBYTE ident 1 100 -128 127 ECU_ADDRESS 0x8219E3 /end MEASUREMENT
/begin MEASUREMENT sint8_04.E_sint8.R05 "" SBYTE ident 1 100 -128 127 ECU_ADDRESS 0x821AB3 /end MEASUREMENT
/begin MEASUREMENT sint8_04.E_sint8.R06 "" SBYTE ident 1 100 -128 127 ECU_ADDRESS 0x821AE3 /end MEASUREMENT
/begin MEASUREMENT sint8_04.E_sint8.R07 "" SBYTE ident 1 100 -128 127 ECU_ADDRESS 0x821B13 /end MEASUREMENT
/begin MEASUREMENT sint8_04.E_sint8.R08 "" SBYTE ident 1 100 -128 127 ECU_ADDRESS 0x821B43 /end MEASUREMENT
/begin MEASUREMENT sint8_04.E_sint8.R09 "" SBYTE ident 1 100 -128 127 ECU_ADDRESS 0x821B73 /end MEASUREMENT
/begin MEASUREMENT sint8_04.E_sint8.R10 "" SBYTE ident 1 100 -128 127 ECU_ADDRESS 0x821BA3 /end MEASUREMENT
/begin MEASUREMENT sint8_04.E_sint8.R11 "" SBYTE ident 1 100 -128 127 ECU_ADDRESS 0x821BD3 /end MEASUREMENT
/begin MEASUREMENT sint8_04.E_sint8.R12 "" SBYTE ident 1 100 -128 127 ECU_ADDRESS 0x821C03 /end MEASUREMENT
/begin MEASUREMENT sint8_04.E_sint8.R13 "" SBYTE ident 1 100 -128 127 ECU_ADDRESS 0x821C33 /end MEASUREMENT
/begin MEASUREMENT sint8_04.E_sint8.R14 "" SBYTE ident 1 100 -128 127 ECU_ADDRESS 0x821C63 /end MEASUREMENT
/begin MEASUREMENT sint8_04.E_sint8.R15 "" SBYTE ident 1 100 -128 127 ECU_ADDRESS 0x821C93 /end MEASUREMENT
/begin MEASUREMENT sint8_04.E_sint8.R16 "" SBYTE ident 1 100 -128 127 ECU_ADDRESS 0x821CB3 /end MEASUREMENT
/begin MEASUREMENT sint8_04.E_sint8_1.R01_8bit "" SBYTE ident 1 100 -128 127 ECU_ADDRESS 0x821713 /end MEASUREMENT
/begin MEASUREMENT sint8_04.E_sint8_2.R01_8bit "" SBYTE ident 1 100 -128 127 ECU_ADDRESS 0x82171B /end MEASUREMENT
/begin MEASUREMENT sint8_04.E_sint8_3.R01_8bit "" SBYTE ident 1 100 -128 127 ECU_ADDRESS 0x821723 /end MEASUREMENT
/begin MEASUREMENT sint8_04.E_sint8_4.R01_8bit "" SBYTE ident 1 100 -128 127 ECU_ADDRESS 0x82172B /end MEASUREMENT
/begin MEASUREMENT sint8_04.E_sint8_5.R01_8bit "" SBYTE ident 1 100 -128 127 ECU_ADDRESS 0x821733 /end MEASUREMENT
/begin MEASUREMENT sint8_04.E_sint8_6.R01_8bit "" SBYTE ident 1 100 -128 127 ECU_ADDRESS 0x82173B /end MEASUREMENT
/begin MEASUREMENT sint8_04.E_sint8_7.R01_8bit "" SBYTE ident 1 100 -128 127 ECU_ADDRESS 0x821743 /end MEASUREMENT
/begin MEASUREMENT sint8_04.E_sint8_8.R01_8bit "" SBYTE ident 1 100 -128 127 ECU_ADDRESS 0x82174B /end MEASUREMENT
/begin MEASUREMENT sint8_05.E_sint8.R01 "" SBYTE ident 1 100 -128 127 ECU_ADDRESS 0x821674 DISPLAY_IDENTIFIER sint8_05.E_sint8.R01_DISP_ID_R01 /end MEASUREMENT
/begin MEASUREMENT sint8_05.E_sint8.R02 "" SBYTE ident 1 100 -128 127 ECU_ADDRESS 0x821844 DISPLAY_IDENTIFIER sint8_05.E_sint8.R02_DISP_ID_R02 /end MEASUREMENT
/begin MEASUREMENT sint8_05.E_sint8.R03 "" SBYTE ident 1 100 -128 127 ECU_ADDRESS 0x821914 DISPLAY_IDENTIFIER sint8_05.E_sint8.R03_DISP_ID_R03 /end MEASUREMENT
/begin MEASUREMENT sint8_05.E_sint8.R04 "" SBYTE ident 1 100 -128 127 ECU_ADDRESS 0x8219E4 /end MEASUREMENT
/begin MEASUREMENT sint8_05.E_sint8.R05 "" SBYTE ident 1 100 -128 127 ECU_ADDRESS 0x821AB4 /end MEASUREMENT
/begin MEASUREMENT sint8_05.E_sint8.R06 "" SBYTE ident 1 100 -128 127 ECU_ADDRESS 0x821AE4 /end MEASUREMENT
/begin MEASUREMENT sint8_05.E_sint8.R07 "" SBYTE ident 1 100 -128 127 ECU_ADDRESS 0x821B14 /end MEASUREMENT
/begin MEASUREMENT sint8_05.E_sint8.R08 "" SBYTE ident 1 100 -128 127 ECU_ADDRESS 0x821B44 /end MEASUREMENT
/begin MEASUREMENT sint8_05.E_sint8.R09 "" SBYTE ident 1 100 -128 127 ECU_ADDRESS 0x821B74 /end MEASUREMENT
/begin MEASUREMENT sint8_05.E_sint8.R10 "" SBYTE ident 1 100 -128 127 ECU_ADDRESS 0x821BA4 /end MEASUREMENT
/begin MEASUREMENT sint8_05.E_sint8.R11 "" SBYTE ident 1 100 -128 127 ECU_ADDRESS 0x821BD4 /end MEASUREMENT
/begin MEASUREMENT sint8_05.E_sint8.R12 "" SBYTE ident 1 100 -128 127 ECU_ADDRESS 0x821C04 /end MEASUREMENT
/begin MEASUREMENT sint8_05.E_sint8.R13 "" SBYTE ident 1 100 -128 127 ECU_ADDRESS 0x821C34 /end MEASUREMENT
/begin MEASUREMENT sint8_05.E_sint8.R14 "" SBYTE ident 1 100 -128 127 ECU_ADDRESS 0x821C64 /end MEASUREMENT
/begin MEASUREMENT sint8_05.E_sint8.R15 "" SBYTE ident 1 100 -128 127 ECU_ADDRESS 0x821C94 /end MEASUREMENT
/begin MEASUREMENT sint8_05.E_sint8.R16 "" SBYTE ident 1 100 -128 127 ECU_ADDRESS 0x821CB4 /end MEASUREMENT
/begin MEASUREMENT sint8_05.E_sint8_1.R01_8bit "" SBYTE ident 1 100 -128 127 ECU_ADDRESS 0x821714 /end MEASUREMENT
/begin MEASUREMENT sint8_05.E_sint8_2.R01_8bit "" SBYTE ident 1 100 -128 127 ECU_ADDRESS 0x82171C /end MEASUREMENT
/begin MEASUREMENT sint8_05.E_sint8_3.R01_8bit "" SBYTE ident 1 100 -128 127 ECU_ADDRESS 0x821724 /end MEASUREMENT
/begin MEASUREMENT sint8_05.E_sint8_4.R01_8bit "" SBYTE ident 1 100 -128 127 ECU_ADDRESS 0x82172C /end MEASUREMENT
/begin MEASUREMENT sint8_05.E_sint8_5.R01_8bit "" SBYTE ident 1 100 -128 127 ECU_ADDRESS 0x821734 /end MEASUREMENT
/begin MEASUREMENT sint8_05.E_sint8_6.R01_8bit "" SBYTE ident 1 100 -128 127 ECU_ADDRESS 0x82173C /end MEASUREMENT
/begin MEASUREMENT sint8_05.E_sint8_7.R01_8bit "" SBYTE ident 1 100 -128 127 ECU_ADDRESS 0x821744 /end MEASUREMENT
/begin MEASUREMENT sint8_05.E_sint8_8.R01_8bit "" SBYTE ident 1 100 -128 127 ECU_ADDRESS 0x82174C /end MEASUREMENT
/begin MEASUREMENT sint8_06.E_sint8.R01 "" SBYTE ident 1 100 -128 127 ECU_ADDRESS 0x821675 DISPLAY_IDENTIFIER sint8_06.E_sint8.R01_DISP_ID_R01 /end MEASUREMENT
/begin MEASUREMENT sint8_06.E_sint8.R02 "" SBYTE ident 1 100 -128 127 ECU_ADDRESS 0x821845 DISPLAY_IDENTIFIER sint8_06.E_sint8.R02_DISP_ID_R02 /end MEASUREMENT
/begin MEASUREMENT sint8_06.E_sint8.R03 "" SBYTE ident 1 100 -128 127 ECU_ADDRESS 0x821915 DISPLAY_IDENTIFIER sint8_06.E_sint8.R03_DISP_ID_R03 /end MEASUREMENT
/begin MEASUREMENT sint8_06.E_sint8.R04 "" SBYTE ident 1 100 -128 127 ECU_ADDRESS 0x8219E5 /end MEASUREMENT
/begin MEASUREMENT sint8_06.E_sint8.R05 "" SBYTE ident 1 100 -128 127 ECU_ADDRESS 0x821AB5 /end MEASUREMENT
/begin MEASUREMENT sint8_06.E_sint8.R06 "" SBYTE ident 1 100 -128 127 ECU_ADDRESS 0x821AE5 /end MEASUREMENT
/begin MEASUREMENT sint8_06.E_sint8.R07 "" SBYTE ident 1 100 -128 127 ECU_ADDRESS 0x821B15 /end MEASUREMENT
/begin MEASUREMENT sint8_06.E_sint8.R08 "" SBYTE ident 1 100 -128 127 ECU_ADDRESS 0x821B45 /end MEASUREMENT
/begin MEASUREMENT sint8_06.E_sint8.R09 "" SBYTE ident 1 100 -128 127 ECU_ADDRESS 0x821B75 /end MEASUREMENT
/begin MEASUREMENT sint8_06.E_sint8.R10 "" SBYTE ident 1 100 -128 127 ECU_ADDRESS 0x821BA5 /end MEASUREMENT
/begin MEASUREMENT sint8_06.E_sint8.R11 "" SBYTE ident 1 100 -128 127 ECU_ADDRESS 0x821BD5 /end MEASUREMENT
/begin MEASUREMENT sint8_06.E_sint8.R12 "" SBYTE ident 1 100 -128 127 ECU_ADDRESS 0x821C05 /end MEASUREMENT
/begin MEASUREMENT sint8_06.E_sint8.R13 "" SBYTE ident 1 100 -128 127 ECU_ADDRESS 0x821C35 /end MEASUREMENT
/begin MEASUREMENT sint8_06.E_sint8.R14 "" SBYTE ident 1 100 -128 127 ECU_ADDRESS 0x821C65 /end MEASUREMENT
/begin MEASUREMENT sint8_06.E_sint8.R15 "" SBYTE ident 1 100 -128 127 ECU_ADDRESS 0x821C95 /end MEASUREMENT
/begin MEASUREMENT sint8_06.E_sint8.R16 "" SBYTE ident 1 100 -128 127 ECU_ADDRESS 0x821CB5 /end MEASUREMENT
/begin MEASUREMENT sint8_06.E_sint8_1.R01_8bit "" SBYTE ident 1 100 -128 127 ECU_ADDRESS 0x821715 /end MEASUREMENT
/begin MEASUREMENT sint8_06.E_sint8_2.R01_8bit "" SBYTE ident 1 100 -128 127 ECU_ADDRESS 0x82171D /end MEASUREMENT
/begin MEASUREMENT sint8_06.E_sint8_3.R01_8bit "" SBYTE ident 1 100 -128 127 ECU_ADDRESS 0x821725 /end MEASUREMENT
/begin MEASUREMENT sint8_06.E_sint8_4.R01_8bit "" SBYTE ident 1 100 -128 127 ECU_ADDRESS 0x82172D /end MEASUREMENT
/begin MEASUREMENT sint8_06.E_sint8_5.R01_8bit "" SBYTE ident 1 100 -128 127 ECU_ADDRESS 0x821735 /end MEASUREMENT
/begin MEASUREMENT sint8_06.E_sint8_6.R01_8bit "" SBYTE ident 1 100 -128 127 ECU_ADDRESS 0x82173D /end MEASUREMENT
/begin MEASUREMENT sint8_06.E_sint8_7.R01_8bit "" SBYTE ident 1 100 -128 127 ECU_ADDRESS 0x821745 /end MEASUREMENT
/begin MEASUREMENT sint8_06.E_sint8_8.R01_8bit "" SBYTE ident 1 100 -128 127 ECU_ADDRESS 0x82174D /end MEASUREMENT
/begin MEASUREMENT sint8_07.E_sint8.R01 "" SBYTE ident 1 100 -128 127 ECU_ADDRESS 0x821676 DISPLAY_IDENTIFIER sint8_07.E_sint8.R01_DISP_ID_R01 /end MEASUREMENT
/begin MEASUREMENT sint8_07.E_sint8.R02 "" SBYTE ident 1 100 -128 127 ECU_ADDRESS 0x821846 DISPLAY_IDENTIFIER sint8_07.E_sint8.R02_DISP_ID_R02 /end MEASUREMENT
/begin MEASUREMENT sint8_07.E_sint8.R03 "" SBYTE ident 1 100 -128 127 ECU_ADDRESS 0x821916 DISPLAY_IDENTIFIER sint8_07.E_sint8.R03_DISP_ID_R03 /end MEASUREMENT
/begin MEASUREMENT sint8_07.E_sint8.R04 "" SBYTE ident 1 100 -128 127 ECU_ADDRESS 0x8219E6 /end MEASUREMENT
/begin MEASUREMENT sint8_07.E_sint8.R05 "" SBYTE ident 1 100 -128 127 ECU_ADDRESS 0x821AB6 /end MEASUREMENT
/begin MEASUREMENT sint8_07.E_sint8.R06 "" SBYTE ident 1 100 -128 127 ECU_ADDRESS 0x821AE6 /end MEASUREMENT
/begin MEASUREMENT sint8_07.E_sint8.R07 "" SBYTE ident 1 100 -128 127 ECU_ADDRESS 0x821B16 /end MEASUREMENT
/begin MEASUREMENT sint8_07.E_sint8.R08 "" SBYTE ident 1 100 -128 127 ECU_ADDRESS 0x821B46 /end MEASUREMENT
/begin MEASUREMENT sint8_07.E_sint8.R09 "" SBYTE ident 1 100 -128 127 ECU_ADDRESS 0x821B76 /end MEASUREMENT
/begin MEASUREMENT sint8_07.E_sint8.R10 "" SBYTE ident 1 100 -128 127 ECU_ADDRESS 0x821BA6 /end MEASUREMENT
/begin MEASUREMENT sint8_07.E_sint8.R11 "" SBYTE ident 1 100 -128 127 ECU_ADDRESS 0x821BD6 /end MEASUREMENT
/begin MEASUREMENT sint8_07.E_sint8.R12 "" SBYTE ident 1 100 -128 127 ECU_ADDRESS 0x821C06 /end MEASUREMENT
/begin MEASUREMENT sint8_07.E_sint8.R13 "" SBYTE ident 1 100 -128 127 ECU_ADDRESS 0x821C36 /end MEASUREMENT
/begin MEASUREMENT sint8_07.E_sint8.R14 "" SBYTE ident 1 100 -128 127 ECU_ADDRESS 0x821C66 /end MEASUREMENT
/begin MEASUREMENT sint8_07.E_sint8.R15 "" SBYTE ident 1 100 -128 127 ECU_ADDRESS 0x821C96 /end MEASUREMENT
/begin MEASUREMENT sint8_07.E_sint8.R16 "" SBYTE ident 1 100 -128 127 ECU_ADDRESS 0x821CB6 /end MEASUREMENT
/begin MEASUREMENT sint8_07.E_sint8_1.R01_8bit "" SBYTE ident 1 100 -128 127 ECU_ADDRESS 0x821716 /end MEASUREMENT
/begin MEASUREMENT sint8_07.E_sint8_2.R01_8bit "" SBYTE ident 1 100 -128 127 ECU_ADDRESS 0x82171E /end MEASUREMENT
/begin MEASUREMENT sint8_07.E_sint8_3.R01_8bit "" SBYTE ident 1 100 -128 127 ECU_ADDRESS 0x821726 /end MEASUREMENT
/begin MEASUREMENT sint8_07.E_sint8_4.R01_8bit "" SBYTE ident 1 100 -128 127 ECU_ADDRESS 0x82172E /end MEASUREMENT
/begin MEASUREMENT sint8_07.E_sint8_5.R01_8bit "" SBYTE ident 1 100 -128 127 ECU_ADDRESS 0x821736 /end MEASUREMENT
/begin MEASUREMENT sint8_07.E_sint8_6.R01_8bit "" SBYTE ident 1 100 -128 127 ECU_ADDRESS 0x82173E /end MEASUREMENT
/begin MEASUREMENT sint8_07.E_sint8_7.R01_8bit "" SBYTE ident 1 100 -128 127 ECU_ADDRESS 0x821746 /end MEASUREMENT
/begin MEASUREMENT sint8_07.E_sint8_8.R01_8bit "" SBYTE ident 1 100 -128 127 ECU_ADDRESS 0x82174E /end MEASUREMENT
/begin MEASUREMENT sint8_08.E_sint8.R01 "" SBYTE ident 1 100 -128 127 ECU_ADDRESS 0x821677 DISPLAY_IDENTIFIER sint8_08.E_sint8.R01_DISP_ID_R01 /end MEASUREMENT
/begin MEASUREMENT sint8_08.E_sint8.R02 "" SBYTE ident 1 100 -128 127 ECU_ADDRESS 0x821847 DISPLAY_IDENTIFIER sint8_08.E_sint8.R02_DISP_ID_R02 /end MEASUREMENT
/begin MEASUREMENT sint8_08.E_sint8.R03 "" SBYTE ident 1 100 -128 127 ECU_ADDRESS 0x821917 DISPLAY_IDENTIFIER sint8_08.E_sint8.R03_DISP_ID_R03 /end MEASUREMENT
/begin MEASUREMENT sint8_08.E_sint8.R04 "" SBYTE ident 1 100 -128 127 ECU_ADDRESS 0x8219E7 /end MEASUREMENT
/begin MEASUREMENT sint8_08.E_sint8.R05 "" SBYTE ident 1 100 -128 127 ECU_ADDRESS 0x821AB7 /end MEASUREMENT
/begin MEASUREMENT sint8_08.E_sint8.R06 "" SBYTE ident 1 100 -128 127 ECU_ADDRESS 0x821AE7 /end MEASUREMENT
/begin MEASUREMENT sint8_08.E_sint8.R07 "" SBYTE ident 1 100 -128 127 ECU_ADDRESS 0x821B17 /end MEASUREMENT
/begin MEASUREMENT sint8_08.E_sint8.R08 "" SBYTE ident 1 100 -128 127 ECU_ADDRESS 0x821B47 /end MEASUREMENT
/begin MEASUREMENT sint8_08.E_sint8.R09 "" SBYTE ident 1 100 -128 127 ECU_ADDRESS 0x821B77 /end MEASUREMENT
/begin MEASUREMENT sint8_08.E_sint8.R10 "" SBYTE ident 1 100 -128 127 ECU_ADDRESS 0x821BA7 /end MEASUREMENT
/begin MEASUREMENT sint8_08.E_sint8.R11 "" SBYTE ident 1 100 -128 127 ECU_ADDRESS 0x821BD7 /end MEASUREMENT
/begin MEASUREMENT sint8_08.E_sint8.R12 "" SBYTE ident 1 100 -128 127 ECU_ADDRESS 0x821C07 /end MEASUREMENT
/begin MEASUREMENT sint8_08.E_sint8.R13 "" SBYTE ident 1 100 -128 127 ECU_ADDRESS 0x821C37 /end MEASUREMENT
/begin MEASUREMENT sint8_08.E_sint8.R14 "" SBYTE ident 1 100 -128 127 ECU_ADDRESS 0x821C67 /end MEASUREMENT
/begin MEASUREMENT sint8_08.E_sint8.R15 "" SBYTE ident 1 100 -128 127 ECU_ADDRESS 0x821C97 /end MEASUREMENT
/begin MEASUREMENT sint8_08.E_sint8.R16 "" SBYTE ident 1 100 -128 127 ECU_ADDRESS 0x821CB7 /end MEASUREMENT
/begin MEASUREMENT sint8_08.E_sint8_1.R01_8bit "" SBYTE ident 1 100 -128 127 ECU_ADDRESS 0x821717 /end MEASUREMENT
/begin MEASUREMENT sint8_08.E_sint8_2.R01_8bit "" SBYTE ident 1 100 -128 127 ECU_ADDRESS 0x82171F /end MEASUREMENT
/begin MEASUREMENT sint8_08.E_sint8_3.R01_8bit "" SBYTE ident 1 100 -128 127 ECU_ADDRESS 0x821727 /end MEASUREMENT
/begin MEASUREMENT sint8_08.E_sint8_4.R01_8bit "" SBYTE ident 1 100 -128 127 ECU_ADDRESS 0x82172F /end MEASUREMENT
/begin MEASUREMENT sint8_08.E_sint8_5.R01_8bit "" SBYTE ident 1 100 -128 127 ECU_ADDRESS 0x821737 /end MEASUREMENT
/begin MEASUREMENT sint8_08.E_sint8_6.R01_8bit "" SBYTE ident 1 100 -128 127 ECU_ADDRESS 0x82173F /end MEASUREMENT
/begin MEASUREMENT sint8_08.E_sint8_7.R01_8bit "" SBYTE ident 1 100 -128 127 ECU_ADDRESS 0x821747 /end MEASUREMENT
/begin MEASUREMENT sint8_08.E_sint8_8.R01_8bit "" SBYTE ident 1 100 -128 127 ECU_ADDRESS 0x82174F /end MEASUREMENT
/begin MEASUREMENT testVariable.Curve_Module "" UBYTE ident 1 100 0 255 ECU_ADDRESS 0x7F85F2 MATRIX_DIM 3 1 1 /end MEASUREMENT
/begin MEASUREMENT Time.Distab.Dist_B01.Distab13_12T "" ULONG TickType2ms 1 100 0.0 1227133.512857143 ECU_ADDRESS 0x7F87E8 /end MEASUREMENT
/begin MEASUREMENT Time.Distab.Dist_B02.Distab13_12T "" ULONG TickType2ms 1 100 0.0 1227133.512857143 ECU_ADDRESS 0x7F880C /end MEASUREMENT
/begin MEASUREMENT Time.Distab.Dist_B03.Distab13_12T "" ULONG TickType2ms 1 100 0.0 1227133.512857143 ECU_ADDRESS 0x7F8830 /end MEASUREMENT
/begin MEASUREMENT Time.Distab.Dist_B04.Distab13_12T "" ULONG TickType2ms 1 100 0.0 1227133.512857143 ECU_ADDRESS 0x7F8854 /end MEASUREMENT
/begin MEASUREMENT Time.MIN_MAX_Tick2Time.EV0_Roundtrip.XCP_SHELL "" ULONG TickType2ms 1 100 0.0 1227133.512857143 ECU_ADDRESS 0x7F9278 /end MEASUREMENT
/begin MEASUREMENT Time.MIN_MAX_Tick2Time.EV0_Sample.XCP_SHELL "" ULONG TickType2ms 1 100 0.0 1227133.512857143 ECU_ADDRESS 0x7F92B8 /end MEASUREMENT
/begin MEASUREMENT Time.MIN_MAX_Tick2Time.EV0_Stim.XCP_SHELL "" ULONG TickType2ms 1 100 0.0 1227133.512857143 ECU_ADDRESS 0x7F92D0 /end MEASUREMENT
/begin MEASUREMENT Time.Roundtrip.Dist_B01.Distab13_12T "" ULONG TickType2ms 1 100 0.0 1227133.512857143 ECU_ADDRESS 0x7F87F4 /end MEASUREMENT
/begin MEASUREMENT Time.Roundtrip.Dist_B02.Distab13_12T "" ULONG TickType2ms 1 100 0.0 1227133.512857143 ECU_ADDRESS 0x7F8818 /end MEASUREMENT
/begin MEASUREMENT Time.Roundtrip.Dist_B03.Distab13_12T "" ULONG TickType2ms 1 100 0.0 1227133.512857143 ECU_ADDRESS 0x7F883C /end MEASUREMENT
/begin MEASUREMENT Time.Roundtrip.Dist_B04.Distab13_12T "" ULONG TickType2ms 1 100 0.0 1227133.512857143 ECU_ADDRESS 0x7F8860 /end MEASUREMENT
/begin MEASUREMENT Time.Time.EV0_Rx.XCP_SHELL "" ULONG TickType2ms 1 100 0.0 1227133.512857143 ECU_ADDRESS 0x7F9294 /end MEASUREMENT
/begin MEASUREMENT Time.Time.EV0_Tx.XCP_SHELL "" ULONG TickType2ms 1 100 0.0 1227133.512857143 ECU_ADDRESS 0x7F92EC /end MEASUREMENT
/begin MEASUREMENT Time.TimeSum.EV0_Rx.XCP_SHELL "" ULONG TickType2ms 1 100 0.0 1227133.512857143 ECU_ADDRESS 0x7F92A0 /end MEASUREMENT
/begin MEASUREMENT Time.TimeSum.EV0_Tx.XCP_SHELL "" ULONG TickType2ms 1 100 0.0 1227133.512857143 ECU_ADDRESS 0x7F92F8 /end MEASUREMENT
/begin MEASUREMENT Timeout_RoundTrip.Dist_B01.Distab13_12T "" UBYTE ident 1 100 0 1 BIT_MASK 0x1 ECU_ADDRESS 0x7F87DD /end MEASUREMENT
/begin MEASUREMENT Timeout_RoundTrip.Dist_B02.Distab13_12T "" UBYTE ident 1 100 0 1 BIT_MASK 0x1 ECU_ADDRESS 0x7F8801 /end MEASUREMENT
/begin MEASUREMENT Timeout_RoundTrip.Dist_B03.Distab13_12T "" UBYTE ident 1 100 0 1 BIT_MASK 0x1 ECU_ADDRESS 0x7F8825 /end MEASUREMENT
/begin MEASUREMENT Timeout_RoundTrip.Dist_B04.Distab13_12T "" UBYTE ident 1 100 0 1 BIT_MASK 0x1 ECU_ADDRESS 0x7F8849 /end MEASUREMENT
/begin MEASUREMENT TimeStampOne.Time_Calc.Curve_Module "" ULONG TickType2ms 1 100 0.1428571428571429 600000.0 ECU_ADDRESS 0x7F8604 MATRIX_DIM 3 1 1 /end MEASUREMENT
/begin MEASUREMENT TimeStampTwo.Time_Calc.Curve_Module "" ULONG TickType2ms 1 100 0.1428571428571429 600000.0 ECU_ADDRESS 0x7F8610 MATRIX_DIM 3 1 1 /end MEASUREMENT
/begin MEASUREMENT uint16_01.E_uint16.R01 "" UWORD ident 1 100 0 65535 ECU_ADDRESS 0x821678 DISPLAY_IDENTIFIER uint16_01.E_uint16.R01_DISP_ID_R01 /end MEASUREMENT
/begin MEASUREMENT uint16_01.E_uint16.R02 "" UWORD ident 1 100 0 65535 ECU_ADDRESS 0x821848 DISPLAY_IDENTIFIER uint16_01.E_uint16.R02_DISP_ID_R02 /end MEASUREMENT
/begin MEASUREMENT uint16_01.E_uint16.R03 "" UWORD ident 1 100 0 65535 ECU_ADDRESS 0x821918 DISPLAY_IDENTIFIER uint16_01.E_uint16.R03_DISP_ID_R03 /end MEASUREMENT
/begin MEASUREMENT uint16_01.E_uint16.R04 "" UWORD ident 1 100 0 65535 ECU_ADDRESS 0x8219E8 /end MEASUREMENT
/begin MEASUREMENT uint16_01.E_uint16.R05 "" UWORD ident 1 100 0 65535 ECU_ADDRESS 0x821AB8 /end MEASUREMENT
/begin MEASUREMENT uint16_01.E_uint16.R06 "" UWORD ident 1 100 0 65535 ECU_ADDRESS 0x821AE8 /end MEASUREMENT
/begin MEASUREMENT uint16_01.E_uint16.R07 "" UWORD ident 1 100 0 65535 ECU_ADDRESS 0x821B18 /end MEASUREMENT
/begin MEASUREMENT uint16_01.E_uint16.R08 "" UWORD ident 1 100 0 65535 ECU_ADDRESS 0x821B48 /end MEASUREMENT
/begin MEASUREMENT uint16_02.E_uint16.R01 "" UWORD ident 1 100 0 65535 ECU_ADDRESS 0x82167A DISPLAY_IDENTIFIER uint16_02.E_uint16.R01_DISP_ID_R01 /end MEASUREMENT
/begin MEASUREMENT uint16_02.E_uint16.R02 "" UWORD ident 1 100 0 65535 ECU_ADDRESS 0x82184A DISPLAY_IDENTIFIER uint16_02.E_uint16.R02_DISP_ID_R02 /end MEASUREMENT
/begin MEASUREMENT uint16_02.E_uint16.R03 "" UWORD ident 1 100 0 65535 ECU_ADDRESS 0x82191A DISPLAY_IDENTIFIER uint16_02.E_uint16.R03_DISP_ID_R03 /end MEASUREMENT
/begin MEASUREMENT uint16_02.E_uint16.R04 "" UWORD ident 1 100 0 65535 ECU_ADDRESS 0x8219EA /end MEASUREMENT
/begin MEASUREMENT uint16_02.E_uint16.R05 "" UWORD ident 1 100 0 65535 ECU_ADDRESS 0x821ABA /end MEASUREMENT
/begin MEASUREMENT uint16_02.E_uint16.R06 "" UWORD ident 1 100 0 65535 ECU_ADDRESS 0x821AEA /end MEASUREMENT
/begin MEASUREMENT uint16_02.E_uint16.R07 "" UWORD ident 1 100 0 65535 ECU_ADDRESS 0x821B1A /end MEASUREMENT
/begin MEASUREMENT uint16_02.E_uint16.R08 "" UWORD ident 1 100 0 65535 ECU_ADDRESS 0x821B4A /end MEASUREMENT
/begin MEASUREMENT uint16_03.E_uint16.R01 "" UWORD ident 1 100 0 65535 ECU_ADDRESS 0x82167C DISPLAY_IDENTIFIER uint16_03.E_uint16.R01_DISP_ID_R01 /end MEASUREMENT
/begin MEASUREMENT uint16_03.E_uint16.R02 "" UWORD ident 1 100 0 65535 ECU_ADDRESS 0x82184C DISPLAY_IDENTIFIER uint16_03.E_uint16.R02_DISP_ID_R02 /end MEASUREMENT
/begin MEASUREMENT uint16_03.E_uint16.R03 "" UWORD ident 1 100 0 65535 ECU_ADDRESS 0x82191C DISPLAY_IDENTIFIER uint16_03.E_uint16.R03_DISP_ID_R03 /end MEASUREMENT
/begin MEASUREMENT uint16_03.E_uint16.R04 "" UWORD ident 1 100 0 65535 ECU_ADDRESS 0x8219EC /end MEASUREMENT
/begin MEASUREMENT uint16_03.E_uint16.R05 "" UWORD ident 1 100 0 65535 ECU_ADDRESS 0x821ABC /end MEASUREMENT
/begin MEASUREMENT uint16_03.E_uint16.R06 "" UWORD ident 1 100 0 65535 ECU_ADDRESS 0x821AEC /end MEASUREMENT
/begin MEASUREMENT uint16_03.E_uint16.R07 "" UWORD ident 1 100 0 65535 ECU_ADDRESS 0x821B1C /end MEASUREMENT
/begin MEASUREMENT uint16_03.E_uint16.R08 "" UWORD ident 1 100 0 65535 ECU_ADDRESS 0x821B4C /end MEASUREMENT
/begin MEASUREMENT uint16_04.E_uint16.R01 "" UWORD ident 1 100 0 65535 ECU_ADDRESS 0x82167E DISPLAY_IDENTIFIER uint16_04.E_uint16.R01_DISP_ID_R01 /end MEASUREMENT
/begin MEASUREMENT uint16_04.E_uint16.R02 "" UWORD ident 1 100 0 65535 ECU_ADDRESS 0x82184E DISPLAY_IDENTIFIER uint16_04.E_uint16.R02_DISP_ID_R02 /end MEASUREMENT
/begin MEASUREMENT uint16_04.E_uint16.R03 "" UWORD ident 1 100 0 65535 ECU_ADDRESS 0x82191E DISPLAY_IDENTIFIER uint16_04.E_uint16.R03_DISP_ID_R03 /end MEASUREMENT
/begin MEASUREMENT uint16_04.E_uint16.R04 "" UWORD ident 1 100 0 65535 ECU_ADDRESS 0x8219EE /end MEASUREMENT
/begin MEASUREMENT uint16_04.E_uint16.R05 "" UWORD ident 1 100 0 65535 ECU_ADDRESS 0x821ABE /end MEASUREMENT
/begin MEASUREMENT uint16_04.E_uint16.R06 "" UWORD ident 1 100 0 65535 ECU_ADDRESS 0x821AEE /end MEASUREMENT
/begin MEASUREMENT uint16_04.E_uint16.R07 "" UWORD ident 1 100 0 65535 ECU_ADDRESS 0x821B1E /end MEASUREMENT
/begin MEASUREMENT uint16_04.E_uint16.R08 "" UWORD ident 1 100 0 65535 ECU_ADDRESS 0x821B4E /end MEASUREMENT
/begin MEASUREMENT uint16_05.E_uint16.R01 "" UWORD ident 1 100 0 65535 ECU_ADDRESS 0x821680 DISPLAY_IDENTIFIER uint16_05.E_uint16.R01_DISP_ID_R01 /end MEASUREMENT
/begin MEASUREMENT uint16_05.E_uint16.R02 "" UWORD ident 1 100 0 65535 ECU_ADDRESS 0x821850 DISPLAY_IDENTIFIER uint16_05.E_uint16.R02_DISP_ID_R02 /end MEASUREMENT
/begin MEASUREMENT uint16_05.E_uint16.R03 "" UWORD ident 1 100 0 65535 ECU_ADDRESS 0x821920 DISPLAY_IDENTIFIER uint16_05.E_uint16.R03_DISP_ID_R03 /end MEASUREMENT
/begin MEASUREMENT uint16_05.E_uint16.R04 "" UWORD ident 1 100 0 65535 ECU_ADDRESS 0x8219F0 /end MEASUREMENT
/begin MEASUREMENT uint16_05.E_uint16.R05 "" UWORD ident 1 100 0 65535 ECU_ADDRESS 0x821AC0 /end MEASUREMENT
/begin MEASUREMENT uint16_05.E_uint16.R06 "" UWORD ident 1 100 0 65535 ECU_ADDRESS 0x821AF0 /end MEASUREMENT
/begin MEASUREMENT uint16_05.E_uint16.R07 "" UWORD ident 1 100 0 65535 ECU_ADDRESS 0x821B20 /end MEASUREMENT
/begin MEASUREMENT uint16_05.E_uint16.R08 "" UWORD ident 1 100 0 65535 ECU_ADDRESS 0x821B50 /end MEASUREMENT
/begin MEASUREMENT uint16_06.E_uint16.R01 "" UWORD ident 1 100 0 65535 ECU_ADDRESS 0x821682 DISPLAY_IDENTIFIER uint16_06.E_uint16.R01_DISP_ID_R01 /end MEASUREMENT
/begin MEASUREMENT uint16_06.E_uint16.R02 "" UWORD ident 1 100 0 65535 ECU_ADDRESS 0x821852 DISPLAY_IDENTIFIER uint16_06.E_uint16.R02_DISP_ID_R02 /end MEASUREMENT
/begin MEASUREMENT uint16_06.E_uint16.R03 "" UWORD ident 1 100 0 65535 ECU_ADDRESS 0x821922 DISPLAY_IDENTIFIER uint16_06.E_uint16.R03_DISP_ID_R03 /end MEASUREMENT
/begin MEASUREMENT uint16_06.E_uint16.R04 "" UWORD ident 1 100 0 65535 ECU_ADDRESS 0x8219F2 /end MEASUREMENT
/begin MEASUREMENT uint16_06.E_uint16.R05 "" UWORD ident 1 100 0 65535 ECU_ADDRESS 0x821AC2 /end MEASUREMENT
/begin MEASUREMENT uint16_06.E_uint16.R06 "" UWORD ident 1 100 0 65535 ECU_ADDRESS 0x821AF2 /end MEASUREMENT
/begin MEASUREMENT uint16_06.E_uint16.R07 "" UWORD ident 1 100 0 65535 ECU_ADDRESS 0x821B22 /end MEASUREMENT
/begin MEASUREMENT uint16_06.E_uint16.R08 "" UWORD ident 1 100 0 65535 ECU_ADDRESS 0x821B52 /end MEASUREMENT
/begin MEASUREMENT uint16_07.E_uint16.R01 "" UWORD ident 1 100 0 65535 ECU_ADDRESS 0x821684 DISPLAY_IDENTIFIER uint16_07.E_uint16.R01_DISP_ID_R01 /end MEASUREMENT
/begin MEASUREMENT uint16_07.E_uint16.R02 "" UWORD ident 1 100 0 65535 ECU_ADDRESS 0x821854 DISPLAY_IDENTIFIER uint16_07.E_uint16.R02_DISP_ID_R02 /end MEASUREMENT
/begin MEASUREMENT uint16_07.E_uint16.R03 "" UWORD ident 1 100 0 65535 ECU_ADDRESS 0x821924 DISPLAY_IDENTIFIER uint16_07.E_uint16.R03_DISP_ID_R03 /end MEASUREMENT
/begin MEASUREMENT uint16_07.E_uint16.R04 "" UWORD ident 1 100 0 65535 ECU_ADDRESS 0x8219F4 /end MEASUREMENT
/begin MEASUREMENT uint16_07.E_uint16.R05 "" UWORD ident 1 100 0 65535 ECU_ADDRESS 0x821AC4 /end MEASUREMENT
/begin MEASUREMENT uint16_07.E_uint16.R06 "" UWORD ident 1 100 0 65535 ECU_ADDRESS 0x821AF4 /end MEASUREMENT
/begin MEASUREMENT uint16_07.E_uint16.R07 "" UWORD ident 1 100 0 65535 ECU_ADDRESS 0x821B24 /end MEASUREMENT
/begin MEASUREMENT uint16_07.E_uint16.R08 "" UWORD ident 1 100 0 65535 ECU_ADDRESS 0x821B54 /end MEASUREMENT
/begin MEASUREMENT uint16_08.E_uint16.R01 "" UWORD ident 1 100 0 65535 ECU_ADDRESS 0x821686 DISPLAY_IDENTIFIER uint16_08.E_uint16.R01_DISP_ID_R01 /end MEASUREMENT
/begin MEASUREMENT uint16_08.E_uint16.R02 "" UWORD ident 1 100 0 65535 ECU_ADDRESS 0x821856 DISPLAY_IDENTIFIER uint16_08.E_uint16.R02_DISP_ID_R02 /end MEASUREMENT
/begin MEASUREMENT uint16_08.E_uint16.R03 "" UWORD ident 1 100 0 65535 ECU_ADDRESS 0x821926 DISPLAY_IDENTIFIER uint16_08.E_uint16.R03_DISP_ID_R03 /end MEASUREMENT
/begin MEASUREMENT uint16_08.E_uint16.R04 "" UWORD ident 1 100 0 65535 ECU_ADDRESS 0x8219F6 /end MEASUREMENT
/begin MEASUREMENT uint16_08.E_uint16.R05 "" UWORD ident 1 100 0 65535 ECU_ADDRESS 0x821AC6 /end MEASUREMENT
/begin MEASUREMENT uint16_08.E_uint16.R06 "" UWORD ident 1 100 0 65535 ECU_ADDRESS 0x821AF6 /end MEASUREMENT
/begin MEASUREMENT uint16_08.E_uint16.R07 "" UWORD ident 1 100 0 65535 ECU_ADDRESS 0x821B26 /end MEASUREMENT
/begin MEASUREMENT uint16_08.E_uint16.R08 "" UWORD ident 1 100 0 65535 ECU_ADDRESS 0x821B56 /end MEASUREMENT
/begin COMPU_METHOD ADC_PT1000 "OP Amp:     315 / 215" RAT_FUNC "%12.4" "V" COEFFS 0 299.7627906976744 0 0 0 1 /end COMPU_METHOD
/begin COMPU_METHOD ident "" RAT_FUNC "%12.4" "" COEFFS 0 1 0 0 0 1 /end COMPU_METHOD
/begin COMPU_METHOD TickType2ms "" RAT_FUNC "%12.4" "ms" COEFFS 0 3500.0 0 0 0 1 /end COMPU_METHOD
/begin COMPU_METHOD TPU_Dcyc "" RAT_FUNC "%12.4" "%" COEFFS 0 100 0 0 0 1 /end COMPU_METHOD
/begin GROUP Curve_Calc_32.Curve_Module ""
 /begin REF_MEASUREMENT cell_nr.Curve_Calc_32.Curve_Module curve_out.Curve_Calc_32.Curve_Module input_array.Curve_Calc_32.Curve_Module /end REF_MEASUREMENT
 /begin REF_CHARACTERISTIC curve_table.Curve_Calc_32.Curve_Module nr_of_cells.Curve_Calc_32.Curve_Module /end REF_CHARACTERISTIC
/end GROUP
/begin GROUP Curve_Calc_real32.Curve_Module ""
 /begin REF_MEASUREMENT cell_nr.Curve_Calc_real32.Curve_Module curve_out.Curve_Calc_real32.Curve_Module input_array.Curve_Calc_real32.Curve_Module /end REF_MEASUREMENT
 /begin REF_CHARACTERISTIC curve_table.Curve_Calc_real32.Curve_Module nr_of_cells.Curve_Calc_real32.Curve_Module /end REF_CHARACTERISTIC
/end GROUP
/begin GROUP Curve_Mod "" ROOT
 /begin REF_MEASUREMENT M_In_KL_Direct_fl32.Curve_Mod M_In_fl32_Distrib1.Curve_Mod M_In_fl32_Distrib2.Curve_Mod M_Out_KL1_Distr_fl32_Distrib1.Curve_Mod M_Out_KL2_Distr_fl32_Distrib1.Curve_Mod M_Out_KL3_Distr_fl32_Distrib2.Curve_Mod M_Out_KL_Direct_fl32.Curve_Mod /end REF_MEASUREMENT
 /begin REF_CHARACTERISTIC KL1_Distr_fl32_Distrib1.Curve_Mod KL2_Distr_fl32_Distrib1.Curve_Mod KL3_Distr_fl32_Distrib2.Curve_Mod KL_Direct_fl32.Curve_Mod P_In_KL_Direct_fl32.Curve_Mod P_In_fl32_Distrib1.Curve_Mod P_In_fl32_Distrib2.Curve_Mod /end REF_CHARACTERISTIC
/end GROUP
/begin GROUP Curve_Module "" ROOT
 /begin REF_MEASUREMENT Result.Time_Calc.Curve_Module TimeStampOne.Time_Calc.Curve_Module TimeStampTwo.Time_Calc.Curve_Module cell_nr.Curve_Calc_32.Curve_Module cell_nr.Curve_Calc_real32.Curve_Module curve_out.Curve_Calc_32.Curve_Module curve_out.Curve_Calc_real32.Curve_Module input_array.Curve_Calc_32.Curve_Module input_array.Curve_Calc_real32.Curve_Module is_started.Time_Calc.Curve_Module loop_counter.Curve_Module testVariable.Curve_Module /end REF_MEASUREMENT
 /begin REF_CHARACTERISTIC PageSwitch_On.Curve_Module calc_loops_16.Curve_Module calc_loops_32.Curve_Module curve_table.Curve_Calc_32.Curve_Module curve_table.Curve_Calc_real32.Curve_Module nr_of_cells.Curve_Calc_32.Curve_Module nr_of_cells.Curve_Calc_real32.Curve_Module testPara.Curve_Module /end REF_CHARACTERISTIC
 /begin SUB_GROUP Curve_Calc_16.Curve_Module Curve_Calc_32.Curve_Module Curve_Calc_real32.Curve_Module Time_Calc.Curve_Module /end SUB_GROUP
/end GROUP
/begin GROUP Curves_Raster_1 "" ROOT /begin REF_CHARACTERISTIC P_Do_Curves.Curves_Raster_1 /end REF_CHARACTERISTIC
 /begin SUB_GROUP All_Curves_FIX.Curves_Raster_1 All_Curves_GRP.Curves_Raster_1 All_Curves_STD.Curves_Raster_1 /end SUB_GROUP
/end GROUP
/begin GROUP Curves_Raster_2 "" ROOT /begin REF_CHARACTERISTIC P_Do_Curves.Curves_Raster_2 /end REF_CHARACTERISTIC
 /begin SUB_GROUP All_Curves_FIX.Curves_Raster_2 All_Curves_GRP.Curves_Raster_2 All_Curves_STD.Curves_Raster_2 /end SUB_GROUP
/end GROUP
/begin GROUP Curves_Raster_3 "" ROOT /begin REF_CHARACTERISTIC P_Do_Curves.Curves_Raster_3 /end REF_CHARACTERISTIC
 /begin SUB_GROUP All_Curves_FIX.Curves_Raster_3 All_Curves_GRP.Curves_Raster_3 All_Curves_STD.Curves_Raster_3 /end SUB_GROUP
/end GROUP
/begin GROUP DAQ2_Sample.CCP_SHELL "" /begin SUB_GROUP MIN_MAX_Tick2Time.DAQ2_Sample.CCP_SHELL /end SUB_GROUP /end GROUP
/begin GROUP DAQ2_Tx.CCP_SHELL "" /begin SUB_GROUP Time.DAQ2_Tx.CCP_SHELL TimeSum.DAQ2_Tx.CCP_SHELL /end SUB_GROUP /end GROUP
/begin GROUP DiagKwpUds "" ROOT /begin REF_MEASUREMENT g_DiagBSmax_u8.DiagKwpUds g_DiagSTmin_u8.DiagKwpUds /end REF_MEASUREMENT /begin REF_CHARACTERISTIC p_DiagBSmax_u8.DiagKwpUds p_DiagSTmin_u8.DiagKwpUds /end REF_CHARACTERISTIC /end GROUP
/begin GROUP Dist_B01.Distab13_12T ""
 /begin REF_MEASUREMENT Active.Dist_B01.Distab13_12T Counter.Dist_B01.Distab13_12T Max.Distab.Dist_B01.Distab13_12T Max.Roundtrip.Dist_B01.Distab13_12T Min.Distab.Dist_B01.Distab13_12T Min.Roundtrip.Dist_B01.Distab13_12T NrBytes_Total.Dist_B01.Distab13_12T NrVar_1Byte.Dist_B01.Distab13_12T NrVar_2Byte.Dist_B01.Distab13_12T NrVar_4Byte.Dist_B01.Distab13_12T NrVar_8Byte.Dist_B01.Distab13_12T Result.Dist_B01.Distab13_12T Time.Distab.Dist_B01.Distab13_12T Time.Roundtrip.Dist_B01.Distab13_12T Timeout_RoundTrip.Dist_B01.Distab13_12T /end REF_MEASUREMENT
 /begin REF_CHARACTERISTIC P_Enable.Dist_B01.Distab13_12T P_TRGID_Nr.Dist_B01.Distab13_12T P_TRGID_Val.Dist_B01.Distab13_12T P_TRG_Direct.Dist_B01.Distab13_12T P_TRG_Nr.Dist_B01.Distab13_12T P_TRG_Val.Dist_B01.Distab13_12T /end REF_CHARACTERISTIC
 /begin SUB_GROUP Distab.Dist_B01.Distab13_12T Roundtrip.Dist_B01.Distab13_12T /end SUB_GROUP
/end GROUP
/begin GROUP Dist_B02.Distab13_12T ""
 /begin REF_MEASUREMENT Active.Dist_B02.Distab13_12T Counter.Dist_B02.Distab13_12T Max.Distab.Dist_B02.Distab13_12T Max.Roundtrip.Dist_B02.Distab13_12T Min.Distab.Dist_B02.Distab13_12T Min.Roundtrip.Dist_B02.Distab13_12T NrBytes_Total.Dist_B02.Distab13_12T NrVar_1Byte.Dist_B02.Distab13_12T NrVar_2Byte.Dist_B02.Distab13_12T NrVar_4Byte.Dist_B02.Distab13_12T NrVar_8Byte.Dist_B02.Distab13_12T Result.Dist_B02.Distab13_12T Time.Distab.Dist_B02.Distab13_12T Time.Roundtrip.Dist_B02.Distab13_12T Timeout_RoundTrip.Dist_B02.Distab13_12T /end REF_MEASUREMENT
 /begin REF_CHARACTERISTIC P_Enable.Dist_B02.Distab13_12T P_TRGID_Nr.Dist_B02.Distab13_12T P_TRGID_Val.Dist_B02.Distab13_12T P_TRG_Direct.Dist_B02.Distab13_12T P_TRG_Nr.Dist_B02.Distab13_12T P_TRG_Val.Dist_B02.Distab13_12T /end REF_CHARACTERISTIC
 /begin SUB_GROUP Distab.Dist_B02.Distab13_12T Roundtrip.Dist_B02.Distab13_12T /end SUB_GROUP
/end GROUP
/begin GROUP Dist_B03.Distab13_12T ""
 /begin REF_MEASUREMENT Active.Dist_B03.Distab13_12T Counter.Dist_B03.Distab13_12T Max.Distab.Dist_B03.Distab13_12T Max.Roundtrip.Dist_B03.Distab13_12T Min.Distab.Dist_B03.Distab13_12T Min.Roundtrip.Dist_B03.Distab13_12T NrBytes_Total.Dist_B03.Distab13_12T NrVar_1Byte.Dist_B03.Distab13_12T NrVar_2Byte.Dist_B03.Distab13_12T NrVar_4Byte.Dist_B03.Distab13_12T NrVar_8Byte.Dist_B03.Distab13_12T Result.Dist_B03.Distab13_12T Time.Distab.Dist_B03.Distab13_12T Time.Roundtrip.Dist_B03.Distab13_12T Timeout_RoundTrip.Dist_B03.Distab13_12T /end REF_MEASUREMENT
 /begin REF_CHARACTERISTIC P_Enable.Dist_B03.Distab13_12T P_TRGID_Nr.Dist_B03.Distab13_12T P_TRGID_Val.Dist_B03.Distab13_12T P_TRG_Direct.Dist_B03.Distab13_12T P_TRG_Nr.Dist_B03.Distab13_12T P_TRG_Val.Dist_B03.Distab13_12T /end REF_CHARACTERISTIC
 /begin SUB_GROUP Distab.Dist_B03.Distab13_12T Roundtrip.Dist_B03.Distab13_12T /end SUB_GROUP
/end GROUP
/begin GROUP Dist_B04.Distab13_12T ""
 /begin REF_MEASUREMENT Active.Dist_B04.Distab13_12T Counter.Dist_B04.Distab13_12T Max.Distab.Dist_B04.Distab13_12T Max.Roundtrip.Dist_B04.Distab13_12T Min.Distab.Dist_B04.Distab13_12T Min.Roundtrip.Dist_B04.Distab13_12T NrBytes_Total.Dist_B04.Distab13_12T NrVar_1Byte.Dist_B04.Distab13_12T NrVar_2Byte.Dist_B04.Distab13_12T NrVar_4Byte.Dist_B04.Distab13_12T NrVar_8Byte.Dist_B04.Distab13_12T Result.Dist_B04.Distab13_12T Time.Distab.Dist_B04.Distab13_12T Time.Roundtrip.Dist_B04.Distab13_12T Timeout_RoundTrip.Dist_B04.Distab13_12T /end REF_MEASUREMENT
 /begin REF_CHARACTERISTIC P_Enable.Dist_B04.Distab13_12T P_TRGID_Nr.Dist_B04.Distab13_12T P_TRGID_Val.Dist_B04.Distab13_12T P_TRG_Direct.Dist_B04.Distab13_12T P_TRG_Nr.Dist_B04.Distab13_12T P_TRG_Val.Dist_B04.Distab13_12T /end REF_CHARACTERISTIC
 /begin SUB_GROUP Distab.Dist_B04.Distab13_12T Roundtrip.Dist_B04.Distab13_12T /end SUB_GROUP
/end GROUP
/begin GROUP Dist_R01.Distab13_12T ""
 /begin REF_MEASUREMENT Active.Dist_R01.Distab13_12T NrBytes_Total.Dist_R01.Distab13_12T NrVar_1Byte.Dist_R01.Distab13_12T NrVar_2Byte.Dist_R01.Distab13_12T NrVar_4Byte.Dist_R01.Distab13_12T NrVar_8Byte.Dist_R01.Distab13_12T Result.Dist_R01.Distab13_12T /end REF_MEASUREMENT
 /begin REF_CHARACTERISTIC P_Enable.Dist_R01.Distab13_12T P_TRGID_Nr.Dist_R01.Distab13_12T P_TRGID_Val.Dist_R01.Distab13_12T P_TRG_Direct.Dist_R01.Distab13_12T P_TRG_Nr.Dist_R01.Distab13_12T P_TRG_Val.Dist_R01.Distab13_12T /end REF_CHARACTERISTIC
/end GROUP
/begin GROUP Dist_R02.Distab13_12T ""
 /begin REF_MEASUREMENT Active.Dist_R02.Distab13_12T NrBytes_Total.Dist_R02.Distab13_12T NrVar_1Byte.Dist_R02.Distab13_12T NrVar_2Byte.Dist_R02.Distab13_12T NrVar_4Byte.Dist_R02.Distab13_12T NrVar_8Byte.Dist_R02.Distab13_12T Result.Dist_R02.Distab13_12T /end REF_MEASUREMENT
 /begin REF_CHARACTERISTIC P_Enable.Dist_R02.Distab13_12T P_TRGID_Nr.Dist_R02.Distab13_12T P_TRGID_Val.Dist_R02.Distab13_12T P_TRG_Direct.Dist_R02.Distab13_12T P_TRG_Nr.Dist_R02.Distab13_12T P_TRG_Val.Dist_R02.Distab13_12T /end REF_CHARACTERISTIC
/end GROUP
/begin GROUP Dist_R03.Distab13_12T ""
 /begin REF_MEASUREMENT Active.Dist_R03.Distab13_12T NrBytes_Total.Dist_R03.Distab13_12T NrVar_1Byte.Dist_R03.Distab13_12T NrVar_2Byte.Dist_R03.Distab13_12T NrVar_4Byte.Dist_R03.Distab13_12T NrVar_8Byte.Dist_R03.Distab13_12T Result.Dist_R03.Distab13_12T /end REF_MEASUREMENT
 /begin REF_CHARACTERISTIC P_Enable.Dist_R03.Distab13_12T P_TRGID_Nr.Dist_R03.Distab13_12T P_TRGID_Val.Dist_R03.Distab13_12T P_TRG_Direct.Dist_R03.Distab13_12T P_TRG_Nr.Dist_R03.Distab13_12T P_TRG_Val.Dist_R03.Distab13_12T /end REF_CHARACTERISTIC
/end GROUP
/begin GROUP Dist_R04.Distab13_12T ""
 /begin REF_MEASUREMENT Active.Dist_R04.Distab13_12T NrBytes_Total.Dist_R04.Distab13_12T NrVar_1Byte.Dist_R04.Distab13_12T NrVar_2Byte.Dist_R04.Distab13_12T NrVar_4Byte.Dist_R04.Distab13_12T NrVar_8Byte.Dist_R04.Distab13_12T Result.Dist_R04.Distab13_12T /end REF_MEASUREMENT
 /begin REF_CHARACTERISTIC P_Enable.Dist_R04.Distab13_12T P_TRGID_Nr.Dist_R04.Distab13_12T P_TRGID_Val.Dist_R04.Distab13_12T P_TRG_Direct.Dist_R04.Distab13_12T P_TRG_Nr.Dist_R04.Distab13_12T P_TRG_Val.Dist_R04.Distab13_12T /end REF_CHARACTERISTIC
/end GROUP
/begin GROUP Dist_R05.Distab13_12T ""
 /begin REF_MEASUREMENT Active.Dist_R05.Distab13_12T NrBytes_Total.Dist_R05.Distab13_12T NrVar_1Byte.Dist_R05.Distab13_12T NrVar_2Byte.Dist_R05.Distab13_12T NrVar_4Byte.Dist_R05.Distab13_12T NrVar_8Byte.Dist_R05.Distab13_12T Result.Dist_R05.Distab13_12T /end REF_MEASUREMENT
 /begin REF_CHARACTERISTIC P_Enable.Dist_R05.Distab13_12T P_TRGID_Nr.Dist_R05.Distab13_12T P_TRGID_Val.Dist_R05.Distab13_12T P_TRG_Direct.Dist_R05.Distab13_12T P_TRG_Nr.Dist_R05.Distab13_12T P_TRG_Val.Dist_R05.Distab13_12T /end REF_CHARACTERISTIC
/end GROUP
/begin GROUP Dist_R06.Distab13_12T ""
 /begin REF_MEASUREMENT Active.Dist_R06.Distab13_12T NrBytes_Total.Dist_R06.Distab13_12T NrVar_1Byte.Dist_R06.Distab13_12T NrVar_2Byte.Dist_R06.Distab13_12T NrVar_4Byte.Dist_R06.Distab13_12T NrVar_8Byte.Dist_R06.Distab13_12T Result.Dist_R06.Distab13_12T /end REF_MEASUREMENT
 /begin REF_CHARACTERISTIC P_Enable.Dist_R06.Distab13_12T P_TRGID_Nr.Dist_R06.Distab13_12T P_TRGID_Val.Dist_R06.Distab13_12T P_TRG_Direct.Dist_R06.Distab13_12T P_TRG_Nr.Dist_R06.Distab13_12T P_TRG_Val.Dist_R06.Distab13_12T /end REF_CHARACTERISTIC
/end GROUP
/begin GROUP Dist_R07.Distab13_12T ""
 /begin REF_MEASUREMENT Active.Dist_R07.Distab13_12T NrBytes_Total.Dist_R07.Distab13_12T NrVar_1Byte.Dist_R07.Distab13_12T NrVar_2Byte.Dist_R07.Distab13_12T NrVar_4Byte.Dist_R07.Distab13_12T NrVar_8Byte.Dist_R07.Distab13_12T Result.Dist_R07.Distab13_12T /end REF_MEASUREMENT
 /begin REF_CHARACTERISTIC P_Enable.Dist_R07.Distab13_12T P_TRGID_Nr.Dist_R07.Distab13_12T P_TRGID_Val.Dist_R07.Distab13_12T P_TRG_Direct.Dist_R07.Distab13_12T P_TRG_Nr.Dist_R07.Distab13_12T P_TRG_Val.Dist_R07.Distab13_12T /end REF_CHARACTERISTIC
/end GROUP
/begin GROUP Dist_R08.Distab13_12T ""
 /begin REF_MEASUREMENT Active.Dist_R08.Distab13_12T NrBytes_Total.Dist_R08.Distab13_12T NrVar_1Byte.Dist_R08.Distab13_12T NrVar_2Byte.Dist_R08.Distab13_12T NrVar_4Byte.Dist_R08.Distab13_12T NrVar_8Byte.Dist_R08.Distab13_12T Result.Dist_R08.Distab13_12T /end REF_MEASUREMENT
 /begin REF_CHARACTERISTIC P_Enable.Dist_R08.Distab13_12T P_TRGID_Nr.Dist_R08.Distab13_12T P_TRGID_Val.Dist_R08.Distab13_12T P_TRG_Direct.Dist_R08.Distab13_12T P_TRG_Nr.Dist_R08.Distab13_12T P_TRG_Val.Dist_R08.Distab13_12T /end REF_CHARACTERISTIC
/end GROUP
/begin GROUP Dist_R09.Distab13_12T ""
 /begin REF_MEASUREMENT Active.Dist_R09.Distab13_12T NrBytes_Total.Dist_R09.Distab13_12T NrVar_1Byte.Dist_R09.Distab13_12T NrVar_2Byte.Dist_R09.Distab13_12T NrVar_4Byte.Dist_R09.Distab13_12T NrVar_8Byte.Dist_R09.Distab13_12T Result.Dist_R09.Distab13_12T /end REF_MEASUREMENT
 /begin REF_CHARACTERISTIC P_Enable.Dist_R09.Distab13_12T P_TRGID_Nr.Dist_R09.Distab13_12T P_TRGID_Val.Dist_R09.Distab13_12T P_TRG_Direct.Dist_R09.Distab13_12T P_TRG_Nr.Dist_R09.Distab13_12T P_TRG_Val.Dist_R09.Distab13_12T /end REF_CHARACTERISTIC
/end GROUP
/begin GROUP Dist_R10.Distab13_12T ""
 /begin REF_MEASUREMENT Active.Dist_R10.Distab13_12T NrBytes_Total.Dist_R10.Distab13_12T NrVar_1Byte.Dist_R10.Distab13_12T NrVar_2Byte.Dist_R10.Distab13_12T NrVar_4Byte.Dist_R10.Distab13_12T NrVar_8Byte.Dist_R10.Distab13_12T Result.Dist_R10.Distab13_12T /end REF_MEASUREMENT
 /begin REF_CHARACTERISTIC P_Enable.Dist_R10.Distab13_12T P_TRGID_Nr.Dist_R10.Distab13_12T P_TRGID_Val.Dist_R10.Distab13_12T P_TRG_Direct.Dist_R10.Distab13_12T P_TRG_Nr.Dist_R10.Distab13_12T P_TRG_Val.Dist_R10.Distab13_12T /end REF_CHARACTERISTIC
/end GROUP
/begin GROUP Dist_R11.Distab13_12T ""
 /begin REF_MEASUREMENT Active.Dist_R11.Distab13_12T NrBytes_Total.Dist_R11.Distab13_12T NrVar_1Byte.Dist_R11.Distab13_12T NrVar_2Byte.Dist_R11.Distab13_12T NrVar_4Byte.Dist_R11.Distab13_12T NrVar_8Byte.Dist_R11.Distab13_12T Result.Dist_R11.Distab13_12T /end REF_MEASUREMENT
 /begin REF_CHARACTERISTIC P_Enable.Dist_R11.Distab13_12T P_TRGID_Nr.Dist_R11.Distab13_12T P_TRGID_Val.Dist_R11.Distab13_12T P_TRG_Direct.Dist_R11.Distab13_12T P_TRG_Nr.Dist_R11.Distab13_12T P_TRG_Val.Dist_R11.Distab13_12T /end REF_CHARACTERISTIC
/end GROUP
/begin GROUP Dist_R12.Distab13_12T ""
 /begin REF_MEASUREMENT Active.Dist_R12.Distab13_12T NrBytes_Total.Dist_R12.Distab13_12T NrVar_1Byte.Dist_R12.Distab13_12T NrVar_2Byte.Dist_R12.Distab13_12T NrVar_4Byte.Dist_R12.Distab13_12T NrVar_8Byte.Dist_R12.Distab13_12T Result.Dist_R12.Distab13_12T /end REF_MEASUREMENT
 /begin REF_CHARACTERISTIC P_Enable.Dist_R12.Distab13_12T P_TRGID_Nr.Dist_R12.Distab13_12T P_TRGID_Val.Dist_R12.Distab13_12T P_TRG_Direct.Dist_R12.Distab13_12T P_TRG_Nr.Dist_R12.Distab13_12T P_TRG_Val.Dist_R12.Distab13_12T /end REF_CHARACTERISTIC
/end GROUP
/begin GROUP Distab.Dist_B01.Distab13_12T ""
 /begin REF_MEASUREMENT Max.Distab.Dist_B01.Distab13_12T Min.Distab.Dist_B01.Distab13_12T Time.Distab.Dist_B01.Distab13_12T /end REF_MEASUREMENT
/end GROUP
/begin GROUP Distab.Dist_B02.Distab13_12T ""
 /begin REF_MEASUREMENT Max.Distab.Dist_B02.Distab13_12T Min.Distab.Dist_B02.Distab13_12T Time.Distab.Dist_B02.Distab13_12T /end REF_MEASUREMENT
/end GROUP
/begin GROUP Distab.Dist_B03.Distab13_12T ""
 /begin REF_MEASUREMENT Max.Distab.Dist_B03.Distab13_12T Min.Distab.Dist_B03.Distab13_12T Time.Distab.Dist_B03.Distab13_12T /end REF_MEASUREMENT
/end GROUP
/begin GROUP Distab.Dist_B04.Distab13_12T ""
 /begin REF_MEASUREMENT Max.Distab.Dist_B04.Distab13_12T Min.Distab.Dist_B04.Distab13_12T Time.Distab.Dist_B04.Distab13_12T /end REF_MEASUREMENT
/end GROUP
/begin GROUP Distab13_12T "" ROOT
 /begin REF_MEASUREMENT Active.Dist_B01.Distab13_12T Active.Dist_B02.Distab13_12T Active.Dist_B03.Distab13_12T Active.Dist_B04.Distab13_12T Active.Dist_R01.Distab13_12T Active.Dist_R02.Distab13_12T Active.Dist_R03.Distab13_12T Active.Dist_R04.Distab13_12T Active.Dist_R05.Distab13_12T Active.Dist_R06.Distab13_12T Active.Dist_R07.Distab13_12T Active.Dist_R08.Distab13_12T Active.Dist_R09.Distab13_12T Active.Dist_R10.Distab13_12T Active.Dist_R11.Distab13_12T Active.Dist_R12.Distab13_12T Counter.Dist_B01.Distab13_12T Counter.Dist_B02.Distab13_12T Counter.Dist_B03.Distab13_12T Counter.Dist_B04.Distab13_12T FSW_OIC01_Dcyc.Distab13_12T FSW_OIC02_Dcyc.Distab13_12T FSW_OPI01_Dcyc.Distab13_12T FSW_OPI02_Dcyc.Distab13_12T FSW_OPI03_Dcyc.Distab13_12T FSW_OPI04_Dcyc.Distab13_12T FSW_OPI05_Dcyc.Distab13_12T FSW_OPI06_Dcyc.Distab13_12T FSW_OPI07_Dcyc.Distab13_12T FSW_OPI08_Dcyc.Distab13_12T FSW_OPI09_Dcyc.Distab13_12T FSW_OPI10_Dcyc.Distab13_12T FSW_OPI11_Dcyc.Distab13_12T FSW_OS01_En.Distab13_12T FSW_OS01_S_Dcyc.Distab13_12T FSW_OS01_V.Distab13_12T FSW_OS02_En.Distab13_12T FSW_OS02_S_Dcyc.Distab13_12T FSW_OS02_V.Distab13_12T FSW_OS03.Distab13_12T FSW_OS04.Distab13_12T FSW_OS05a.Distab13_12T FSW_OS05b.Distab13_12T FSW_OS05c.Distab13_12T FSW_OS06.Distab13_12T FSW_OS07.Distab13_12T FSW_OS08.Distab13_12T FSW_OS09.Distab13_12T FSW_OS10.Distab13_12T FSW_OS11.Distab13_12T FSW_OS12.Distab13_12T FSW_OS13.Distab13_12T FSW_OS14.Distab13_12T FSW_OS15.Distab13_12T FSW_OS_MR.Distab13_12T Max.Distab.Dist_B01.Distab13_12T Max.Distab.Dist_B02.Distab13_12T Max.Distab.Dist_B03.Distab13_12T Max.Distab.Dist_B04.Distab13_12T Max.Roundtrip.Dist_B01.Distab13_12T Max.Roundtrip.Dist_B02.Distab13_12T Max.Roundtrip.Dist_B03.Distab13_12T Max.Roundtrip.Dist_B04.Distab13_12T Min.Distab.Dist_B01.Distab13_12T Min.Distab.Dist_B02.Distab13_12T Min.Distab.Dist_B03.Distab13_12T Min.Distab.Dist_B04.Distab13_12T Min.Roundtrip.Dist_B01.Distab13_12T Min.Roundtrip.Dist_B02.Distab13_12T Min.Roundtrip.Dist_B03.Distab13_12T Min.Roundtrip.Dist_B04.Distab13_12T NrBytes_Total.Dist_B01.Distab13_12T NrBytes_Total.Dist_B02.Distab13_12T NrBytes_Total.Dist_B03.Distab13_12T NrBytes_Total.Dist_B04.Distab13_12T NrBytes_Total.Dist_R01.Distab13_12T NrBytes_Total.Dist_R02.Distab13_12T NrBytes_Total.Dist_R03.Distab13_12T NrBytes_Total.Dist_R04.Distab13_12T NrBytes_Total.Dist_R05.Distab13_12T NrBytes_Total.Dist_R06.Distab13_12T NrBytes_Total.Dist_R07.Distab13_12T NrBytes_Total.Dist_R08.Distab13_12T NrBytes_Total.Dist_R09.Distab13_12T NrBytes_Total.Dist_R10.Distab13_12T NrBytes_Total.Dist_R11.Distab13_12T NrBytes_Total.Dist_R12.Distab13_12T NrVar_1Byte.Dist_B01.Distab13_12T NrVar_1Byte.Dist_B02.Distab13_12T NrVar_1Byte.Dist_B03.Distab13_12T NrVar_1Byte.Dist_B04.Distab13_12T NrVar_1Byte.Dist_R01.Distab13_12T NrVar_1Byte.Dist_R02.Distab13_12T NrVar_1Byte.Dist_R03.Distab13_12T NrVar_1Byte.Dist_R04.Distab13_12T NrVar_1Byte.Dist_R05.Distab13_12T NrVar_1Byte.Dist_R06.Distab13_12T NrVar_1Byte.Dist_R07.Distab13_12T NrVar_1Byte.Dist_R08.Distab13_12T NrVar_1Byte.Dist_R09.Distab13_12T NrVar_1Byte.Dist_R10.Distab13_12T NrVar_1Byte.Dist_R11.Distab13_12T NrVar_1Byte.Dist_R12.Distab13_12T NrVar_2Byte.Dist_B01.Distab13_12T NrVar_2Byte.Dist_B02.Distab13_12T NrVar_2Byte.Dist_B03.Distab13_12T NrVar_2Byte.Dist_B04.Distab13_12T NrVar_2Byte.Dist_R01.Distab13_12T NrVar_2Byte.Dist_R02.Distab13_12T NrVar_2Byte.Dist_R03.Distab13_12T NrVar_2Byte.Dist_R04.Distab13_12T NrVar_2Byte.Dist_R05.Distab13_12T NrVar_2Byte.Dist_R06.Distab13_12T NrVar_2Byte.Dist_R07.Distab13_12T NrVar_2Byte.Dist_R08.Distab13_12T NrVar_2Byte.Dist_R09.Distab13_12T NrVar_2Byte.Dist_R10.Distab13_12T NrVar_2Byte.Dist_R11.Distab13_12T NrVar_2Byte.Dist_R12.Distab13_12T NrVar_4Byte.Dist_B01.Distab13_12T NrVar_4Byte.Dist_B02.Distab13_12T NrVar_4Byte.Dist_B03.Distab13_12T NrVar_4Byte.Dist_B04.Distab13_12T NrVar_4Byte.Dist_R01.Distab13_12T NrVar_4Byte.Dist_R02.Distab13_12T NrVar_4Byte.Dist_R03.Distab13_12T NrVar_4Byte.Dist_R04.Distab13_12T NrVar_4Byte.Dist_R05.Distab13_12T NrVar_4Byte.Dist_R06.Distab13_12T NrVar_4Byte.Dist_R07.Distab13_12T NrVar_4Byte.Dist_R08.Distab13_12T NrVar_4Byte.Dist_R09.Distab13_12T NrVar_4Byte.Dist_R10.Distab13_12T NrVar_4Byte.Dist_R11.Distab13_12T NrVar_4Byte.Dist_R12.Distab13_12T NrVar_8Byte.Dist_B01.Distab13_12T NrVar_8Byte.Dist_B02.Distab13_12T NrVar_8Byte.Dist_B03.Distab13_12T NrVar_8Byte.Dist_B04.Distab13_12T NrVar_8Byte.Dist_R01.Distab13_12T NrVar_8Byte.Dist_R02.Distab13_12T NrVar_8Byte.Dist_R03.Distab13_12T NrVar_8Byte.Dist_R04.Distab13_12T NrVar_8Byte.Dist_R05.Distab13_12T NrVar_8Byte.Dist_R06.Distab13_12T NrVar_8Byte.Dist_R07.Distab13_12T NrVar_8Byte.Dist_R08.Distab13_12T NrVar_8Byte.Dist_R09.Distab13_12T NrVar_8Byte.Dist_R10.Distab13_12T NrVar_8Byte.Dist_R11.Distab13_12T NrVar_8Byte.Dist_R12.Distab13_12T Result.Dist_B01.Distab13_12T Result.Dist_B02.Distab13_12T Result.Dist_B03.Distab13_12T Result.Dist_B04.Distab13_12T Result.Dist_R01.Distab13_12T Result.Dist_R02.Distab13_12T Result.Dist_R03.Distab13_12T Result.Dist_R04.Distab13_12T Result.Dist_R05.Distab13_12T Result.Dist_R06.Distab13_12T Result.Dist_R07.Distab13_12T Result.Dist_R08.Distab13_12T Result.Dist_R09.Distab13_12T Result.Dist_R10.Distab13_12T Result.Dist_R11.Distab13_12T Result.Dist_R12.Distab13_12T Time.Distab.Dist_B01.Distab13_12T Time.Distab.Dist_B02.Distab13_12T Time.Distab.Dist_B03.Distab13_12T Time.Distab.Dist_B04.Distab13_12T Time.Roundtrip.Dist_B01.Distab13_12T Time.Roundtrip.Dist_B02.Distab13_12T Time.Roundtrip.Dist_B03.Distab13_12T Time.Roundtrip.Dist_B04.Distab13_12T Timeout_RoundTrip.Dist_B01.Distab13_12T Timeout_RoundTrip.Dist_B02.Distab13_12T Timeout_RoundTrip.Dist_B03.Distab13_12T Timeout_RoundTrip.Dist_B04.Distab13_12T /end REF_MEASUREMENT
 /begin REF_CHARACTERISTIC EBYP_BitOff_OS01_En.Distab13_12T EBYP_BitOff_OS01_V.Distab13_12T EBYP_BitOff_OS02_En.Distab13_12T EBYP_BitOff_OS02_V.Distab13_12T EBYP_BitOff_OS03.Distab13_12T EBYP_BitOff_OS04.Distab13_12T EBYP_BitOff_OS05a.Distab13_12T EBYP_BitOff_OS05b.Distab13_12T EBYP_BitOff_OS05c.Distab13_12T EBYP_BitOff_OS06.Distab13_12T EBYP_BitOff_OS07.Distab13_12T EBYP_BitOff_OS08.Distab13_12T EBYP_BitOff_OS09.Distab13_12T EBYP_BitOff_OS10.Distab13_12T EBYP_BitOff_OS11.Distab13_12T EBYP_BitOff_OS12.Distab13_12T EBYP_BitOff_OS13.Distab13_12T EBYP_BitOff_OS14.Distab13_12T EBYP_BitOff_OS15.Distab13_12T EBYP_BitOff_OSMR.Distab13_12T EBYP_Off_OIC01_Dcyc.Distab13_12T EBYP_Off_OIC02_Dcyc.Distab13_12T EBYP_Off_OPI01_Dcyc.Distab13_12T EBYP_Off_OPI02_Dcyc.Distab13_12T EBYP_Off_OPI03_Dcyc.Distab13_12T EBYP_Off_OPI04_Dcyc.Distab13_12T EBYP_Off_OPI05_Dcyc.Distab13_12T EBYP_Off_OPI06_Dcyc.Distab13_12T EBYP_Off_OPI07_Dcyc.Distab13_12T EBYP_Off_OS01_En.Distab13_12T EBYP_Off_OS01_S_Dcyc.Distab13_12T EBYP_Off_OS01_V.Distab13_12T EBYP_Off_OS02_En.Distab13_12T EBYP_Off_OS02_S_Dcyc.Distab13_12T EBYP_Off_OS02_V.Distab13_12T EBYP_Off_OS03.Distab13_12T EBYP_Off_OS04.Distab13_12T EBYP_Off_OS05a.Distab13_12T EBYP_Off_OS05b.Distab13_12T EBYP_Off_OS05c.Distab13_12T EBYP_Off_OS06.Distab13_12T EBYP_Off_OS07.Distab13_12T EBYP_Off_OS08.Distab13_12T EBYP_Off_OS09.Distab13_12T EBYP_Off_OS10.Distab13_12T EBYP_Off_OS11.Distab13_12T EBYP_Off_OS12.Distab13_12T EBYP_Off_OS13.Distab13_12T EBYP_Off_OS14.Distab13_12T EBYP_Off_OS15.Distab13_12T EBYP_Off_OSMR.Distab13_12T P_AML1_1_3P2R_Compatibility.Distab13_12T P_Byp_Roundtrip_Timeout_Time.Distab13_12T P_Do_TRG_Without_Distab.Distab13_12T P_Enable.Dist_B01.Distab13_12T P_Enable.Dist_B02.Distab13_12T P_Enable.Dist_B03.Distab13_12T P_Enable.Dist_B04.Distab13_12T P_Enable.Dist_R01.Distab13_12T P_Enable.Dist_R02.Distab13_12T P_Enable.Dist_R03.Distab13_12T P_Enable.Dist_R04.Distab13_12T P_Enable.Dist_R05.Distab13_12T P_Enable.Dist_R06.Distab13_12T P_Enable.Dist_R07.Distab13_12T P_Enable.Dist_R08.Distab13_12T P_Enable.Dist_R09.Distab13_12T P_Enable.Dist_R10.Distab13_12T P_Enable.Dist_R11.Distab13_12T P_Enable.Dist_R12.Distab13_12T P_Enable_ETK.Distab13_12T P_TRGID_Nr.Dist_B01.Distab13_12T P_TRGID_Nr.Dist_B02.Distab13_12T P_TRGID_Nr.Dist_B03.Distab13_12T P_TRGID_Nr.Dist_B04.Distab13_12T P_TRGID_Nr.Dist_R01.Distab13_12T P_TRGID_Nr.Dist_R02.Distab13_12T P_TRGID_Nr.Dist_R03.Distab13_12T P_TRGID_Nr.Dist_R04.Distab13_12T P_TRGID_Nr.Dist_R05.Distab13_12T P_TRGID_Nr.Dist_R06.Distab13_12T P_TRGID_Nr.Dist_R07.Distab13_12T P_TRGID_Nr.Dist_R08.Distab13_12T P_TRGID_Nr.Dist_R09.Distab13_12T P_TRGID_Nr.Dist_R10.Distab13_12T P_TRGID_Nr.Dist_R11.Distab13_12T P_TRGID_Nr.Dist_R12.Distab13_12T P_TRGID_Val.Dist_B01.Distab13_12T P_TRGID_Val.Dist_B02.Distab13_12T P_TRGID_Val.Dist_B03.Distab13_12T P_TRGID_Val.Dist_B04.Distab13_12T P_TRGID_Val.Dist_R01.Distab13_12T P_TRGID_Val.Dist_R02.Distab13_12T P_TRGID_Val.Dist_R03.Distab13_12T P_TRGID_Val.Dist_R04.Distab13_12T P_TRGID_Val.Dist_R05.Distab13_12T P_TRGID_Val.Dist_R06.Distab13_12T P_TRGID_Val.Dist_R07.Distab13_12T P_TRGID_Val.Dist_R08.Distab13_12T P_TRGID_Val.Dist_R09.Distab13_12T P_TRGID_Val.Dist_R10.Distab13_12T P_TRGID_Val.Dist_R11.Distab13_12T P_TRGID_Val.Dist_R12.Distab13_12T P_TRG_Direct.Dist_B01.Distab13_12T P_TRG_Direct.Dist_B02.Distab13_12T P_TRG_Direct.Dist_B03.Distab13_12T P_TRG_Direct.Dist_B04.Distab13_12T P_TRG_Direct.Dist_R01.Distab13_12T P_TRG_Direct.Dist_R02.Distab13_12T P_TRG_Direct.Dist_R03.Distab13_12T P_TRG_Direct.Dist_R04.Distab13_12T P_TRG_Direct.Dist_R05.Distab13_12T P_TRG_Direct.Dist_R06.Distab13_12T P_TRG_Direct.Dist_R07.Distab13_12T P_TRG_Direct.Dist_R08.Distab13_12T P_TRG_Direct.Dist_R09.Distab13_12T P_TRG_Direct.Dist_R10.Distab13_12T P_TRG_Direct.Dist_R11.Distab13_12T P_TRG_Direct.Dist_R12.Distab13_12T P_TRG_Nr.Dist_B01.Distab13_12T P_TRG_Nr.Dist_B02.Distab13_12T P_TRG_Nr.Dist_B03.Distab13_12T P_TRG_Nr.Dist_B04.Distab13_12T P_TRG_Nr.Dist_R01.Distab13_12T P_TRG_Nr.Dist_R02.Distab13_12T P_TRG_Nr.Dist_R03.Distab13_12T P_TRG_Nr.Dist_R04.Distab13_12T P_TRG_Nr.Dist_R05.Distab13_12T P_TRG_Nr.Dist_R06.Distab13_12T P_TRG_Nr.Dist_R07.Distab13_12T P_TRG_Nr.Dist_R08.Distab13_12T P_TRG_Nr.Dist_R09.Distab13_12T P_TRG_Nr.Dist_R10.Distab13_12T P_TRG_Nr.Dist_R11.Distab13_12T P_TRG_Nr.Dist_R12.Distab13_12T P_TRG_Val.Dist_B01.Distab13_12T P_TRG_Val.Dist_B02.Distab13_12T P_TRG_Val.Dist_B03.Distab13_12T P_TRG_Val.Dist_B04.Distab13_12T P_TRG_Val.Dist_R01.Distab13_12T P_TRG_Val.Dist_R02.Distab13_12T P_TRG_Val.Dist_R03.Distab13_12T P_TRG_Val.Dist_R04.Distab13_12T P_TRG_Val.Dist_R05.Distab13_12T P_TRG_Val.Dist_R06.Distab13_12T P_TRG_Val.Dist_R07.Distab13_12T P_TRG_Val.Dist_R08.Distab13_12T P_TRG_Val.Dist_R09.Distab13_12T P_TRG_Val.Dist_R10.Distab13_12T P_TRG_Val.Dist_R11.Distab13_12T P_TRG_Val.Dist_R12.Distab13_12T P_Wait_Bypass_Roundtrip.Distab13_12T TST_OIC01_Dcyc.Distab13_12T TST_OIC02_Dcyc.Distab13_12T TST_OPI01_Dcyc.Distab13_12T TST_OPI02_Dcyc.Distab13_12T TST_OPI03_Dcyc.Distab13_12T TST_OPI04_Dcyc.Distab13_12T TST_OPI05_Dcyc.Distab13_12T TST_OPI06_Dcyc.Distab13_12T TST_OPI07_Dcyc.Distab13_12T TST_OPI08_Dcyc.Distab13_12T TST_OPI09_Dcyc.Distab13_12T TST_OPI10_Dcyc.Distab13_12T TST_OPI11_Dcyc.Distab13_12T TST_OS01_En.Distab13_12T TST_OS01_S_Dcyc.Distab13_12T TST_OS01_V.Distab13_12T TST_OS02_En.Distab13_12T TST_OS02_S_Dcyc.Distab13_12T TST_OS02_V.Distab13_12T TST_OS03.Distab13_12T TST_OS04.Distab13_12T TST_OS05a.Distab13_12T TST_OS05b.Distab13_12T TST_OS05c.Distab13_12T TST_OS06.Distab13_12T TST_OS07.Distab13_12T TST_OS08.Distab13_12T TST_OS09.Distab13_12T TST_OS10.Distab13_12T TST_OS11.Distab13_12T TST_OS12.Distab13_12T TST_OS13.Distab13_12T TST_OS14.Distab13_12T TST_OS15.Distab13_12T TST_OS_MR.Distab13_12T /end REF_CHARACTERISTIC
 /begin SUB_GROUP Dist_B01.Distab13_12T Dist_B02.Distab13_12T Dist_B03.Distab13_12T Dist_B04.Distab13_12T Dist_R01.Distab13_12T Dist_R02.Distab13_12T Dist_R03.Distab13_12T Dist_R04.Distab13_12T Dist_R05.Distab13_12T Dist_R06.Distab13_12T Dist_R07.Distab13_12T Dist_R08.Distab13_12T Dist_R09.Distab13_12T Dist_R10.Distab13_12T Dist_R11.Distab13_12T Dist_R12.Distab13_12T /end SUB_GROUP
/end GROUP
/begin GROUP EV0_Roundtrip.XCP_SHELL ""
 /begin REF_MEASUREMENT Max.MIN_MAX_Tick2Time.EV0_Roundtrip.XCP_SHELL Min.MIN_MAX_Tick2Time.EV0_Roundtrip.XCP_SHELL Time.MIN_MAX_Tick2Time.EV0_Roundtrip.XCP_SHELL l_ResetTimer_b.EV0_Roundtrip.XCP_SHELL l_StartTicks_u32.EV0_Roundtrip.XCP_SHELL l_StopTicks_u32.EV0_Roundtrip.XCP_SHELL l_Timeout_b.EV0_Roundtrip.XCP_SHELL /end REF_MEASUREMENT
 /begin REF_CHARACTERISTIC p_ResetTimer_b.EV0_Roundtrip.XCP_SHELL /end REF_CHARACTERISTIC
 /begin SUB_GROUP MIN_MAX_Tick2Time.EV0_Roundtrip.XCP_SHELL /end SUB_GROUP
/end GROUP
/begin GROUP EV0_Rx.XCP_SHELL ""
 /begin REF_MEASUREMENT Max.Time.EV0_Rx.XCP_SHELL Max.TimeSum.EV0_Rx.XCP_SHELL Min.Time.EV0_Rx.XCP_SHELL Min.TimeSum.EV0_Rx.XCP_SHELL Time.Time.EV0_Rx.XCP_SHELL Time.TimeSum.EV0_Rx.XCP_SHELL l_ResetTimer_b.EV0_Rx.XCP_SHELL l_StartTicks_u32.EV0_Rx.XCP_SHELL l_StopTicks_u32.EV0_Rx.XCP_SHELL l_TimeSum_u32.EV0_Rx.XCP_SHELL l_Timeout_b.EV0_Rx.XCP_SHELL /end REF_MEASUREMENT
 /begin REF_CHARACTERISTIC p_ResetTimer_b.EV0_Rx.XCP_SHELL /end REF_CHARACTERISTIC
 /begin SUB_GROUP Time.EV0_Rx.XCP_SHELL TimeSum.EV0_Rx.XCP_SHELL /end SUB_GROUP
/end GROUP
/begin GROUP EV0_Sample.XCP_SHELL ""
 /begin REF_MEASUREMENT Max.MIN_MAX_Tick2Time.EV0_Sample.XCP_SHELL Min.MIN_MAX_Tick2Time.EV0_Sample.XCP_SHELL Time.MIN_MAX_Tick2Time.EV0_Sample.XCP_SHELL l_ResetTimer_b.EV0_Sample.XCP_SHELL l_StartTicks_u32.EV0_Sample.XCP_SHELL l_StopTicks_u32.EV0_Sample.XCP_SHELL l_Timeout_b.EV0_Sample.XCP_SHELL /end REF_MEASUREMENT
 /begin REF_CHARACTERISTIC p_ResetTimer_b.EV0_Sample.XCP_SHELL /end REF_CHARACTERISTIC
 /begin SUB_GROUP MIN_MAX_Tick2Time.EV0_Sample.XCP_SHELL /end SUB_GROUP
/end GROUP
/begin GROUP EV0_Stim.XCP_SHELL ""
 /begin REF_MEASUREMENT Max.MIN_MAX_Tick2Time.EV0_Stim.XCP_SHELL Min.MIN_MAX_Tick2Time.EV0_Stim.XCP_SHELL Time.MIN_MAX_Tick2Time.EV0_Stim.XCP_SHELL l_ResetTimer_b.EV0_Stim.XCP_SHELL l_StartTicks_u32.EV0_Stim.XCP_SHELL l_StopTicks_u32.EV0_Stim.XCP_SHELL l_Timeout_b.EV0_Stim.XCP_SHELL /end REF_MEASUREMENT
 /begin REF_CHARACTERISTIC p_ResetTimer_b.EV0_Stim.XCP_SHELL /end REF_CHARACTERISTIC
 /begin SUB_GROUP MIN_MAX_Tick2Time.EV0_Stim.XCP_SHELL /end SUB_GROUP
/end GROUP
/begin GROUP EV0_Tx.XCP_SHELL ""
 /begin REF_MEASUREMENT Max.Time.EV0_Tx.XCP_SHELL Max.TimeSum.EV0_Tx.XCP_SHELL Min.Time.EV0_Tx.XCP_SHELL Min.TimeSum.EV0_Tx.XCP_SHELL Time.Time.EV0_Tx.XCP_SHELL Time.TimeSum.EV0_Tx.XCP_SHELL l_ResetTimer_b.EV0_Tx.XCP_SHELL l_StartTicks_u32.EV0_Tx.XCP_SHELL l_StopTicks_u32.EV0_Tx.XCP_SHELL l_TimeSum_u32.EV0_Tx.XCP_SHELL l_Timeout_b.EV0_Tx.XCP_SHELL /end REF_MEASUREMENT
 /begin REF_CHARACTERISTIC p_ResetTimer_b.EV0_Tx.XCP_SHELL /end REF_CHARACTERISTIC
 /begin SUB_GROUP Time.EV0_Tx.XCP_SHELL TimeSum.EV0_Tx.XCP_SHELL /end SUB_GROUP
/end GROUP
/begin GROUP E_fl32.R01_B ""
 /begin REF_MEASUREMENT fl32_01.E_fl32.R01_B fl32_02.E_fl32.R01_B fl32_03.E_fl32.R01_B fl32_04.E_fl32.R01_B fl32_05.E_fl32.R01_B fl32_06.E_fl32.R01_B fl32_07.E_fl32.R01_B fl32_08.E_fl32.R01_B /end REF_MEASUREMENT
/end GROUP
/begin GROUP E_fl32.R02_B ""
 /begin REF_MEASUREMENT fl32_01.E_fl32.R02_B fl32_02.E_fl32.R02_B fl32_03.E_fl32.R02_B fl32_04.E_fl32.R02_B fl32_05.E_fl32.R02_B fl32_06.E_fl32.R02_B fl32_07.E_fl32.R02_B fl32_08.E_fl32.R02_B /end REF_MEASUREMENT
/end GROUP
/begin GROUP E_fl32.R03_B ""
 /begin REF_MEASUREMENT fl32_01.E_fl32.R03_B fl32_02.E_fl32.R03_B fl32_03.E_fl32.R03_B fl32_04.E_fl32.R03_B fl32_05.E_fl32.R03_B fl32_06.E_fl32.R03_B fl32_07.E_fl32.R03_B fl32_08.E_fl32.R03_B /end REF_MEASUREMENT
/end GROUP
/begin GROUP E_fl32.R04_B ""
 /begin REF_MEASUREMENT fl32_01.E_fl32.R04_B fl32_02.E_fl32.R04_B fl32_03.E_fl32.R04_B fl32_04.E_fl32.R04_B fl32_05.E_fl32.R04_B fl32_06.E_fl32.R04_B fl32_07.E_fl32.R04_B fl32_08.E_fl32.R04_B /end REF_MEASUREMENT
/end GROUP
/begin GROUP E_fl64.R01_B ""
 /begin REF_MEASUREMENT fl64_01.E_fl64.R01_B fl64_02.E_fl64.R01_B fl64_03.E_fl64.R01_B fl64_04.E_fl64.R01_B fl64_05.E_fl64.R01_B fl64_06.E_fl64.R01_B fl64_07.E_fl64.R01_B fl64_08.E_fl64.R01_B /end REF_MEASUREMENT
/end GROUP
/begin GROUP E_fl64.R02_B ""
 /begin REF_MEASUREMENT fl64_01.E_fl64.R02_B fl64_02.E_fl64.R02_B fl64_03.E_fl64.R02_B fl64_04.E_fl64.R02_B fl64_05.E_fl64.R02_B fl64_06.E_fl64.R02_B fl64_07.E_fl64.R02_B fl64_08.E_fl64.R02_B /end REF_MEASUREMENT
/end GROUP
/begin GROUP E_fl64.R03_B ""
 /begin REF_MEASUREMENT fl64_01.E_fl64.R03_B fl64_02.E_fl64.R03_B fl64_03.E_fl64.R03_B fl64_04.E_fl64.R03_B fl64_05.E_fl64.R03_B fl64_06.E_fl64.R03_B fl64_07.E_fl64.R03_B fl64_08.E_fl64.R03_B /end REF_MEASUREMENT
/end GROUP
/begin GROUP E_fl64.R04_B ""
 /begin REF_MEASUREMENT fl64_01.E_fl64.R04_B fl64_02.E_fl64.R04_B fl64_03.E_fl64.R04_B fl64_04.E_fl64.R04_B fl64_05.E_fl64.R04_B fl64_06.E_fl64.R04_B fl64_07.E_fl64.R04_B fl64_08.E_fl64.R04_B /end REF_MEASUREMENT
/end GROUP
/begin GROUP E_sint16.R01 ""
 /begin REF_MEASUREMENT sint16_01.E_sint16.R01 sint16_02.E_sint16.R01 sint16_03.E_sint16.R01 sint16_04.E_sint16.R01 sint16_05.E_sint16.R01 sint16_06.E_sint16.R01 sint16_07.E_sint16.R01 sint16_08.E_sint16.R01 /end REF_MEASUREMENT
/end GROUP
/begin GROUP E_sint16.R02 ""
 /begin REF_MEASUREMENT sint16_01.E_sint16.R02 sint16_02.E_sint16.R02 sint16_03.E_sint16.R02 sint16_04.E_sint16.R02 sint16_05.E_sint16.R02 sint16_06.E_sint16.R02 sint16_07.E_sint16.R02 sint16_08.E_sint16.R02 /end REF_MEASUREMENT
/end GROUP
/begin GROUP E_sint16.R03 ""
 /begin REF_MEASUREMENT sint16_01.E_sint16.R03 sint16_02.E_sint16.R03 sint16_03.E_sint16.R03 sint16_04.E_sint16.R03 sint16_05.E_sint16.R03 sint16_06.E_sint16.R03 sint16_07.E_sint16.R03 sint16_08.E_sint16.R03 /end REF_MEASUREMENT
/end GROUP
/begin GROUP E_sint16.R04 ""
 /begin REF_MEASUREMENT sint16_01.E_sint16.R04 sint16_02.E_sint16.R04 sint16_03.E_sint16.R04 sint16_04.E_sint16.R04 sint16_05.E_sint16.R04 sint16_06.E_sint16.R04 sint16_07.E_sint16.R04 sint16_08.E_sint16.R04 /end REF_MEASUREMENT
/end GROUP
/begin GROUP E_sint16.R05 ""
 /begin REF_MEASUREMENT sint16_01.E_sint16.R05 sint16_02.E_sint16.R05 sint16_03.E_sint16.R05 sint16_04.E_sint16.R05 sint16_05.E_sint16.R05 sint16_06.E_sint16.R05 sint16_07.E_sint16.R05 sint16_08.E_sint16.R05 /end REF_MEASUREMENT
/end GROUP
/begin GROUP E_sint16.R06 ""
 /begin REF_MEASUREMENT sint16_01.E_sint16.R06 sint16_02.E_sint16.R06 sint16_03.E_sint16.R06 sint16_04.E_sint16.R06 sint16_05.E_sint16.R06 sint16_06.E_sint16.R06 sint16_07.E_sint16.R06 sint16_08.E_sint16.R06 /end REF_MEASUREMENT
/end GROUP
/begin GROUP E_sint16.R07 ""
 /begin REF_MEASUREMENT sint16_01.E_sint16.R07 sint16_02.E_sint16.R07 sint16_03.E_sint16.R07 sint16_04.E_sint16.R07 sint16_05.E_sint16.R07 sint16_06.E_sint16.R07 sint16_07.E_sint16.R07 sint16_08.E_sint16.R07 /end REF_MEASUREMENT
/end GROUP
/begin GROUP E_sint16.R08 ""
 /begin REF_MEASUREMENT sint16_01.E_sint16.R08 sint16_02.E_sint16.R08 sint16_03.E_sint16.R08 sint16_04.E_sint16.R08 sint16_05.E_sint16.R08 sint16_06.E_sint16.R08 sint16_07.E_sint16.R08 sint16_08.E_sint16.R08 /end REF_MEASUREMENT
/end GROUP
/begin GROUP E_sint16.R09 ""
 /begin REF_MEASUREMENT sint16_01.E_sint16.R09 sint16_02.E_sint16.R09 sint16_03.E_sint16.R09 sint16_04.E_sint16.R09 sint16_05.E_sint16.R09 sint16_06.E_sint16.R09 sint16_07.E_sint16.R09 sint16_08.E_sint16.R09 /end REF_MEASUREMENT
/end GROUP
/begin GROUP E_sint16.R10 ""
 /begin REF_MEASUREMENT sint16_01.E_sint16.R10 sint16_02.E_sint16.R10 sint16_03.E_sint16.R10 sint16_04.E_sint16.R10 sint16_05.E_sint16.R10 sint16_06.E_sint16.R10 sint16_07.E_sint16.R10 sint16_08.E_sint16.R10 /end REF_MEASUREMENT
/end GROUP
/begin GROUP E_sint16.R11 ""
 /begin REF_MEASUREMENT sint16_01.E_sint16.R11 sint16_02.E_sint16.R11 sint16_03.E_sint16.R11 sint16_04.E_sint16.R11 sint16_05.E_sint16.R11 sint16_06.E_sint16.R11 sint16_07.E_sint16.R11 sint16_08.E_sint16.R11 /end REF_MEASUREMENT
/end GROUP
/begin GROUP E_sint16.R12 ""
 /begin REF_MEASUREMENT sint16_01.E_sint16.R12 sint16_02.E_sint16.R12 sint16_03.E_sint16.R12 sint16_04.E_sint16.R12 sint16_05.E_sint16.R12 sint16_06.E_sint16.R12 sint16_07.E_sint16.R12 sint16_08.E_sint16.R12 /end REF_MEASUREMENT
/end GROUP
/begin GROUP E_sint16.R13 ""
 /begin REF_MEASUREMENT sint16_01.E_sint16.R13 sint16_02.E_sint16.R13 sint16_03.E_sint16.R13 sint16_04.E_sint16.R13 sint16_05.E_sint16.R13 sint16_06.E_sint16.R13 sint16_07.E_sint16.R13 sint16_08.E_sint16.R13 /end REF_MEASUREMENT
/end GROUP
/begin GROUP E_sint16.R14 ""
 /begin REF_MEASUREMENT sint16_01.E_sint16.R14 sint16_02.E_sint16.R14 sint16_03.E_sint16.R14 sint16_04.E_sint16.R14 sint16_05.E_sint16.R14 sint16_06.E_sint16.R14 sint16_07.E_sint16.R14 sint16_08.E_sint16.R14 /end REF_MEASUREMENT
/end GROUP
/begin GROUP E_sint16.R15 ""
 /begin REF_MEASUREMENT sint16_01.E_sint16.R15 sint16_02.E_sint16.R15 sint16_03.E_sint16.R15 sint16_04.E_sint16.R15 sint16_05.E_sint16.R15 sint16_06.E_sint16.R15 sint16_07.E_sint16.R15 sint16_08.E_sint16.R15 /end REF_MEASUREMENT
/end GROUP
/begin GROUP E_sint16_1.R01_16bit ""
 /begin REF_MEASUREMENT sint16_01.E_sint16_1.R01_16bit sint16_02.E_sint16_1.R01_16bit sint16_03.E_sint16_1.R01_16bit sint16_04.E_sint16_1.R01_16bit sint16_05.E_sint16_1.R01_16bit sint16_06.E_sint16_1.R01_16bit sint16_07.E_sint16_1.R01_16bit sint16_08.E_sint16_1.R01_16bit /end REF_MEASUREMENT
/end GROUP
/begin GROUP E_sint16_2.R01_16bit ""
 /begin REF_MEASUREMENT sint16_01.E_sint16_2.R01_16bit sint16_02.E_sint16_2.R01_16bit sint16_03.E_sint16_2.R01_16bit sint16_04.E_sint16_2.R01_16bit sint16_05.E_sint16_2.R01_16bit sint16_06.E_sint16_2.R01_16bit sint16_07.E_sint16_2.R01_16bit sint16_08.E_sint16_2.R01_16bit /end REF_MEASUREMENT
/end GROUP
/begin GROUP E_sint16_3.R01_16bit ""
 /begin REF_MEASUREMENT sint16_01.E_sint16_3.R01_16bit sint16_02.E_sint16_3.R01_16bit sint16_03.E_sint16_3.R01_16bit sint16_04.E_sint16_3.R01_16bit sint16_05.E_sint16_3.R01_16bit sint16_06.E_sint16_3.R01_16bit sint16_07.E_sint16_3.R01_16bit sint16_08.E_sint16_3.R01_16bit /end REF_MEASUREMENT
/end GROUP
/begin GROUP E_sint16_4.R01_16bit ""
 /begin REF_MEASUREMENT sint16_01.E_sint16_4.R01_16bit sint16_02.E_sint16_4.R01_16bit sint16_03.E_sint16_4.R01_16bit sint16_04.E_sint16_4.R01_16bit sint16_05.E_sint16_4.R01_16bit sint16_06.E_sint16_4.R01_16bit sint16_07.E_sint16_4.R01_16bit sint16_08.E_sint16_4.R01_16bit /end REF_MEASUREMENT
/end GROUP
/begin GROUP E_sint32.R01_B ""
 /begin REF_MEASUREMENT sint32_01.E_sint32.R01_B sint32_02.E_sint32.R01_B sint32_03.E_sint32.R01_B sint32_04.E_sint32.R01_B sint32_05.E_sint32.R01_B sint32_06.E_sint32.R01_B sint32_07.E_sint32.R01_B sint32_08.E_sint32.R01_B /end REF_MEASUREMENT
/end GROUP
/begin GROUP E_sint32.R02_B ""
 /begin REF_MEASUREMENT sint32_01.E_sint32.R02_B sint32_02.E_sint32.R02_B sint32_03.E_sint32.R02_B sint32_04.E_sint32.R02_B sint32_05.E_sint32.R02_B sint32_06.E_sint32.R02_B sint32_07.E_sint32.R02_B sint32_08.E_sint32.R02_B /end REF_MEASUREMENT
/end GROUP
/begin GROUP E_sint32.R03_B ""
 /begin REF_MEASUREMENT sint32_01.E_sint32.R03_B sint32_02.E_sint32.R03_B sint32_03.E_sint32.R03_B sint32_04.E_sint32.R03_B sint32_05.E_sint32.R03_B sint32_06.E_sint32.R03_B sint32_07.E_sint32.R03_B sint32_08.E_sint32.R03_B /end REF_MEASUREMENT
/end GROUP
/begin GROUP E_sint32.R04_B ""
 /begin REF_MEASUREMENT sint32_01.E_sint32.R04_B sint32_02.E_sint32.R04_B sint32_03.E_sint32.R04_B sint32_04.E_sint32.R04_B sint32_05.E_sint32.R04_B sint32_06.E_sint32.R04_B sint32_07.E_sint32.R04_B sint32_08.E_sint32.R04_B /end REF_MEASUREMENT
/end GROUP
/begin GROUP E_sint8.R01 ""
 /begin REF_MEASUREMENT sint8_01.E_sint8.R01 sint8_02.E_sint8.R01 sint8_03.E_sint8.R01 sint8_04.E_sint8.R01 sint8_05.E_sint8.R01 sint8_06.E_sint8.R01 sint8_07.E_sint8.R01 sint8_08.E_sint8.R01 /end REF_MEASUREMENT
/end GROUP
/begin GROUP E_sint8.R02 ""
 /begin REF_MEASUREMENT sint8_01.E_sint8.R02 sint8_02.E_sint8.R02 sint8_03.E_sint8.R02 sint8_04.E_sint8.R02 sint8_05.E_sint8.R02 sint8_06.E_sint8.R02 sint8_07.E_sint8.R02 sint8_08.E_sint8.R02 /end REF_MEASUREMENT
/end GROUP
/begin GROUP E_sint8.R03 ""
 /begin REF_MEASUREMENT sint8_01.E_sint8.R03 sint8_02.E_sint8.R03 sint8_03.E_sint8.R03 sint8_04.E_sint8.R03 sint8_05.E_sint8.R03 sint8_06.E_sint8.R03 sint8_07.E_sint8.R03 sint8_08.E_sint8.R03 /end REF_MEASUREMENT
/end GROUP
/begin GROUP E_sint8.R04 ""
 /begin REF_MEASUREMENT sint8_01.E_sint8.R04 sint8_02.E_sint8.R04 sint8_03.E_sint8.R04 sint8_04.E_sint8.R04 sint8_05.E_sint8.R04 sint8_06.E_sint8.R04 sint8_07.E_sint8.R04 sint8_08.E_sint8.R04 /end REF_MEASUREMENT
/end GROUP
/begin GROUP E_sint8.R05 ""
 /begin REF_MEASUREMENT sint8_01.E_sint8.R05 sint8_02.E_sint8.R05 sint8_03.E_sint8.R05 sint8_04.E_sint8.R05 sint8_05.E_sint8.R05 sint8_06.E_sint8.R05 sint8_07.E_sint8.R05 sint8_08.E_sint8.R05 /end REF_MEASUREMENT
/end GROUP
/begin GROUP E_sint8.R06 ""
 /begin REF_MEASUREMENT sint8_01.E_sint8.R06 sint8_02.E_sint8.R06 sint8_03.E_sint8.R06 sint8_04.E_sint8.R06 sint8_05.E_sint8.R06 sint8_06.E_sint8.R06 sint8_07.E_sint8.R06 sint8_08.E_sint8.R06 /end REF_MEASUREMENT
/end GROUP
/begin GROUP E_sint8.R07 ""
 /begin REF_MEASUREMENT sint8_01.E_sint8.R07 sint8_02.E_sint8.R07 sint8_03.E_sint8.R07 sint8_04.E_sint8.R07 sint8_05.E_sint8.R07 sint8_06.E_sint8.R07 sint8_07.E_sint8.R07 sint8_08.E_sint8.R07 /end REF_MEASUREMENT
/end GROUP
/begin GROUP E_sint8.R08 ""
 /begin REF_MEASUREMENT sint8_01.E_sint8.R08 sint8_02.E_sint8.R08 sint8_03.E_sint8.R08 sint8_04.E_sint8.R08 sint8_05.E_sint8.R08 sint8_06.E_sint8.R08 sint8_07.E_sint8.R08 sint8_08.E_sint8.R08 /end REF_MEASUREMENT
/end GROUP
/begin GROUP E_sint8.R09 ""
 /begin REF_MEASUREMENT sint8_01.E_sint8.R09 sint8_02.E_sint8.R09 sint8_03.E_sint8.R09 sint8_04.E_sint8.R09 sint8_05.E_sint8.R09 sint8_06.E_sint8.R09 sint8_07.E_sint8.R09 sint8_08.E_sint8.R09 /end REF_MEASUREMENT
/end GROUP
/begin GROUP E_sint8.R10 ""
 /begin REF_MEASUREMENT sint8_01.E_sint8.R10 sint8_02.E_sint8.R10 sint8_03.E_sint8.R10 sint8_04.E_sint8.R10 sint8_05.E_sint8.R10 sint8_06.E_sint8.R10 sint8_07.E_sint8.R10 sint8_08.E_sint8.R10 /end REF_MEASUREMENT
/end GROUP
/begin GROUP E_sint8.R11 ""
 /begin REF_MEASUREMENT sint8_01.E_sint8.R11 sint8_02.E_sint8.R11 sint8_03.E_sint8.R11 sint8_04.E_sint8.R11 sint8_05.E_sint8.R11 sint8_06.E_sint8.R11 sint8_07.E_sint8.R11 sint8_08.E_sint8.R11 /end REF_MEASUREMENT
/end GROUP
/begin GROUP E_sint8.R12 ""
 /begin REF_MEASUREMENT sint8_01.E_sint8.R12 sint8_02.E_sint8.R12 sint8_03.E_sint8.R12 sint8_04.E_sint8.R12 sint8_05.E_sint8.R12 sint8_06.E_sint8.R12 sint8_07.E_sint8.R12 sint8_08.E_sint8.R12 /end REF_MEASUREMENT
/end GROUP
/begin GROUP E_sint8.R13 ""
 /begin REF_MEASUREMENT sint8_01.E_sint8.R13 sint8_02.E_sint8.R13 sint8_03.E_sint8.R13 sint8_04.E_sint8.R13 sint8_05.E_sint8.R13 sint8_06.E_sint8.R13 sint8_07.E_sint8.R13 sint8_08.E_sint8.R13 /end REF_MEASUREMENT
/end GROUP
/begin GROUP E_sint8.R14 ""
 /begin REF_MEASUREMENT sint8_01.E_sint8.R14 sint8_02.E_sint8.R14 sint8_03.E_sint8.R14 sint8_04.E_sint8.R14 sint8_05.E_sint8.R14 sint8_06.E_sint8.R14 sint8_07.E_sint8.R14 sint8_08.E_sint8.R14 /end REF_MEASUREMENT
/end GROUP
/begin GROUP E_sint8.R15 ""
 /begin REF_MEASUREMENT sint8_01.E_sint8.R15 sint8_02.E_sint8.R15 sint8_03.E_sint8.R15 sint8_04.E_sint8.R15 sint8_05.E_sint8.R15 sint8_06.E_sint8.R15 sint8_07.E_sint8.R15 sint8_08.E_sint8.R15 /end REF_MEASUREMENT
/end GROUP
/begin GROUP E_sint8.R16 ""
 /begin REF_MEASUREMENT sint8_01.E_sint8.R16 sint8_02.E_sint8.R16 sint8_03.E_sint8.R16 sint8_04.E_sint8.R16 sint8_05.E_sint8.R16 sint8_06.E_sint8.R16 sint8_07.E_sint8.R16 sint8_08.E_sint8.R16 /end REF_MEASUREMENT
/end GROUP
/begin GROUP E_sint8_1.R01_8bit ""
 /begin REF_MEASUREMENT sint8_01.E_sint8_1.R01_8bit sint8_02.E_sint8_1.R01_8bit sint8_03.E_sint8_1.R01_8bit sint8_04.E_sint8_1.R01_8bit sint8_05.E_sint8_1.R01_8bit sint8_06.E_sint8_1.R01_8bit sint8_07.E_sint8_1.R01_8bit sint8_08.E_sint8_1.R01_8bit /end REF_MEASUREMENT
/end GROUP
/begin GROUP E_sint8_2.R01_8bit ""
 /begin REF_MEASUREMENT sint8_01.E_sint8_2.R01_8bit sint8_02.E_sint8_2.R01_8bit sint8_03.E_sint8_2.R01_8bit sint8_04.E_sint8_2.R01_8bit sint8_05.E_sint8_2.R01_8bit sint8_06.E_sint8_2.R01_8bit sint8_07.E_sint8_2.R01_8bit sint8_08.E_sint8_2.R01_8bit /end REF_MEASUREMENT
/end GROUP
/begin GROUP E_sint8_3.R01_8bit ""
 /begin REF_MEASUREMENT sint8_01.E_sint8_3.R01_8bit sint8_02.E_sint8_3.R01_8bit sint8_03.E_sint8_3.R01_8bit sint8_04.E_sint8_3.R01_8bit sint8_05.E_sint8_3.R01_8bit sint8_06.E_sint8_3.R01_8bit sint8_07.E_sint8_3.R01_8bit sint8_08.E_sint8_3.R01_8bit /end REF_MEASUREMENT
/end GROUP
/begin GROUP E_sint8_4.R01_8bit ""
 /begin REF_MEASUREMENT sint8_01.E_sint8_4.R01_8bit sint8_02.E_sint8_4.R01_8bit sint8_03.E_sint8_4.R01_8bit sint8_04.E_sint8_4.R01_8bit sint8_05.E_sint8_4.R01_8bit sint8_06.E_sint8_4.R01_8bit sint8_07.E_sint8_4.R01_8bit sint8_08.E_sint8_4.R01_8bit /end REF_MEASUREMENT
/end GROUP
/begin GROUP E_sint8_5.R01_8bit ""
 /begin REF_MEASUREMENT sint8_01.E_sint8_5.R01_8bit sint8_02.E_sint8_5.R01_8bit sint8_03.E_sint8_5.R01_8bit sint8_04.E_sint8_5.R01_8bit sint8_05.E_sint8_5.R01_8bit sint8_06.E_sint8_5.R01_8bit sint8_07.E_sint8_5.R01_8bit sint8_08.E_sint8_5.R01_8bit /end REF_MEASUREMENT
/end GROUP
/begin GROUP E_sint8_6.R01_8bit ""
 /begin REF_MEASUREMENT sint8_01.E_sint8_6.R01_8bit sint8_02.E_sint8_6.R01_8bit sint8_03.E_sint8_6.R01_8bit sint8_04.E_sint8_6.R01_8bit sint8_05.E_sint8_6.R01_8bit sint8_06.E_sint8_6.R01_8bit sint8_07.E_sint8_6.R01_8bit sint8_08.E_sint8_6.R01_8bit /end REF_MEASUREMENT
/end GROUP
/begin GROUP E_sint8_7.R01_8bit ""
 /begin REF_MEASUREMENT sint8_01.E_sint8_7.R01_8bit sint8_02.E_sint8_7.R01_8bit sint8_03.E_sint8_7.R01_8bit sint8_04.E_sint8_7.R01_8bit sint8_05.E_sint8_7.R01_8bit sint8_06.E_sint8_7.R01_8bit sint8_07.E_sint8_7.R01_8bit sint8_08.E_sint8_7.R01_8bit /end REF_MEASUREMENT
/end GROUP
/begin GROUP E_sint8_8.R01_8bit ""
 /begin REF_MEASUREMENT sint8_01.E_sint8_8.R01_8bit sint8_02.E_sint8_8.R01_8bit sint8_03.E_sint8_8.R01_8bit sint8_04.E_sint8_8.R01_8bit sint8_05.E_sint8_8.R01_8bit sint8_06.E_sint8_8.R01_8bit sint8_07.E_sint8_8.R01_8bit sint8_08.E_sint8_8.R01_8bit /end REF_MEASUREMENT
/end GROUP
/begin GROUP E_uint16.R01 ""
 /begin REF_MEASUREMENT uint16_01.E_uint16.R01 uint16_02.E_uint16.R01 uint16_03.E_uint16.R01 uint16_04.E_uint16.R01 uint16_05.E_uint16.R01 uint16_06.E_uint16.R01 uint16_07.E_uint16.R01 uint16_08.E_uint16.R01 /end REF_MEASUREMENT
/end GROUP
/begin GROUP E_uint16.R02 ""
 /begin REF_MEASUREMENT uint16_01.E_uint16.R02 uint16_02.E_uint16.R02 uint16_03.E_uint16.R02 uint16_04.E_uint16.R02 uint16_05.E_uint16.R02 uint16_06.E_uint16.R02 uint16_07.E_uint16.R02 uint16_08.E_uint16.R02 /end REF_MEASUREMENT
/end GROUP
/begin GROUP E_uint16.R03 ""
 /begin REF_MEASUREMENT uint16_01.E_uint16.R03 uint16_02.E_uint16.R03 uint16_03.E_uint16.R03 uint16_04.E_uint16.R03 uint16_05.E_uint16.R03 uint16_06.E_uint16.R03 uint16_07.E_uint16.R03 uint16_08.E_uint16.R03 /end REF_MEASUREMENT
/end GROUP
/begin GROUP E_uint16.R04 ""
 /begin REF_MEASUREMENT uint16_01.E_uint16.R04 uint16_02.E_uint16.R04 uint16_03.E_uint16.R04 uint16_04.E_uint16.R04 uint16_05.E_uint16.R04 uint16_06.E_uint16.R04 uint16_07.E_uint16.R04 uint16_08.E_uint16.R04 /end REF_MEASUREMENT
/end GROUP
/begin GROUP E_uint16.R05 ""
 /begin REF_MEASUREMENT uint16_01.E_uint16.R05 uint16_02.E_uint16.R05 uint16_03.E_uint16.R05 uint16_04.E_uint16.R05 uint16_05.E_uint16.R05 uint16_06.E_uint16.R05 uint16_07.E_uint16.R05 uint16_08.E_uint16.R05 /end REF_MEASUREMENT
/end GROUP
/begin GROUP E_uint16.R06 ""
 /begin REF_MEASUREMENT uint16_01.E_uint16.R06 uint16_02.E_uint16.R06 uint16_03.E_uint16.R06 uint16_04.E_uint16.R06 uint16_05.E_uint16.R06 uint16_06.E_uint16.R06 uint16_07.E_uint16.R06 uint16_08.E_uint16.R06 /end REF_MEASUREMENT
/end GROUP
/begin GROUP E_uint16.R07 ""
 /begin REF_MEASUREMENT uint16_01.E_uint16.R07 uint16_02.E_uint16.R07 uint16_03.E_uint16.R07 uint16_04.E_uint16.R07 uint16_05.E_uint16.R07 uint16_06.E_uint16.R07 uint16_07.E_uint16.R07 uint16_08.E_uint16.R07 /end REF_MEASUREMENT
/end GROUP
/begin GROUP E_uint16.R08 ""
 /begin REF_MEASUREMENT uint16_01.E_uint16.R08 uint16_02.E_uint16.R08 uint16_03.E_uint16.R08 uint16_04.E_uint16.R08 uint16_05.E_uint16.R08 uint16_06.E_uint16.R08 uint16_07.E_uint16.R08 uint16_08.E_uint16.R08 /end REF_MEASUREMENT
/end GROUP
/begin GROUP MIN_MAX_Tick2Time.EV0_Roundtrip.XCP_SHELL ""
 /begin REF_MEASUREMENT Max.MIN_MAX_Tick2Time.EV0_Roundtrip.XCP_SHELL Min.MIN_MAX_Tick2Time.EV0_Roundtrip.XCP_SHELL Time.MIN_MAX_Tick2Time.EV0_Roundtrip.XCP_SHELL /end REF_MEASUREMENT
/end GROUP
/begin GROUP MIN_MAX_Tick2Time.EV0_Sample.XCP_SHELL ""
 /begin REF_MEASUREMENT Max.MIN_MAX_Tick2Time.EV0_Sample.XCP_SHELL Min.MIN_MAX_Tick2Time.EV0_Sample.XCP_SHELL Time.MIN_MAX_Tick2Time.EV0_Sample.XCP_SHELL /end REF_MEASUREMENT
/end GROUP
/begin GROUP MIN_MAX_Tick2Time.EV0_Stim.XCP_SHELL ""
 /begin REF_MEASUREMENT Max.MIN_MAX_Tick2Time.EV0_Stim.XCP_SHELL Min.MIN_MAX_Tick2Time.EV0_Stim.XCP_SHELL Time.MIN_MAX_Tick2Time.EV0_Stim.XCP_SHELL /end REF_MEASUREMENT
/end GROUP
/begin GROUP R01 "" ROOT
 /begin REF_MEASUREMENT sint16_01.E_sint16.R01 sint16_02.E_sint16.R01 sint16_03.E_sint16.R01 sint16_04.E_sint16.R01 sint16_05.E_sint16.R01 sint16_06.E_sint16.R01 sint16_07.E_sint16.R01 sint16_08.E_sint16.R01 sint8_01.E_sint8.R01 sint8_02.E_sint8.R01 sint8_03.E_sint8.R01 sint8_04.E_sint8.R01 sint8_05.E_sint8.R01 sint8_06.E_sint8.R01 sint8_07.E_sint8.R01 sint8_08.E_sint8.R01 uint16_01.E_uint16.R01 uint16_02.E_uint16.R01 uint16_03.E_uint16.R01 uint16_04.E_uint16.R01 uint16_05.E_uint16.R01 uint16_06.E_uint16.R01 uint16_07.E_uint16.R01 uint16_08.E_uint16.R01 /end REF_MEASUREMENT
/end GROUP
/begin GROUP R01_16bit "" ROOT
 /begin REF_MEASUREMENT sint16_01.E_sint16_1.R01_16bit sint16_01.E_sint16_2.R01_16bit sint16_01.E_sint16_3.R01_16bit sint16_01.E_sint16_4.R01_16bit sint16_02.E_sint16_1.R01_16bit sint16_02.E_sint16_2.R01_16bit sint16_02.E_sint16_3.R01_16bit sint16_02.E_sint16_4.R01_16bit sint16_03.E_sint16_1.R01_16bit sint16_03.E_sint16_2.R01_16bit sint16_03.E_sint16_3.R01_16bit sint16_03.E_sint16_4.R01_16bit sint16_04.E_sint16_1.R01_16bit sint16_04.E_sint16_2.R01_16bit sint16_04.E_sint16_3.R01_16bit sint16_04.E_sint16_4.R01_16bit sint16_05.E_sint16_1.R01_16bit sint16_05.E_sint16_2.R01_16bit sint16_05.E_sint16_3.R01_16bit sint16_05.E_sint16_4.R01_16bit sint16_06.E_sint16_1.R01_16bit sint16_06.E_sint16_2.R01_16bit sint16_06.E_sint16_3.R01_16bit sint16_06.E_sint16_4.R01_16bit sint16_07.E_sint16_1.R01_16bit sint16_07.E_sint16_2.R01_16bit sint16_07.E_sint16_3.R01_16bit sint16_07.E_sint16_4.R01_16bit sint16_08.E_sint16_1.R01_16bit sint16_08.E_sint16_2.R01_16bit sint16_08.E_sint16_3.R01_16bit sint16_08.E_sint16_4.R01_16bit /end REF_MEASUREMENT
/end GROUP
/begin GROUP R01_8bit "" ROOT
 /begin REF_MEASUREMENT sint8_01.E_sint8_1.R01_8bit sint8_01.E_sint8_2.R01_8bit sint8_01.E_sint8_3.R01_8bit sint8_01.E_sint8_4.R01_8bit sint8_01.E_sint8_5.R01_8bit sint8_01.E_sint8_6.R01_8bit sint8_01.E_sint8_7.R01_8bit sint8_01.E_sint8_8.R01_8bit sint8_02.E_sint8_1.R01_8bit sint8_02.E_sint8_2.R01_8bit sint8_02.E_sint8_3.R01_8bit sint8_02.E_sint8_4.R01_8bit sint8_02.E_sint8_5.R01_8bit sint8_02.E_sint8_6.R01_8bit sint8_02.E_sint8_7.R01_8bit sint8_02.E_sint8_8.R01_8bit sint8_03.E_sint8_1.R01_8bit sint8_03.E_sint8_2.R01_8bit sint8_03.E_sint8_3.R01_8bit sint8_03.E_sint8_4.R01_8bit sint8_03.E_sint8_5.R01_8bit sint8_03.E_sint8_6.R01_8bit sint8_03.E_sint8_7.R01_8bit sint8_03.E_sint8_8.R01_8bit sint8_04.E_sint8_1.R01_8bit sint8_04.E_sint8_2.R01_8bit sint8_04.E_sint8_3.R01_8bit sint8_04.E_sint8_4.R01_8bit sint8_04.E_sint8_5.R01_8bit sint8_04.E_sint8_6.R01_8bit sint8_04.E_sint8_7.R01_8bit sint8_04.E_sint8_8.R01_8bit sint8_05.E_sint8_1.R01_8bit sint8_05.E_sint8_2.R01_8bit sint8_05.E_sint8_3.R01_8bit sint8_05.E_sint8_4.R01_8bit sint8_05.E_sint8_5.R01_8bit sint8_05.E_sint8_6.R01_8bit sint8_05.E_sint8_7.R01_8bit sint8_05.E_sint8_8.R01_8bit sint8_06.E_sint8_1.R01_8bit sint8_06.E_sint8_2.R01_8bit sint8_06.E_sint8_3.R01_8bit sint8_06.E_sint8_4.R01_8bit sint8_06.E_sint8_5.R01_8bit sint8_06.E_sint8_6.R01_8bit sint8_06.E_sint8_7.R01_8bit sint8_06.E_sint8_8.R01_8bit sint8_07.E_sint8_1.R01_8bit sint8_07.E_sint8_2.R01_8bit sint8_07.E_sint8_3.R01_8bit sint8_07.E_sint8_4.R01_8bit sint8_07.E_sint8_5.R01_8bit sint8_07.E_sint8_6.R01_8bit sint8_07.E_sint8_7.R01_8bit sint8_07.E_sint8_8.R01_8bit sint8_08.E_sint8_1.R01_8bit sint8_08.E_sint8_2.R01_8bit sint8_08.E_sint8_3.R01_8bit sint8_08.E_sint8_4.R01_8bit sint8_08.E_sint8_5.R01_8bit sint8_08.E_sint8_6.R01_8bit sint8_08.E_sint8_7.R01_8bit sint8_08.E_sint8_8.R01_8bit /end REF_MEASUREMENT
/end GROUP
/begin GROUP R01_B "" ROOT
 /begin REF_MEASUREMENT fl32_01.E_fl32.R01_B fl32_02.E_fl32.R01_B fl32_03.E_fl32.R01_B fl32_04.E_fl32.R01_B fl32_05.E_fl32.R01_B fl32_06.E_fl32.R01_B fl32_07.E_fl32.R01_B fl32_08.E_fl32.R01_B fl64_01.E_fl64.R01_B fl64_02.E_fl64.R01_B fl64_03.E_fl64.R01_B fl64_04.E_fl64.R01_B fl64_05.E_fl64.R01_B fl64_06.E_fl64.R01_B fl64_07.E_fl64.R01_B fl64_08.E_fl64.R01_B sint32_01.E_sint32.R01_B sint32_02.E_sint32.R01_B sint32_03.E_sint32.R01_B sint32_04.E_sint32.R01_B sint32_05.E_sint32.R01_B sint32_06.E_sint32.R01_B sint32_07.E_sint32.R01_B sint32_08.E_sint32.R01_B /end REF_MEASUREMENT
/end GROUP
/begin GROUP R02 "" ROOT
 /begin REF_MEASUREMENT sint16_01.E_sint16.R02 sint16_02.E_sint16.R02 sint16_03.E_sint16.R02 sint16_04.E_sint16.R02 sint16_05.E_sint16.R02 sint16_06.E_sint16.R02 sint16_07.E_sint16.R02 sint16_08.E_sint16.R02 sint8_01.E_sint8.R02 sint8_02.E_sint8.R02 sint8_03.E_sint8.R02 sint8_04.E_sint8.R02 sint8_05.E_sint8.R02 sint8_06.E_sint8.R02 sint8_07.E_sint8.R02 sint8_08.E_sint8.R02 uint16_01.E_uint16.R02 uint16_02.E_uint16.R02 uint16_03.E_uint16.R02 uint16_04.E_uint16.R02 uint16_05.E_uint16.R02 uint16_06.E_uint16.R02 uint16_07.E_uint16.R02 uint16_08.E_uint16.R02 /end REF_MEASUREMENT
/end GROUP
/begin GROUP R02_B "" ROOT
 /begin REF_MEASUREMENT fl32_01.E_fl32.R02_B fl32_02.E_fl32.R02_B fl32_03.E_fl32.R02_B fl32_04.E_fl32.R02_B fl32_05.E_fl32.R02_B fl32_06.E_fl32.R02_B fl32_07.E_fl32.R02_B fl32_08.E_fl32.R02_B fl64_01.E_fl64.R02_B fl64_02.E_fl64.R02_B fl64_03.E_fl64.R02_B fl64_04.E_fl64.R02_B fl64_05.E_fl64.R02_B fl64_06.E_fl64.R02_B fl64_07.E_fl64.R02_B fl64_08.E_fl64.R02_B sint32_01.E_sint32.R02_B sint32_02.E_sint32.R02_B sint32_03.E_sint32.R02_B sint32_04.E_sint32.R02_B sint32_05.E_sint32.R02_B sint32_06.E_sint32.R02_B sint32_07.E_sint32.R02_B sint32_08.E_sint32.R02_B /end REF_MEASUREMENT
/end GROUP
/begin GROUP R03 "" ROOT
 /begin REF_MEASUREMENT sint16_01.E_sint16.R03 sint16_02.E_sint16.R03 sint16_03.E_sint16.R03 sint16_04.E_sint16.R03 sint16_05.E_sint16.R03 sint16_06.E_sint16.R03 sint16_07.E_sint16.R03 sint16_08.E_sint16.R03 sint8_01.E_sint8.R03 sint8_02.E_sint8.R03 sint8_03.E_sint8.R03 sint8_04.E_sint8.R03 sint8_05.E_sint8.R03 sint8_06.E_sint8.R03 sint8_07.E_sint8.R03 sint8_08.E_sint8.R03 uint16_01.E_uint16.R03 uint16_02.E_uint16.R03 uint16_03.E_uint16.R03 uint16_04.E_uint16.R03 uint16_05.E_uint16.R03 uint16_06.E_uint16.R03 uint16_07.E_uint16.R03 uint16_08.E_uint16.R03 /end REF_MEASUREMENT
/end GROUP
/begin GROUP R03_B "" ROOT
 /begin REF_MEASUREMENT fl32_01.E_fl32.R03_B fl32_02.E_fl32.R03_B fl32_03.E_fl32.R03_B fl32_04.E_fl32.R03_B fl32_05.E_fl32.R03_B fl32_06.E_fl32.R03_B fl32_07.E_fl32.R03_B fl32_08.E_fl32.R03_B fl64_01.E_fl64.R03_B fl64_02.E_fl64.R03_B fl64_03.E_fl64.R03_B fl64_04.E_fl64.R03_B fl64_05.E_fl64.R03_B fl64_06.E_fl64.R03_B fl64_07.E_fl64.R03_B fl64_08.E_fl64.R03_B sint32_01.E_sint32.R03_B sint32_02.E_sint32.R03_B sint32_03.E_sint32.R03_B sint32_04.E_sint32.R03_B sint32_05.E_sint32.R03_B sint32_06.E_sint32.R03_B sint32_07.E_sint32.R03_B sint32_08.E_sint32.R03_B /end REF_MEASUREMENT
/end GROUP
/begin GROUP R04 "" ROOT
 /begin REF_MEASUREMENT sint16_01.E_sint16.R04 sint16_02.E_sint16.R04 sint16_03.E_sint16.R04 sint16_04.E_sint16.R04 sint16_05.E_sint16.R04 sint16_06.E_sint16.R04 sint16_07.E_sint16.R04 sint16_08.E_sint16.R04 sint8_01.E_sint8.R04 sint8_02.E_sint8.R04 sint8_03.E_sint8.R04 sint8_04.E_sint8.R04 sint8_05.E_sint8.R04 sint8_06.E_sint8.R04 sint8_07.E_sint8.R04 sint8_08.E_sint8.R04 uint16_01.E_uint16.R04 uint16_02.E_uint16.R04 uint16_03.E_uint16.R04 uint16_04.E_uint16.R04 uint16_05.E_uint16.R04 uint16_06.E_uint16.R04 uint16_07.E_uint16.R04 uint16_08.E_uint16.R04 /end REF_MEASUREMENT
/end GROUP
/begin GROUP R04_B "" ROOT
 /begin REF_MEASUREMENT fl32_01.E_fl32.R04_B fl32_02.E_fl32.R04_B fl32_03.E_fl32.R04_B fl32_04.E_fl32.R04_B fl32_05.E_fl32.R04_B fl32_06.E_fl32.R04_B fl32_07.E_fl32.R04_B fl32_08.E_fl32.R04_B fl64_01.E_fl64.R04_B fl64_02.E_fl64.R04_B fl64_03.E_fl64.R04_B fl64_04.E_fl64.R04_B fl64_05.E_fl64.R04_B fl64_06.E_fl64.R04_B fl64_07.E_fl64.R04_B fl64_08.E_fl64.R04_B sint32_01.E_sint32.R04_B sint32_02.E_sint32.R04_B sint32_03.E_sint32.R04_B sint32_04.E_sint32.R04_B sint32_05.E_sint32.R04_B sint32_06.E_sint32.R04_B sint32_07.E_sint32.R04_B sint32_08.E_sint32.R04_B /end REF_MEASUREMENT
/end GROUP
/begin GROUP R05 "" ROOT
 /begin REF_MEASUREMENT sint16_01.E_sint16.R05 sint16_02.E_sint16.R05 sint16_03.E_sint16.R05 sint16_04.E_sint16.R05 sint16_05.E_sint16.R05 sint16_06.E_sint16.R05 sint16_07.E_sint16.R05 sint16_08.E_sint16.R05 sint8_01.E_sint8.R05 sint8_02.E_sint8.R05 sint8_03.E_sint8.R05 sint8_04.E_sint8.R05 sint8_05.E_sint8.R05 sint8_06.E_sint8.R05 sint8_07.E_sint8.R05 sint8_08.E_sint8.R05 uint16_01.E_uint16.R05 uint16_02.E_uint16.R05 uint16_03.E_uint16.R05 uint16_04.E_uint16.R05 uint16_05.E_uint16.R05 uint16_06.E_uint16.R05 uint16_07.E_uint16.R05 uint16_08.E_uint16.R05 /end REF_MEASUREMENT
/end GROUP
/begin GROUP R06 "" ROOT
 /begin REF_MEASUREMENT sint16_01.E_sint16.R06 sint16_02.E_sint16.R06 sint16_03.E_sint16.R06 sint16_04.E_sint16.R06 sint16_05.E_sint16.R06 sint16_06.E_sint16.R06 sint16_07.E_sint16.R06 sint16_08.E_sint16.R06 sint8_01.E_sint8.R06 sint8_02.E_sint8.R06 sint8_03.E_sint8.R06 sint8_04.E_sint8.R06 sint8_05.E_sint8.R06 sint8_06.E_sint8.R06 sint8_07.E_sint8.R06 sint8_08.E_sint8.R06 uint16_01.E_uint16.R06 uint16_02.E_uint16.R06 uint16_03.E_uint16.R06 uint16_04.E_uint16.R06 uint16_05.E_uint16.R06 uint16_06.E_uint16.R06 uint16_07.E_uint16.R06 uint16_08.E_uint16.R06 /end REF_MEASUREMENT
/end GROUP
/begin GROUP R07 "" ROOT
 /begin REF_MEASUREMENT sint16_01.E_sint16.R07 sint16_02.E_sint16.R07 sint16_03.E_sint16.R07 sint16_04.E_sint16.R07 sint16_05.E_sint16.R07 sint16_06.E_sint16.R07 sint16_07.E_sint16.R07 sint16_08.E_sint16.R07 sint8_01.E_sint8.R07 sint8_02.E_sint8.R07 sint8_03.E_sint8.R07 sint8_04.E_sint8.R07 sint8_05.E_sint8.R07 sint8_06.E_sint8.R07 sint8_07.E_sint8.R07 sint8_08.E_sint8.R07 uint16_01.E_uint16.R07 uint16_02.E_uint16.R07 uint16_03.E_uint16.R07 uint16_04.E_uint16.R07 uint16_05.E_uint16.R07 uint16_06.E_uint16.R07 uint16_07.E_uint16.R07 uint16_08.E_uint16.R07 /end REF_MEASUREMENT
/end GROUP
/begin GROUP R08 "" ROOT
 /begin REF_MEASUREMENT sint16_01.E_sint16.R08 sint16_02.E_sint16.R08 sint16_03.E_sint16.R08 sint16_04.E_sint16.R08 sint16_05.E_sint16.R08 sint16_06.E_sint16.R08 sint16_07.E_sint16.R08 sint16_08.E_sint16.R08 sint8_01.E_sint8.R08 sint8_02.E_sint8.R08 sint8_03.E_sint8.R08 sint8_04.E_sint8.R08 sint8_05.E_sint8.R08 sint8_06.E_sint8.R08 sint8_07.E_sint8.R08 sint8_08.E_sint8.R08 uint16_01.E_uint16.R08 uint16_02.E_uint16.R08 uint16_03.E_uint16.R08 uint16_04.E_uint16.R08 uint16_05.E_uint16.R08 uint16_06.E_uint16.R08 uint16_07.E_uint16.R08 uint16_08.E_uint16.R08 /end REF_MEASUREMENT
/end GROUP
/begin GROUP R09 "" ROOT
 /begin REF_MEASUREMENT sint16_01.E_sint16.R09 sint16_02.E_sint16.R09 sint16_03.E_sint16.R09 sint16_04.E_sint16.R09 sint16_05.E_sint16.R09 sint16_06.E_sint16.R09 sint16_07.E_sint16.R09 sint16_08.E_sint16.R09 sint8_01.E_sint8.R09 sint8_02.E_sint8.R09 sint8_03.E_sint8.R09 sint8_04.E_sint8.R09 sint8_05.E_sint8.R09 sint8_06.E_sint8.R09 sint8_07.E_sint8.R09 sint8_08.E_sint8.R09 /end REF_MEASUREMENT
/end GROUP
/begin GROUP R10 "" ROOT
 /begin REF_MEASUREMENT sint16_01.E_sint16.R10 sint16_02.E_sint16.R10 sint16_03.E_sint16.R10 sint16_04.E_sint16.R10 sint16_05.E_sint16.R10 sint16_06.E_sint16.R10 sint16_07.E_sint16.R10 sint16_08.E_sint16.R10 sint8_01.E_sint8.R10 sint8_02.E_sint8.R10 sint8_03.E_sint8.R10 sint8_04.E_sint8.R10 sint8_05.E_sint8.R10 sint8_06.E_sint8.R10 sint8_07.E_sint8.R10 sint8_08.E_sint8.R10 /end REF_MEASUREMENT
/end GROUP
/begin GROUP R11 "" ROOT
 /begin REF_MEASUREMENT sint16_01.E_sint16.R11 sint16_02.E_sint16.R11 sint16_03.E_sint16.R11 sint16_04.E_sint16.R11 sint16_05.E_sint16.R11 sint16_06.E_sint16.R11 sint16_07.E_sint16.R11 sint16_08.E_sint16.R11 sint8_01.E_sint8.R11 sint8_02.E_sint8.R11 sint8_03.E_sint8.R11 sint8_04.E_sint8.R11 sint8_05.E_sint8.R11 sint8_06.E_sint8.R11 sint8_07.E_sint8.R11 sint8_08.E_sint8.R11 /end REF_MEASUREMENT
/end GROUP
/begin GROUP R12 "" ROOT
 /begin REF_MEASUREMENT sint16_01.E_sint16.R12 sint16_02.E_sint16.R12 sint16_03.E_sint16.R12 sint16_04.E_sint16.R12 sint16_05.E_sint16.R12 sint16_06.E_sint16.R12 sint16_07.E_sint16.R12 sint16_08.E_sint16.R12 sint8_01.E_sint8.R12 sint8_02.E_sint8.R12 sint8_03.E_sint8.R12 sint8_04.E_sint8.R12 sint8_05.E_sint8.R12 sint8_06.E_sint8.R12 sint8_07.E_sint8.R12 sint8_08.E_sint8.R12 /end REF_MEASUREMENT
/end GROUP
/begin GROUP R13 "" ROOT
 /begin REF_MEASUREMENT sint16_01.E_sint16.R13 sint16_02.E_sint16.R13 sint16_03.E_sint16.R13 sint16_04.E_sint16.R13 sint16_05.E_sint16.R13 sint16_06.E_sint16.R13 sint16_07.E_sint16.R13 sint16_08.E_sint16.R13 sint8_01.E_sint8.R13 sint8_02.E_sint8.R13 sint8_03.E_sint8.R13 sint8_04.E_sint8.R13 sint8_05.E_sint8.R13 sint8_06.E_sint8.R13 sint8_07.E_sint8.R13 sint8_08.E_sint8.R13 /end REF_MEASUREMENT
/end GROUP
/begin GROUP R14 "" ROOT
 /begin REF_MEASUREMENT sint16_01.E_sint16.R14 sint16_02.E_sint16.R14 sint16_03.E_sint16.R14 sint16_04.E_sint16.R14 sint16_05.E_sint16.R14 sint16_06.E_sint16.R14 sint16_07.E_sint16.R14 sint16_08.E_sint16.R14 sint8_01.E_sint8.R14 sint8_02.E_sint8.R14 sint8_03.E_sint8.R14 sint8_04.E_sint8.R14 sint8_05.E_sint8.R14 sint8_06.E_sint8.R14 sint8_07.E_sint8.R14 sint8_08.E_sint8.R14 /end REF_MEASUREMENT
/end GROUP
/begin GROUP R15 "" ROOT
 /begin REF_MEASUREMENT sint16_01.E_sint16.R15 sint16_02.E_sint16.R15 sint16_03.E_sint16.R15 sint16_04.E_sint16.R15 sint16_05.E_sint16.R15 sint16_06.E_sint16.R15 sint16_07.E_sint16.R15 sint16_08.E_sint16.R15 sint8_01.E_sint8.R15 sint8_02.E_sint8.R15 sint8_03.E_sint8.R15 sint8_04.E_sint8.R15 sint8_05.E_sint8.R15 sint8_06.E_sint8.R15 sint8_07.E_sint8.R15 sint8_08.E_sint8.R15 /end REF_MEASUREMENT
/end GROUP
/begin GROUP R16 "" ROOT
 /begin REF_MEASUREMENT sint8_01.E_sint8.R16 sint8_02.E_sint8.R16 sint8_03.E_sint8.R16 sint8_04.E_sint8.R16 sint8_05.E_sint8.R16 sint8_06.E_sint8.R16 sint8_07.E_sint8.R16 sint8_08.E_sint8.R16 /end REF_MEASUREMENT
/end GROUP
/begin GROUP Roundtrip.Dist_B01.Distab13_12T ""
 /begin REF_MEASUREMENT Max.Roundtrip.Dist_B01.Distab13_12T Min.Roundtrip.Dist_B01.Distab13_12T Time.Roundtrip.Dist_B01.Distab13_12T /end REF_MEASUREMENT
/end GROUP
/begin GROUP Roundtrip.Dist_B02.Distab13_12T ""
 /begin REF_MEASUREMENT Max.Roundtrip.Dist_B02.Distab13_12T Min.Roundtrip.Dist_B02.Distab13_12T Time.Roundtrip.Dist_B02.Distab13_12T /end REF_MEASUREMENT
/end GROUP
/begin GROUP Roundtrip.Dist_B03.Distab13_12T ""
 /begin REF_MEASUREMENT Max.Roundtrip.Dist_B03.Distab13_12T Min.Roundtrip.Dist_B03.Distab13_12T Time.Roundtrip.Dist_B03.Distab13_12T /end REF_MEASUREMENT
/end GROUP
/begin GROUP Roundtrip.Dist_B04.Distab13_12T ""
 /begin REF_MEASUREMENT Max.Roundtrip.Dist_B04.Distab13_12T Min.Roundtrip.Dist_B04.Distab13_12T Time.Roundtrip.Dist_B04.Distab13_12T /end REF_MEASUREMENT
/end GROUP
/begin GROUP Time.EV0_Rx.XCP_SHELL ""
 /begin REF_MEASUREMENT Max.Time.EV0_Rx.XCP_SHELL Min.Time.EV0_Rx.XCP_SHELL Time.Time.EV0_Rx.XCP_SHELL /end REF_MEASUREMENT
/end GROUP
/begin GROUP Time.EV0_Tx.XCP_SHELL ""
 /begin REF_MEASUREMENT Max.Time.EV0_Tx.XCP_SHELL Min.Time.EV0_Tx.XCP_SHELL Time.Time.EV0_Tx.XCP_SHELL /end REF_MEASUREMENT
/end GROUP
/begin GROUP TimeSum.EV0_Rx.XCP_SHELL ""
 /begin REF_MEASUREMENT Max.TimeSum.EV0_Rx.XCP_SHELL Min.TimeSum.EV0_Rx.XCP_SHELL Time.TimeSum.EV0_Rx.XCP_SHELL /end REF_MEASUREMENT
/end GROUP
/begin GROUP TimeSum.EV0_Tx.XCP_SHELL ""
 /begin REF_MEASUREMENT Max.TimeSum.EV0_Tx.XCP_SHELL Min.TimeSum.EV0_Tx.XCP_SHELL Time.TimeSum.EV0_Tx.XCP_SHELL /end REF_MEASUREMENT
/end GROUP
/begin GROUP Time_Calc.Curve_Module ""
 /begin REF_MEASUREMENT Result.Time_Calc.Curve_Module TimeStampOne.Time_Calc.Curve_Module TimeStampTwo.Time_Calc.Curve_Module is_started.Time_Calc.Curve_Module /end REF_MEASUREMENT
/end GROUP
/begin GROUP XCP_SHELL "" ROOT
 /begin REF_MEASUREMENT Max.MIN_MAX_Tick2Time.EV0_Roundtrip.XCP_SHELL Max.MIN_MAX_Tick2Time.EV0_Sample.XCP_SHELL Max.MIN_MAX_Tick2Time.EV0_Stim.XCP_SHELL Max.Time.EV0_Rx.XCP_SHELL Max.Time.EV0_Tx.XCP_SHELL Max.TimeSum.EV0_Rx.XCP_SHELL Max.TimeSum.EV0_Tx.XCP_SHELL Min.MIN_MAX_Tick2Time.EV0_Roundtrip.XCP_SHELL Min.MIN_MAX_Tick2Time.EV0_Sample.XCP_SHELL Min.MIN_MAX_Tick2Time.EV0_Stim.XCP_SHELL Min.Time.EV0_Rx.XCP_SHELL Min.Time.EV0_Tx.XCP_SHELL Min.TimeSum.EV0_Rx.XCP_SHELL Min.TimeSum.EV0_Tx.XCP_SHELL Time.MIN_MAX_Tick2Time.EV0_Roundtrip.XCP_SHELL Time.MIN_MAX_Tick2Time.EV0_Sample.XCP_SHELL Time.MIN_MAX_Tick2Time.EV0_Stim.XCP_SHELL Time.Time.EV0_Rx.XCP_SHELL Time.Time.EV0_Tx.XCP_SHELL Time.TimeSum.EV0_Rx.XCP_SHELL Time.TimeSum.EV0_Tx.XCP_SHELL l_ResetTimer_b.EV0_Roundtrip.XCP_SHELL l_ResetTimer_b.EV0_Rx.XCP_SHELL l_ResetTimer_b.EV0_Sample.XCP_SHELL l_ResetTimer_b.EV0_Stim.XCP_SHELL l_ResetTimer_b.EV0_Tx.XCP_SHELL l_StartTicks_u32.EV0_Roundtrip.XCP_SHELL l_StartTicks_u32.EV0_Rx.XCP_SHELL l_StartTicks_u32.EV0_Sample.XCP_SHELL l_StartTicks_u32.EV0_Stim.XCP_SHELL l_StartTicks_u32.EV0_Tx.XCP_SHELL l_StopTicks_u32.EV0_Roundtrip.XCP_SHELL l_StopTicks_u32.EV0_Rx.XCP_SHELL l_StopTicks_u32.EV0_Sample.XCP_SHELL l_StopTicks_u32.EV0_Stim.XCP_SHELL l_StopTicks_u32.EV0_Tx.XCP_SHELL l_TimeSum_u32.EV0_Rx.XCP_SHELL l_TimeSum_u32.EV0_Tx.XCP_SHELL l_Timeout_b.EV0_Roundtrip.XCP_SHELL l_Timeout_b.EV0_Rx.XCP_SHELL l_Timeout_b.EV0_Sample.XCP_SHELL l_Timeout_b.EV0_Stim.XCP_SHELL l_Timeout_b.EV0_Tx.XCP_SHELL /end REF_MEASUREMENT
 /begin REF_CHARACTERISTIC p_ResetTimer_b.EV0_Roundtrip.XCP_SHELL p_ResetTimer_b.EV0_Rx.XCP_SHELL p_ResetTimer_b.EV0_Sample.XCP_SHELL p_ResetTimer_b.EV0_Stim.XCP_SHELL p_ResetTimer_b.EV0_Tx.XCP_SHELL /end REF_CHARACTERISTIC
/end GROUP
/begin RECORD_LAYOUT STANDARD_CURVE_R32R32 FNC_VALUES 3 FLOAT32_IEEE COLUMN_DIR DIRECT AXIS_PTS_X 2 FLOAT32_IEEE INDEX_INCR DIRECT NO_AXIS_PTS_X 1 UWORD /end RECORD_LAYOUT
/begin RECORD_LAYOUT STANDARD_CURVE_R64R64 FNC_VALUES 3 FLOAT64_IEEE COLUMN_DIR DIRECT AXIS_PTS_X 2 FLOAT64_IEEE INDEX_INCR DIRECT NO_AXIS_PTS_X 1 UWORD /end RECORD_LAYOUT
/begin RECORD_LAYOUT STANDARD_CURVE_U32U16 FNC_VALUES 3 UWORD COLUMN_DIR DIRECT AXIS_PTS_X 2 ULONG INDEX_INCR DIRECT NO_AXIS_PTS_X 1 UWORD /end RECORD_LAYOUT
/begin RECORD_LAYOUT STANDARD_DIST_R64 AXIS_PTS_X 2 FLOAT64_IEEE INDEX_INCR DIRECT NO_AXIS_PTS_X 1 UWORD /end RECORD_LAYOUT
/begin RECORD_LAYOUT STANDARD_GROUP_R64 FNC_VALUES 1 FLOAT64_IEEE COLUMN_DIR DIRECT /end RECORD_LAYOUT
/begin RECORD_LAYOUT STANDARD_VALUE_R64 FNC_VALUES 1 FLOAT64_IEEE COLUMN_DIR DIRECT /end RECORD_LAYOUT
/begin RECORD_LAYOUT STANDARD_VALUE_S8 FNC_VALUES 1 SBYTE COLUMN_DIR DIRECT /end RECORD_LAYOUT
/begin RECORD_LAYOUT STANDARD_VALUE_U16 FNC_VALUES 1 UWORD COLUMN_DIR DIRECT /end RECORD_LAYOUT
/begin RECORD_LAYOUT STANDARD_VALUE_U32 FNC_VALUES 1 ULONG COLUMN_DIR DIRECT /end RECORD_LAYOUT
/begin RECORD_LAYOUT STANDARD_VALUE_U8 FNC_VALUES 1 UBYTE COLUMN_DIR DIRECT /end RECORD_LAYOUT
/end MODULE
/end PROJECT

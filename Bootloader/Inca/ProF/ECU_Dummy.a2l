ASAP2_VERSION 1 40
/begin PROJECT ECU_Base_Prj_CAN3Mon_UdsFlashing "Generated by ETAS from Project ECU_Base_Prj_CAN3Mon_UdsFlashing"
/begin HEADER "" VERSION "000" PROJECT_NO ASD /end HEADER
/begin MODULE ECU_Base_Prj_CAN3Mon_UdsFlashing "Generated by ETAS from Project ECU_Base_Prj_CAN3Mon_UdsFlashing"
/* AML Section included by script insert_a2mls.pl */
/* END: AML Section included by script insert_a2mls.pl */
/begin MOD_PAR "" /* /begin C:/ETAS/ASCET513/target/mpc555/Add_ToolChain/ASAP_Templates\mem_lay_me9u_serial_protocols.a2l inserted by post asap script INSERT_MEM_LAY.pl */ /* *
* Change description: *
* 07.03 BPS-Stu Additional Code sections added (extFlash2, extFlash3, cbb, cmfFlash) *
* 02.02 ETAS-PU new memory Areas for C-Sample - green oak. *
* In the Data Section The last 4 Words are reserved. *
* Reason: INCA calculates the checksum *
* of the Data Eprom Areas. Omit the Signature area for checksum. *
* ??.02.2005 ETAS-ZJ : Add XCP part and moved file to MEM_LAY_pl.a2l *
* for post ASAP script processing *
* 29.03.2007 ETAS-Mle : change ADDR_MAPPING --> ADDRESS_MAPPING *
* 30.10.2007 ETAS-Mle : VARIABLES RAM INTERN 0x800000 0x20000 for MEMORY_SEGMENT Ram800000 *
* as MEMORY_SEGMENT ExtRam940000 allready contains VARIABLES RAM EXTERN *
* at 0x940000 for Trigger Segment Ram800000 has to be INTERN *
* ETK can only handle one MEMORY_SEGMENT with VARIABLES RAM INTERN *
* 30.10.2007 ETAS-Mle : change OFFLINE_DATA --> RESERVED for MEMORY_SEGMENT Dst942000 *
* 30.10.2007 ETAS-Mle : change OFFLINE_DATA --> RESERVED for MEMORY_SEGMENT Dst1E0000 *
* 27.11.2007 ETAS-Mle : create separate MEMORY_SEGMENT "Dst942000_ETK" & "Dst1D0000_ETK" for ETK *
* 14.01.2008 ETAS-Mle : comment MEMORY_SEGMENT "Dst942000_ETK" & "Dst1D0000_ETK" for ETK *
*/
 /begin MEMORY_SEGMENT boot0000 "" RESERVED EPROM EXTERN 0x00000 0x2000 -1 -1 -1 -1 -1 /begin IF_DATA ASAP1B_CCP ADDRESS_MAPPING 0x00000 0x00000 0x2000 /end IF_DATA /begin IF_DATA ASAP1B_KWP2000 ADDRESS_MAPPING 0x00000 0x00000 0x2000 /end IF_DATA
  /begin IF_DATA ASAP1B_DIAGNOSTIC_SERVICES ADDRESS_MAPPING 0x00000 0x00000 0x2000 /end IF_DATA
  /begin IF_DATA ETK ADDRESS_MAPPING 0x00000 0x00000 0x2000 /end IF_DATA
 /end MEMORY_SEGMENT
 /begin MEMORY_SEGMENT boot4000 "" RESERVED EPROM EXTERN 0x04000 0x2000 -1 -1 -1 -1 -1 /begin IF_DATA ASAP1B_CCP ADDRESS_MAPPING 0x04000 0x04000 0x2000 /end IF_DATA /begin IF_DATA ASAP1B_KWP2000 ADDRESS_MAPPING 0x04000 0x04000 0x2000 /end IF_DATA
  /begin IF_DATA ASAP1B_DIAGNOSTIC_SERVICES ADDRESS_MAPPING 0x04000 0x04000 0x2000 /end IF_DATA
  /begin IF_DATA ETK ADDRESS_MAPPING 0x04000 0x04000 0x2000 /end IF_DATA
 /end MEMORY_SEGMENT
 /begin MEMORY_SEGMENT boot10000 "" RESERVED EPROM EXTERN 0x10000 0x10000 -1 -1 -1 -1 -1 /begin IF_DATA ASAP1B_CCP ADDRESS_MAPPING 0x10000 0x10000 0x10000 /end IF_DATA /begin IF_DATA ASAP1B_KWP2000 ADDRESS_MAPPING 0x10000 0x10000 0x10000 /end IF_DATA
  /begin IF_DATA ASAP1B_DIAGNOSTIC_SERVICES ADDRESS_MAPPING 0x10000 0x10000 0x10000 /end IF_DATA
  /begin IF_DATA ETK ADDRESS_MAPPING 0x10000 0x10000 0x10000 /end IF_DATA
 /end MEMORY_SEGMENT
 /begin MEMORY_SEGMENT Pst20000 "" CODE EPROM EXTERN 0x20000 0x60000 -1 -1 -1 -1 -1 /begin IF_DATA ASAP1B_CCP ADDRESS_MAPPING 0x20000 0x20000 0x60000 /end IF_DATA /begin IF_DATA ASAP1B_KWP2000 ADDRESS_MAPPING 0x20000 0x20000 0x60000 /end IF_DATA
  /begin IF_DATA ASAP1B_DIAGNOSTIC_SERVICES ADDRESS_MAPPING 0x20000 0x20000 0x60000 /end IF_DATA
  /begin IF_DATA ETK ADDRESS_MAPPING 0x20000 0x20000 0x60000 /end IF_DATA
 /end MEMORY_SEGMENT
 /begin MEMORY_SEGMENT Pst80000 "" CODE EPROM EXTERN 0x80000 0x20000 -1 -1 -1 -1 -1 /begin IF_DATA ASAP1B_CCP ADDRESS_MAPPING 0x80000 0x80000 0x20000 /end IF_DATA /begin IF_DATA ASAP1B_KWP2000 ADDRESS_MAPPING 0x80000 0x80000 0x20000 /end IF_DATA
  /begin IF_DATA ASAP1B_DIAGNOSTIC_SERVICES ADDRESS_MAPPING 0x80000 0x80000 0x20000 /end IF_DATA
  /begin IF_DATA ETK ADDRESS_MAPPING 0x80000 0x80000 0x20000 /end IF_DATA
 /end MEMORY_SEGMENT
 /begin MEMORY_SEGMENT PstA0000 "" CODE EPROM EXTERN 0xA0000 0x120000 -1 -1 -1 -1 -1 /begin IF_DATA ASAP1B_CCP ADDRESS_MAPPING 0xA0000 0xA0000 0x120000 /end IF_DATA /begin IF_DATA ASAP1B_KWP2000 ADDRESS_MAPPING 0xA0000 0xA0000 0x120000 /end IF_DATA
  /begin IF_DATA ASAP1B_DIAGNOSTIC_SERVICES ADDRESS_MAPPING 0xA0000 0xA0000 0x120000 /end IF_DATA
  /begin IF_DATA ETK ADDRESS_MAPPING 0xA0000 0xA0000 0x120000 /end IF_DATA
 /end MEMORY_SEGMENT
 /begin MEMORY_SEGMENT Pst400000 "" CODE EPROM EXTERN 0x400000 0x80000 -1 -1 -1 -1 -1 /begin IF_DATA ASAP1B_CCP ADDRESS_MAPPING 0x400000 0x400000 0x80000 /end IF_DATA /begin IF_DATA ASAP1B_KWP2000 ADDRESS_MAPPING 0x400000 0x400000 0x80000 /end IF_DATA
  /begin IF_DATA ASAP1B_DIAGNOSTIC_SERVICES ADDRESS_MAPPING 0x400000 0x400000 0x80000 /end IF_DATA
  /begin IF_DATA ETK ADDRESS_MAPPING 0x400000 0x400000 0x80000 /end IF_DATA
  /begin IF_DATA XCP
   /begin SEGMENT 0x00 0x01 0x00 0x00 0x00 /begin CHECKSUM XCP_ADD_14 /end CHECKSUM
    /begin PAGE 0x00 ECU_ACCESS_WITH_XCP_ONLY XCP_READ_ACCESS_WITH_ECU_ONLY XCP_WRITE_ACCESS_NOT_ALLOWED /end PAGE
    /begin ADDRESS_MAPPING 0x400000 0x400000 0x80000 /end ADDRESS_MAPPING
   /end SEGMENT
  /end IF_DATA
 /end MEMORY_SEGMENT
 /begin MEMORY_SEGMENT Dst942000 "" RESERVED EPROM EXTERN 0x1C2000 0xE000 -1 -1 -1 -1 -1 /begin IF_DATA ASAP1B_CCP ADDRESS_MAPPING 0x1C2000 0x942000 0xE000 /end IF_DATA /begin IF_DATA ASAP1B_KWP2000 ADDRESS_MAPPING 0x1C2000 0x942000 0xE000 /end IF_DATA
  /begin IF_DATA ASAP1B_DIAGNOSTIC_SERVICES ADDRESS_MAPPING 0x1C2000 0x942000 0xE000 /end IF_DATA
 /end MEMORY_SEGMENT
 /* /begin MEMORY_SEGMENT Dst942000_ETK */ /* DATA EPROM EXTERN 0x1C2000 0xE000 -1 -1 -1 -1 -1 */ /* /begin IF_DATA ETK */ /* ADDRESS_MAPPING  /*orig_adr:* /0x1C2000  /*mapping_adr:* /0x942000  /*length:* /0xE000 */ /* /end IF_DATA */ /* /end MEMORY_SEGMENT */
 /begin MEMORY_SEGMENT Dst5D0000 "" DATA EPROM EXTERN 0x1D0000 0x10000 -1 -1 -1 -1 -1 /begin IF_DATA ASAP1B_CCP ADDRESS_MAPPING 0x1D0000 0x5D0000 0x10000 /end IF_DATA /begin IF_DATA ASAP1B_KWP2000 ADDRESS_MAPPING 0x1D0000 0x5D0000 0x10000 /end IF_DATA
  /begin IF_DATA ASAP1B_DIAGNOSTIC_SERVICES ADDRESS_MAPPING 0x1D0000 0x5D0000 0x10000 /end IF_DATA
  /begin IF_DATA XCP
   /begin SEGMENT 0x01 0x02 0x00 0x00 0x00 /begin CHECKSUM XCP_ADD_14 /end CHECKSUM
    /begin PAGE 0x00 ECU_ACCESS_WITH_XCP_ONLY XCP_READ_ACCESS_WITH_ECU_ONLY XCP_WRITE_ACCESS_NOT_ALLOWED /end PAGE
    /begin PAGE 0x01 ECU_ACCESS_WITH_XCP_ONLY XCP_READ_ACCESS_WITH_ECU_ONLY XCP_WRITE_ACCESS_WITH_ECU_ONLY /end PAGE
    /begin ADDRESS_MAPPING 0x1D0000 0x5D0000 0x10000 /end ADDRESS_MAPPING
   /end SEGMENT
  /end IF_DATA
 /end MEMORY_SEGMENT
 /begin MEMORY_SEGMENT Dst1E0000 "" RESERVED EPROM EXTERN 0x1E0000 0x20000 -1 -1 -1 -1 -1 /begin IF_DATA ASAP1B_CCP ADDRESS_MAPPING 0x1E0000 0x960000 0x20000 /end IF_DATA /begin IF_DATA ASAP1B_KWP2000 ADDRESS_MAPPING 0x1E0000 0x960000 0x20000 /end IF_DATA
  /begin IF_DATA ASAP1B_DIAGNOSTIC_SERVICES ADDRESS_MAPPING 0x1E0000 0x960000 0x20000 /end IF_DATA
 /end MEMORY_SEGMENT
 /* /begin MEMORY_SEGMENT Dst1D0000_ETK */ /* DATA EPROM EXTERN 0x1D0000 0x30000 -1 -1 -1 -1 -1 */ /* /begin IF_DATA ETK */ /* ADDRESS_MAPPING  /*orig_adr:* /0x1D0000  /*mapping_adr:* /0x950000  /*length:* /0x30000 */ /* /end IF_DATA */ /* /end MEMORY_SEGMENT */
 /begin MEMORY_SEGMENT ExtRam940000 "" VARIABLES RAM EXTERN 0x940000 0x2000 -1 -1 -1 -1 -1 /begin IF_DATA ETK ADDRESS_MAPPING 0x940000 0x940000 0x2000 /end IF_DATA /end MEMORY_SEGMENT
 /begin MEMORY_SEGMENT Ram7F8000 "" VARIABLES RAM INTERN 0x7F8000 0x8000 -1 -1 -1 -1 -1
  /begin IF_DATA XCP
   /begin SEGMENT 0x02 0x01 0x00 0x00 0x00 /begin CHECKSUM XCP_ADD_14 /end CHECKSUM
    /begin PAGE 0x00 ECU_ACCESS_WITH_XCP_ONLY XCP_READ_ACCESS_WITH_ECU_ONLY XCP_WRITE_ACCESS_WITH_ECU_ONLY /end PAGE
   /end SEGMENT
  /end IF_DATA
 /end MEMORY_SEGMENT
 /begin MEMORY_SEGMENT Ram800000 "" VARIABLES RAM INTERN 0x800000 0x20000 -1 -1 -1 -1 -1
  /begin IF_DATA XCP
   /begin SEGMENT 0x03 0x01 0x00 0x00 0x00 /begin CHECKSUM XCP_ADD_14 /end CHECKSUM
    /begin PAGE 0x00 ECU_ACCESS_WITH_XCP_ONLY XCP_READ_ACCESS_WITH_ECU_ONLY XCP_WRITE_ACCESS_WITH_ECU_ONLY /end PAGE
   /end SEGMENT
  /end IF_DATA
 /end MEMORY_SEGMENT
 /* /end C:/ETAS/ASCET513/target/mpc555/Add_ToolChain/ASAP_Templates\mem_lay_me9u_serial_protocols.a2l inserted by post asap script INSERT_MEM_LAY.pl */ /end MOD_PAR
/begin MOD_COMMON "2009-04-06 10:39:06	create by ETASHexVirtualAddressTableHeaderV2" BYTE_ORDER MSB_FIRST ALIGNMENT_BYTE 1 ALIGNMENT_WORD 2 ALIGNMENT_LONG 4 ALIGNMENT_FLOAT32_IEEE 4 ALIGNMENT_FLOAT64_IEEE 8 /end MOD_COMMON
/* /begin C:/ETAS/ASCET513/target/mpc555/Add_ToolChain/ASAP_Templates\bypass_if_data.a2l inserted by post asap script insert_bypass_if_data.pl */
/begin IF_DATA ASAP1B_Bypass
 /begin TP_BLOB 0x100 /* Bypass version */ 0x100 /* Blob version */ /end TP_BLOB
/end IF_DATA
/* /end C:/ETAS/ASCET513/target/mpc555/Add_ToolChain/ASAP_Templates\bypass_if_data.a2l inserted by post asap script insert_bypass_if_data.pl */ /* *
* Change description: *
* 2007-12-19 ETAS-Mle: Change Rate in Rate in Scaling Unit of CCP_R02 to 5 --> 50ms *
* 2002-12-05 ETAS-Pu: Change RAM_INIT_BY_TOOL to RAM_INIT_BY_ECU *
* 2002-03-15 ETAS-Pu: mofify security key names for ccp *
* 2008-06-10 ETAS-Mle: Change CAN parameter according to recomendation of Hf *
* - CALL 77855 and CALL 82090 *
* 2008-08-20 ETAS-Mle: add STORE_SUPPORTED and FLASH_BACK (freezs mode) *
*/
/begin IF_DATA ASAP1B_CCP /* spezific definition for CCP */
 /begin SOURCE "CCP_R01" 2 1
  /begin QP_BLOB /* The QP-BLOB specifies the behavior of*/ 0 LENGTH 20 CAN_ID_FIXED 0x320 RASTER 0 /end QP_BLOB
 /end SOURCE
 /begin SOURCE "CCP_R02" 2 1
  /begin QP_BLOB /* The QP-BLOB specifies the behavior of*/ 1 LENGTH 30 CAN_ID_FIXED 0x321 RASTER 1 /end QP_BLOB
 /end SOURCE
 /begin SOURCE "CCP_R03" 1 1
  /begin QP_BLOB /* The QP-BLOB specify the behavior of */ 2 LENGTH 40 CAN_ID_FIXED 0x322 RASTER 2 /end QP_BLOB
 /end SOURCE
 /begin RASTER "CCP_R01" "CCP_R01" 0 4 /* Scaling Unit: 4 = 10 msec */ 1 /* Rate in Scaling Unit: 1 --> 10ms */ /* Refresh rate = 10 msec * 1 = 10 msec */ /end RASTER
 /begin RASTER "CCP_R02" "CCP_R02" 1 4 /* Scaling Unit: 4 = 10 msec */ 5 /* Rate in Scaling Unit: 5 --> 50ms */ /* Refresh rate = 10 msec * 1 = 10 msec */ /end RASTER
 /begin RASTER "CCP_R03" "CCP_R03" 2 103 /* Scaling Unit: 103 = cylinder segment */ 1 /* Refresh rate = */ /* every cylinder combustion */ /end RASTER
 /begin SEED_KEY /* Specifies the DLL with the Seed&Key- */ /* Algorithm (optional parameter) */ "seedplus1rr1.dll" /* DLL for measure-function */ "seedplus2rr1.dll" /* DLL for calibration-function */ "seedplus3rr1.dll" /* DLL for programming-function */ /end SEED_KEY
 /begin TP_BLOB /* This BLOB describes all parameters */ /* that are necessary for CAN-timing and*/ /* ECU-calibration-technics */ 0x0201 /* CCP-Version V2.1 => 0x0201 */ 0x0202 /* BLOB-Version V2.2 => 0x0202 */ 0x4F0 /* CAN-ID INCA -> ECU, Bit 32= ext.ID */ 0x31E /* CAN-ID ECU -> INCA */ 0x1234 /* ECU CCP-Address */ 1 /* Byte-order: 1 - High-Byte-First (MOT)*/ /* 2 - Low-Byte-First(INTEL)*/ BAUDRATE 1000000 /* in Hz */ SAMPLE_POINT 80 /* in % */ SAMPLE_RATE 1 /* 1 or 3 */ BTL_CYCLES 10 SJW 3 SYNC_EDGE SINGLE /* SINGLE or DUAL */ /* RESUME_SUPPORTED */ /* necessary for Suspended Mode */ STORE_SUPPORTED /* necessary for flash ECU at power down */
  /begin CHECKSUM_PARAM 0x8001 /* Checksumalgorithm: */ /* 0x8001 - M_16_BIT_BY_ADD8 */ 0xFFFFFFFF /* max. checksum-length in ECU */ /* 0xFFFFFFFF */ CHECKSUM_CALCULATION ACTIVE_PAGE /* Checksum-calculation on activ-page */ /end CHECKSUM_PARAM
  /begin DEFINED_PAGES /* Description of the memory-page */ 1 /* Logical-page-number */ "Referencepage" /* Name of page */ 0x0000 /* Address-Extension */ /* (only low-byte sgnificant) */ 0x5D0000 /* Address of Memorypage */ 0x10000 /* Memorysize */ ROM /* Memorytype */ /end DEFINED_PAGES
  /begin DEFINED_PAGES /* Description of the memory-page */ 2 /* Logical-page-number */ "Workingpage" /* Name of page */ 0x0000 /* Address-Extension */ /* (only low-byte sgnificant) */ 0x810000 /* Address of Memorypage */ 0x10000 /* Memorysize */ RAM /* Memorytype */ RAM_INIT_BY_ECU /* Initialisationmethod */ FLASH_BACK /* necessary for Store bit */ /end DEFINED_PAGES
  /* OPTIONAL_CMD 0x05 */ /* optional CCP-command "TEST" */ /* OPTIONAL_CMD 0x08 */ /* optional CCP-command "START_STOP_ALL" */ /* OPTIONAL_CMD 0x09 */ /* optional CCP-command "GET_ACTIVE_CAL_PAGE" */ OPTIONAL_CMD 0x0C /* optional CCP-command "SET_S_STATUS" */ OPTIONAL_CMD 0x0D /* optional CCP-command "GET_S_STATUS" */ OPTIONAL_CMD 0x0E /* optional CCP-command "BUILD_CHKSUM" */ /* OPTIONAL_CMD 0x0F */ /* optional CCP-command "SHORT_UP" */ OPTIONAL_CMD 0x10 /* optional CCP-command "CLEAR_MEMORY" */ OPTIONAL_CMD 0x11 /* optional CCP-command "SEL_CAL_PAGE" */ OPTIONAL_CMD 0x12 /* optional CCP-command "GET_SEED" */ OPTIONAL_CMD 0x13 /* optional CCP-command "UNLOCK" */ OPTIONAL_CMD 0x18 /* optional CCP-command "PROGRAM" */ OPTIONAL_CMD 0x19 /* optional CCP-command "MOVE" */ /* OPTIONAL_CMD 0x20 */ /* optional CCP-command "DIAG_SERVICE" */ OPTIONAL_CMD 0x21 /* optional CCP-command "ACTIONSERVICE" */ OPTIONAL_CMD 0x22 /* optional CCP-command "PROGRAM6" */ /* OPTIONAL_CMD 0x23 */ /* optional CCP-command "DOWNLOD6" */ /end TP_BLOB
/end IF_DATA
/* *
* Change description: *
* ??.01.03 ETAS-PU : Change Baudrate and Baudrateparameters for 56 MHz Frequency *
* ??.02.02 ETAS-PU : New Baudrate selection added "DIAG_BAUD" for 10400 kBaud *
* ??.02.02 ETAS-PU : New Timing Parameters added "KWP_TIMING" for KWP on CAN (with p2max= 100) *
* 29.03.07 ETAS-Mle: Change KLINE+CAN --> CAN due to INTECRIO Warning *
* 26.07.07 ETAS-Mle: Change CAN --> KLINE_AND_CAN possible with new AML *
* 21.04.07 ETAS-Mle: Change XDL_MAX 0x500 --> 0xFA *
* 10.06.08 ETAS-Mle: Change CAN parameter according to recomendation of Hf - CALL 77855 *
* 25.08.08 ETAS-Mle: Change FLASH - TOOLFLASHBACK behaviour ( copy WP --> RP ) : *
* RequestRoutineResults 0x3 --> StartRoutine 0x1 *
* 03.04.09 ETAS-Mle: Change/Activate SECURITY_ACCESS : accMode = 1 ; calcmethod = 16 (rand) *
* delay is not testet yet *
*/
/begin IF_DATA ASAP1B_KWP2000 /* Specific definition for KWP2000 */
 /begin SEED_KEY "seed_dev.dll" /end SEED_KEY
 /begin SOURCE "KWP2000_10ms" /* Name of raster */ 4 /* Scaling Unit: 4 = 10 ms */ 6 /* Rate in Scaling Unit: 6 */ /* Refresh rate = 10 ms * 6 = 60 */
  /begin QP_BLOB /* QP-BLOB includes special info about */ /* measure sampling rate */ KLINE_AND_CAN /* availability of this raster : K-line, CAN or both*/ BLOCKMODE /* Measurement mode of ECU: Blockmode */ 0xf0 /* Block mode: local identifier */ 20 /* max. number of signals */ 50 /* max. number of bytes */ 0x711 /* CAN-Id for EUDTP frames */ 20 /* discriminator if CAN-id shared */ /end QP_BLOB
 /end SOURCE
 /begin TP_BLOB /* TP-Blob includes general information */ /* for the ASAP1b driver */ 0x0200 /* blob version */ VDA_1996 /* KWP2000 version */ MSB_FIRST /* byte order in measurements and characteristics */
  /begin K_LINE WuP /* stimulation mode of ECU: WuP / 5Baud */ 0x12 /* ECU address on k line */ 0xF1 /* required tester address */ /end K_LINE
  /begin CAN 1000000 /* Baudrate [Hz] */ 80 /* Sample point [% complete bit time] */ 1 /* 1 or 3 samples per bit */ 10 /* BTL_CYCLES [slots/bit time] */ 3 /* SJW length synchr. segm. In BTL_CYCLES */ 0 /* SYNC_EDGE */
   /begin ADDRESS 0x612 /* CAN_ID ECU (gateway)-> INCA */ 0x000 /* CAN_ID INCA -> ECU (gateway) */ TGT_INCA 0x00 /* Extended address INCA */ TGT_ECU 0x12 /* Extended / remote address ECU ^ */ /end ADDRESS
   NETWORK_LIMITS 10 /* WFT_MAX */ 0xFA /* XDL_MAX */ START_STOP 0x05 /* Start_stop FREE_RUNNING : routine number */ /end CAN
  /begin DIAG_BAUD 10400 0x86 BD_PARA 0x06 0x00 0x28 0xA0 /end DIAG_BAUD
  /begin DIAG_BAUD 125000 0x86 BD_PARA 0x06 0x01 0xE8 0x48 /end DIAG_BAUD
  /begin DIAG_BAUD 250000 0x86 BD_PARA 0x06 0x03 0xD0 0x90 /end DIAG_BAUD
  /begin TIME_DEF /*Timing parameter: p1Max p2Min p2Max p3Min p3Max p4Min [ms] */ KWP_TIMING 0x0001 0x0000 0x0064 0x0003 0x1388 0x0000 KWP_TIMING 0x0001 0x0000 0x0032 0x0003 0x1388 0x0001 KWP_TIMING 0x0001 0x0000 0x0032 0x0003 0x1388 0x0001 /* As Bs Cr [ms] */ USDTP_TIMING 0x03E8 0x03E8 0x03E8 USDTP_TIMING 0x0100 0x0100 0x0100 /end TIME_DEF
  /* 10.08.01 XC-Stu security access commented */ /*Parameter for Seed&Key: accMode calcmethod delay */ SECURITY_ACCESS 1 16 0
  /begin COPY RAM_InitByECU /* ECU mode for copying Flash into RAM */ 0x81 /* diagnostic mode for copying Flash into RAM */ COPY_PARA 3 /* list of add. parameters for StartDiag */ /end COPY
  /begin FLASH TOOLFLASHBACK /* ECU mode for copying RAM into Flash */ 3 /* No of local routine for copy RAM into Flash */ StartRoutine /* result of copy routine delivered by */ COPY_FRAME 1 /* list of page frames to be copied */ RNC_RESULT 0x23 0xfb 0xfc /* only at 'RequestRoutineResults': */ /* result codes, that sign 'copy in progress' */ /end FLASH
  /begin CHECKSUM 0x010201 /* check sum type qualifier (see table) */ 1 /* 1: check sum calculation only on active page */ 5 /* No of local routine for checksum */ StartRoutine /* result of checksum routine delivered by */ /* result codes, that sign 'calculation in progress' */ /end CHECKSUM
  /begin PAGE_SWITCH ESCAPE_CODE /* type of page switching service */ /* Reference Page Working Page */ PAGE_CODE 0x00 0x01 ESCAPE_CODE_PARA_SET 0x90 ESCAPE_CODE_PARA_GET 0x91 /end PAGE_SWITCH
  DATA_ACCESS 0x000000 /* ECU address type qualifier for Flash page */ 0x000000 /* ECU address type qualifier for RAMpage */ 0 /* Flag 1: Upload from ECU flash data possible */ 0 /* Flag 1: Verify access on ECU flash code possible */ 0 /* Flag 1: Upload from ECU flash code possible */ 1 /* Flag1: Upload and download only on active.page. */ /end TP_BLOB
/end IF_DATA
/* *
* Change description: *
* ??.01.03 ETAS-PU : Change Baudrate and Baudrateparameters for 56 MHz Frequency *
* ??.02.02 ETAS-PU : New Baudrate selection added "DIAG_BAUD" for 10400 kBaud *
* ??.02.02 ETAS-PU : New Timing Parameters added "KWP_TIMING" for KWP on CAN (with p2max= 100) *
* 29.03.07 ETAS-Mle: Change KLINE+CAN --> CAN due to INTECRIO Warning *
* 26.07.07 ETAS-Mle: Change CAN --> KLINE_AND_CAN possible with new AML *
* 21.04.07 ETAS-Mle: Change XDL_MAX 0x500 --> 0xFA *
* 21.04.07 ETAS-Mle: Change flags in DATA_ACCESS due to Download - Problem *
* 10.06.08 ETAS-Mle: Change CAN parameter according to recomendation of Hf - CALL 77855 *
* 11.06.08 ETAS-Mle: Change AVAILABLE_PERIODIC_IDENTIFIER_RANGE *
* 25.08.08 ETAS-Mle: Change FLASH - TOOLFLASHBACK behaviour ( copy WP --> RP ) : *
* RequestRoutineResults 0x3 --> StartRoutine 0x1 *
* 29.08.08 ETAS-Mle: Remove FREERUNNINGMODE as not running on ECU yet *
* 08.09.08 ETAS-Mle: Change USDTP_TIMING equal to KWP_TIMING *
* CAUTION : there is no AccessTimingParameter service on UDSonCAN *
* 03.04.09 ETAS-Mle: Change/Activate SECURITY_ACCESS : accMode = 1 ; calcmethod = 16 (rand) *
* delay is not testet yet *
*/
/begin IF_DATA ASAP1B_DIAGNOSTIC_SERVICES /* Definition for KWP2000 on CAN and K-Line */
 /begin TP_BLOB /* TP-Blob includes general information */ 0x0300 /* blob version */ ISO14229_1_2003 /* KWP2000 version */ BYTEORDER_MSB_FIRST /* byte order in measurements and characteristics */
  /begin ADDRESS_AND_LENGTH_FORMAT_IDENTIFIER 0x44 /* Ruo: as I remember Volvo uses 4 Byte Addresses --> 0x24 */ /end ADDRESS_AND_LENGTH_FORMAT_IDENTIFIER
  /begin CAN 500000 /* Baudrate [Hz] */ SamplePoint 70 /* Sample point [% complete bit time] */ SamplesPerBit 1 /* 1 or 3 samples per bit */ BTL_CYCLES 14 /* BTL_CYCLES [slots/bit time] */ SJW 2 /* SJW length synchr. segm. In BTL_CYCLES */ SYNC_EDGE 0 /* SYNC_EDGE */
   /begin ADDRESS 0x07EC /* CAN_ID ECU (gateway)-> INCA */ 0x07E4 /* CAN_ID INCA -> ECU (gateway) */ TGT_INCA 0xE4 TGT_ECU 0xEC /end ADDRESS
   /begin TransportProtocolVersion ISO15765_2_2003 /end TransportProtocolVersion
   NETWORK_LIMITS 10 /* WFT_MAX */ 0x500 /* XDL_MAX */ /* AS BS CD P2min P2max P3min P3max in ms */ USDTP_TIMING_DEFAULTS 0x03E8 0x03E8 0x03E8 0x0000 0x0064 0x0003 0x1388 USDTP_TIMING 0x0100 0x0100 0x0100 0x0000 0x0032 0x0003 0x1388 /end CAN
  /begin FLASH NOFLASHBACK /end FLASH
 /end TP_BLOB
/end IF_DATA
/* *
* Change description: *
* 10.06.08 ETAS-Mle: Change CAN parameter according to recomendation of Hf - CALL 77855 *
* 25.06.08 ETAS-Mle: Comment PROGRAM_NEXT - is not supported yet *
* 18.08.08 ETAS-Mle: MAX_SEGMENTS : 2 --> 4, FREEZ_SUPPORTED *
* 29.08.08 ETAS-Mle: Comment PID_OFF_SUPPORTED as default for INCA in A2L -File *
* 04.09.08 ETAS-Mle: Comment around COMMUNICATION_MODE_SUPPORTED was wrong and is supported now *
* 02.04.09 ETAS-Mle: Change BSmax 10 -> 42 and STmin 2 -> 0 to speedup block download *
*/ /*********** IF_DATA XCP ***********/
/begin IF_DATA XCP
 /begin PROTOCOL_LAYER 0x0100 /* XCP 1.0 */ 100 /* T1 ms = default Timeout for most CMDs */ 100 /* T2 ms = Timeout for Build Checksum */ 100 /* T3 ms = Timeout for Program - Start, - Prepare, - Verify */ 45000 /* T4 ms = Timeout for Program Clear */ 100 /* T5 ms = Timeout for Program, - Reset, -Max */ 100 /* T6 ms = RepeatTimeout between "CONNECT(USER_DEFINED)" */ 100 /* T7 ms = Timeout for PreAction after CMD - Timeout (Master) */ 0x08 /* MAX_CTO */ 0x0008 /* MAX_DTO */ BYTE_ORDER_MSB_FIRST /* _FIRST = 0 , _LAST = 1 */ ADDRESS_GRANULARITY_BYTE /* _BYTE = 0 , _WORD = 1 , _DWORD = 2 */ OPTIONAL_CMD GET_COMM_MODE_INFO /* 0xFB */ OPTIONAL_CMD GET_ID /* 0xFA */ OPTIONAL_CMD SET_REQUEST /* 0xF9 */ OPTIONAL_CMD GET_SEED /* 0xF8 */ OPTIONAL_CMD UNLOCK /* 0xF7 */ OPTIONAL_CMD SET_MTA /* 0xF6 */ OPTIONAL_CMD UPLOAD /* 0xF5 */ OPTIONAL_CMD SHORT_UPLOAD /* 0xF4 */ OPTIONAL_CMD BUILD_CHECKSUM /* 0xF3 */ OPTIONAL_CMD TRANSPORT_LAYER_CMD /* 0xF2 */ OPTIONAL_CMD USER_CMD /* 0xF1 */ /* OPTIONAL_CMD DOWNLOAD                /* 0xF0   ??? NOT_OPTIONAL ??? * / */ OPTIONAL_CMD DOWNLOAD_NEXT /* 0xEF */ OPTIONAL_CMD DOWNLOAD_MAX /* 0xEE */ OPTIONAL_CMD SHORT_DOWNLOAD /* 0xED */ OPTIONAL_CMD MODIFY_BITS /* 0xEC */ OPTIONAL_CMD SET_CAL_PAGE /* 0xEB */ OPTIONAL_CMD GET_CAL_PAGE /* 0xEA */ OPTIONAL_CMD GET_PAG_PROCESSOR_INFO /* 0xE9 */ OPTIONAL_CMD GET_SEGMENT_INFO /* 0xE8 */ OPTIONAL_CMD GET_PAGE_INFO /* 0xE7 */ OPTIONAL_CMD GET_SEGMENT_MODE /* 0xE6 */ OPTIONAL_CMD SET_SEGMENT_MODE /* 0xE5 */ OPTIONAL_CMD COPY_CAL_PAGE /* 0xE4 */ OPTIONAL_CMD CLEAR_DAQ_LIST /* 0xE3 */ OPTIONAL_CMD SET_DAQ_PTR /* 0xE2 */ OPTIONAL_CMD WRITE_DAQ /* 0xE1 */ OPTIONAL_CMD SET_DAQ_LIST_MODE /* 0xE0 */ OPTIONAL_CMD GET_DAQ_LIST_MODE /* 0xDF */ OPTIONAL_CMD START_STOP_DAQ_LIST /* 0xDE */ OPTIONAL_CMD START_STOP_SYNCH /* 0xDD */ OPTIONAL_CMD GET_DAQ_CLOCK /* 0xDC */ OPTIONAL_CMD READ_DAQ /* 0xDB */ OPTIONAL_CMD GET_DAQ_PROCESSOR_INFO /* 0xDA */ OPTIONAL_CMD GET_DAQ_RESOLUTION_INFO /* 0xD9 */ OPTIONAL_CMD GET_DAQ_LIST_INFO /* 0xD8 */ OPTIONAL_CMD GET_DAQ_EVENT_INFO /* 0xD7 */ OPTIONAL_CMD FREE_DAQ /* 0xD6 */ OPTIONAL_CMD ALLOC_DAQ /* 0xD5 */ OPTIONAL_CMD ALLOC_ODT /* 0xD4 */ OPTIONAL_CMD ALLOC_ODT_ENTRY /* 0xD3 */ OPTIONAL_CMD PROGRAM_START /* 0xD2 */ OPTIONAL_CMD PROGRAM_CLEAR /* 0xD1 */ OPTIONAL_CMD PROGRAM /* 0xD0 */ OPTIONAL_CMD PROGRAM_RESET /* 0xCF */ OPTIONAL_CMD GET_PGM_PROCESSOR_INFO /* 0xCE */ OPTIONAL_CMD GET_SECTOR_INFO /* 0xCD */ OPTIONAL_CMD PROGRAM_PREPARE /* 0xCC */ OPTIONAL_CMD PROGRAM_FORMAT /* 0xCB */ /* OPTIONAL_CMD PROGRAM_NEXT              /* 0xCA   BLOCK_MODE only ?* / */ OPTIONAL_CMD PROGRAM_MAX /* 0xC9 */ OPTIONAL_CMD PROGRAM_VERIFY /* 0xC8 */ COMMUNICATION_MODE_SUPPORTED BLOCK /* Master and/or Slave ??? */ SLAVE MASTER 42 0 /* MAX_BS, MIN_ST:unit 100 us ??? in 100us */ SEED_AND_KEY_EXTERNAL_FUNCTION "SeedNKeyXcpDaq2Cal1Stim4Pgm3.dll" /end PROTOCOL_LAYER
 /begin DAQ STATIC /* DAQ_CONFIG_TYPE STATIC / DYNAMIC */ 0x08 /* MAX_DAQ */ 0x06 /* MAX_EVENT_CHANNEL */ 0x00 /* MIN_DAQ = Num of predef DAQs*/ OPTIMISATION_TYPE_DEFAULT /* _DEFAULT = 0, _ODT_TYPE_16 = 1, _ODT_TYPE_32 = 2, _ODT_TYPE_64 = 3, _ODT_TYPE_ALIGNMENT = 4, _MAX_ENTRY_SIZE = 5 */ ADDRESS_EXTENSION_FREE /* _FREE = 0, _ODT = 1, _DAQ = 3 */ IDENTIFICATION_FIELD_TYPE_ABSOLUTE /* _ABSOLUTE = 0, _RELATIVE_BYTE = 1, _RELATIVE_WORD = 2, _RELATIVE_WORD_ALIGNED" = 3 */ GRANULARITY_ODT_ENTRY_SIZE_DAQ_BYTE /* _BYTE = 1, _WORD = 2, _DWORD = 4, _DLONG = 8*/ 0x08 /* MAX_ODT_ENTRY_SIZE_DAQ */ OVERLOAD_INDICATION_EVENT /* NO_ = 0, _PID = 1, _EVENT = 2 */ PRESCALER_SUPPORTED /* DIRECTION = DAQ ! ??? How does the Master act */ /* RESUME_SUPPORTED */ /* RESUME_SUPPORTED ? ECU not yet */
  /begin STIM GRANULARITY_ODT_ENTRY_SIZE_STIM_BYTE /* _BYTE = 1, _WORD = 2, _DWORD = 4, _DLONG = 8*/ 8 /* MAX_ODT_ENTRY_SIZE_STIM */ BIT_STIM_SUPPORTED /* BIT_STIM_SUPPORTED must not be changed for INTECRIO */ /* otherwise Phyton script will not work with bool */ /end STIM
  /begin TIMESTAMP_SUPPORTED 36535 /* TIMESTAMP_TICKS ??? */ NO_TIME_STAMP /* NO_TIME_STAMP = 0; SIZE_BYTE, _WORD, _DWORD */ UNIT_1NS /* UNIT_1NS = 0 */ /* TIMESTAMP_FIXED */ /* TIMESTAMP_FIXED */ /end TIMESTAMP_SUPPORTED
  /* PID_OFF_SUPPORTED */ /* PID_OFF_SUPPORTED */
  /begin DAQ_LIST 0 DAQ_LIST_TYPE DAQ MAX_ODT 0x0A MAX_ODT_ENTRIES 0x08 FIRST_PID 0 EVENT_FIXED 0 /end DAQ_LIST
  /begin DAQ_LIST 1 DAQ_LIST_TYPE DAQ MAX_ODT 0x0A MAX_ODT_ENTRIES 0x08 FIRST_PID 0x0A EVENT_FIXED 1 /end DAQ_LIST
  /begin DAQ_LIST 2 DAQ_LIST_TYPE DAQ MAX_ODT 0x0A MAX_ODT_ENTRIES 0x08 FIRST_PID 0x14 EVENT_FIXED 2 /end DAQ_LIST
  /begin DAQ_LIST 3 DAQ_LIST_TYPE DAQ MAX_ODT 0x0A MAX_ODT_ENTRIES 0x08 FIRST_PID 0x1E EVENT_FIXED 5 /end DAQ_LIST
  /begin DAQ_LIST 4 DAQ_LIST_TYPE STIM MAX_ODT 0x0A MAX_ODT_ENTRIES 0x08 FIRST_PID 0x28 EVENT_FIXED 3 /end DAQ_LIST
  /begin DAQ_LIST 5 DAQ_LIST_TYPE STIM MAX_ODT 0x0A MAX_ODT_ENTRIES 0x08 FIRST_PID 0x32 EVENT_FIXED 4 /end DAQ_LIST
  /begin DAQ_LIST 6 DAQ_LIST_TYPE STIM MAX_ODT 0x0A MAX_ODT_ENTRIES 0x08 FIRST_PID 0x3C EVENT_FIXED 2 /end DAQ_LIST
  /begin DAQ_LIST 7 DAQ_LIST_TYPE STIM MAX_ODT 0x0A MAX_ODT_ENTRIES 0x08 FIRST_PID 0x46 EVENT_FIXED 5 /end DAQ_LIST
  /begin EVENT "Byp_01_receive_from_ECU" "R01" 0x00 DAQ 0x01 0x0A /* TIME_CYCLE (10ms)*/ 0x06 /* TIME_UNIT (1ms) */ 0x02 /* PRIORITY 0 --> FF ? Effect in Bypass and/or MC usecase ?*/ /end EVENT
  /begin EVENT "Byp_02_receive_from_ECU" "R02" 0x01 DAQ 0x01 0x05 /* TIME_CYCLE (50ms)*/ 0x07 0x01 /end EVENT
  /begin EVENT "XCP_EV2_100ms_DAQ329_STIM325isCMD" "R03" 0x02 DAQ_STIM 0x02 0x0A /* TIME_CYCLE(100ms) */ 0x07 0x00 /end EVENT
  /begin EVENT "Byp_01_send_to_ECU" "B01" 0x03 STIM 0x01 0x0A /* TIME_CYCLE (10ms)*/ 0x06 /* TIME_UNIT (1ms) */ 0x02 /* PRIORITY 0 --> FF ? Effect in Bypass and/or MC usecase ?*/ /end EVENT
  /begin EVENT "Byp_02_send_to_ECU" "B02" 0x04 STIM 0x01 0x05 /* TIME_CYCLE (50ms)*/ 0x07 0x01 /end EVENT
  /begin EVENT "XCP_EV5_Sync_DAQ329_STIM325isCMD" "Sync" 0x05 DAQ_STIM 0x02 0x00 /* TIME_CYCLE(100ms) */ 0x00 0x03 /end EVENT
 /end DAQ
 /begin PAG 0x04 /* MAX_SEGMENTS */ FREEZE_SUPPORTED /*FREEZE_SUPPORTED*/ /end PAG
 /begin XCP_ON_CAN 0x0100 /* XCP on CAN version : e.g V1.0 = 0x0100*/ /*CAN_ID_BROADCAST */ /* Auto detection CAN-ID ??? */ CAN_ID_MASTER 0x04F8 /* CMD/STIM (CROs) ??? STIM ??? */ CAN_ID_SLAVE 0x0326 /* RES/ERR/EV/SERV/DAQ (DTOs) */ BAUDRATE 1000000 /* BAUDRATE */ SAMPLE_POINT 80 SAMPLE_RATE SINGLE BTL_CYCLES 10 SJW 3 SYNC_EDGE SINGLE /*MAX_DLC_REQUIRED*/ /* MAX_DLC_REQUIRED --> Master has to send alwas DLC = 8 */ /begin DAQ_LIST_CAN_ID 0x0000 /* for DAQ_LIST 0 */ FIXED 0x327 /end DAQ_LIST_CAN_ID /* DAQ_LIST 1 (DAQ direction is expected on XCP-RESPONCE CAN-ID 0x0326 */ /begin DAQ_LIST_CAN_ID 0x0002 /* for DAQ_LIST 2 */ FIXED 0x329 /end DAQ_LIST_CAN_ID /begin DAQ_LIST_CAN_ID 0x0003 /* for DAQ_LIST 3 */ FIXED 0x326 /end DAQ_LIST_CAN_ID /begin DAQ_LIST_CAN_ID 0x0004 /* for DAQ LIST 4 (STIM_direction) */ FIXED 0x2F0 /end DAQ_LIST_CAN_ID /begin DAQ_LIST_CAN_ID 0x0005 /* for DAQ LIST 5 (STIM_direction) */ FIXED 0x2F1 /end DAQ_LIST_CAN_ID /* DAQ_LIST 6 (STIM direction is expected on XCP-Command CAN-ID 0x04F8 */ /* DAQ_LIST 7 (STIM direction is expected on XCP-Command CAN-ID 0x04F8 */ /end XCP_ON_CAN
/end IF_DATA
/begin IF_DATA ETK /* /begin C:/ETAS/ASCET513/target/mpc555/Add_ToolChain/ASAP_Templates/dim_x_AML1_2_ECU.a2l inserted by post asap script Multiple_DIM_X.pl */ /*
2004-01-22 ETAS-Dm: Corrected TRGSEg SIze in TRG_CFG Value
2003-11-04 ETAS-PU: -adapt Trigersegment for ETKP3, 128 Byte segment with trigger addresses
ETAS-PU: -Codecheck wurde ausgeschaltet
-Adressen fuer Distab koennen auf 5Cxxxxx liegen, wenn im memory Layout gemapped wird
-(siehe mem_lay.a2l) ansonsten auf 1C0000
2002-01-18 ETAS-Gt: Anpassung an ETKP3 auf C-Muster XCellsis, Adressanpassungen an C-Muster Memorylayout
2006-11-29 ETAS-Mle: Anpassung an ETKP7
2007-01-12 ETAS-Mle: For ETK-Mailbox Flashing with BOSCH StBootblock Mailbox is at 900000
For ETK-Distab "trgsegad" is at 940000
2007-02-21 ETAS-Mle: remove \begin \end DISTAB_CFG (just use DISTAB_CFG)
Replace RESERVED with RESERVED_DISTAB_MEMORY
2008-01-14 ETAS-Mle: change bypass TriggerID-address "Byp_B01" --> 0x940060
change bypass TriggerID-address "Byp_B02" --> 0x940062
*/ /*begin IF_DATA ETK*/
 /begin TP_BLOB /*version:*/ 0x1000100 /*IFS:*/ INTERFACE_SPEED_100MBIT /* InterfaceSpeed 1=8MBit, 2=100MBit */ /* for INCA please use INTERFACE_SPEED_100MBIT for ASCET < 5.0 use number 2 */ /*reset_cfg:*/ 0x0 /* Dummy */ DISTAB_CFG /*dsptab:*/ 0xD /*dat_mod:*/ 0x1 /*rfg:*/ 0x1 /*trgsegad:*/ 0x940000 /*trg_cfg: */ 0x1010100 TRG_MOD /*Id:*/ 0x0 /*trg_mod:*/ 0xFF 0x0 0x0 0x0 CODE_CHK /*prg_data:*/ 0x00000 /*prg_length:*/ 0x0 /*prg_eram:*/ 0x00000 /*prg_length:*/ 0x0 ETK_CFG 0x03 0xC2 0x3D 0xFF 0xEF 0x3E 0xDF 0xEF 0x3D 0xFF 0xFB 0xFE 0xFF 0xFF 0xFE 0xFF 0xFF 0xF0 0x0F 0xFF 0x03 0xCD 0xFF 0xFF /* ??? no CRC-Check via display table please use RESERVED ... ??? */ RESERVED_DISTAB_MEMORY /*start_addr:*/ 0x942250 0x7F8 /*location*/ EXTERN /*mirrors*/ -1 -1 -1 -1 -1 RESERVED_DISTAB_MEMORY /*start_addr:*/ 0x95FFF0 0x0F /*location*/ EXTERN /*mirrors*/ -1 -1 -1 -1 -1 ETK_MAILBOX /*pattern:*/ 0x55555555 /*page_ecu:*/ DATA /*ecu_adr:*/ 0x903000 0x8000 /*page_am:*/ EXRAM /*am_adr:*/ 0x901000 0x7000 /end TP_BLOB
 /begin SOURCE "R_01" 103 1 QP_BLOB 0x0100 15 INDIRECT 31 MEASUREMENT 0x940040 0x38 0x942250 0x940100 /* Data memory: CHNL_R1 */ 0 0x0 0x0 5000 /end SOURCE
 /begin SOURCE "R_02" 4 1 QP_BLOB 0x0100 16 INDIRECT 29 MEASUREMENT 0x940042 0x58 0x942338 0x940138 /* Data memory: CHNL_R2 */ 0 0x0 0x0 10000 /end SOURCE
 /begin SOURCE "R_03" 5 1 QP_BLOB 0x0100 16 INDIRECT 27 MEASUREMENT 0x940044 0x58 0x9424A0 0x940190 /* Data memory: CHNL_R3 */ 0x58 0x0 0x0 20000 /end SOURCE
 /begin SOURCE "Byp_01" 103 1 QP_BLOB 0x0100 15 INDIRECT 32 BYPASS 0x940060 0x58 0x942608 0x9401E8 /* Data memory: CHNL_B1 */ 0x58 0x0 0x9428D8 5000 /end SOURCE
 /begin SOURCE "Byp_02" 4 1 QP_BLOB 0x0100 16 INDIRECT 30 BYPASS 0x940062 0x58 0x942770 0x940240 /* Data memory: CHNL_B2 */ 0x58 0x0 0x942990 10000 /end SOURCE
 /*end IF_DATA*/ /* /end C:/ETAS/ASCET513/target/mpc555/Add_ToolChain/ASAP_Templates/dim_x_AML1_2_ECU.a2l inserted by post asap script Multiple_DIM_X.pl */ /end IF_DATA
/begin CHARACTERISTIC EBEN_ASD.AS.BASE "" VALUE 0x1D004C STANDARD_VALUE_U32 0.0 identity 0 4294967295 /end CHARACTERISTIC
/begin CHARACTERISTIC One_D.STD_sint16_sint16.All_Curves_STD.Curves_Raster_1 "" CURVE 0x1D0F78 STANDARD_CURVE_S16S16 0.0 ident -32768.0 32767.0
 /begin AXIS_DESCR STD_AXIS M_In.STD_sint16_sint16.All_Curves_STD.Curves_Raster_1 ident 10 -32768.0 32767.0 /end AXIS_DESCR
/end CHARACTERISTIC
/begin CHARACTERISTIC One_D.STD_sint16_sint16.All_Curves_STD.Curves_Raster_2 "" CURVE 0x1D1358 STANDARD_CURVE_S16S16 0.0 ident -32768.0 32767.0
 /begin AXIS_DESCR STD_AXIS M_In.STD_sint16_sint16.All_Curves_STD.Curves_Raster_2 ident 10 -32768.0 32767.0 /end AXIS_DESCR
/end CHARACTERISTIC
/begin CHARACTERISTIC One_D.STD_sint16_sint16.All_Curves_STD.Curves_Raster_3 "" CURVE 0x1D1738 STANDARD_CURVE_S16S16 0.0 ident -32768.0 32767.0
 /begin AXIS_DESCR STD_AXIS M_In.STD_sint16_sint16.All_Curves_STD.Curves_Raster_3 ident 10 -32768.0 32767.0 /end AXIS_DESCR
/end CHARACTERISTIC
/begin CHARACTERISTIC One_D.STD_sint32_sint32.All_Curves_STD.Curves_Raster_1 "" CURVE 0x1D0FB0 STANDARD_CURVE_S32S32 0.0 ident -2147483648.0 2147483647.0
 /begin AXIS_DESCR STD_AXIS M_In.STD_sint32_sint32.All_Curves_STD.Curves_Raster_1 ident 10 -2147483648.0 2147483647.0 /end AXIS_DESCR
/end CHARACTERISTIC
/begin CHARACTERISTIC One_D.STD_sint32_sint32.All_Curves_STD.Curves_Raster_2 "" CURVE 0x1D1390 STANDARD_CURVE_S32S32 0.0 ident -2147483648.0 2147483647.0
 /begin AXIS_DESCR STD_AXIS M_In.STD_sint32_sint32.All_Curves_STD.Curves_Raster_2 ident 10 -2147483648.0 2147483647.0 /end AXIS_DESCR
/end CHARACTERISTIC
/begin CHARACTERISTIC One_D.STD_sint32_sint32.All_Curves_STD.Curves_Raster_3 "" CURVE 0x1D1770 STANDARD_CURVE_S32S32 0.0 ident -2147483648.0 2147483647.0
 /begin AXIS_DESCR STD_AXIS M_In.STD_sint32_sint32.All_Curves_STD.Curves_Raster_3 ident 10 -2147483648.0 2147483647.0 /end AXIS_DESCR
/end CHARACTERISTIC
/begin CHARACTERISTIC One_D.STD_sint8_sint8.All_Curves_STD.Curves_Raster_1 "" CURVE 0x1D100A STANDARD_CURVE_S8S8 0.0 ident -128.0 127.0
 /begin AXIS_DESCR STD_AXIS M_In.STD_sint8_sint8.All_Curves_STD.Curves_Raster_1 ident 10 -128.0 127.0 /end AXIS_DESCR
/end CHARACTERISTIC
/begin CHARACTERISTIC One_D.STD_sint8_sint8.All_Curves_STD.Curves_Raster_2 "" CURVE 0x1D13EA STANDARD_CURVE_S8S8 0.0 ident -128.0 127.0
 /begin AXIS_DESCR STD_AXIS M_In.STD_sint8_sint8.All_Curves_STD.Curves_Raster_2 ident 10 -128.0 127.0 /end AXIS_DESCR
/end CHARACTERISTIC
/begin CHARACTERISTIC One_D.STD_sint8_sint8.All_Curves_STD.Curves_Raster_3 "" CURVE 0x1D17CA STANDARD_CURVE_S8S8 0.0 ident -128.0 127.0
 /begin AXIS_DESCR STD_AXIS M_In.STD_sint8_sint8.All_Curves_STD.Curves_Raster_3 ident 10 -128.0 127.0 /end AXIS_DESCR
/end CHARACTERISTIC
/begin CHARACTERISTIC One_D.STD_uint16_uint16.All_Curves_STD.Curves_Raster_1 "" CURVE 0x1D1028 STANDARD_CURVE_U16U16 0.0 ident 0.0 65535.0
 /begin AXIS_DESCR STD_AXIS M_In.STD_uint16_uint16.All_Curves_STD.Curves_Raster_1 ident 10 0.0 65535.0 /end AXIS_DESCR
/end CHARACTERISTIC
/begin CHARACTERISTIC One_D.STD_uint16_uint16.All_Curves_STD.Curves_Raster_2 "" CURVE 0x1D1408 STANDARD_CURVE_U16U16 0.0 ident 0.0 65535.0
 /begin AXIS_DESCR STD_AXIS M_In.STD_uint16_uint16.All_Curves_STD.Curves_Raster_2 ident 10 0.0 65535.0 /end AXIS_DESCR
/end CHARACTERISTIC
/begin CHARACTERISTIC One_D.STD_uint16_uint16.All_Curves_STD.Curves_Raster_3 "" CURVE 0x1D17E8 STANDARD_CURVE_U16U16 0.0 ident 0.0 65535.0
 /begin AXIS_DESCR STD_AXIS M_In.STD_uint16_uint16.All_Curves_STD.Curves_Raster_3 ident 10 0.0 65535.0 /end AXIS_DESCR
/end CHARACTERISTIC
/begin CHARACTERISTIC One_D.STD_uint32_uint32.All_Curves_STD.Curves_Raster_1 "" CURVE 0x1D1060 STANDARD_CURVE_U32U32 0.0 ident 0.0 4294967295.0
 /begin AXIS_DESCR STD_AXIS M_In.STD_uint32_uint32.All_Curves_STD.Curves_Raster_1 ident 10 0.0 4294967295.0 /end AXIS_DESCR
/end CHARACTERISTIC
/begin CHARACTERISTIC One_D.STD_uint32_uint32.All_Curves_STD.Curves_Raster_2 "" CURVE 0x1D1440 STANDARD_CURVE_U32U32 0.0 ident 0.0 4294967295.0
 /begin AXIS_DESCR STD_AXIS M_In.STD_uint32_uint32.All_Curves_STD.Curves_Raster_2 ident 10 0.0 4294967295.0 /end AXIS_DESCR
/end CHARACTERISTIC
/begin CHARACTERISTIC One_D.STD_uint32_uint32.All_Curves_STD.Curves_Raster_3 "" CURVE 0x1D1820 STANDARD_CURVE_U32U32 0.0 ident 0.0 4294967295.0
 /begin AXIS_DESCR STD_AXIS M_In.STD_uint32_uint32.All_Curves_STD.Curves_Raster_3 ident 10 0.0 4294967295.0 /end AXIS_DESCR
/end CHARACTERISTIC
/begin CHARACTERISTIC One_D.STD_uint8_uint8.All_Curves_STD.Curves_Raster_1 "" CURVE 0x1D10BA STANDARD_CURVE_U8U8 0.0 ident 0.0 255.0
 /begin AXIS_DESCR STD_AXIS M_In.STD_uint8_uint8.All_Curves_STD.Curves_Raster_1 ident 10 0.0 255.0 /end AXIS_DESCR
/end CHARACTERISTIC
/begin CHARACTERISTIC One_D.STD_uint8_uint8.All_Curves_STD.Curves_Raster_2 "" CURVE 0x1D149A STANDARD_CURVE_U8U8 0.0 ident 0.0 255.0
 /begin AXIS_DESCR STD_AXIS M_In.STD_uint8_uint8.All_Curves_STD.Curves_Raster_2 ident 10 0.0 255.0 /end AXIS_DESCR
/end CHARACTERISTIC
/begin CHARACTERISTIC One_D.STD_uint8_uint8.All_Curves_STD.Curves_Raster_3 "" CURVE 0x1D187A STANDARD_CURVE_U8U8 0.0 ident 0.0 255.0
 /begin AXIS_DESCR STD_AXIS M_In.STD_uint8_uint8.All_Curves_STD.Curves_Raster_3 ident 10 0.0 255.0 /end AXIS_DESCR
/end CHARACTERISTIC
/begin CHARACTERISTIC One_D_1.GRP_sint16_sint16.All_Curves_GRP.Curves_Raster_1 "" CURVE 0x1D0DFA STANDARD_GROUP_S16 0.0 ident -32768.0 32767.0
 /begin AXIS_DESCR COM_AXIS M_In.GRP_sint16_sint16.All_Curves_GRP.Curves_Raster_1 ident 10 -32768.0 32767.0 AXIS_PTS_REF distrib.GRP_sint16_sint16.All_Curves_GRP.Curves_Raster_1 /end AXIS_DESCR
/end CHARACTERISTIC
/begin CHARACTERISTIC One_D_1.GRP_sint16_sint16.All_Curves_GRP.Curves_Raster_2 "" CURVE 0x1D11DA STANDARD_GROUP_S16 0.0 ident -32768.0 32767.0
 /begin AXIS_DESCR COM_AXIS M_In.GRP_sint16_sint16.All_Curves_GRP.Curves_Raster_2 ident 10 -32768.0 32767.0 AXIS_PTS_REF distrib.GRP_sint16_sint16.All_Curves_GRP.Curves_Raster_2 /end AXIS_DESCR
/end CHARACTERISTIC
/begin CHARACTERISTIC One_D_1.GRP_sint16_sint16.All_Curves_GRP.Curves_Raster_3 "" CURVE 0x1D15BA STANDARD_GROUP_S16 0.0 ident -32768.0 32767.0
 /begin AXIS_DESCR COM_AXIS M_In.GRP_sint16_sint16.All_Curves_GRP.Curves_Raster_3 ident 10 -32768.0 32767.0 AXIS_PTS_REF distrib.GRP_sint16_sint16.All_Curves_GRP.Curves_Raster_3 /end AXIS_DESCR
/end CHARACTERISTIC
/begin CHARACTERISTIC One_D_1.GRP_sint32_sint32.All_Curves_GRP.Curves_Raster_1 "" CURVE 0x1D0E34 STANDARD_GROUP_S32 0.0 ident -2147483648.0 2147483647.0
 /begin AXIS_DESCR COM_AXIS M_In.GRP_sint32_sint32.All_Curves_GRP.Curves_Raster_1 ident 10 -2147483648.0 2147483647.0 AXIS_PTS_REF distrib.GRP_sint32_sint32.All_Curves_GRP.Curves_Raster_1 /end AXIS_DESCR
/end CHARACTERISTIC
/begin CHARACTERISTIC One_D_1.GRP_sint32_sint32.All_Curves_GRP.Curves_Raster_2 "" CURVE 0x1D1214 STANDARD_GROUP_S32 0.0 ident -2147483648.0 2147483647.0
 /begin AXIS_DESCR COM_AXIS M_In.GRP_sint32_sint32.All_Curves_GRP.Curves_Raster_2 ident 10 -2147483648.0 2147483647.0 AXIS_PTS_REF distrib.GRP_sint32_sint32.All_Curves_GRP.Curves_Raster_2 /end AXIS_DESCR
/end CHARACTERISTIC
/begin CHARACTERISTIC One_D_1.GRP_sint32_sint32.All_Curves_GRP.Curves_Raster_3 "" CURVE 0x1D15F4 STANDARD_GROUP_S32 0.0 ident -2147483648.0 2147483647.0
 /begin AXIS_DESCR COM_AXIS M_In.GRP_sint32_sint32.All_Curves_GRP.Curves_Raster_3 ident 10 -2147483648.0 2147483647.0 AXIS_PTS_REF distrib.GRP_sint32_sint32.All_Curves_GRP.Curves_Raster_3 /end AXIS_DESCR
/end CHARACTERISTIC
/begin CHARACTERISTIC One_D_1.GRP_sint8_sint8.All_Curves_GRP.Curves_Raster_1 "" CURVE 0x1D0E94 STANDARD_GROUP_S8 0.0 ident -128.0 127.0
 /begin AXIS_DESCR COM_AXIS M_In.GRP_sint8_sint8.All_Curves_GRP.Curves_Raster_1 ident 10 -128.0 127.0 AXIS_PTS_REF distrib.GRP_sint8_sint8.All_Curves_GRP.Curves_Raster_1 /end AXIS_DESCR
/end CHARACTERISTIC
/begin CHARACTERISTIC One_D_1.GRP_sint8_sint8.All_Curves_GRP.Curves_Raster_2 "" CURVE 0x1D1274 STANDARD_GROUP_S8 0.0 ident -128.0 127.0
 /begin AXIS_DESCR COM_AXIS M_In.GRP_sint8_sint8.All_Curves_GRP.Curves_Raster_2 ident 10 -128.0 127.0 AXIS_PTS_REF distrib.GRP_sint8_sint8.All_Curves_GRP.Curves_Raster_2 /end AXIS_DESCR
/end CHARACTERISTIC
/begin CHARACTERISTIC One_D_1.GRP_sint8_sint8.All_Curves_GRP.Curves_Raster_3 "" CURVE 0x1D1654 STANDARD_GROUP_S8 0.0 ident -128.0 127.0
 /begin AXIS_DESCR COM_AXIS M_In.GRP_sint8_sint8.All_Curves_GRP.Curves_Raster_3 ident 10 -128.0 127.0 AXIS_PTS_REF distrib.GRP_sint8_sint8.All_Curves_GRP.Curves_Raster_3 /end AXIS_DESCR
/end CHARACTERISTIC
/begin CHARACTERISTIC One_D_1.GRP_uint16_uint16.All_Curves_GRP.Curves_Raster_1 "" CURVE 0x1D0EBA STANDARD_GROUP_U16 0.0 ident 0.0 65535.0
 /begin AXIS_DESCR COM_AXIS M_In.GRP_uint16_uint16.All_Curves_GRP.Curves_Raster_1 ident 10 0.0 65535.0 AXIS_PTS_REF distrib.GRP_uint16_uint16.All_Curves_GRP.Curves_Raster_1 /end AXIS_DESCR
/end CHARACTERISTIC
/begin CHARACTERISTIC One_D_1.GRP_uint16_uint16.All_Curves_GRP.Curves_Raster_2 "" CURVE 0x1D129A STANDARD_GROUP_U16 0.0 ident 0.0 65535.0
 /begin AXIS_DESCR COM_AXIS M_In.GRP_uint16_uint16.All_Curves_GRP.Curves_Raster_2 ident 10 0.0 65535.0 AXIS_PTS_REF distrib.GRP_uint16_uint16.All_Curves_GRP.Curves_Raster_2 /end AXIS_DESCR
/end CHARACTERISTIC
/begin CHARACTERISTIC One_D_1.GRP_uint16_uint16.All_Curves_GRP.Curves_Raster_3 "" CURVE 0x1D167A STANDARD_GROUP_U16 0.0 ident 0.0 65535.0
 /begin AXIS_DESCR COM_AXIS M_In.GRP_uint16_uint16.All_Curves_GRP.Curves_Raster_3 ident 10 0.0 65535.0 AXIS_PTS_REF distrib.GRP_uint16_uint16.All_Curves_GRP.Curves_Raster_3 /end AXIS_DESCR
/end CHARACTERISTIC
/begin CHARACTERISTIC One_D_1.GRP_uint32_uint32.All_Curves_GRP.Curves_Raster_1 "" CURVE 0x1D0EF4 STANDARD_GROUP_U32 0.0 ident 0.0 4294967295.0
 /begin AXIS_DESCR COM_AXIS M_In.GRP_uint32_uint32.All_Curves_GRP.Curves_Raster_1 ident 10 0.0 4294967295.0 AXIS_PTS_REF distrib.GRP_uint32_uint32.All_Curves_GRP.Curves_Raster_1 /end AXIS_DESCR
/end CHARACTERISTIC
/begin CHARACTERISTIC One_D_1.GRP_uint32_uint32.All_Curves_GRP.Curves_Raster_2 "" CURVE 0x1D12D4 STANDARD_GROUP_U32 0.0 ident 0.0 4294967295.0
 /begin AXIS_DESCR COM_AXIS M_In.GRP_uint32_uint32.All_Curves_GRP.Curves_Raster_2 ident 10 0.0 4294967295.0 AXIS_PTS_REF distrib.GRP_uint32_uint32.All_Curves_GRP.Curves_Raster_2 /end AXIS_DESCR
/end CHARACTERISTIC
/begin CHARACTERISTIC One_D_1.GRP_uint32_uint32.All_Curves_GRP.Curves_Raster_3 "" CURVE 0x1D16B4 STANDARD_GROUP_U32 0.0 ident 0.0 4294967295.0
 /begin AXIS_DESCR COM_AXIS M_In.GRP_uint32_uint32.All_Curves_GRP.Curves_Raster_3 ident 10 0.0 4294967295.0 AXIS_PTS_REF distrib.GRP_uint32_uint32.All_Curves_GRP.Curves_Raster_3 /end AXIS_DESCR
/end CHARACTERISTIC
/begin CHARACTERISTIC One_D_1.GRP_uint8_uint8.All_Curves_GRP.Curves_Raster_1 "" CURVE 0x1D0F54 STANDARD_GROUP_U8 0.0 ident 0.0 255.0
 /begin AXIS_DESCR COM_AXIS M_In.GRP_uint8_uint8.All_Curves_GRP.Curves_Raster_1 ident 10 0.0 255.0 AXIS_PTS_REF distrib.GRP_uint8_uint8.All_Curves_GRP.Curves_Raster_1 /end AXIS_DESCR
/end CHARACTERISTIC
/begin CHARACTERISTIC One_D_1.GRP_uint8_uint8.All_Curves_GRP.Curves_Raster_2 "" CURVE 0x1D1334 STANDARD_GROUP_U8 0.0 ident 0.0 255.0
 /begin AXIS_DESCR COM_AXIS M_In.GRP_uint8_uint8.All_Curves_GRP.Curves_Raster_2 ident 10 0.0 255.0 AXIS_PTS_REF distrib.GRP_uint8_uint8.All_Curves_GRP.Curves_Raster_2 /end AXIS_DESCR
/end CHARACTERISTIC
/begin CHARACTERISTIC One_D_1.GRP_uint8_uint8.All_Curves_GRP.Curves_Raster_3 "" CURVE 0x1D1714 STANDARD_GROUP_U8 0.0 ident 0.0 255.0
 /begin AXIS_DESCR COM_AXIS M_In.GRP_uint8_uint8.All_Curves_GRP.Curves_Raster_3 ident 10 0.0 255.0 AXIS_PTS_REF distrib.GRP_uint8_uint8.All_Curves_GRP.Curves_Raster_3 /end AXIS_DESCR
/end CHARACTERISTIC
/begin CHARACTERISTIC One_D_Fix.FIX_sint16_sint16.All_Curves_FIX.Curves_Raster_1 "" CURVE 0x1D0D06 STANDARD_FIXED_S16 0.0 ident -32768.0 32767.0
 /begin AXIS_DESCR FIX_AXIS M_In.FIX_sint16_sint16.All_Curves_FIX.Curves_Raster_1 ident 10 -32768.0 32767.0 FIX_AXIS_PAR_DIST 0 1 10 /end AXIS_DESCR
/end CHARACTERISTIC
/begin CHARACTERISTIC One_D_Fix.FIX_sint16_sint16.All_Curves_FIX.Curves_Raster_2 "" CURVE 0x1D10E6 STANDARD_FIXED_S16 0.0 ident -32768.0 32767.0
 /begin AXIS_DESCR FIX_AXIS M_In.FIX_sint16_sint16.All_Curves_FIX.Curves_Raster_2 ident 10 -32768.0 32767.0 FIX_AXIS_PAR_DIST 0 1 10 /end AXIS_DESCR
/end CHARACTERISTIC
/begin CHARACTERISTIC One_D_Fix.FIX_sint16_sint16.All_Curves_FIX.Curves_Raster_3 "" CURVE 0x1D14C6 STANDARD_FIXED_S16 0.0 ident -32768.0 32767.0
 /begin AXIS_DESCR FIX_AXIS M_In.FIX_sint16_sint16.All_Curves_FIX.Curves_Raster_3 ident 10 -32768.0 32767.0 FIX_AXIS_PAR_DIST 0 1 10 /end AXIS_DESCR
/end CHARACTERISTIC
/begin CHARACTERISTIC One_D_Fix.FIX_sint32_sint32.All_Curves_FIX.Curves_Raster_1 "" CURVE 0x1D0D34 STANDARD_FIXED_S32 0.0 ident -2147483648.0 2147483647.0
 /begin AXIS_DESCR FIX_AXIS M_In.FIX_sint32_sint32.All_Curves_FIX.Curves_Raster_1 ident 10 -2147483648.0 2147483647.0 FIX_AXIS_PAR_DIST 0 1 10 /end AXIS_DESCR
/end CHARACTERISTIC
/begin CHARACTERISTIC One_D_Fix.FIX_sint32_sint32.All_Curves_FIX.Curves_Raster_2 "" CURVE 0x1D1114 STANDARD_FIXED_S32 0.0 ident -2147483648.0 2147483647.0
 /begin AXIS_DESCR FIX_AXIS M_In.FIX_sint32_sint32.All_Curves_FIX.Curves_Raster_2 ident 10 -2147483648.0 2147483647.0 FIX_AXIS_PAR_DIST 0 1 10 /end AXIS_DESCR
/end CHARACTERISTIC
/begin CHARACTERISTIC One_D_Fix.FIX_sint32_sint32.All_Curves_FIX.Curves_Raster_3 "" CURVE 0x1D14F4 STANDARD_FIXED_S32 0.0 ident -2147483648.0 2147483647.0
 /begin AXIS_DESCR FIX_AXIS M_In.FIX_sint32_sint32.All_Curves_FIX.Curves_Raster_3 ident 10 -2147483648.0 2147483647.0 FIX_AXIS_PAR_DIST 0 1 10 /end AXIS_DESCR
/end CHARACTERISTIC
/begin CHARACTERISTIC One_D_Fix.FIX_sint8_sint8.All_Curves_FIX.Curves_Raster_1 "" CURVE 0x1D0D65 STANDARD_FIXED_S8 0.0 ident -128.0 127.0
 /begin AXIS_DESCR FIX_AXIS M_In.FIX_sint8_sint8.All_Curves_FIX.Curves_Raster_1 ident 10 -128.0 127.0 FIX_AXIS_PAR_DIST 0 1 10 /end AXIS_DESCR
/end CHARACTERISTIC
/begin CHARACTERISTIC One_D_Fix.FIX_sint8_sint8.All_Curves_FIX.Curves_Raster_2 "" CURVE 0x1D1145 STANDARD_FIXED_S8 0.0 ident -128.0 127.0
 /begin AXIS_DESCR FIX_AXIS M_In.FIX_sint8_sint8.All_Curves_FIX.Curves_Raster_2 ident 10 -128.0 127.0 FIX_AXIS_PAR_DIST 0 1 10 /end AXIS_DESCR
/end CHARACTERISTIC
/begin CHARACTERISTIC One_D_Fix.FIX_sint8_sint8.All_Curves_FIX.Curves_Raster_3 "" CURVE 0x1D1525 STANDARD_FIXED_S8 0.0 ident -128.0 127.0
 /begin AXIS_DESCR FIX_AXIS M_In.FIX_sint8_sint8.All_Curves_FIX.Curves_Raster_3 ident 10 -128.0 127.0 FIX_AXIS_PAR_DIST 0 1 10 /end AXIS_DESCR
/end CHARACTERISTIC
/begin CHARACTERISTIC One_D_Fix.FIX_uint16_uint16.All_Curves_FIX.Curves_Raster_1 "" CURVE 0x1D0D7E STANDARD_FIXED_U16 0.0 ident 0.0 65535.0
 /begin AXIS_DESCR FIX_AXIS M_In.FIX_uint16_uint16.All_Curves_FIX.Curves_Raster_1 ident 10 0.0 65535.0 FIX_AXIS_PAR_DIST 0 1 10 /end AXIS_DESCR
/end CHARACTERISTIC
/begin CHARACTERISTIC One_D_Fix.FIX_uint16_uint16.All_Curves_FIX.Curves_Raster_2 "" CURVE 0x1D115E STANDARD_FIXED_U16 0.0 ident 0.0 65535.0
 /begin AXIS_DESCR FIX_AXIS M_In.FIX_uint16_uint16.All_Curves_FIX.Curves_Raster_2 ident 10 0.0 65535.0 FIX_AXIS_PAR_DIST 0 1 10 /end AXIS_DESCR
/end CHARACTERISTIC
/begin CHARACTERISTIC One_D_Fix.FIX_uint16_uint16.All_Curves_FIX.Curves_Raster_3 "" CURVE 0x1D153E STANDARD_FIXED_U16 0.0 ident 0.0 65535.0
 /begin AXIS_DESCR FIX_AXIS M_In.FIX_uint16_uint16.All_Curves_FIX.Curves_Raster_3 ident 10 0.0 65535.0 FIX_AXIS_PAR_DIST 0 1 10 /end AXIS_DESCR
/end CHARACTERISTIC
/begin CHARACTERISTIC One_D_Fix.FIX_uint32_uint32.All_Curves_FIX.Curves_Raster_1 "" CURVE 0x1D0DAC STANDARD_FIXED_U32 0.0 ident 0.0 4294967295.0
 /begin AXIS_DESCR FIX_AXIS M_In.FIX_uint32_uint32.All_Curves_FIX.Curves_Raster_1 ident 10 0.0 4294967295.0 FIX_AXIS_PAR_DIST 0 1 10 /end AXIS_DESCR
/end CHARACTERISTIC
/begin CHARACTERISTIC One_D_Fix.FIX_uint32_uint32.All_Curves_FIX.Curves_Raster_2 "" CURVE 0x1D118C STANDARD_FIXED_U32 0.0 ident 0.0 4294967295.0
 /begin AXIS_DESCR FIX_AXIS M_In.FIX_uint32_uint32.All_Curves_FIX.Curves_Raster_2 ident 10 0.0 4294967295.0 FIX_AXIS_PAR_DIST 0 1 10 /end AXIS_DESCR
/end CHARACTERISTIC
/begin CHARACTERISTIC One_D_Fix.FIX_uint32_uint32.All_Curves_FIX.Curves_Raster_3 "" CURVE 0x1D156C STANDARD_FIXED_U32 0.0 ident 0.0 4294967295.0
 /begin AXIS_DESCR FIX_AXIS M_In.FIX_uint32_uint32.All_Curves_FIX.Curves_Raster_3 ident 10 0.0 4294967295.0 FIX_AXIS_PAR_DIST 0 1 10 /end AXIS_DESCR
/end CHARACTERISTIC
/begin CHARACTERISTIC One_D_Fix.FIX_uint8_uint8.All_Curves_FIX.Curves_Raster_1 "" CURVE 0x1D0DDD STANDARD_FIXED_U8 0.0 ident 0.0 255.0
 /begin AXIS_DESCR FIX_AXIS M_In.FIX_uint8_uint8.All_Curves_FIX.Curves_Raster_1 ident 10 0.0 255.0 FIX_AXIS_PAR_DIST 0 1 10 /end AXIS_DESCR
/end CHARACTERISTIC
/begin CHARACTERISTIC One_D_Fix.FIX_uint8_uint8.All_Curves_FIX.Curves_Raster_2 "" CURVE 0x1D11BD STANDARD_FIXED_U8 0.0 ident 0.0 255.0
 /begin AXIS_DESCR FIX_AXIS M_In.FIX_uint8_uint8.All_Curves_FIX.Curves_Raster_2 ident 10 0.0 255.0 FIX_AXIS_PAR_DIST 0 1 10 /end AXIS_DESCR
/end CHARACTERISTIC
/begin CHARACTERISTIC One_D_Fix.FIX_uint8_uint8.All_Curves_FIX.Curves_Raster_3 "" CURVE 0x1D159D STANDARD_FIXED_U8 0.0 ident 0.0 255.0
 /begin AXIS_DESCR FIX_AXIS M_In.FIX_uint8_uint8.All_Curves_FIX.Curves_Raster_3 ident 10 0.0 255.0 FIX_AXIS_PAR_DIST 0 1 10 /end AXIS_DESCR
/end CHARACTERISTIC
/begin CHARACTERISTIC p_ChecksumByteOrder_u8.ALL_PROT "" VALUE 0x1D0041 STANDARD_VALUE_U8 0.0 enum_XCP_ByteOrder_e 0 1 /end CHARACTERISTIC
/begin CHARACTERISTIC p_ChecksumType_u8.ALL_PROT "" VALUE 0x1D0040 STANDARD_VALUE_U8 0.0 enum_XCP_ChecksumType_e 0 7 /end CHARACTERISTIC
/begin CHARACTERISTIC P_Do_Active_Fix.FIX_sint16_sint16.All_Curves_FIX.Curves_Raster_1 "" VALUE 0x1D0CFE STANDARD_VALUE_S8 0.0 ident 0 1 BIT_MASK 0x1 /end CHARACTERISTIC
/begin CHARACTERISTIC P_Do_Active_Fix.FIX_sint16_sint16.All_Curves_FIX.Curves_Raster_2 "" VALUE 0x1D10DE STANDARD_VALUE_S8 0.0 ident 0 1 BIT_MASK 0x1 /end CHARACTERISTIC
/begin CHARACTERISTIC P_Do_Active_Fix.FIX_sint16_sint16.All_Curves_FIX.Curves_Raster_3 "" VALUE 0x1D14BE STANDARD_VALUE_S8 0.0 ident 0 1 BIT_MASK 0x1 /end CHARACTERISTIC
/begin CHARACTERISTIC P_Do_Active_Fix.FIX_sint32_sint32.All_Curves_FIX.Curves_Raster_1 "" VALUE 0x1D0D24 STANDARD_VALUE_S8 0.0 ident 0 1 BIT_MASK 0x1 /end CHARACTERISTIC
/begin CHARACTERISTIC P_Do_Active_Fix.FIX_sint32_sint32.All_Curves_FIX.Curves_Raster_2 "" VALUE 0x1D1104 STANDARD_VALUE_S8 0.0 ident 0 1 BIT_MASK 0x1 /end CHARACTERISTIC
/begin CHARACTERISTIC P_Do_Active_Fix.FIX_sint32_sint32.All_Curves_FIX.Curves_Raster_3 "" VALUE 0x1D14E4 STANDARD_VALUE_S8 0.0 ident 0 1 BIT_MASK 0x1 /end CHARACTERISTIC
/begin CHARACTERISTIC P_Do_Active_Fix.FIX_sint8_sint8.All_Curves_FIX.Curves_Raster_1 "" VALUE 0x1D0D60 STANDARD_VALUE_S8 0.0 ident 0 1 BIT_MASK 0x1 /end CHARACTERISTIC
/begin CHARACTERISTIC P_Do_Active_Fix.FIX_sint8_sint8.All_Curves_FIX.Curves_Raster_2 "" VALUE 0x1D1140 STANDARD_VALUE_S8 0.0 ident 0 1 BIT_MASK 0x1 /end CHARACTERISTIC
/begin CHARACTERISTIC P_Do_Active_Fix.FIX_sint8_sint8.All_Curves_FIX.Curves_Raster_3 "" VALUE 0x1D1520 STANDARD_VALUE_S8 0.0 ident 0 1 BIT_MASK 0x1 /end CHARACTERISTIC
/begin CHARACTERISTIC P_Do_Active_Fix.FIX_uint16_uint16.All_Curves_FIX.Curves_Raster_1 "" VALUE 0x1D0D76 STANDARD_VALUE_S8 0.0 ident 0 1 BIT_MASK 0x1 /end CHARACTERISTIC
/begin CHARACTERISTIC P_Do_Active_Fix.FIX_uint16_uint16.All_Curves_FIX.Curves_Raster_2 "" VALUE 0x1D1156 STANDARD_VALUE_S8 0.0 ident 0 1 BIT_MASK 0x1 /end CHARACTERISTIC
/begin CHARACTERISTIC P_Do_Active_Fix.FIX_uint16_uint16.All_Curves_FIX.Curves_Raster_3 "" VALUE 0x1D1536 STANDARD_VALUE_S8 0.0 ident 0 1 BIT_MASK 0x1 /end CHARACTERISTIC
/begin CHARACTERISTIC P_Do_Active_Fix.FIX_uint32_uint32.All_Curves_FIX.Curves_Raster_1 "" VALUE 0x1D0D9C STANDARD_VALUE_S8 0.0 ident 0 1 BIT_MASK 0x1 /end CHARACTERISTIC
/begin CHARACTERISTIC P_Do_Active_Fix.FIX_uint32_uint32.All_Curves_FIX.Curves_Raster_2 "" VALUE 0x1D117C STANDARD_VALUE_S8 0.0 ident 0 1 BIT_MASK 0x1 /end CHARACTERISTIC
/begin CHARACTERISTIC P_Do_Active_Fix.FIX_uint32_uint32.All_Curves_FIX.Curves_Raster_3 "" VALUE 0x1D155C STANDARD_VALUE_S8 0.0 ident 0 1 BIT_MASK 0x1 /end CHARACTERISTIC
/begin CHARACTERISTIC P_Do_Active_Fix.FIX_uint8_uint8.All_Curves_FIX.Curves_Raster_1 "" VALUE 0x1D0DD8 STANDARD_VALUE_S8 0.0 ident 0 1 BIT_MASK 0x1 /end CHARACTERISTIC
/begin CHARACTERISTIC P_Do_Active_Fix.FIX_uint8_uint8.All_Curves_FIX.Curves_Raster_2 "" VALUE 0x1D11B8 STANDARD_VALUE_S8 0.0 ident 0 1 BIT_MASK 0x1 /end CHARACTERISTIC
/begin CHARACTERISTIC P_Do_Active_Fix.FIX_uint8_uint8.All_Curves_FIX.Curves_Raster_3 "" VALUE 0x1D1598 STANDARD_VALUE_S8 0.0 ident 0 1 BIT_MASK 0x1 /end CHARACTERISTIC
/begin CHARACTERISTIC P_Do_Active_Grp.GRP_sint16_sint16.All_Curves_GRP.Curves_Raster_1 "" VALUE 0x1D0DF6 STANDARD_VALUE_U8 0.0 ident 0 1 BIT_MASK 0x1 /end CHARACTERISTIC
/begin CHARACTERISTIC P_Do_Active_Grp.GRP_sint16_sint16.All_Curves_GRP.Curves_Raster_2 "" VALUE 0x1D11D6 STANDARD_VALUE_U8 0.0 ident 0 1 BIT_MASK 0x1 /end CHARACTERISTIC
/begin CHARACTERISTIC P_Do_Active_Grp.GRP_sint16_sint16.All_Curves_GRP.Curves_Raster_3 "" VALUE 0x1D15B6 STANDARD_VALUE_U8 0.0 ident 0 1 BIT_MASK 0x1 /end CHARACTERISTIC
/begin CHARACTERISTIC P_Do_Active_Grp.GRP_sint32_sint32.All_Curves_GRP.Curves_Raster_1 "" VALUE 0x1D0E30 STANDARD_VALUE_S8 0.0 ident 0 1 BIT_MASK 0x1 /end CHARACTERISTIC
/begin CHARACTERISTIC P_Do_Active_Grp.GRP_sint32_sint32.All_Curves_GRP.Curves_Raster_2 "" VALUE 0x1D1210 STANDARD_VALUE_S8 0.0 ident 0 1 BIT_MASK 0x1 /end CHARACTERISTIC
/begin CHARACTERISTIC P_Do_Active_Grp.GRP_sint32_sint32.All_Curves_GRP.Curves_Raster_3 "" VALUE 0x1D15F0 STANDARD_VALUE_S8 0.0 ident 0 1 BIT_MASK 0x1 /end CHARACTERISTIC
/begin CHARACTERISTIC P_Do_Active_Grp.GRP_sint8_sint8.All_Curves_GRP.Curves_Raster_1 "" VALUE 0x1D0E90 STANDARD_VALUE_U8 0.0 ident 0 1 BIT_MASK 0x1 /end CHARACTERISTIC
/begin CHARACTERISTIC P_Do_Active_Grp.GRP_sint8_sint8.All_Curves_GRP.Curves_Raster_2 "" VALUE 0x1D1270 STANDARD_VALUE_U8 0.0 ident 0 1 BIT_MASK 0x1 /end CHARACTERISTIC
/begin CHARACTERISTIC P_Do_Active_Grp.GRP_sint8_sint8.All_Curves_GRP.Curves_Raster_3 "" VALUE 0x1D1650 STANDARD_VALUE_U8 0.0 ident 0 1 BIT_MASK 0x1 /end CHARACTERISTIC
/begin CHARACTERISTIC P_Do_Active_Grp.GRP_uint16_uint16.All_Curves_GRP.Curves_Raster_1 "" VALUE 0x1D0EB6 STANDARD_VALUE_U8 0.0 ident 0 1 BIT_MASK 0x1 /end CHARACTERISTIC
/begin CHARACTERISTIC P_Do_Active_Grp.GRP_uint16_uint16.All_Curves_GRP.Curves_Raster_2 "" VALUE 0x1D1296 STANDARD_VALUE_U8 0.0 ident 0 1 BIT_MASK 0x1 /end CHARACTERISTIC
/begin CHARACTERISTIC P_Do_Active_Grp.GRP_uint16_uint16.All_Curves_GRP.Curves_Raster_3 "" VALUE 0x1D1676 STANDARD_VALUE_U8 0.0 ident 0 1 BIT_MASK 0x1 /end CHARACTERISTIC
/begin CHARACTERISTIC P_Do_Active_Grp.GRP_uint32_uint32.All_Curves_GRP.Curves_Raster_1 "" VALUE 0x1D0EF0 STANDARD_VALUE_S8 0.0 ident 0 1 BIT_MASK 0x1 /end CHARACTERISTIC
/begin CHARACTERISTIC P_Do_Active_Grp.GRP_uint32_uint32.All_Curves_GRP.Curves_Raster_2 "" VALUE 0x1D12D0 STANDARD_VALUE_S8 0.0 ident 0 1 BIT_MASK 0x1 /end CHARACTERISTIC
/begin CHARACTERISTIC P_Do_Active_Grp.GRP_uint32_uint32.All_Curves_GRP.Curves_Raster_3 "" VALUE 0x1D16B0 STANDARD_VALUE_S8 0.0 ident 0 1 BIT_MASK 0x1 /end CHARACTERISTIC
/begin CHARACTERISTIC P_Do_Active_Grp.GRP_uint8_uint8.All_Curves_GRP.Curves_Raster_1 "" VALUE 0x1D0F50 STANDARD_VALUE_U8 0.0 ident 0 1 BIT_MASK 0x1 /end CHARACTERISTIC
/begin CHARACTERISTIC P_Do_Active_Grp.GRP_uint8_uint8.All_Curves_GRP.Curves_Raster_2 "" VALUE 0x1D1330 STANDARD_VALUE_U8 0.0 ident 0 1 BIT_MASK 0x1 /end CHARACTERISTIC
/begin CHARACTERISTIC P_Do_Active_Grp.GRP_uint8_uint8.All_Curves_GRP.Curves_Raster_3 "" VALUE 0x1D1710 STANDARD_VALUE_U8 0.0 ident 0 1 BIT_MASK 0x1 /end CHARACTERISTIC
/begin CHARACTERISTIC P_Do_Active_Std.STD_sint16_sint16.All_Curves_STD.Curves_Raster_1 "" VALUE 0x1D0F76 STANDARD_VALUE_U8 0.0 ident 0 1 BIT_MASK 0x1 /end CHARACTERISTIC
/begin CHARACTERISTIC P_Do_Active_Std.STD_sint16_sint16.All_Curves_STD.Curves_Raster_2 "" VALUE 0x1D1356 STANDARD_VALUE_U8 0.0 ident 0 1 BIT_MASK 0x1 /end CHARACTERISTIC
/begin CHARACTERISTIC P_Do_Active_Std.STD_sint16_sint16.All_Curves_STD.Curves_Raster_3 "" VALUE 0x1D1736 STANDARD_VALUE_U8 0.0 ident 0 1 BIT_MASK 0x1 /end CHARACTERISTIC
/begin CHARACTERISTIC P_Do_Active_Std.STD_sint32_sint32.All_Curves_STD.Curves_Raster_1 "" VALUE 0x1D0FAC STANDARD_VALUE_U8 0.0 ident 0 1 BIT_MASK 0x1 /end CHARACTERISTIC
/begin CHARACTERISTIC P_Do_Active_Std.STD_sint32_sint32.All_Curves_STD.Curves_Raster_2 "" VALUE 0x1D138C STANDARD_VALUE_U8 0.0 ident 0 1 BIT_MASK 0x1 /end CHARACTERISTIC
/begin CHARACTERISTIC P_Do_Active_Std.STD_sint32_sint32.All_Curves_STD.Curves_Raster_3 "" VALUE 0x1D176C STANDARD_VALUE_U8 0.0 ident 0 1 BIT_MASK 0x1 /end CHARACTERISTIC
/begin CHARACTERISTIC P_Do_Active_Std.STD_sint8_sint8.All_Curves_STD.Curves_Raster_1 "" VALUE 0x1D1008 STANDARD_VALUE_U8 0.0 ident 0 1 BIT_MASK 0x1 /end CHARACTERISTIC
/begin CHARACTERISTIC P_Do_Active_Std.STD_sint8_sint8.All_Curves_STD.Curves_Raster_2 "" VALUE 0x1D13E8 STANDARD_VALUE_U8 0.0 ident 0 1 BIT_MASK 0x1 /end CHARACTERISTIC
/begin CHARACTERISTIC P_Do_Active_Std.STD_sint8_sint8.All_Curves_STD.Curves_Raster_3 "" VALUE 0x1D17C8 STANDARD_VALUE_U8 0.0 ident 0 1 BIT_MASK 0x1 /end CHARACTERISTIC
/begin CHARACTERISTIC P_Do_Active_Std.STD_uint16_uint16.All_Curves_STD.Curves_Raster_1 "" VALUE 0x1D1026 STANDARD_VALUE_U8 0.0 ident 0 1 BIT_MASK 0x1 /end CHARACTERISTIC
/begin CHARACTERISTIC P_Do_Active_Std.STD_uint16_uint16.All_Curves_STD.Curves_Raster_2 "" VALUE 0x1D1406 STANDARD_VALUE_U8 0.0 ident 0 1 BIT_MASK 0x1 /end CHARACTERISTIC
/begin CHARACTERISTIC P_Do_Active_Std.STD_uint16_uint16.All_Curves_STD.Curves_Raster_3 "" VALUE 0x1D17E6 STANDARD_VALUE_U8 0.0 ident 0 1 BIT_MASK 0x1 /end CHARACTERISTIC
/begin CHARACTERISTIC P_Do_Active_Std.STD_uint32_uint32.All_Curves_STD.Curves_Raster_1 "" VALUE 0x1D105C STANDARD_VALUE_U8 0.0 ident 0 1 BIT_MASK 0x1 /end CHARACTERISTIC
/begin CHARACTERISTIC P_Do_Active_Std.STD_uint32_uint32.All_Curves_STD.Curves_Raster_2 "" VALUE 0x1D143C STANDARD_VALUE_U8 0.0 ident 0 1 BIT_MASK 0x1 /end CHARACTERISTIC
/begin CHARACTERISTIC P_Do_Active_Std.STD_uint32_uint32.All_Curves_STD.Curves_Raster_3 "" VALUE 0x1D181C STANDARD_VALUE_U8 0.0 ident 0 1 BIT_MASK 0x1 /end CHARACTERISTIC
/begin CHARACTERISTIC P_Do_Active_Std.STD_uint8_uint8.All_Curves_STD.Curves_Raster_1 "" VALUE 0x1D10B8 STANDARD_VALUE_U8 0.0 ident 0 1 BIT_MASK 0x1 /end CHARACTERISTIC
/begin CHARACTERISTIC P_Do_Active_Std.STD_uint8_uint8.All_Curves_STD.Curves_Raster_2 "" VALUE 0x1D1498 STANDARD_VALUE_U8 0.0 ident 0 1 BIT_MASK 0x1 /end CHARACTERISTIC
/begin CHARACTERISTIC P_Do_Active_Std.STD_uint8_uint8.All_Curves_STD.Curves_Raster_3 "" VALUE 0x1D1878 STANDARD_VALUE_U8 0.0 ident 0 1 BIT_MASK 0x1 /end CHARACTERISTIC
/begin CHARACTERISTIC P_Do_All_FIX_Curves.All_Curves_FIX.Curves_Raster_1 "" VALUE 0x1D0CF4 STANDARD_VALUE_U8 0.0 ident 0 1 BIT_MASK 0x1 /end CHARACTERISTIC
/begin CHARACTERISTIC P_Do_All_FIX_Curves.All_Curves_FIX.Curves_Raster_2 "" VALUE 0x1D10D4 STANDARD_VALUE_U8 0.0 ident 0 1 BIT_MASK 0x1 /end CHARACTERISTIC
/begin CHARACTERISTIC P_Do_All_FIX_Curves.All_Curves_FIX.Curves_Raster_3 "" VALUE 0x1D14B4 STANDARD_VALUE_U8 0.0 ident 0 1 BIT_MASK 0x1 /end CHARACTERISTIC
/begin CHARACTERISTIC P_Do_All_GRP_Curves.All_Curves_GRP.Curves_Raster_1 "" VALUE 0x1D0DE8 STANDARD_VALUE_U8 0.0 ident 0 1 BIT_MASK 0x1 /end CHARACTERISTIC
/begin CHARACTERISTIC P_Do_All_GRP_Curves.All_Curves_GRP.Curves_Raster_2 "" VALUE 0x1D11C8 STANDARD_VALUE_U8 0.0 ident 0 1 BIT_MASK 0x1 /end CHARACTERISTIC
/begin CHARACTERISTIC P_Do_All_GRP_Curves.All_Curves_GRP.Curves_Raster_3 "" VALUE 0x1D15A8 STANDARD_VALUE_U8 0.0 ident 0 1 BIT_MASK 0x1 /end CHARACTERISTIC
/begin CHARACTERISTIC P_Do_All_STD_Curves.All_Curves_STD.Curves_Raster_1 "" VALUE 0x1D0F6C STANDARD_VALUE_U8 0.0 ident 0 1 BIT_MASK 0x1 /end CHARACTERISTIC
/begin CHARACTERISTIC P_Do_All_STD_Curves.All_Curves_STD.Curves_Raster_2 "" VALUE 0x1D134C STANDARD_VALUE_U8 0.0 ident 0 1 BIT_MASK 0x1 /end CHARACTERISTIC
/begin CHARACTERISTIC P_Do_All_STD_Curves.All_Curves_STD.Curves_Raster_3 "" VALUE 0x1D172C STANDARD_VALUE_U8 0.0 ident 0 1 BIT_MASK 0x1 /end CHARACTERISTIC
/begin CHARACTERISTIC P_Do_Grp_get.GRP_sint16_sint16.All_Curves_GRP.Curves_Raster_1 "" VALUE 0x1D0DF7 STANDARD_VALUE_S8 0.0 ident 0 1 BIT_MASK 0x1 /end CHARACTERISTIC
/begin CHARACTERISTIC P_Do_Grp_get.GRP_sint16_sint16.All_Curves_GRP.Curves_Raster_2 "" VALUE 0x1D11D7 STANDARD_VALUE_S8 0.0 ident 0 1 BIT_MASK 0x1 /end CHARACTERISTIC
/begin CHARACTERISTIC P_Do_Grp_get.GRP_sint16_sint16.All_Curves_GRP.Curves_Raster_3 "" VALUE 0x1D15B7 STANDARD_VALUE_S8 0.0 ident 0 1 BIT_MASK 0x1 /end CHARACTERISTIC
/begin CHARACTERISTIC P_Do_Grp_get.GRP_sint32_sint32.All_Curves_GRP.Curves_Raster_1 "" VALUE 0x1D0E31 STANDARD_VALUE_S8 0.0 ident 0 1 BIT_MASK 0x1 /end CHARACTERISTIC
/begin CHARACTERISTIC P_Do_Grp_get.GRP_sint32_sint32.All_Curves_GRP.Curves_Raster_2 "" VALUE 0x1D1211 STANDARD_VALUE_S8 0.0 ident 0 1 BIT_MASK 0x1 /end CHARACTERISTIC
/begin CHARACTERISTIC P_Do_Grp_get.GRP_sint32_sint32.All_Curves_GRP.Curves_Raster_3 "" VALUE 0x1D15F1 STANDARD_VALUE_S8 0.0 ident 0 1 BIT_MASK 0x1 /end CHARACTERISTIC
/begin CHARACTERISTIC P_Do_Grp_get.GRP_sint8_sint8.All_Curves_GRP.Curves_Raster_1 "" VALUE 0x1D0E91 STANDARD_VALUE_S8 0.0 ident 0 1 BIT_MASK 0x1 /end CHARACTERISTIC
/begin CHARACTERISTIC P_Do_Grp_get.GRP_sint8_sint8.All_Curves_GRP.Curves_Raster_2 "" VALUE 0x1D1271 STANDARD_VALUE_S8 0.0 ident 0 1 BIT_MASK 0x1 /end CHARACTERISTIC
/begin CHARACTERISTIC P_Do_Grp_get.GRP_sint8_sint8.All_Curves_GRP.Curves_Raster_3 "" VALUE 0x1D1651 STANDARD_VALUE_S8 0.0 ident 0 1 BIT_MASK 0x1 /end CHARACTERISTIC
/begin CHARACTERISTIC P_Do_Grp_get.GRP_uint16_uint16.All_Curves_GRP.Curves_Raster_1 "" VALUE 0x1D0EB7 STANDARD_VALUE_S8 0.0 ident 0 1 BIT_MASK 0x1 /end CHARACTERISTIC
/begin CHARACTERISTIC P_Do_Grp_get.GRP_uint16_uint16.All_Curves_GRP.Curves_Raster_2 "" VALUE 0x1D1297 STANDARD_VALUE_S8 0.0 ident 0 1 BIT_MASK 0x1 /end CHARACTERISTIC
/begin CHARACTERISTIC P_Do_Grp_get.GRP_uint16_uint16.All_Curves_GRP.Curves_Raster_3 "" VALUE 0x1D1677 STANDARD_VALUE_S8 0.0 ident 0 1 BIT_MASK 0x1 /end CHARACTERISTIC
/begin CHARACTERISTIC P_Do_Grp_get.GRP_uint32_uint32.All_Curves_GRP.Curves_Raster_1 "" VALUE 0x1D0EF1 STANDARD_VALUE_S8 0.0 ident 0 1 BIT_MASK 0x1 /end CHARACTERISTIC
/begin CHARACTERISTIC P_Do_Grp_get.GRP_uint32_uint32.All_Curves_GRP.Curves_Raster_2 "" VALUE 0x1D12D1 STANDARD_VALUE_S8 0.0 ident 0 1 BIT_MASK 0x1 /end CHARACTERISTIC
/begin CHARACTERISTIC P_Do_Grp_get.GRP_uint32_uint32.All_Curves_GRP.Curves_Raster_3 "" VALUE 0x1D16B1 STANDARD_VALUE_S8 0.0 ident 0 1 BIT_MASK 0x1 /end CHARACTERISTIC
/begin CHARACTERISTIC P_Do_Grp_get.GRP_uint8_uint8.All_Curves_GRP.Curves_Raster_1 "" VALUE 0x1D0F51 STANDARD_VALUE_S8 0.0 ident 0 1 BIT_MASK 0x1 /end CHARACTERISTIC
/begin CHARACTERISTIC P_Do_Grp_get.GRP_uint8_uint8.All_Curves_GRP.Curves_Raster_2 "" VALUE 0x1D1331 STANDARD_VALUE_S8 0.0 ident 0 1 BIT_MASK 0x1 /end CHARACTERISTIC
/begin CHARACTERISTIC P_Do_Grp_get.GRP_uint8_uint8.All_Curves_GRP.Curves_Raster_3 "" VALUE 0x1D1711 STANDARD_VALUE_S8 0.0 ident 0 1 BIT_MASK 0x1 /end CHARACTERISTIC
/begin CHARACTERISTIC P_Do_Grp_set.GRP_sint16_sint16.All_Curves_GRP.Curves_Raster_1 "" VALUE 0x1D0DF8 STANDARD_VALUE_S8 0.0 ident 0 1 BIT_MASK 0x1 /end CHARACTERISTIC
/begin CHARACTERISTIC P_Do_Grp_set.GRP_sint16_sint16.All_Curves_GRP.Curves_Raster_2 "" VALUE 0x1D11D8 STANDARD_VALUE_S8 0.0 ident 0 1 BIT_MASK 0x1 /end CHARACTERISTIC
/begin CHARACTERISTIC P_Do_Grp_set.GRP_sint16_sint16.All_Curves_GRP.Curves_Raster_3 "" VALUE 0x1D15B8 STANDARD_VALUE_S8 0.0 ident 0 1 BIT_MASK 0x1 /end CHARACTERISTIC
/begin CHARACTERISTIC P_Do_Grp_set.GRP_sint32_sint32.All_Curves_GRP.Curves_Raster_1 "" VALUE 0x1D0E32 STANDARD_VALUE_S8 0.0 ident 0 1 BIT_MASK 0x1 /end CHARACTERISTIC
/begin CHARACTERISTIC P_Do_Grp_set.GRP_sint32_sint32.All_Curves_GRP.Curves_Raster_2 "" VALUE 0x1D1212 STANDARD_VALUE_S8 0.0 ident 0 1 BIT_MASK 0x1 /end CHARACTERISTIC
/begin CHARACTERISTIC P_Do_Grp_set.GRP_sint32_sint32.All_Curves_GRP.Curves_Raster_3 "" VALUE 0x1D15F2 STANDARD_VALUE_S8 0.0 ident 0 1 BIT_MASK 0x1 /end CHARACTERISTIC
/begin CHARACTERISTIC P_Do_Grp_set.GRP_sint8_sint8.All_Curves_GRP.Curves_Raster_1 "" VALUE 0x1D0E92 STANDARD_VALUE_S8 0.0 ident 0 1 BIT_MASK 0x1 /end CHARACTERISTIC
/begin CHARACTERISTIC P_Do_Grp_set.GRP_sint8_sint8.All_Curves_GRP.Curves_Raster_2 "" VALUE 0x1D1272 STANDARD_VALUE_S8 0.0 ident 0 1 BIT_MASK 0x1 /end CHARACTERISTIC
/begin CHARACTERISTIC P_Do_Grp_set.GRP_sint8_sint8.All_Curves_GRP.Curves_Raster_3 "" VALUE 0x1D1652 STANDARD_VALUE_S8 0.0 ident 0 1 BIT_MASK 0x1 /end CHARACTERISTIC
/begin CHARACTERISTIC P_Do_Grp_set.GRP_uint16_uint16.All_Curves_GRP.Curves_Raster_1 "" VALUE 0x1D0EB8 STANDARD_VALUE_S8 0.0 ident 0 1 BIT_MASK 0x1 /end CHARACTERISTIC
/begin CHARACTERISTIC P_Do_Grp_set.GRP_uint16_uint16.All_Curves_GRP.Curves_Raster_2 "" VALUE 0x1D1298 STANDARD_VALUE_S8 0.0 ident 0 1 BIT_MASK 0x1 /end CHARACTERISTIC
/begin CHARACTERISTIC P_Do_Grp_set.GRP_uint16_uint16.All_Curves_GRP.Curves_Raster_3 "" VALUE 0x1D1678 STANDARD_VALUE_S8 0.0 ident 0 1 BIT_MASK 0x1 /end CHARACTERISTIC
/begin CHARACTERISTIC P_Do_Grp_set.GRP_uint32_uint32.All_Curves_GRP.Curves_Raster_1 "" VALUE 0x1D0EF2 STANDARD_VALUE_S8 0.0 ident 0 1 BIT_MASK 0x1 /end CHARACTERISTIC
/begin CHARACTERISTIC P_Do_Grp_set.GRP_uint32_uint32.All_Curves_GRP.Curves_Raster_2 "" VALUE 0x1D12D2 STANDARD_VALUE_S8 0.0 ident 0 1 BIT_MASK 0x1 /end CHARACTERISTIC
/begin CHARACTERISTIC P_Do_Grp_set.GRP_uint32_uint32.All_Curves_GRP.Curves_Raster_3 "" VALUE 0x1D16B2 STANDARD_VALUE_S8 0.0 ident 0 1 BIT_MASK 0x1 /end CHARACTERISTIC
/begin CHARACTERISTIC P_Do_Grp_set.GRP_uint8_uint8.All_Curves_GRP.Curves_Raster_1 "" VALUE 0x1D0F52 STANDARD_VALUE_S8 0.0 ident 0 1 BIT_MASK 0x1 /end CHARACTERISTIC
/begin CHARACTERISTIC P_Do_Grp_set.GRP_uint8_uint8.All_Curves_GRP.Curves_Raster_2 "" VALUE 0x1D1332 STANDARD_VALUE_S8 0.0 ident 0 1 BIT_MASK 0x1 /end CHARACTERISTIC
/begin CHARACTERISTIC P_Do_Grp_set.GRP_uint8_uint8.All_Curves_GRP.Curves_Raster_3 "" VALUE 0x1D1712 STANDARD_VALUE_S8 0.0 ident 0 1 BIT_MASK 0x1 /end CHARACTERISTIC
/begin CHARACTERISTIC P_In.FIX_sint16_sint16.All_Curves_FIX.Curves_Raster_1 "" VALUE 0x1D0CFC STANDARD_VALUE_S16 0.0 ident -32768.0 32767.0 /end CHARACTERISTIC
/begin CHARACTERISTIC P_In.FIX_sint16_sint16.All_Curves_FIX.Curves_Raster_2 "" VALUE 0x1D10DC STANDARD_VALUE_S16 0.0 ident -32768.0 32767.0 /end CHARACTERISTIC
/begin CHARACTERISTIC P_In.FIX_sint16_sint16.All_Curves_FIX.Curves_Raster_3 "" VALUE 0x1D14BC STANDARD_VALUE_S16 0.0 ident -32768.0 32767.0 /end CHARACTERISTIC
/begin CHARACTERISTIC P_In.FIX_sint32_sint32.All_Curves_FIX.Curves_Raster_1 "" VALUE 0x1D0D20 STANDARD_VALUE_S32 0.0 ident -2147483648.0 2147483647.0 /end CHARACTERISTIC
/begin CHARACTERISTIC P_In.FIX_sint32_sint32.All_Curves_FIX.Curves_Raster_2 "" VALUE 0x1D1100 STANDARD_VALUE_S32 0.0 ident -2147483648.0 2147483647.0 /end CHARACTERISTIC
/begin CHARACTERISTIC P_In.FIX_sint32_sint32.All_Curves_FIX.Curves_Raster_3 "" VALUE 0x1D14E0 STANDARD_VALUE_S32 0.0 ident -2147483648.0 2147483647.0 /end CHARACTERISTIC
/begin CHARACTERISTIC P_In.FIX_sint8_sint8.All_Curves_FIX.Curves_Raster_1 "" VALUE 0x1D0D61 STANDARD_VALUE_S8 0.0 ident -128.0 127.0 /end CHARACTERISTIC
/begin CHARACTERISTIC P_In.FIX_sint8_sint8.All_Curves_FIX.Curves_Raster_2 "" VALUE 0x1D1141 STANDARD_VALUE_S8 0.0 ident -128.0 127.0 /end CHARACTERISTIC
/begin CHARACTERISTIC P_In.FIX_sint8_sint8.All_Curves_FIX.Curves_Raster_3 "" VALUE 0x1D1521 STANDARD_VALUE_S8 0.0 ident -128.0 127.0 /end CHARACTERISTIC
/begin CHARACTERISTIC P_In.FIX_uint16_uint16.All_Curves_FIX.Curves_Raster_1 "" VALUE 0x1D0D74 STANDARD_VALUE_U16 0.0 ident 0.0 65535.0 /end CHARACTERISTIC
/begin CHARACTERISTIC P_In.FIX_uint16_uint16.All_Curves_FIX.Curves_Raster_2 "" VALUE 0x1D1154 STANDARD_VALUE_U16 0.0 ident 0.0 65535.0 /end CHARACTERISTIC
/begin CHARACTERISTIC P_In.FIX_uint16_uint16.All_Curves_FIX.Curves_Raster_3 "" VALUE 0x1D1534 STANDARD_VALUE_U16 0.0 ident 0.0 65535.0 /end CHARACTERISTIC
/begin CHARACTERISTIC P_In.FIX_uint32_uint32.All_Curves_FIX.Curves_Raster_1 "" VALUE 0x1D0D98 STANDARD_VALUE_U32 0.0 ident 0.0 4294967295.0 /end CHARACTERISTIC
/begin CHARACTERISTIC P_In.FIX_uint32_uint32.All_Curves_FIX.Curves_Raster_2 "" VALUE 0x1D1178 STANDARD_VALUE_U32 0.0 ident 0.0 4294967295.0 /end CHARACTERISTIC
/begin CHARACTERISTIC P_In.FIX_uint32_uint32.All_Curves_FIX.Curves_Raster_3 "" VALUE 0x1D1558 STANDARD_VALUE_U32 0.0 ident 0.0 4294967295.0 /end CHARACTERISTIC
/begin CHARACTERISTIC P_In.FIX_uint8_uint8.All_Curves_FIX.Curves_Raster_1 "" VALUE 0x1D0DD9 STANDARD_VALUE_U8 0.0 ident 0.0 255.0 /end CHARACTERISTIC
/begin CHARACTERISTIC P_In.FIX_uint8_uint8.All_Curves_FIX.Curves_Raster_2 "" VALUE 0x1D11B9 STANDARD_VALUE_U8 0.0 ident 0.0 255.0 /end CHARACTERISTIC
/begin CHARACTERISTIC P_In.FIX_uint8_uint8.All_Curves_FIX.Curves_Raster_3 "" VALUE 0x1D1599 STANDARD_VALUE_U8 0.0 ident 0.0 255.0 /end CHARACTERISTIC
/begin CHARACTERISTIC P_In.GRP_sint16_sint16.All_Curves_GRP.Curves_Raster_1 "" VALUE 0x1D0DF4 STANDARD_VALUE_S16 0.0 ident -32768.0 32767.0 /end CHARACTERISTIC
/begin CHARACTERISTIC P_In.GRP_sint16_sint16.All_Curves_GRP.Curves_Raster_2 "" VALUE 0x1D11D4 STANDARD_VALUE_S16 0.0 ident -32768.0 32767.0 /end CHARACTERISTIC
/begin CHARACTERISTIC P_In.GRP_sint16_sint16.All_Curves_GRP.Curves_Raster_3 "" VALUE 0x1D15B4 STANDARD_VALUE_S16 0.0 ident -32768.0 32767.0 /end CHARACTERISTIC
/begin CHARACTERISTIC P_In.GRP_sint32_sint32.All_Curves_GRP.Curves_Raster_1 "" VALUE 0x1D0E2C STANDARD_VALUE_S32 0.0 ident -2147483648.0 2147483647.0 /end CHARACTERISTIC
/begin CHARACTERISTIC P_In.GRP_sint32_sint32.All_Curves_GRP.Curves_Raster_2 "" VALUE 0x1D120C STANDARD_VALUE_S32 0.0 ident -2147483648.0 2147483647.0 /end CHARACTERISTIC
/begin CHARACTERISTIC P_In.GRP_sint32_sint32.All_Curves_GRP.Curves_Raster_3 "" VALUE 0x1D15EC STANDARD_VALUE_S32 0.0 ident -2147483648.0 2147483647.0 /end CHARACTERISTIC
/begin CHARACTERISTIC P_In.GRP_sint8_sint8.All_Curves_GRP.Curves_Raster_1 "" VALUE 0x1D0E93 STANDARD_VALUE_S8 0.0 ident -128.0 127.0 /end CHARACTERISTIC
/begin CHARACTERISTIC P_In.GRP_sint8_sint8.All_Curves_GRP.Curves_Raster_2 "" VALUE 0x1D1273 STANDARD_VALUE_S8 0.0 ident -128.0 127.0 /end CHARACTERISTIC
/begin CHARACTERISTIC P_In.GRP_sint8_sint8.All_Curves_GRP.Curves_Raster_3 "" VALUE 0x1D1653 STANDARD_VALUE_S8 0.0 ident -128.0 127.0 /end CHARACTERISTIC
/begin CHARACTERISTIC P_In.GRP_uint16_uint16.All_Curves_GRP.Curves_Raster_1 "" VALUE 0x1D0EB4 STANDARD_VALUE_U16 0.0 ident 0.0 65535.0 /end CHARACTERISTIC
/begin CHARACTERISTIC P_In.GRP_uint16_uint16.All_Curves_GRP.Curves_Raster_2 "" VALUE 0x1D1294 STANDARD_VALUE_U16 0.0 ident 0.0 65535.0 /end CHARACTERISTIC
/begin CHARACTERISTIC P_In.GRP_uint16_uint16.All_Curves_GRP.Curves_Raster_3 "" VALUE 0x1D1674 STANDARD_VALUE_U16 0.0 ident 0.0 65535.0 /end CHARACTERISTIC
/begin CHARACTERISTIC P_In.GRP_uint32_uint32.All_Curves_GRP.Curves_Raster_1 "" VALUE 0x1D0EEC STANDARD_VALUE_U32 0.0 ident 0.0 4294967295.0 /end CHARACTERISTIC
/begin CHARACTERISTIC P_In.GRP_uint32_uint32.All_Curves_GRP.Curves_Raster_2 "" VALUE 0x1D12CC STANDARD_VALUE_U32 0.0 ident 0.0 4294967295.0 /end CHARACTERISTIC
/begin CHARACTERISTIC P_In.GRP_uint32_uint32.All_Curves_GRP.Curves_Raster_3 "" VALUE 0x1D16AC STANDARD_VALUE_U32 0.0 ident 0.0 4294967295.0 /end CHARACTERISTIC
/begin CHARACTERISTIC P_In.GRP_uint8_uint8.All_Curves_GRP.Curves_Raster_1 "" VALUE 0x1D0F53 STANDARD_VALUE_U8 0.0 ident 0.0 255.0 /end CHARACTERISTIC
/begin CHARACTERISTIC P_In.GRP_uint8_uint8.All_Curves_GRP.Curves_Raster_2 "" VALUE 0x1D1333 STANDARD_VALUE_U8 0.0 ident 0.0 255.0 /end CHARACTERISTIC
/begin CHARACTERISTIC P_In.GRP_uint8_uint8.All_Curves_GRP.Curves_Raster_3 "" VALUE 0x1D1713 STANDARD_VALUE_U8 0.0 ident 0.0 255.0 /end CHARACTERISTIC
/begin CHARACTERISTIC P_In.STD_sint16_sint16.All_Curves_STD.Curves_Raster_1 "" VALUE 0x1D0F74 STANDARD_VALUE_S16 0.0 ident -32768.0 32767.0 /end CHARACTERISTIC
/begin CHARACTERISTIC P_In.STD_sint16_sint16.All_Curves_STD.Curves_Raster_2 "" VALUE 0x1D1354 STANDARD_VALUE_S16 0.0 ident -32768.0 32767.0 /end CHARACTERISTIC
/begin CHARACTERISTIC P_In.STD_sint16_sint16.All_Curves_STD.Curves_Raster_3 "" VALUE 0x1D1734 STANDARD_VALUE_S16 0.0 ident -32768.0 32767.0 /end CHARACTERISTIC
/begin CHARACTERISTIC P_In.STD_sint32_sint32.All_Curves_STD.Curves_Raster_1 "" VALUE 0x1D0FA8 STANDARD_VALUE_S32 0.0 ident -2147483648.0 2147483647.0 /end CHARACTERISTIC
/begin CHARACTERISTIC P_In.STD_sint32_sint32.All_Curves_STD.Curves_Raster_2 "" VALUE 0x1D1388 STANDARD_VALUE_S32 0.0 ident -2147483648.0 2147483647.0 /end CHARACTERISTIC
/begin CHARACTERISTIC P_In.STD_sint32_sint32.All_Curves_STD.Curves_Raster_3 "" VALUE 0x1D1768 STANDARD_VALUE_S32 0.0 ident -2147483648.0 2147483647.0 /end CHARACTERISTIC
/begin CHARACTERISTIC P_In.STD_sint8_sint8.All_Curves_STD.Curves_Raster_1 "" VALUE 0x1D1009 STANDARD_VALUE_S8 0.0 ident -128.0 127.0 /end CHARACTERISTIC
/begin CHARACTERISTIC P_In.STD_sint8_sint8.All_Curves_STD.Curves_Raster_2 "" VALUE 0x1D13E9 STANDARD_VALUE_S8 0.0 ident -128.0 127.0 /end CHARACTERISTIC
/begin CHARACTERISTIC P_In.STD_sint8_sint8.All_Curves_STD.Curves_Raster_3 "" VALUE 0x1D17C9 STANDARD_VALUE_S8 0.0 ident -128.0 127.0 /end CHARACTERISTIC
/begin CHARACTERISTIC P_In.STD_uint16_uint16.All_Curves_STD.Curves_Raster_1 "" VALUE 0x1D1024 STANDARD_VALUE_U16 0.0 ident 0.0 65535.0 /end CHARACTERISTIC
/begin CHARACTERISTIC P_In.STD_uint16_uint16.All_Curves_STD.Curves_Raster_2 "" VALUE 0x1D1404 STANDARD_VALUE_U16 0.0 ident 0.0 65535.0 /end CHARACTERISTIC
/begin CHARACTERISTIC P_In.STD_uint16_uint16.All_Curves_STD.Curves_Raster_3 "" VALUE 0x1D17E4 STANDARD_VALUE_U16 0.0 ident 0.0 65535.0 /end CHARACTERISTIC
/begin CHARACTERISTIC P_In.STD_uint32_uint32.All_Curves_STD.Curves_Raster_1 "" VALUE 0x1D1058 STANDARD_VALUE_U32 0.0 ident 0.0 4294967295.0 /end CHARACTERISTIC
/begin CHARACTERISTIC P_In.STD_uint32_uint32.All_Curves_STD.Curves_Raster_2 "" VALUE 0x1D1438 STANDARD_VALUE_U32 0.0 ident 0.0 4294967295.0 /end CHARACTERISTIC
/begin CHARACTERISTIC P_In.STD_uint32_uint32.All_Curves_STD.Curves_Raster_3 "" VALUE 0x1D1818 STANDARD_VALUE_U32 0.0 ident 0.0 4294967295.0 /end CHARACTERISTIC
/begin CHARACTERISTIC P_In.STD_uint8_uint8.All_Curves_STD.Curves_Raster_1 "" VALUE 0x1D10B9 STANDARD_VALUE_U8 0.0 ident 0.0 255.0 /end CHARACTERISTIC
/begin CHARACTERISTIC P_In.STD_uint8_uint8.All_Curves_STD.Curves_Raster_2 "" VALUE 0x1D1499 STANDARD_VALUE_U8 0.0 ident 0.0 255.0 /end CHARACTERISTIC
/begin CHARACTERISTIC P_In.STD_uint8_uint8.All_Curves_STD.Curves_Raster_3 "" VALUE 0x1D1879 STANDARD_VALUE_U8 0.0 ident 0.0 255.0 /end CHARACTERISTIC
/begin AXIS_PTS distrib.GRP_sint16_sint16.All_Curves_GRP.Curves_Raster_1 "" 0x1D0E0E M_In.GRP_sint16_sint16.All_Curves_GRP.Curves_Raster_1 STANDARD_DIST_S16 0.0 ident 10 -32768.0 32767.0 /end AXIS_PTS
/begin AXIS_PTS distrib.GRP_sint16_sint16.All_Curves_GRP.Curves_Raster_2 "" 0x1D11EE M_In.GRP_sint16_sint16.All_Curves_GRP.Curves_Raster_2 STANDARD_DIST_S16 0.0 ident 10 -32768.0 32767.0 /end AXIS_PTS
/begin AXIS_PTS distrib.GRP_sint16_sint16.All_Curves_GRP.Curves_Raster_3 "" 0x1D15CE M_In.GRP_sint16_sint16.All_Curves_GRP.Curves_Raster_3 STANDARD_DIST_S16 0.0 ident 10 -32768.0 32767.0 /end AXIS_PTS
/begin AXIS_PTS distrib.GRP_sint32_sint32.All_Curves_GRP.Curves_Raster_1 "" 0x1D0E5C M_In.GRP_sint32_sint32.All_Curves_GRP.Curves_Raster_1 STANDARD_DIST_S32 0.0 ident 10 -2147483648.0 2147483647.0 /end AXIS_PTS
/begin AXIS_PTS distrib.GRP_sint32_sint32.All_Curves_GRP.Curves_Raster_2 "" 0x1D123C M_In.GRP_sint32_sint32.All_Curves_GRP.Curves_Raster_2 STANDARD_DIST_S32 0.0 ident 10 -2147483648.0 2147483647.0 /end AXIS_PTS
/begin AXIS_PTS distrib.GRP_sint32_sint32.All_Curves_GRP.Curves_Raster_3 "" 0x1D161C M_In.GRP_sint32_sint32.All_Curves_GRP.Curves_Raster_3 STANDARD_DIST_S32 0.0 ident 10 -2147483648.0 2147483647.0 /end AXIS_PTS
/begin AXIS_PTS distrib.GRP_sint8_sint8.All_Curves_GRP.Curves_Raster_1 "" 0x1D0E9E M_In.GRP_sint8_sint8.All_Curves_GRP.Curves_Raster_1 STANDARD_DIST_S8 0.0 ident 10 -128.0 127.0 /end AXIS_PTS
/begin AXIS_PTS distrib.GRP_sint8_sint8.All_Curves_GRP.Curves_Raster_2 "" 0x1D127E M_In.GRP_sint8_sint8.All_Curves_GRP.Curves_Raster_2 STANDARD_DIST_S8 0.0 ident 10 -128.0 127.0 /end AXIS_PTS
/begin AXIS_PTS distrib.GRP_sint8_sint8.All_Curves_GRP.Curves_Raster_3 "" 0x1D165E M_In.GRP_sint8_sint8.All_Curves_GRP.Curves_Raster_3 STANDARD_DIST_S8 0.0 ident 10 -128.0 127.0 /end AXIS_PTS
/begin AXIS_PTS distrib.GRP_uint16_uint16.All_Curves_GRP.Curves_Raster_1 "" 0x1D0ECE M_In.GRP_uint16_uint16.All_Curves_GRP.Curves_Raster_1 STANDARD_DIST_U16 0.0 ident 10 0.0 65535.0 /end AXIS_PTS
/begin AXIS_PTS distrib.GRP_uint16_uint16.All_Curves_GRP.Curves_Raster_2 "" 0x1D12AE M_In.GRP_uint16_uint16.All_Curves_GRP.Curves_Raster_2 STANDARD_DIST_U16 0.0 ident 10 0.0 65535.0 /end AXIS_PTS
/begin AXIS_PTS distrib.GRP_uint16_uint16.All_Curves_GRP.Curves_Raster_3 "" 0x1D168E M_In.GRP_uint16_uint16.All_Curves_GRP.Curves_Raster_3 STANDARD_DIST_U16 0.0 ident 10 0.0 65535.0 /end AXIS_PTS
/begin AXIS_PTS distrib.GRP_uint32_uint32.All_Curves_GRP.Curves_Raster_1 "" 0x1D0F1C M_In.GRP_uint32_uint32.All_Curves_GRP.Curves_Raster_1 STANDARD_DIST_U32 0.0 ident 10 0.0 4294967295.0 /end AXIS_PTS
/begin AXIS_PTS distrib.GRP_uint32_uint32.All_Curves_GRP.Curves_Raster_2 "" 0x1D12FC M_In.GRP_uint32_uint32.All_Curves_GRP.Curves_Raster_2 STANDARD_DIST_U32 0.0 ident 10 0.0 4294967295.0 /end AXIS_PTS
/begin AXIS_PTS distrib.GRP_uint32_uint32.All_Curves_GRP.Curves_Raster_3 "" 0x1D16DC M_In.GRP_uint32_uint32.All_Curves_GRP.Curves_Raster_3 STANDARD_DIST_U32 0.0 ident 10 0.0 4294967295.0 /end AXIS_PTS
/begin AXIS_PTS distrib.GRP_uint8_uint8.All_Curves_GRP.Curves_Raster_1 "" 0x1D0F5E M_In.GRP_uint8_uint8.All_Curves_GRP.Curves_Raster_1 STANDARD_DIST_U8 0.0 ident 10 0.0 255.0 /end AXIS_PTS
/begin AXIS_PTS distrib.GRP_uint8_uint8.All_Curves_GRP.Curves_Raster_2 "" 0x1D133E M_In.GRP_uint8_uint8.All_Curves_GRP.Curves_Raster_2 STANDARD_DIST_U8 0.0 ident 10 0.0 255.0 /end AXIS_PTS
/begin AXIS_PTS distrib.GRP_uint8_uint8.All_Curves_GRP.Curves_Raster_3 "" 0x1D171E M_In.GRP_uint8_uint8.All_Curves_GRP.Curves_Raster_3 STANDARD_DIST_U8 0.0 ident 10 0.0 255.0 /end AXIS_PTS
/begin MEASUREMENT Calculated.FIX_sint16_sint16.All_Curves_FIX.Curves_Raster_1 "" SBYTE ident 1 100 0 1 BIT_MASK 0x1 ECU_ADDRESS 0x7F8624 /end MEASUREMENT
/begin MEASUREMENT Calculated.FIX_sint16_sint16.All_Curves_FIX.Curves_Raster_2 "" SBYTE ident 1 100 0 1 BIT_MASK 0x1 ECU_ADDRESS 0x7F86B4 /end MEASUREMENT
/begin MEASUREMENT Calculated.FIX_sint16_sint16.All_Curves_FIX.Curves_Raster_3 "" SBYTE ident 1 100 0 1 BIT_MASK 0x1 ECU_ADDRESS 0x7F8744 /end MEASUREMENT
/begin MEASUREMENT Calculated.FIX_sint32_sint32.All_Curves_FIX.Curves_Raster_1 "" SBYTE ident 1 100 0 1 BIT_MASK 0x1 ECU_ADDRESS 0x7F8630 /end MEASUREMENT
/begin MEASUREMENT Calculated.FIX_sint32_sint32.All_Curves_FIX.Curves_Raster_2 "" SBYTE ident 1 100 0 1 BIT_MASK 0x1 ECU_ADDRESS 0x7F86C0 /end MEASUREMENT
/begin MEASUREMENT Calculated.FIX_sint32_sint32.All_Curves_FIX.Curves_Raster_3 "" SBYTE ident 1 100 0 1 BIT_MASK 0x1 ECU_ADDRESS 0x7F8750 /end MEASUREMENT
/begin MEASUREMENT Calculated.FIX_sint8_sint8.All_Curves_FIX.Curves_Raster_1 "" SBYTE ident 1 100 0 1 BIT_MASK 0x1 ECU_ADDRESS 0x7F8634 /end MEASUREMENT
/begin MEASUREMENT Calculated.FIX_sint8_sint8.All_Curves_FIX.Curves_Raster_2 "" SBYTE ident 1 100 0 1 BIT_MASK 0x1 ECU_ADDRESS 0x7F86C4 /end MEASUREMENT
/begin MEASUREMENT Calculated.FIX_sint8_sint8.All_Curves_FIX.Curves_Raster_3 "" SBYTE ident 1 100 0 1 BIT_MASK 0x1 ECU_ADDRESS 0x7F8754 /end MEASUREMENT
/begin MEASUREMENT Calculated.FIX_uint16_uint16.All_Curves_FIX.Curves_Raster_1 "" SBYTE ident 1 100 0 1 BIT_MASK 0x1 ECU_ADDRESS 0x7F863C /end MEASUREMENT
/begin MEASUREMENT Calculated.FIX_uint16_uint16.All_Curves_FIX.Curves_Raster_2 "" SBYTE ident 1 100 0 1 BIT_MASK 0x1 ECU_ADDRESS 0x7F86CC /end MEASUREMENT
/begin MEASUREMENT Calculated.FIX_uint16_uint16.All_Curves_FIX.Curves_Raster_3 "" SBYTE ident 1 100 0 1 BIT_MASK 0x1 ECU_ADDRESS 0x7F875C /end MEASUREMENT
/begin MEASUREMENT Calculated.FIX_uint32_uint32.All_Curves_FIX.Curves_Raster_1 "" SBYTE ident 1 100 0 1 BIT_MASK 0x1 ECU_ADDRESS 0x7F8648 /end MEASUREMENT
/begin MEASUREMENT Calculated.FIX_uint32_uint32.All_Curves_FIX.Curves_Raster_2 "" SBYTE ident 1 100 0 1 BIT_MASK 0x1 ECU_ADDRESS 0x7F86D8 /end MEASUREMENT
/begin MEASUREMENT Calculated.FIX_uint32_uint32.All_Curves_FIX.Curves_Raster_3 "" SBYTE ident 1 100 0 1 BIT_MASK 0x1 ECU_ADDRESS 0x7F8768 /end MEASUREMENT
/begin MEASUREMENT Calculated.FIX_uint8_uint8.All_Curves_FIX.Curves_Raster_1 "" SBYTE ident 1 100 0 1 BIT_MASK 0x1 ECU_ADDRESS 0x7F864C /end MEASUREMENT
/begin MEASUREMENT Calculated.FIX_uint8_uint8.All_Curves_FIX.Curves_Raster_2 "" SBYTE ident 1 100 0 1 BIT_MASK 0x1 ECU_ADDRESS 0x7F86DC /end MEASUREMENT
/begin MEASUREMENT Calculated.FIX_uint8_uint8.All_Curves_FIX.Curves_Raster_3 "" SBYTE ident 1 100 0 1 BIT_MASK 0x1 ECU_ADDRESS 0x7F876C /end MEASUREMENT
/begin MEASUREMENT Calculated.GRP_sint16_sint16.All_Curves_GRP.Curves_Raster_1 "" UBYTE ident 1 100 0 1 BIT_MASK 0x1 ECU_ADDRESS 0x7F8654 /end MEASUREMENT
/begin MEASUREMENT Calculated.GRP_sint16_sint16.All_Curves_GRP.Curves_Raster_2 "" UBYTE ident 1 100 0 1 BIT_MASK 0x1 ECU_ADDRESS 0x7F86E4 /end MEASUREMENT
/begin MEASUREMENT Calculated.GRP_sint16_sint16.All_Curves_GRP.Curves_Raster_3 "" UBYTE ident 1 100 0 1 BIT_MASK 0x1 ECU_ADDRESS 0x7F8774 /end MEASUREMENT
/begin MEASUREMENT Calculated.GRP_sint32_sint32.All_Curves_GRP.Curves_Raster_1 "" SBYTE ident 1 100 0 1 BIT_MASK 0x1 ECU_ADDRESS 0x7F8660 /end MEASUREMENT
/begin MEASUREMENT Calculated.GRP_sint32_sint32.All_Curves_GRP.Curves_Raster_2 "" SBYTE ident 1 100 0 1 BIT_MASK 0x1 ECU_ADDRESS 0x7F86F0 /end MEASUREMENT
/begin MEASUREMENT Calculated.GRP_sint32_sint32.All_Curves_GRP.Curves_Raster_3 "" SBYTE ident 1 100 0 1 BIT_MASK 0x1 ECU_ADDRESS 0x7F8780 /end MEASUREMENT
/begin MEASUREMENT Calculated.GRP_sint8_sint8.All_Curves_GRP.Curves_Raster_1 "" UBYTE ident 1 100 0 1 BIT_MASK 0x1 ECU_ADDRESS 0x7F8664 /end MEASUREMENT
/begin MEASUREMENT Calculated.GRP_sint8_sint8.All_Curves_GRP.Curves_Raster_2 "" UBYTE ident 1 100 0 1 BIT_MASK 0x1 ECU_ADDRESS 0x7F86F4 /end MEASUREMENT
/begin MEASUREMENT Calculated.GRP_sint8_sint8.All_Curves_GRP.Curves_Raster_3 "" UBYTE ident 1 100 0 1 BIT_MASK 0x1 ECU_ADDRESS 0x7F8784 /end MEASUREMENT
/begin MEASUREMENT Calculated.GRP_uint16_uint16.All_Curves_GRP.Curves_Raster_1 "" UBYTE ident 1 100 0 1 BIT_MASK 0x1 ECU_ADDRESS 0x7F866C /end MEASUREMENT
/begin MEASUREMENT Calculated.GRP_uint16_uint16.All_Curves_GRP.Curves_Raster_2 "" UBYTE ident 1 100 0 1 BIT_MASK 0x1 ECU_ADDRESS 0x7F86FC /end MEASUREMENT
/begin MEASUREMENT Calculated.GRP_uint16_uint16.All_Curves_GRP.Curves_Raster_3 "" UBYTE ident 1 100 0 1 BIT_MASK 0x1 ECU_ADDRESS 0x7F878C /end MEASUREMENT
/begin MEASUREMENT Calculated.GRP_uint32_uint32.All_Curves_GRP.Curves_Raster_1 "" SBYTE ident 1 100 0 1 BIT_MASK 0x1 ECU_ADDRESS 0x7F8678 /end MEASUREMENT
/begin MEASUREMENT Calculated.GRP_uint32_uint32.All_Curves_GRP.Curves_Raster_2 "" SBYTE ident 1 100 0 1 BIT_MASK 0x1 ECU_ADDRESS 0x7F8708 /end MEASUREMENT
/begin MEASUREMENT Calculated.GRP_uint32_uint32.All_Curves_GRP.Curves_Raster_3 "" SBYTE ident 1 100 0 1 BIT_MASK 0x1 ECU_ADDRESS 0x7F8798 /end MEASUREMENT
/begin MEASUREMENT Calculated.GRP_uint8_uint8.All_Curves_GRP.Curves_Raster_1 "" UBYTE ident 1 100 0 1 BIT_MASK 0x1 ECU_ADDRESS 0x7F867C /end MEASUREMENT
/begin MEASUREMENT Calculated.GRP_uint8_uint8.All_Curves_GRP.Curves_Raster_2 "" UBYTE ident 1 100 0 1 BIT_MASK 0x1 ECU_ADDRESS 0x7F870C /end MEASUREMENT
/begin MEASUREMENT Calculated.GRP_uint8_uint8.All_Curves_GRP.Curves_Raster_3 "" UBYTE ident 1 100 0 1 BIT_MASK 0x1 ECU_ADDRESS 0x7F879C /end MEASUREMENT
/begin MEASUREMENT Calculated.STD_sint16_sint16.All_Curves_STD.Curves_Raster_1 "" UBYTE ident 1 100 0 1 BIT_MASK 0x1 ECU_ADDRESS 0x7F8684 /end MEASUREMENT
/begin MEASUREMENT Calculated.STD_sint16_sint16.All_Curves_STD.Curves_Raster_2 "" UBYTE ident 1 100 0 1 BIT_MASK 0x1 ECU_ADDRESS 0x7F8714 /end MEASUREMENT
/begin MEASUREMENT Calculated.STD_sint16_sint16.All_Curves_STD.Curves_Raster_3 "" UBYTE ident 1 100 0 1 BIT_MASK 0x1 ECU_ADDRESS 0x7F87A4 /end MEASUREMENT
/begin MEASUREMENT Calculated.STD_sint32_sint32.All_Curves_STD.Curves_Raster_1 "" UBYTE ident 1 100 0 1 BIT_MASK 0x1 ECU_ADDRESS 0x7F8690 /end MEASUREMENT
/begin MEASUREMENT Calculated.STD_sint32_sint32.All_Curves_STD.Curves_Raster_2 "" UBYTE ident 1 100 0 1 BIT_MASK 0x1 ECU_ADDRESS 0x7F8720 /end MEASUREMENT
/begin MEASUREMENT Calculated.STD_sint32_sint32.All_Curves_STD.Curves_Raster_3 "" UBYTE ident 1 100 0 1 BIT_MASK 0x1 ECU_ADDRESS 0x7F87B0 /end MEASUREMENT
/begin MEASUREMENT Calculated.STD_sint8_sint8.All_Curves_STD.Curves_Raster_1 "" UBYTE ident 1 100 0 1 BIT_MASK 0x1 ECU_ADDRESS 0x7F8694 /end MEASUREMENT
/begin MEASUREMENT Calculated.STD_sint8_sint8.All_Curves_STD.Curves_Raster_2 "" UBYTE ident 1 100 0 1 BIT_MASK 0x1 ECU_ADDRESS 0x7F8724 /end MEASUREMENT
/begin MEASUREMENT Calculated.STD_sint8_sint8.All_Curves_STD.Curves_Raster_3 "" UBYTE ident 1 100 0 1 BIT_MASK 0x1 ECU_ADDRESS 0x7F87B4 /end MEASUREMENT
/begin MEASUREMENT Calculated.STD_uint16_uint16.All_Curves_STD.Curves_Raster_1 "" UBYTE ident 1 100 0 1 BIT_MASK 0x1 ECU_ADDRESS 0x7F869C /end MEASUREMENT
/begin MEASUREMENT Calculated.STD_uint16_uint16.All_Curves_STD.Curves_Raster_2 "" UBYTE ident 1 100 0 1 BIT_MASK 0x1 ECU_ADDRESS 0x7F872C /end MEASUREMENT
/begin MEASUREMENT Calculated.STD_uint16_uint16.All_Curves_STD.Curves_Raster_3 "" UBYTE ident 1 100 0 1 BIT_MASK 0x1 ECU_ADDRESS 0x7F87BC /end MEASUREMENT
/begin MEASUREMENT Calculated.STD_uint32_uint32.All_Curves_STD.Curves_Raster_1 "" UBYTE ident 1 100 0 1 BIT_MASK 0x1 ECU_ADDRESS 0x7F86A8 /end MEASUREMENT
/begin MEASUREMENT Calculated.STD_uint32_uint32.All_Curves_STD.Curves_Raster_2 "" UBYTE ident 1 100 0 1 BIT_MASK 0x1 ECU_ADDRESS 0x7F8738 /end MEASUREMENT
/begin MEASUREMENT Calculated.STD_uint32_uint32.All_Curves_STD.Curves_Raster_3 "" UBYTE ident 1 100 0 1 BIT_MASK 0x1 ECU_ADDRESS 0x7F87C8 /end MEASUREMENT
/begin MEASUREMENT Calculated.STD_uint8_uint8.All_Curves_STD.Curves_Raster_1 "" UBYTE ident 1 100 0 1 BIT_MASK 0x1 ECU_ADDRESS 0x7F86AC /end MEASUREMENT
/begin MEASUREMENT Calculated.STD_uint8_uint8.All_Curves_STD.Curves_Raster_2 "" UBYTE ident 1 100 0 1 BIT_MASK 0x1 ECU_ADDRESS 0x7F873C /end MEASUREMENT
/begin MEASUREMENT Calculated.STD_uint8_uint8.All_Curves_STD.Curves_Raster_3 "" UBYTE ident 1 100 0 1 BIT_MASK 0x1 ECU_ADDRESS 0x7F87CC /end MEASUREMENT
/begin MEASUREMENT Distr_Set.GRP_sint16_sint16.All_Curves_GRP.Curves_Raster_1 "" SBYTE ident 1 100 0 1 BIT_MASK 0x1 ECU_ADDRESS 0x7F8655 /end MEASUREMENT
/begin MEASUREMENT Distr_Set.GRP_sint16_sint16.All_Curves_GRP.Curves_Raster_2 "" SBYTE ident 1 100 0 1 BIT_MASK 0x1 ECU_ADDRESS 0x7F86E5 /end MEASUREMENT
/begin MEASUREMENT Distr_Set.GRP_sint16_sint16.All_Curves_GRP.Curves_Raster_3 "" SBYTE ident 1 100 0 1 BIT_MASK 0x1 ECU_ADDRESS 0x7F8775 /end MEASUREMENT
/begin MEASUREMENT Distr_Set.GRP_sint32_sint32.All_Curves_GRP.Curves_Raster_1 "" SBYTE ident 1 100 0 1 BIT_MASK 0x1 ECU_ADDRESS 0x7F8661 /end MEASUREMENT
/begin MEASUREMENT Distr_Set.GRP_sint32_sint32.All_Curves_GRP.Curves_Raster_2 "" SBYTE ident 1 100 0 1 BIT_MASK 0x1 ECU_ADDRESS 0x7F86F1 /end MEASUREMENT
/begin MEASUREMENT Distr_Set.GRP_sint32_sint32.All_Curves_GRP.Curves_Raster_3 "" SBYTE ident 1 100 0 1 BIT_MASK 0x1 ECU_ADDRESS 0x7F8781 /end MEASUREMENT
/begin MEASUREMENT Distr_Set.GRP_sint8_sint8.All_Curves_GRP.Curves_Raster_1 "" SBYTE ident 1 100 0 1 BIT_MASK 0x1 ECU_ADDRESS 0x7F8665 /end MEASUREMENT
/begin MEASUREMENT Distr_Set.GRP_sint8_sint8.All_Curves_GRP.Curves_Raster_2 "" SBYTE ident 1 100 0 1 BIT_MASK 0x1 ECU_ADDRESS 0x7F86F5 /end MEASUREMENT
/begin MEASUREMENT Distr_Set.GRP_sint8_sint8.All_Curves_GRP.Curves_Raster_3 "" SBYTE ident 1 100 0 1 BIT_MASK 0x1 ECU_ADDRESS 0x7F8785 /end MEASUREMENT
/begin MEASUREMENT Distr_Set.GRP_uint16_uint16.All_Curves_GRP.Curves_Raster_1 "" SBYTE ident 1 100 0 1 BIT_MASK 0x1 ECU_ADDRESS 0x7F866D /end MEASUREMENT
/begin MEASUREMENT Distr_Set.GRP_uint16_uint16.All_Curves_GRP.Curves_Raster_2 "" SBYTE ident 1 100 0 1 BIT_MASK 0x1 ECU_ADDRESS 0x7F86FD /end MEASUREMENT
/begin MEASUREMENT Distr_Set.GRP_uint16_uint16.All_Curves_GRP.Curves_Raster_3 "" SBYTE ident 1 100 0 1 BIT_MASK 0x1 ECU_ADDRESS 0x7F878D /end MEASUREMENT
/begin MEASUREMENT Distr_Set.GRP_uint32_uint32.All_Curves_GRP.Curves_Raster_1 "" SBYTE ident 1 100 0 1 BIT_MASK 0x1 ECU_ADDRESS 0x7F8679 /end MEASUREMENT
/begin MEASUREMENT Distr_Set.GRP_uint32_uint32.All_Curves_GRP.Curves_Raster_2 "" SBYTE ident 1 100 0 1 BIT_MASK 0x1 ECU_ADDRESS 0x7F8709 /end MEASUREMENT
/begin MEASUREMENT Distr_Set.GRP_uint32_uint32.All_Curves_GRP.Curves_Raster_3 "" SBYTE ident 1 100 0 1 BIT_MASK 0x1 ECU_ADDRESS 0x7F8799 /end MEASUREMENT
/begin MEASUREMENT Distr_Set.GRP_uint8_uint8.All_Curves_GRP.Curves_Raster_1 "" SBYTE ident 1 100 0 1 BIT_MASK 0x1 ECU_ADDRESS 0x7F867D /end MEASUREMENT
/begin MEASUREMENT Distr_Set.GRP_uint8_uint8.All_Curves_GRP.Curves_Raster_2 "" SBYTE ident 1 100 0 1 BIT_MASK 0x1 ECU_ADDRESS 0x7F870D /end MEASUREMENT
/begin MEASUREMENT Distr_Set.GRP_uint8_uint8.All_Curves_GRP.Curves_Raster_3 "" SBYTE ident 1 100 0 1 BIT_MASK 0x1 ECU_ADDRESS 0x7F879D /end MEASUREMENT
/begin MEASUREMENT ebCtrNewT_ASD.AS.BASE "" UBYTE identity 1 100 0 255 ECU_ADDRESS 0x821120 /end MEASUREMENT
/begin MEASUREMENT ebCtrNewY_ASD.AS.BASE "" UBYTE identity 1 100 0 255 ECU_ADDRESS 0x821121 /end MEASUREMENT
/begin MEASUREMENT ebCtrOldT_ASD.AS.BASE "" UBYTE identity 1 100 0 255 ECU_ADDRESS 0x821122 /end MEASUREMENT
/begin MEASUREMENT ebCtrOldY_ASD.AS.BASE "" UBYTE identity 1 100 0 255 ECU_ADDRESS 0x821123 /end MEASUREMENT
/begin MEASUREMENT g_checksum_u32.ALL_PROT "" ULONG ident 1 100 0 4294967295 ECU_ADDRESS 0x7FAFA0 /end MEASUREMENT
/begin MEASUREMENT g_ChecksumByteOrder_u8.ALL_PROT "" UBYTE enum_XCP_ByteOrder_e 1 100 0 1 ECU_ADDRESS 0x7FAFA4 /end MEASUREMENT
/begin MEASUREMENT g_ChecksumType_u8.ALL_PROT "" UBYTE enum_XCP_ChecksumType_e 1 100 0 7 ECU_ADDRESS 0x7FAF9C /end MEASUREMENT
/begin MEASUREMENT g_chksumlength_u8.ALL_PROT "" UBYTE ident 1 100 0 255 ECU_ADDRESS 0x7FAF9D /end MEASUREMENT
/begin MEASUREMENT M_In.FIX_sint16_sint16.All_Curves_FIX.Curves_Raster_1 "" SWORD ident 1 100 -32768.0 32767.0 ECU_ADDRESS 0x7F8620 /end MEASUREMENT
/begin MEASUREMENT M_In.FIX_sint16_sint16.All_Curves_FIX.Curves_Raster_2 "" SWORD ident 1 100 -32768.0 32767.0 ECU_ADDRESS 0x7F86B0 /end MEASUREMENT
/begin MEASUREMENT M_In.FIX_sint16_sint16.All_Curves_FIX.Curves_Raster_3 "" SWORD ident 1 100 -32768.0 32767.0 ECU_ADDRESS 0x7F8740 /end MEASUREMENT
/begin MEASUREMENT M_In.FIX_sint32_sint32.All_Curves_FIX.Curves_Raster_1 "" SLONG ident 1 100 -2147483648.0 2147483647.0 ECU_ADDRESS 0x7F8628 /end MEASUREMENT
/begin MEASUREMENT M_In.FIX_sint32_sint32.All_Curves_FIX.Curves_Raster_2 "" SLONG ident 1 100 -2147483648.0 2147483647.0 ECU_ADDRESS 0x7F86B8 /end MEASUREMENT
/begin MEASUREMENT M_In.FIX_sint32_sint32.All_Curves_FIX.Curves_Raster_3 "" SLONG ident 1 100 -2147483648.0 2147483647.0 ECU_ADDRESS 0x7F8748 /end MEASUREMENT
/begin MEASUREMENT M_In.FIX_sint8_sint8.All_Curves_FIX.Curves_Raster_1 "" SBYTE ident 1 100 -128.0 127.0 ECU_ADDRESS 0x7F8635 /end MEASUREMENT
/begin MEASUREMENT M_In.FIX_sint8_sint8.All_Curves_FIX.Curves_Raster_2 "" SBYTE ident 1 100 -128.0 127.0 ECU_ADDRESS 0x7F86C5 /end MEASUREMENT
/begin MEASUREMENT M_In.FIX_sint8_sint8.All_Curves_FIX.Curves_Raster_3 "" SBYTE ident 1 100 -128.0 127.0 ECU_ADDRESS 0x7F8755 /end MEASUREMENT
/begin MEASUREMENT M_In.FIX_uint16_uint16.All_Curves_FIX.Curves_Raster_1 "" UWORD ident 1 100 0.0 65535.0 ECU_ADDRESS 0x7F8638 /end MEASUREMENT
/begin MEASUREMENT M_In.FIX_uint16_uint16.All_Curves_FIX.Curves_Raster_2 "" UWORD ident 1 100 0.0 65535.0 ECU_ADDRESS 0x7F86C8 /end MEASUREMENT
/begin MEASUREMENT M_In.FIX_uint16_uint16.All_Curves_FIX.Curves_Raster_3 "" UWORD ident 1 100 0.0 65535.0 ECU_ADDRESS 0x7F8758 /end MEASUREMENT
/begin MEASUREMENT M_In.FIX_uint32_uint32.All_Curves_FIX.Curves_Raster_1 "" ULONG ident 1 100 0.0 4294967295.0 ECU_ADDRESS 0x7F8640 /end MEASUREMENT
/begin MEASUREMENT M_In.FIX_uint32_uint32.All_Curves_FIX.Curves_Raster_2 "" ULONG ident 1 100 0.0 4294967295.0 ECU_ADDRESS 0x7F86D0 /end MEASUREMENT
/begin MEASUREMENT M_In.FIX_uint32_uint32.All_Curves_FIX.Curves_Raster_3 "" ULONG ident 1 100 0.0 4294967295.0 ECU_ADDRESS 0x7F8760 /end MEASUREMENT
/begin MEASUREMENT M_In.FIX_uint8_uint8.All_Curves_FIX.Curves_Raster_1 "" UBYTE ident 1 100 0.0 255.0 ECU_ADDRESS 0x7F864D /end MEASUREMENT
/begin MEASUREMENT M_In.FIX_uint8_uint8.All_Curves_FIX.Curves_Raster_2 "" UBYTE ident 1 100 0.0 255.0 ECU_ADDRESS 0x7F86DD /end MEASUREMENT
/begin MEASUREMENT M_In.FIX_uint8_uint8.All_Curves_FIX.Curves_Raster_3 "" UBYTE ident 1 100 0.0 255.0 ECU_ADDRESS 0x7F876D /end MEASUREMENT
/begin MEASUREMENT M_In.GRP_sint16_sint16.All_Curves_GRP.Curves_Raster_1 "" SWORD ident 1 100 -32768.0 32767.0 ECU_ADDRESS 0x7F8650 /end MEASUREMENT
/begin MEASUREMENT M_In.GRP_sint16_sint16.All_Curves_GRP.Curves_Raster_2 "" SWORD ident 1 100 -32768.0 32767.0 ECU_ADDRESS 0x7F86E0 /end MEASUREMENT
/begin MEASUREMENT M_In.GRP_sint16_sint16.All_Curves_GRP.Curves_Raster_3 "" SWORD ident 1 100 -32768.0 32767.0 ECU_ADDRESS 0x7F8770 /end MEASUREMENT
/begin MEASUREMENT M_In.GRP_sint32_sint32.All_Curves_GRP.Curves_Raster_1 "" SLONG ident 1 100 -2147483648.0 2147483647.0 ECU_ADDRESS 0x7F8658 /end MEASUREMENT
/begin MEASUREMENT M_In.GRP_sint32_sint32.All_Curves_GRP.Curves_Raster_2 "" SLONG ident 1 100 -2147483648.0 2147483647.0 ECU_ADDRESS 0x7F86E8 /end MEASUREMENT
/begin MEASUREMENT M_In.GRP_sint32_sint32.All_Curves_GRP.Curves_Raster_3 "" SLONG ident 1 100 -2147483648.0 2147483647.0 ECU_ADDRESS 0x7F8778 /end MEASUREMENT
/begin MEASUREMENT M_In.GRP_sint8_sint8.All_Curves_GRP.Curves_Raster_1 "" SBYTE ident 1 100 -128.0 127.0 ECU_ADDRESS 0x7F8666 /end MEASUREMENT
/begin MEASUREMENT M_In.GRP_sint8_sint8.All_Curves_GRP.Curves_Raster_2 "" SBYTE ident 1 100 -128.0 127.0 ECU_ADDRESS 0x7F86F6 /end MEASUREMENT
/begin MEASUREMENT M_In.GRP_sint8_sint8.All_Curves_GRP.Curves_Raster_3 "" SBYTE ident 1 100 -128.0 127.0 ECU_ADDRESS 0x7F8786 /end MEASUREMENT
/begin MEASUREMENT M_In.GRP_uint16_uint16.All_Curves_GRP.Curves_Raster_1 "" UWORD ident 1 100 0.0 65535.0 ECU_ADDRESS 0x7F8668 /end MEASUREMENT
/begin MEASUREMENT M_In.GRP_uint16_uint16.All_Curves_GRP.Curves_Raster_2 "" UWORD ident 1 100 0.0 65535.0 ECU_ADDRESS 0x7F86F8 /end MEASUREMENT
/begin MEASUREMENT M_In.GRP_uint16_uint16.All_Curves_GRP.Curves_Raster_3 "" UWORD ident 1 100 0.0 65535.0 ECU_ADDRESS 0x7F8788 /end MEASUREMENT
/begin MEASUREMENT M_In.GRP_uint32_uint32.All_Curves_GRP.Curves_Raster_1 "" ULONG ident 1 100 0.0 4294967295.0 ECU_ADDRESS 0x7F8670 /end MEASUREMENT
/begin MEASUREMENT M_In.GRP_uint32_uint32.All_Curves_GRP.Curves_Raster_2 "" ULONG ident 1 100 0.0 4294967295.0 ECU_ADDRESS 0x7F8700 /end MEASUREMENT
/begin MEASUREMENT M_In.GRP_uint32_uint32.All_Curves_GRP.Curves_Raster_3 "" ULONG ident 1 100 0.0 4294967295.0 ECU_ADDRESS 0x7F8790 /end MEASUREMENT
/begin MEASUREMENT M_In.GRP_uint8_uint8.All_Curves_GRP.Curves_Raster_1 "" UBYTE ident 1 100 0.0 255.0 ECU_ADDRESS 0x7F867E /end MEASUREMENT
/begin MEASUREMENT M_In.GRP_uint8_uint8.All_Curves_GRP.Curves_Raster_2 "" UBYTE ident 1 100 0.0 255.0 ECU_ADDRESS 0x7F870E /end MEASUREMENT
/begin MEASUREMENT M_In.GRP_uint8_uint8.All_Curves_GRP.Curves_Raster_3 "" UBYTE ident 1 100 0.0 255.0 ECU_ADDRESS 0x7F879E /end MEASUREMENT
/begin MEASUREMENT M_In.STD_sint16_sint16.All_Curves_STD.Curves_Raster_1 "" SWORD ident 1 100 -32768.0 32767.0 ECU_ADDRESS 0x7F8680 /end MEASUREMENT
/begin MEASUREMENT M_In.STD_sint16_sint16.All_Curves_STD.Curves_Raster_2 "" SWORD ident 1 100 -32768.0 32767.0 ECU_ADDRESS 0x7F8710 /end MEASUREMENT
/begin MEASUREMENT M_In.STD_sint16_sint16.All_Curves_STD.Curves_Raster_3 "" SWORD ident 1 100 -32768.0 32767.0 ECU_ADDRESS 0x7F87A0 /end MEASUREMENT
/begin MEASUREMENT M_In.STD_sint32_sint32.All_Curves_STD.Curves_Raster_1 "" SLONG ident 1 100 -2147483648.0 2147483647.0 ECU_ADDRESS 0x7F8688 /end MEASUREMENT
/begin MEASUREMENT M_In.STD_sint32_sint32.All_Curves_STD.Curves_Raster_2 "" SLONG ident 1 100 -2147483648.0 2147483647.0 ECU_ADDRESS 0x7F8718 /end MEASUREMENT
/begin MEASUREMENT M_In.STD_sint32_sint32.All_Curves_STD.Curves_Raster_3 "" SLONG ident 1 100 -2147483648.0 2147483647.0 ECU_ADDRESS 0x7F87A8 /end MEASUREMENT
/begin MEASUREMENT M_In.STD_sint8_sint8.All_Curves_STD.Curves_Raster_1 "" SBYTE ident 1 100 -128.0 127.0 ECU_ADDRESS 0x7F8695 /end MEASUREMENT
/begin MEASUREMENT M_In.STD_sint8_sint8.All_Curves_STD.Curves_Raster_2 "" SBYTE ident 1 100 -128.0 127.0 ECU_ADDRESS 0x7F8725 /end MEASUREMENT
/begin MEASUREMENT M_In.STD_sint8_sint8.All_Curves_STD.Curves_Raster_3 "" SBYTE ident 1 100 -128.0 127.0 ECU_ADDRESS 0x7F87B5 /end MEASUREMENT
/begin MEASUREMENT M_In.STD_uint16_uint16.All_Curves_STD.Curves_Raster_1 "" UWORD ident 1 100 0.0 65535.0 ECU_ADDRESS 0x7F8698 /end MEASUREMENT
/begin MEASUREMENT M_In.STD_uint16_uint16.All_Curves_STD.Curves_Raster_2 "" UWORD ident 1 100 0.0 65535.0 ECU_ADDRESS 0x7F8728 /end MEASUREMENT
/begin MEASUREMENT M_In.STD_uint16_uint16.All_Curves_STD.Curves_Raster_3 "" UWORD ident 1 100 0.0 65535.0 ECU_ADDRESS 0x7F87B8 /end MEASUREMENT
/begin MEASUREMENT M_In.STD_uint32_uint32.All_Curves_STD.Curves_Raster_1 "" ULONG ident 1 100 0.0 4294967295.0 ECU_ADDRESS 0x7F86A0 /end MEASUREMENT
/begin MEASUREMENT M_In.STD_uint32_uint32.All_Curves_STD.Curves_Raster_2 "" ULONG ident 1 100 0.0 4294967295.0 ECU_ADDRESS 0x7F8730 /end MEASUREMENT
/begin MEASUREMENT M_In.STD_uint32_uint32.All_Curves_STD.Curves_Raster_3 "" ULONG ident 1 100 0.0 4294967295.0 ECU_ADDRESS 0x7F87C0 /end MEASUREMENT
/begin MEASUREMENT M_In.STD_uint8_uint8.All_Curves_STD.Curves_Raster_1 "" UBYTE ident 1 100 0.0 255.0 ECU_ADDRESS 0x7F86AD /end MEASUREMENT
/begin MEASUREMENT M_In.STD_uint8_uint8.All_Curves_STD.Curves_Raster_2 "" UBYTE ident 1 100 0.0 255.0 ECU_ADDRESS 0x7F873D /end MEASUREMENT
/begin MEASUREMENT M_In.STD_uint8_uint8.All_Curves_STD.Curves_Raster_3 "" UBYTE ident 1 100 0.0 255.0 ECU_ADDRESS 0x7F87CD /end MEASUREMENT
/begin MEASUREMENT M_out.FIX_sint16_sint16.All_Curves_FIX.Curves_Raster_1 "" SWORD ident 1 100 -32768.0 32767.0 ECU_ADDRESS 0x7F8622 /end MEASUREMENT
/begin MEASUREMENT M_out.FIX_sint16_sint16.All_Curves_FIX.Curves_Raster_2 "" SWORD ident 1 100 -32768.0 32767.0 ECU_ADDRESS 0x7F86B2 /end MEASUREMENT
/begin MEASUREMENT M_out.FIX_sint16_sint16.All_Curves_FIX.Curves_Raster_3 "" SWORD ident 1 100 -32768.0 32767.0 ECU_ADDRESS 0x7F8742 /end MEASUREMENT
/begin MEASUREMENT M_out.FIX_sint32_sint32.All_Curves_FIX.Curves_Raster_1 "" SLONG ident 1 100 -2147483648.0 2147483647.0 ECU_ADDRESS 0x7F862C /end MEASUREMENT
/begin MEASUREMENT M_out.FIX_sint32_sint32.All_Curves_FIX.Curves_Raster_2 "" SLONG ident 1 100 -2147483648.0 2147483647.0 ECU_ADDRESS 0x7F86BC /end MEASUREMENT
/begin MEASUREMENT M_out.FIX_sint32_sint32.All_Curves_FIX.Curves_Raster_3 "" SLONG ident 1 100 -2147483648.0 2147483647.0 ECU_ADDRESS 0x7F874C /end MEASUREMENT
/begin MEASUREMENT M_out.FIX_sint8_sint8.All_Curves_FIX.Curves_Raster_1 "" SBYTE ident 1 100 -128.0 127.0 ECU_ADDRESS 0x7F8636 /end MEASUREMENT
/begin MEASUREMENT M_out.FIX_sint8_sint8.All_Curves_FIX.Curves_Raster_2 "" SBYTE ident 1 100 -128.0 127.0 ECU_ADDRESS 0x7F86C6 /end MEASUREMENT
/begin MEASUREMENT M_out.FIX_sint8_sint8.All_Curves_FIX.Curves_Raster_3 "" SBYTE ident 1 100 -128.0 127.0 ECU_ADDRESS 0x7F8756 /end MEASUREMENT
/begin MEASUREMENT M_out.FIX_uint16_uint16.All_Curves_FIX.Curves_Raster_1 "" UWORD ident 1 100 0.0 65535.0 ECU_ADDRESS 0x7F863A /end MEASUREMENT
/begin MEASUREMENT M_out.FIX_uint16_uint16.All_Curves_FIX.Curves_Raster_2 "" UWORD ident 1 100 0.0 65535.0 ECU_ADDRESS 0x7F86CA /end MEASUREMENT
/begin MEASUREMENT M_out.FIX_uint16_uint16.All_Curves_FIX.Curves_Raster_3 "" UWORD ident 1 100 0.0 65535.0 ECU_ADDRESS 0x7F875A /end MEASUREMENT
/begin MEASUREMENT M_out.FIX_uint32_uint32.All_Curves_FIX.Curves_Raster_1 "" ULONG ident 1 100 0.0 4294967295.0 ECU_ADDRESS 0x7F8644 /end MEASUREMENT
/begin MEASUREMENT M_out.FIX_uint32_uint32.All_Curves_FIX.Curves_Raster_2 "" ULONG ident 1 100 0.0 4294967295.0 ECU_ADDRESS 0x7F86D4 /end MEASUREMENT
/begin MEASUREMENT M_out.FIX_uint32_uint32.All_Curves_FIX.Curves_Raster_3 "" ULONG ident 1 100 0.0 4294967295.0 ECU_ADDRESS 0x7F8764 /end MEASUREMENT
/begin MEASUREMENT M_out.FIX_uint8_uint8.All_Curves_FIX.Curves_Raster_1 "" UBYTE ident 1 100 0.0 255.0 ECU_ADDRESS 0x7F864E /end MEASUREMENT
/begin MEASUREMENT M_out.FIX_uint8_uint8.All_Curves_FIX.Curves_Raster_2 "" UBYTE ident 1 100 0.0 255.0 ECU_ADDRESS 0x7F86DE /end MEASUREMENT
/begin MEASUREMENT M_out.FIX_uint8_uint8.All_Curves_FIX.Curves_Raster_3 "" UBYTE ident 1 100 0.0 255.0 ECU_ADDRESS 0x7F876E /end MEASUREMENT
/begin MEASUREMENT M_out.GRP_sint16_sint16.All_Curves_GRP.Curves_Raster_1 "" SWORD ident 1 100 -32768.0 32767.0 ECU_ADDRESS 0x7F8652 /end MEASUREMENT
/begin MEASUREMENT M_out.GRP_sint16_sint16.All_Curves_GRP.Curves_Raster_2 "" SWORD ident 1 100 -32768.0 32767.0 ECU_ADDRESS 0x7F86E2 /end MEASUREMENT
/begin MEASUREMENT M_out.GRP_sint16_sint16.All_Curves_GRP.Curves_Raster_3 "" SWORD ident 1 100 -32768.0 32767.0 ECU_ADDRESS 0x7F8772 /end MEASUREMENT
/begin MEASUREMENT M_out.GRP_sint32_sint32.All_Curves_GRP.Curves_Raster_1 "" SLONG ident 1 100 -2147483648.0 2147483647.0 ECU_ADDRESS 0x7F865C /end MEASUREMENT
/begin MEASUREMENT M_out.GRP_sint32_sint32.All_Curves_GRP.Curves_Raster_2 "" SLONG ident 1 100 -2147483648.0 2147483647.0 ECU_ADDRESS 0x7F86EC /end MEASUREMENT
/begin MEASUREMENT M_out.GRP_sint32_sint32.All_Curves_GRP.Curves_Raster_3 "" SLONG ident 1 100 -2147483648.0 2147483647.0 ECU_ADDRESS 0x7F877C /end MEASUREMENT
/begin MEASUREMENT M_out.GRP_sint8_sint8.All_Curves_GRP.Curves_Raster_1 "" SBYTE ident 1 100 -128.0 127.0 ECU_ADDRESS 0x7F8667 /end MEASUREMENT
/begin MEASUREMENT M_out.GRP_sint8_sint8.All_Curves_GRP.Curves_Raster_2 "" SBYTE ident 1 100 -128.0 127.0 ECU_ADDRESS 0x7F86F7 /end MEASUREMENT
/begin MEASUREMENT M_out.GRP_sint8_sint8.All_Curves_GRP.Curves_Raster_3 "" SBYTE ident 1 100 -128.0 127.0 ECU_ADDRESS 0x7F8787 /end MEASUREMENT
/begin MEASUREMENT M_out.GRP_uint16_uint16.All_Curves_GRP.Curves_Raster_1 "" UWORD ident 1 100 0.0 65535.0 ECU_ADDRESS 0x7F866A /end MEASUREMENT
/begin MEASUREMENT M_out.GRP_uint16_uint16.All_Curves_GRP.Curves_Raster_2 "" UWORD ident 1 100 0.0 65535.0 ECU_ADDRESS 0x7F86FA /end MEASUREMENT
/begin MEASUREMENT M_out.GRP_uint16_uint16.All_Curves_GRP.Curves_Raster_3 "" UWORD ident 1 100 0.0 65535.0 ECU_ADDRESS 0x7F878A /end MEASUREMENT
/begin MEASUREMENT M_out.GRP_uint32_uint32.All_Curves_GRP.Curves_Raster_1 "" ULONG ident 1 100 0.0 4294967295.0 ECU_ADDRESS 0x7F8674 /end MEASUREMENT
/begin MEASUREMENT M_out.GRP_uint32_uint32.All_Curves_GRP.Curves_Raster_2 "" ULONG ident 1 100 0.0 4294967295.0 ECU_ADDRESS 0x7F8704 /end MEASUREMENT
/begin MEASUREMENT M_out.GRP_uint32_uint32.All_Curves_GRP.Curves_Raster_3 "" ULONG ident 1 100 0.0 4294967295.0 ECU_ADDRESS 0x7F8794 /end MEASUREMENT
/begin MEASUREMENT M_out.GRP_uint8_uint8.All_Curves_GRP.Curves_Raster_1 "" UBYTE ident 1 100 0.0 255.0 ECU_ADDRESS 0x7F867F /end MEASUREMENT
/begin MEASUREMENT M_out.GRP_uint8_uint8.All_Curves_GRP.Curves_Raster_2 "" UBYTE ident 1 100 0.0 255.0 ECU_ADDRESS 0x7F870F /end MEASUREMENT
/begin MEASUREMENT M_out.GRP_uint8_uint8.All_Curves_GRP.Curves_Raster_3 "" UBYTE ident 1 100 0.0 255.0 ECU_ADDRESS 0x7F879F /end MEASUREMENT
/begin MEASUREMENT M_out.STD_sint16_sint16.All_Curves_STD.Curves_Raster_1 "" SWORD ident 1 100 -32768.0 32767.0 ECU_ADDRESS 0x7F8682 /end MEASUREMENT
/begin MEASUREMENT M_out.STD_sint16_sint16.All_Curves_STD.Curves_Raster_2 "" SWORD ident 1 100 -32768.0 32767.0 ECU_ADDRESS 0x7F8712 /end MEASUREMENT
/begin MEASUREMENT M_out.STD_sint16_sint16.All_Curves_STD.Curves_Raster_3 "" SWORD ident 1 100 -32768.0 32767.0 ECU_ADDRESS 0x7F87A2 /end MEASUREMENT
/begin MEASUREMENT M_out.STD_sint32_sint32.All_Curves_STD.Curves_Raster_1 "" SLONG ident 1 100 -2147483648.0 2147483647.0 ECU_ADDRESS 0x7F868C /end MEASUREMENT
/begin MEASUREMENT M_out.STD_sint32_sint32.All_Curves_STD.Curves_Raster_2 "" SLONG ident 1 100 -2147483648.0 2147483647.0 ECU_ADDRESS 0x7F871C /end MEASUREMENT
/begin MEASUREMENT M_out.STD_sint32_sint32.All_Curves_STD.Curves_Raster_3 "" SLONG ident 1 100 -2147483648.0 2147483647.0 ECU_ADDRESS 0x7F87AC /end MEASUREMENT
/begin MEASUREMENT M_out.STD_sint8_sint8.All_Curves_STD.Curves_Raster_1 "" SBYTE ident 1 100 -128.0 127.0 ECU_ADDRESS 0x7F8696 /end MEASUREMENT
/begin MEASUREMENT M_out.STD_sint8_sint8.All_Curves_STD.Curves_Raster_2 "" SBYTE ident 1 100 -128.0 127.0 ECU_ADDRESS 0x7F8726 /end MEASUREMENT
/begin MEASUREMENT M_out.STD_sint8_sint8.All_Curves_STD.Curves_Raster_3 "" SBYTE ident 1 100 -128.0 127.0 ECU_ADDRESS 0x7F87B6 /end MEASUREMENT
/begin MEASUREMENT M_out.STD_uint16_uint16.All_Curves_STD.Curves_Raster_1 "" UWORD ident 1 100 0.0 65535.0 ECU_ADDRESS 0x7F869A /end MEASUREMENT
/begin MEASUREMENT M_out.STD_uint16_uint16.All_Curves_STD.Curves_Raster_2 "" UWORD ident 1 100 0.0 65535.0 ECU_ADDRESS 0x7F872A /end MEASUREMENT
/begin MEASUREMENT M_out.STD_uint16_uint16.All_Curves_STD.Curves_Raster_3 "" UWORD ident 1 100 0.0 65535.0 ECU_ADDRESS 0x7F87BA /end MEASUREMENT
/begin MEASUREMENT M_out.STD_uint32_uint32.All_Curves_STD.Curves_Raster_1 "" ULONG ident 1 100 0.0 4294967295.0 ECU_ADDRESS 0x7F86A4 /end MEASUREMENT
/begin MEASUREMENT M_out.STD_uint32_uint32.All_Curves_STD.Curves_Raster_2 "" ULONG ident 1 100 0.0 4294967295.0 ECU_ADDRESS 0x7F8734 /end MEASUREMENT
/begin MEASUREMENT M_out.STD_uint32_uint32.All_Curves_STD.Curves_Raster_3 "" ULONG ident 1 100 0.0 4294967295.0 ECU_ADDRESS 0x7F87C4 /end MEASUREMENT
/begin MEASUREMENT M_out.STD_uint8_uint8.All_Curves_STD.Curves_Raster_1 "" UBYTE ident 1 100 0.0 255.0 ECU_ADDRESS 0x7F86AE /end MEASUREMENT
/begin MEASUREMENT M_out.STD_uint8_uint8.All_Curves_STD.Curves_Raster_2 "" UBYTE ident 1 100 0.0 255.0 ECU_ADDRESS 0x7F873E /end MEASUREMENT
/begin MEASUREMENT M_out.STD_uint8_uint8.All_Curves_STD.Curves_Raster_3 "" UBYTE ident 1 100 0.0 255.0 ECU_ADDRESS 0x7F87CE /end MEASUREMENT
/begin MEASUREMENT r100msTaskCtr.AS.BASE "" ULONG identity 1 100 0 2147483647 ECU_ADDRESS 0x7FAFA8 /end MEASUREMENT
/begin COMPU_METHOD enum_XCP_ByteOrder_e "" TAB_VERB "%8.4" "" COEFFS 0 1 0 0 0 1 COMPU_TAB_REF enum_XCP_ByteOrder_e_tab_ref /end COMPU_METHOD
/begin COMPU_METHOD enum_XCP_ChecksumType_e "" TAB_VERB "%8.4" "" COEFFS 0 1 0 0 0 1 COMPU_TAB_REF enum_XCP_ChecksumType_e_tab_ref /end COMPU_METHOD
/begin COMPU_METHOD ident "" RAT_FUNC "%12.4" "" COEFFS 0 1 0 0 0 1 /end COMPU_METHOD
/begin COMPU_METHOD identity "" RAT_FUNC "%12.4" "" COEFFS 0 1 0 0 0 1 /end COMPU_METHOD
/begin COMPU_VTAB enum_XCP_ByteOrder_e_tab_ref "" TAB_VERB 2 0 "INTEL_MSB_LAST_0" 1 "MOTOROLA_MSB_FIRST_1" DEFAULT_VALUE "Error" /end COMPU_VTAB
/begin COMPU_VTAB enum_XCP_ChecksumType_e_tab_ref "" TAB_VERB 8 0 "NOT_USED_0" 1 "XCP_ADD_11_1" 2 "XCP_ADD_12_2" 3 "XCP_ADD_14_3" 4 "XCP_ADD_22_4" 5 "XCP_ADD_24_5" 6 "XCP_ADD_44_6" 7 "XCP_CRC_16_NO_TEST_AVAIL" DEFAULT_VALUE "Error" /end COMPU_VTAB
/begin GROUP ALL_PROT "" ROOT
 /begin REF_MEASUREMENT g_ChecksumByteOrder_u8.ALL_PROT g_ChecksumType_u8.ALL_PROT g_checksum_u32.ALL_PROT g_chksumlength_u8.ALL_PROT /end REF_MEASUREMENT
 /begin REF_CHARACTERISTIC p_ChecksumByteOrder_u8.ALL_PROT p_ChecksumType_u8.ALL_PROT /end REF_CHARACTERISTIC
/end GROUP
/begin GROUP AS.BASE ""
 /begin REF_MEASUREMENT ebCtrNewT_ASD.AS.BASE ebCtrNewY_ASD.AS.BASE ebCtrOldT_ASD.AS.BASE ebCtrOldY_ASD.AS.BASE r100msTaskCtr.AS.BASE /end REF_MEASUREMENT
 /begin REF_CHARACTERISTIC EBEN_ASD.AS.BASE /end REF_CHARACTERISTIC
/end GROUP
/begin GROUP All_Curves_FIX.Curves_Raster_1 ""
 /begin REF_MEASUREMENT Calculated.FIX_sint16_sint16.All_Curves_FIX.Curves_Raster_1 Calculated.FIX_sint32_sint32.All_Curves_FIX.Curves_Raster_1 Calculated.FIX_sint8_sint8.All_Curves_FIX.Curves_Raster_1 Calculated.FIX_uint16_uint16.All_Curves_FIX.Curves_Raster_1 Calculated.FIX_uint32_uint32.All_Curves_FIX.Curves_Raster_1 Calculated.FIX_uint8_uint8.All_Curves_FIX.Curves_Raster_1 M_In.FIX_sint16_sint16.All_Curves_FIX.Curves_Raster_1 M_In.FIX_sint32_sint32.All_Curves_FIX.Curves_Raster_1 M_In.FIX_sint8_sint8.All_Curves_FIX.Curves_Raster_1 M_In.FIX_uint16_uint16.All_Curves_FIX.Curves_Raster_1 M_In.FIX_uint32_uint32.All_Curves_FIX.Curves_Raster_1 M_In.FIX_uint8_uint8.All_Curves_FIX.Curves_Raster_1 M_out.FIX_sint16_sint16.All_Curves_FIX.Curves_Raster_1 M_out.FIX_sint32_sint32.All_Curves_FIX.Curves_Raster_1 M_out.FIX_sint8_sint8.All_Curves_FIX.Curves_Raster_1 M_out.FIX_uint16_uint16.All_Curves_FIX.Curves_Raster_1 M_out.FIX_uint32_uint32.All_Curves_FIX.Curves_Raster_1 M_out.FIX_uint8_uint8.All_Curves_FIX.Curves_Raster_1 /end REF_MEASUREMENT
 /begin REF_CHARACTERISTIC One_D_Fix.FIX_sint16_sint16.All_Curves_FIX.Curves_Raster_1 One_D_Fix.FIX_sint32_sint32.All_Curves_FIX.Curves_Raster_1 One_D_Fix.FIX_sint8_sint8.All_Curves_FIX.Curves_Raster_1 One_D_Fix.FIX_uint16_uint16.All_Curves_FIX.Curves_Raster_1 One_D_Fix.FIX_uint32_uint32.All_Curves_FIX.Curves_Raster_1 One_D_Fix.FIX_uint8_uint8.All_Curves_FIX.Curves_Raster_1 P_Do_Active_Fix.FIX_sint16_sint16.All_Curves_FIX.Curves_Raster_1 P_Do_Active_Fix.FIX_sint32_sint32.All_Curves_FIX.Curves_Raster_1 P_Do_Active_Fix.FIX_sint8_sint8.All_Curves_FIX.Curves_Raster_1 P_Do_Active_Fix.FIX_uint16_uint16.All_Curves_FIX.Curves_Raster_1 P_Do_Active_Fix.FIX_uint32_uint32.All_Curves_FIX.Curves_Raster_1 P_Do_Active_Fix.FIX_uint8_uint8.All_Curves_FIX.Curves_Raster_1 P_Do_All_FIX_Curves.All_Curves_FIX.Curves_Raster_1 P_In.FIX_sint16_sint16.All_Curves_FIX.Curves_Raster_1 P_In.FIX_sint32_sint32.All_Curves_FIX.Curves_Raster_1 P_In.FIX_sint8_sint8.All_Curves_FIX.Curves_Raster_1 P_In.FIX_uint16_uint16.All_Curves_FIX.Curves_Raster_1 P_In.FIX_uint32_uint32.All_Curves_FIX.Curves_Raster_1 P_In.FIX_uint8_uint8.All_Curves_FIX.Curves_Raster_1 /end REF_CHARACTERISTIC
 /begin SUB_GROUP FIX_sint16_sint16.All_Curves_FIX.Curves_Raster_1 FIX_sint32_sint32.All_Curves_FIX.Curves_Raster_1 FIX_sint8_sint8.All_Curves_FIX.Curves_Raster_1 FIX_uint16_uint16.All_Curves_FIX.Curves_Raster_1 FIX_uint32_uint32.All_Curves_FIX.Curves_Raster_1 FIX_uint8_uint8.All_Curves_FIX.Curves_Raster_1 /end SUB_GROUP
/end GROUP
/begin GROUP All_Curves_FIX.Curves_Raster_2 ""
 /begin REF_MEASUREMENT Calculated.FIX_sint16_sint16.All_Curves_FIX.Curves_Raster_2 Calculated.FIX_sint32_sint32.All_Curves_FIX.Curves_Raster_2 Calculated.FIX_sint8_sint8.All_Curves_FIX.Curves_Raster_2 Calculated.FIX_uint16_uint16.All_Curves_FIX.Curves_Raster_2 Calculated.FIX_uint32_uint32.All_Curves_FIX.Curves_Raster_2 Calculated.FIX_uint8_uint8.All_Curves_FIX.Curves_Raster_2 M_In.FIX_sint16_sint16.All_Curves_FIX.Curves_Raster_2 M_In.FIX_sint32_sint32.All_Curves_FIX.Curves_Raster_2 M_In.FIX_sint8_sint8.All_Curves_FIX.Curves_Raster_2 M_In.FIX_uint16_uint16.All_Curves_FIX.Curves_Raster_2 M_In.FIX_uint32_uint32.All_Curves_FIX.Curves_Raster_2 M_In.FIX_uint8_uint8.All_Curves_FIX.Curves_Raster_2 M_out.FIX_sint16_sint16.All_Curves_FIX.Curves_Raster_2 M_out.FIX_sint32_sint32.All_Curves_FIX.Curves_Raster_2 M_out.FIX_sint8_sint8.All_Curves_FIX.Curves_Raster_2 M_out.FIX_uint16_uint16.All_Curves_FIX.Curves_Raster_2 M_out.FIX_uint32_uint32.All_Curves_FIX.Curves_Raster_2 M_out.FIX_uint8_uint8.All_Curves_FIX.Curves_Raster_2 /end REF_MEASUREMENT
 /begin REF_CHARACTERISTIC One_D_Fix.FIX_sint16_sint16.All_Curves_FIX.Curves_Raster_2 One_D_Fix.FIX_sint32_sint32.All_Curves_FIX.Curves_Raster_2 One_D_Fix.FIX_sint8_sint8.All_Curves_FIX.Curves_Raster_2 One_D_Fix.FIX_uint16_uint16.All_Curves_FIX.Curves_Raster_2 One_D_Fix.FIX_uint32_uint32.All_Curves_FIX.Curves_Raster_2 One_D_Fix.FIX_uint8_uint8.All_Curves_FIX.Curves_Raster_2 P_Do_Active_Fix.FIX_sint16_sint16.All_Curves_FIX.Curves_Raster_2 P_Do_Active_Fix.FIX_sint32_sint32.All_Curves_FIX.Curves_Raster_2 P_Do_Active_Fix.FIX_sint8_sint8.All_Curves_FIX.Curves_Raster_2 P_Do_Active_Fix.FIX_uint16_uint16.All_Curves_FIX.Curves_Raster_2 P_Do_Active_Fix.FIX_uint32_uint32.All_Curves_FIX.Curves_Raster_2 P_Do_Active_Fix.FIX_uint8_uint8.All_Curves_FIX.Curves_Raster_2 P_Do_All_FIX_Curves.All_Curves_FIX.Curves_Raster_2 P_In.FIX_sint16_sint16.All_Curves_FIX.Curves_Raster_2 P_In.FIX_sint32_sint32.All_Curves_FIX.Curves_Raster_2 P_In.FIX_sint8_sint8.All_Curves_FIX.Curves_Raster_2 P_In.FIX_uint16_uint16.All_Curves_FIX.Curves_Raster_2 P_In.FIX_uint32_uint32.All_Curves_FIX.Curves_Raster_2 P_In.FIX_uint8_uint8.All_Curves_FIX.Curves_Raster_2 /end REF_CHARACTERISTIC
 /begin SUB_GROUP FIX_sint16_sint16.All_Curves_FIX.Curves_Raster_2 FIX_sint32_sint32.All_Curves_FIX.Curves_Raster_2 FIX_sint8_sint8.All_Curves_FIX.Curves_Raster_2 FIX_uint16_uint16.All_Curves_FIX.Curves_Raster_2 FIX_uint32_uint32.All_Curves_FIX.Curves_Raster_2 FIX_uint8_uint8.All_Curves_FIX.Curves_Raster_2 /end SUB_GROUP
/end GROUP
/begin GROUP All_Curves_FIX.Curves_Raster_3 ""
 /begin REF_MEASUREMENT Calculated.FIX_sint16_sint16.All_Curves_FIX.Curves_Raster_3 Calculated.FIX_sint32_sint32.All_Curves_FIX.Curves_Raster_3 Calculated.FIX_sint8_sint8.All_Curves_FIX.Curves_Raster_3 Calculated.FIX_uint16_uint16.All_Curves_FIX.Curves_Raster_3 Calculated.FIX_uint32_uint32.All_Curves_FIX.Curves_Raster_3 Calculated.FIX_uint8_uint8.All_Curves_FIX.Curves_Raster_3 M_In.FIX_sint16_sint16.All_Curves_FIX.Curves_Raster_3 M_In.FIX_sint32_sint32.All_Curves_FIX.Curves_Raster_3 M_In.FIX_sint8_sint8.All_Curves_FIX.Curves_Raster_3 M_In.FIX_uint16_uint16.All_Curves_FIX.Curves_Raster_3 M_In.FIX_uint32_uint32.All_Curves_FIX.Curves_Raster_3 M_In.FIX_uint8_uint8.All_Curves_FIX.Curves_Raster_3 M_out.FIX_sint16_sint16.All_Curves_FIX.Curves_Raster_3 M_out.FIX_sint32_sint32.All_Curves_FIX.Curves_Raster_3 M_out.FIX_sint8_sint8.All_Curves_FIX.Curves_Raster_3 M_out.FIX_uint16_uint16.All_Curves_FIX.Curves_Raster_3 M_out.FIX_uint32_uint32.All_Curves_FIX.Curves_Raster_3 M_out.FIX_uint8_uint8.All_Curves_FIX.Curves_Raster_3 /end REF_MEASUREMENT
 /begin REF_CHARACTERISTIC One_D_Fix.FIX_sint16_sint16.All_Curves_FIX.Curves_Raster_3 One_D_Fix.FIX_sint32_sint32.All_Curves_FIX.Curves_Raster_3 One_D_Fix.FIX_sint8_sint8.All_Curves_FIX.Curves_Raster_3 One_D_Fix.FIX_uint16_uint16.All_Curves_FIX.Curves_Raster_3 One_D_Fix.FIX_uint32_uint32.All_Curves_FIX.Curves_Raster_3 One_D_Fix.FIX_uint8_uint8.All_Curves_FIX.Curves_Raster_3 P_Do_Active_Fix.FIX_sint16_sint16.All_Curves_FIX.Curves_Raster_3 P_Do_Active_Fix.FIX_sint32_sint32.All_Curves_FIX.Curves_Raster_3 P_Do_Active_Fix.FIX_sint8_sint8.All_Curves_FIX.Curves_Raster_3 P_Do_Active_Fix.FIX_uint16_uint16.All_Curves_FIX.Curves_Raster_3 P_Do_Active_Fix.FIX_uint32_uint32.All_Curves_FIX.Curves_Raster_3 P_Do_Active_Fix.FIX_uint8_uint8.All_Curves_FIX.Curves_Raster_3 P_Do_All_FIX_Curves.All_Curves_FIX.Curves_Raster_3 P_In.FIX_sint16_sint16.All_Curves_FIX.Curves_Raster_3 P_In.FIX_sint32_sint32.All_Curves_FIX.Curves_Raster_3 P_In.FIX_sint8_sint8.All_Curves_FIX.Curves_Raster_3 P_In.FIX_uint16_uint16.All_Curves_FIX.Curves_Raster_3 P_In.FIX_uint32_uint32.All_Curves_FIX.Curves_Raster_3 P_In.FIX_uint8_uint8.All_Curves_FIX.Curves_Raster_3 /end REF_CHARACTERISTIC
 /begin SUB_GROUP FIX_sint16_sint16.All_Curves_FIX.Curves_Raster_3 FIX_sint32_sint32.All_Curves_FIX.Curves_Raster_3 FIX_sint8_sint8.All_Curves_FIX.Curves_Raster_3 FIX_uint16_uint16.All_Curves_FIX.Curves_Raster_3 FIX_uint32_uint32.All_Curves_FIX.Curves_Raster_3 FIX_uint8_uint8.All_Curves_FIX.Curves_Raster_3 /end SUB_GROUP
/end GROUP
/begin GROUP All_Curves_GRP.Curves_Raster_1 ""
 /begin REF_MEASUREMENT Calculated.GRP_sint16_sint16.All_Curves_GRP.Curves_Raster_1 Calculated.GRP_sint32_sint32.All_Curves_GRP.Curves_Raster_1 Calculated.GRP_sint8_sint8.All_Curves_GRP.Curves_Raster_1 Calculated.GRP_uint16_uint16.All_Curves_GRP.Curves_Raster_1 Calculated.GRP_uint32_uint32.All_Curves_GRP.Curves_Raster_1 Calculated.GRP_uint8_uint8.All_Curves_GRP.Curves_Raster_1 Distr_Set.GRP_sint16_sint16.All_Curves_GRP.Curves_Raster_1 Distr_Set.GRP_sint32_sint32.All_Curves_GRP.Curves_Raster_1 Distr_Set.GRP_sint8_sint8.All_Curves_GRP.Curves_Raster_1 Distr_Set.GRP_uint16_uint16.All_Curves_GRP.Curves_Raster_1 Distr_Set.GRP_uint32_uint32.All_Curves_GRP.Curves_Raster_1 Distr_Set.GRP_uint8_uint8.All_Curves_GRP.Curves_Raster_1 M_In.GRP_sint16_sint16.All_Curves_GRP.Curves_Raster_1 M_In.GRP_sint32_sint32.All_Curves_GRP.Curves_Raster_1 M_In.GRP_sint8_sint8.All_Curves_GRP.Curves_Raster_1 M_In.GRP_uint16_uint16.All_Curves_GRP.Curves_Raster_1 M_In.GRP_uint32_uint32.All_Curves_GRP.Curves_Raster_1 M_In.GRP_uint8_uint8.All_Curves_GRP.Curves_Raster_1 M_out.GRP_sint16_sint16.All_Curves_GRP.Curves_Raster_1 M_out.GRP_sint32_sint32.All_Curves_GRP.Curves_Raster_1 M_out.GRP_sint8_sint8.All_Curves_GRP.Curves_Raster_1 M_out.GRP_uint16_uint16.All_Curves_GRP.Curves_Raster_1 M_out.GRP_uint32_uint32.All_Curves_GRP.Curves_Raster_1 M_out.GRP_uint8_uint8.All_Curves_GRP.Curves_Raster_1 /end REF_MEASUREMENT
 /begin REF_CHARACTERISTIC One_D_1.GRP_sint16_sint16.All_Curves_GRP.Curves_Raster_1 One_D_1.GRP_sint32_sint32.All_Curves_GRP.Curves_Raster_1 One_D_1.GRP_sint8_sint8.All_Curves_GRP.Curves_Raster_1 One_D_1.GRP_uint16_uint16.All_Curves_GRP.Curves_Raster_1 One_D_1.GRP_uint32_uint32.All_Curves_GRP.Curves_Raster_1 One_D_1.GRP_uint8_uint8.All_Curves_GRP.Curves_Raster_1 P_Do_Active_Grp.GRP_sint16_sint16.All_Curves_GRP.Curves_Raster_1 P_Do_Active_Grp.GRP_sint32_sint32.All_Curves_GRP.Curves_Raster_1 P_Do_Active_Grp.GRP_sint8_sint8.All_Curves_GRP.Curves_Raster_1 P_Do_Active_Grp.GRP_uint16_uint16.All_Curves_GRP.Curves_Raster_1 P_Do_Active_Grp.GRP_uint32_uint32.All_Curves_GRP.Curves_Raster_1 P_Do_Active_Grp.GRP_uint8_uint8.All_Curves_GRP.Curves_Raster_1 P_Do_All_GRP_Curves.All_Curves_GRP.Curves_Raster_1 P_Do_Grp_get.GRP_sint16_sint16.All_Curves_GRP.Curves_Raster_1 P_Do_Grp_get.GRP_sint32_sint32.All_Curves_GRP.Curves_Raster_1 P_Do_Grp_get.GRP_sint8_sint8.All_Curves_GRP.Curves_Raster_1 P_Do_Grp_get.GRP_uint16_uint16.All_Curves_GRP.Curves_Raster_1 P_Do_Grp_get.GRP_uint32_uint32.All_Curves_GRP.Curves_Raster_1 P_Do_Grp_get.GRP_uint8_uint8.All_Curves_GRP.Curves_Raster_1 P_Do_Grp_set.GRP_sint16_sint16.All_Curves_GRP.Curves_Raster_1 P_Do_Grp_set.GRP_sint32_sint32.All_Curves_GRP.Curves_Raster_1 P_Do_Grp_set.GRP_sint8_sint8.All_Curves_GRP.Curves_Raster_1 P_Do_Grp_set.GRP_uint16_uint16.All_Curves_GRP.Curves_Raster_1 P_Do_Grp_set.GRP_uint32_uint32.All_Curves_GRP.Curves_Raster_1 P_Do_Grp_set.GRP_uint8_uint8.All_Curves_GRP.Curves_Raster_1 P_In.GRP_sint16_sint16.All_Curves_GRP.Curves_Raster_1 P_In.GRP_sint32_sint32.All_Curves_GRP.Curves_Raster_1 P_In.GRP_sint8_sint8.All_Curves_GRP.Curves_Raster_1 P_In.GRP_uint16_uint16.All_Curves_GRP.Curves_Raster_1 P_In.GRP_uint32_uint32.All_Curves_GRP.Curves_Raster_1 P_In.GRP_uint8_uint8.All_Curves_GRP.Curves_Raster_1 /end REF_CHARACTERISTIC
 /begin SUB_GROUP GRP_sint16_sint16.All_Curves_GRP.Curves_Raster_1 GRP_sint32_sint32.All_Curves_GRP.Curves_Raster_1 GRP_sint8_sint8.All_Curves_GRP.Curves_Raster_1 GRP_uint16_uint16.All_Curves_GRP.Curves_Raster_1 GRP_uint32_uint32.All_Curves_GRP.Curves_Raster_1 GRP_uint8_uint8.All_Curves_GRP.Curves_Raster_1 /end SUB_GROUP
/end GROUP
/begin GROUP All_Curves_GRP.Curves_Raster_2 ""
 /begin REF_MEASUREMENT Calculated.GRP_sint16_sint16.All_Curves_GRP.Curves_Raster_2 Calculated.GRP_sint32_sint32.All_Curves_GRP.Curves_Raster_2 Calculated.GRP_sint8_sint8.All_Curves_GRP.Curves_Raster_2 Calculated.GRP_uint16_uint16.All_Curves_GRP.Curves_Raster_2 Calculated.GRP_uint32_uint32.All_Curves_GRP.Curves_Raster_2 Calculated.GRP_uint8_uint8.All_Curves_GRP.Curves_Raster_2 Distr_Set.GRP_sint16_sint16.All_Curves_GRP.Curves_Raster_2 Distr_Set.GRP_sint32_sint32.All_Curves_GRP.Curves_Raster_2 Distr_Set.GRP_sint8_sint8.All_Curves_GRP.Curves_Raster_2 Distr_Set.GRP_uint16_uint16.All_Curves_GRP.Curves_Raster_2 Distr_Set.GRP_uint32_uint32.All_Curves_GRP.Curves_Raster_2 Distr_Set.GRP_uint8_uint8.All_Curves_GRP.Curves_Raster_2 M_In.GRP_sint16_sint16.All_Curves_GRP.Curves_Raster_2 M_In.GRP_sint32_sint32.All_Curves_GRP.Curves_Raster_2 M_In.GRP_sint8_sint8.All_Curves_GRP.Curves_Raster_2 M_In.GRP_uint16_uint16.All_Curves_GRP.Curves_Raster_2 M_In.GRP_uint32_uint32.All_Curves_GRP.Curves_Raster_2 M_In.GRP_uint8_uint8.All_Curves_GRP.Curves_Raster_2 M_out.GRP_sint16_sint16.All_Curves_GRP.Curves_Raster_2 M_out.GRP_sint32_sint32.All_Curves_GRP.Curves_Raster_2 M_out.GRP_sint8_sint8.All_Curves_GRP.Curves_Raster_2 M_out.GRP_uint16_uint16.All_Curves_GRP.Curves_Raster_2 M_out.GRP_uint32_uint32.All_Curves_GRP.Curves_Raster_2 M_out.GRP_uint8_uint8.All_Curves_GRP.Curves_Raster_2 /end REF_MEASUREMENT
 /begin REF_CHARACTERISTIC One_D_1.GRP_sint16_sint16.All_Curves_GRP.Curves_Raster_2 One_D_1.GRP_sint32_sint32.All_Curves_GRP.Curves_Raster_2 One_D_1.GRP_sint8_sint8.All_Curves_GRP.Curves_Raster_2 One_D_1.GRP_uint16_uint16.All_Curves_GRP.Curves_Raster_2 One_D_1.GRP_uint32_uint32.All_Curves_GRP.Curves_Raster_2 One_D_1.GRP_uint8_uint8.All_Curves_GRP.Curves_Raster_2 P_Do_Active_Grp.GRP_sint16_sint16.All_Curves_GRP.Curves_Raster_2 P_Do_Active_Grp.GRP_sint32_sint32.All_Curves_GRP.Curves_Raster_2 P_Do_Active_Grp.GRP_sint8_sint8.All_Curves_GRP.Curves_Raster_2 P_Do_Active_Grp.GRP_uint16_uint16.All_Curves_GRP.Curves_Raster_2 P_Do_Active_Grp.GRP_uint32_uint32.All_Curves_GRP.Curves_Raster_2 P_Do_Active_Grp.GRP_uint8_uint8.All_Curves_GRP.Curves_Raster_2 P_Do_All_GRP_Curves.All_Curves_GRP.Curves_Raster_2 P_Do_Grp_get.GRP_sint16_sint16.All_Curves_GRP.Curves_Raster_2 P_Do_Grp_get.GRP_sint32_sint32.All_Curves_GRP.Curves_Raster_2 P_Do_Grp_get.GRP_sint8_sint8.All_Curves_GRP.Curves_Raster_2 P_Do_Grp_get.GRP_uint16_uint16.All_Curves_GRP.Curves_Raster_2 P_Do_Grp_get.GRP_uint32_uint32.All_Curves_GRP.Curves_Raster_2 P_Do_Grp_get.GRP_uint8_uint8.All_Curves_GRP.Curves_Raster_2 P_Do_Grp_set.GRP_sint16_sint16.All_Curves_GRP.Curves_Raster_2 P_Do_Grp_set.GRP_sint32_sint32.All_Curves_GRP.Curves_Raster_2 P_Do_Grp_set.GRP_sint8_sint8.All_Curves_GRP.Curves_Raster_2 P_Do_Grp_set.GRP_uint16_uint16.All_Curves_GRP.Curves_Raster_2 P_Do_Grp_set.GRP_uint32_uint32.All_Curves_GRP.Curves_Raster_2 P_Do_Grp_set.GRP_uint8_uint8.All_Curves_GRP.Curves_Raster_2 P_In.GRP_sint16_sint16.All_Curves_GRP.Curves_Raster_2 P_In.GRP_sint32_sint32.All_Curves_GRP.Curves_Raster_2 P_In.GRP_sint8_sint8.All_Curves_GRP.Curves_Raster_2 P_In.GRP_uint16_uint16.All_Curves_GRP.Curves_Raster_2 P_In.GRP_uint32_uint32.All_Curves_GRP.Curves_Raster_2 P_In.GRP_uint8_uint8.All_Curves_GRP.Curves_Raster_2 /end REF_CHARACTERISTIC
 /begin SUB_GROUP GRP_sint16_sint16.All_Curves_GRP.Curves_Raster_2 GRP_sint32_sint32.All_Curves_GRP.Curves_Raster_2 GRP_sint8_sint8.All_Curves_GRP.Curves_Raster_2 GRP_uint16_uint16.All_Curves_GRP.Curves_Raster_2 GRP_uint32_uint32.All_Curves_GRP.Curves_Raster_2 GRP_uint8_uint8.All_Curves_GRP.Curves_Raster_2 /end SUB_GROUP
/end GROUP
/begin GROUP All_Curves_GRP.Curves_Raster_3 ""
 /begin REF_MEASUREMENT Calculated.GRP_sint16_sint16.All_Curves_GRP.Curves_Raster_3 Calculated.GRP_sint32_sint32.All_Curves_GRP.Curves_Raster_3 Calculated.GRP_sint8_sint8.All_Curves_GRP.Curves_Raster_3 Calculated.GRP_uint16_uint16.All_Curves_GRP.Curves_Raster_3 Calculated.GRP_uint32_uint32.All_Curves_GRP.Curves_Raster_3 Calculated.GRP_uint8_uint8.All_Curves_GRP.Curves_Raster_3 Distr_Set.GRP_sint16_sint16.All_Curves_GRP.Curves_Raster_3 Distr_Set.GRP_sint32_sint32.All_Curves_GRP.Curves_Raster_3 Distr_Set.GRP_sint8_sint8.All_Curves_GRP.Curves_Raster_3 Distr_Set.GRP_uint16_uint16.All_Curves_GRP.Curves_Raster_3 Distr_Set.GRP_uint32_uint32.All_Curves_GRP.Curves_Raster_3 Distr_Set.GRP_uint8_uint8.All_Curves_GRP.Curves_Raster_3 M_In.GRP_sint16_sint16.All_Curves_GRP.Curves_Raster_3 M_In.GRP_sint32_sint32.All_Curves_GRP.Curves_Raster_3 M_In.GRP_sint8_sint8.All_Curves_GRP.Curves_Raster_3 M_In.GRP_uint16_uint16.All_Curves_GRP.Curves_Raster_3 M_In.GRP_uint32_uint32.All_Curves_GRP.Curves_Raster_3 M_In.GRP_uint8_uint8.All_Curves_GRP.Curves_Raster_3 M_out.GRP_sint16_sint16.All_Curves_GRP.Curves_Raster_3 M_out.GRP_sint32_sint32.All_Curves_GRP.Curves_Raster_3 M_out.GRP_sint8_sint8.All_Curves_GRP.Curves_Raster_3 M_out.GRP_uint16_uint16.All_Curves_GRP.Curves_Raster_3 M_out.GRP_uint32_uint32.All_Curves_GRP.Curves_Raster_3 M_out.GRP_uint8_uint8.All_Curves_GRP.Curves_Raster_3 /end REF_MEASUREMENT
 /begin REF_CHARACTERISTIC One_D_1.GRP_sint16_sint16.All_Curves_GRP.Curves_Raster_3 One_D_1.GRP_sint32_sint32.All_Curves_GRP.Curves_Raster_3 One_D_1.GRP_sint8_sint8.All_Curves_GRP.Curves_Raster_3 One_D_1.GRP_uint16_uint16.All_Curves_GRP.Curves_Raster_3 One_D_1.GRP_uint32_uint32.All_Curves_GRP.Curves_Raster_3 One_D_1.GRP_uint8_uint8.All_Curves_GRP.Curves_Raster_3 P_Do_Active_Grp.GRP_sint16_sint16.All_Curves_GRP.Curves_Raster_3 P_Do_Active_Grp.GRP_sint32_sint32.All_Curves_GRP.Curves_Raster_3 P_Do_Active_Grp.GRP_sint8_sint8.All_Curves_GRP.Curves_Raster_3 P_Do_Active_Grp.GRP_uint16_uint16.All_Curves_GRP.Curves_Raster_3 P_Do_Active_Grp.GRP_uint32_uint32.All_Curves_GRP.Curves_Raster_3 P_Do_Active_Grp.GRP_uint8_uint8.All_Curves_GRP.Curves_Raster_3 P_Do_All_GRP_Curves.All_Curves_GRP.Curves_Raster_3 P_Do_Grp_get.GRP_sint16_sint16.All_Curves_GRP.Curves_Raster_3 P_Do_Grp_get.GRP_sint32_sint32.All_Curves_GRP.Curves_Raster_3 P_Do_Grp_get.GRP_sint8_sint8.All_Curves_GRP.Curves_Raster_3 P_Do_Grp_get.GRP_uint16_uint16.All_Curves_GRP.Curves_Raster_3 P_Do_Grp_get.GRP_uint32_uint32.All_Curves_GRP.Curves_Raster_3 P_Do_Grp_get.GRP_uint8_uint8.All_Curves_GRP.Curves_Raster_3 P_Do_Grp_set.GRP_sint16_sint16.All_Curves_GRP.Curves_Raster_3 P_Do_Grp_set.GRP_sint32_sint32.All_Curves_GRP.Curves_Raster_3 P_Do_Grp_set.GRP_sint8_sint8.All_Curves_GRP.Curves_Raster_3 P_Do_Grp_set.GRP_uint16_uint16.All_Curves_GRP.Curves_Raster_3 P_Do_Grp_set.GRP_uint32_uint32.All_Curves_GRP.Curves_Raster_3 P_Do_Grp_set.GRP_uint8_uint8.All_Curves_GRP.Curves_Raster_3 P_In.GRP_sint16_sint16.All_Curves_GRP.Curves_Raster_3 P_In.GRP_sint32_sint32.All_Curves_GRP.Curves_Raster_3 P_In.GRP_sint8_sint8.All_Curves_GRP.Curves_Raster_3 P_In.GRP_uint16_uint16.All_Curves_GRP.Curves_Raster_3 P_In.GRP_uint32_uint32.All_Curves_GRP.Curves_Raster_3 P_In.GRP_uint8_uint8.All_Curves_GRP.Curves_Raster_3 /end REF_CHARACTERISTIC
 /begin SUB_GROUP GRP_sint16_sint16.All_Curves_GRP.Curves_Raster_3 GRP_sint32_sint32.All_Curves_GRP.Curves_Raster_3 GRP_sint8_sint8.All_Curves_GRP.Curves_Raster_3 GRP_uint16_uint16.All_Curves_GRP.Curves_Raster_3 GRP_uint32_uint32.All_Curves_GRP.Curves_Raster_3 GRP_uint8_uint8.All_Curves_GRP.Curves_Raster_3 /end SUB_GROUP
/end GROUP
/begin GROUP All_Curves_STD.Curves_Raster_1 ""
 /begin REF_MEASUREMENT Calculated.STD_sint16_sint16.All_Curves_STD.Curves_Raster_1 Calculated.STD_sint32_sint32.All_Curves_STD.Curves_Raster_1 Calculated.STD_sint8_sint8.All_Curves_STD.Curves_Raster_1 Calculated.STD_uint16_uint16.All_Curves_STD.Curves_Raster_1 Calculated.STD_uint32_uint32.All_Curves_STD.Curves_Raster_1 Calculated.STD_uint8_uint8.All_Curves_STD.Curves_Raster_1 M_In.STD_sint16_sint16.All_Curves_STD.Curves_Raster_1 M_In.STD_sint32_sint32.All_Curves_STD.Curves_Raster_1 M_In.STD_sint8_sint8.All_Curves_STD.Curves_Raster_1 M_In.STD_uint16_uint16.All_Curves_STD.Curves_Raster_1 M_In.STD_uint32_uint32.All_Curves_STD.Curves_Raster_1 M_In.STD_uint8_uint8.All_Curves_STD.Curves_Raster_1 M_out.STD_sint16_sint16.All_Curves_STD.Curves_Raster_1 M_out.STD_sint32_sint32.All_Curves_STD.Curves_Raster_1 M_out.STD_sint8_sint8.All_Curves_STD.Curves_Raster_1 M_out.STD_uint16_uint16.All_Curves_STD.Curves_Raster_1 M_out.STD_uint32_uint32.All_Curves_STD.Curves_Raster_1 M_out.STD_uint8_uint8.All_Curves_STD.Curves_Raster_1 /end REF_MEASUREMENT
 /begin REF_CHARACTERISTIC One_D.STD_sint16_sint16.All_Curves_STD.Curves_Raster_1 One_D.STD_sint32_sint32.All_Curves_STD.Curves_Raster_1 One_D.STD_sint8_sint8.All_Curves_STD.Curves_Raster_1 One_D.STD_uint16_uint16.All_Curves_STD.Curves_Raster_1 One_D.STD_uint32_uint32.All_Curves_STD.Curves_Raster_1 One_D.STD_uint8_uint8.All_Curves_STD.Curves_Raster_1 P_Do_Active_Std.STD_sint16_sint16.All_Curves_STD.Curves_Raster_1 P_Do_Active_Std.STD_sint32_sint32.All_Curves_STD.Curves_Raster_1 P_Do_Active_Std.STD_sint8_sint8.All_Curves_STD.Curves_Raster_1 P_Do_Active_Std.STD_uint16_uint16.All_Curves_STD.Curves_Raster_1 P_Do_Active_Std.STD_uint32_uint32.All_Curves_STD.Curves_Raster_1 P_Do_Active_Std.STD_uint8_uint8.All_Curves_STD.Curves_Raster_1 P_Do_All_STD_Curves.All_Curves_STD.Curves_Raster_1 P_In.STD_sint16_sint16.All_Curves_STD.Curves_Raster_1 P_In.STD_sint32_sint32.All_Curves_STD.Curves_Raster_1 P_In.STD_sint8_sint8.All_Curves_STD.Curves_Raster_1 P_In.STD_uint16_uint16.All_Curves_STD.Curves_Raster_1 P_In.STD_uint32_uint32.All_Curves_STD.Curves_Raster_1 P_In.STD_uint8_uint8.All_Curves_STD.Curves_Raster_1 /end REF_CHARACTERISTIC
 /begin SUB_GROUP STD_sint16_sint16.All_Curves_STD.Curves_Raster_1 STD_sint32_sint32.All_Curves_STD.Curves_Raster_1 STD_sint8_sint8.All_Curves_STD.Curves_Raster_1 STD_uint16_uint16.All_Curves_STD.Curves_Raster_1 STD_uint32_uint32.All_Curves_STD.Curves_Raster_1 STD_uint8_uint8.All_Curves_STD.Curves_Raster_1 /end SUB_GROUP
/end GROUP
/begin GROUP All_Curves_STD.Curves_Raster_2 ""
 /begin REF_MEASUREMENT Calculated.STD_sint16_sint16.All_Curves_STD.Curves_Raster_2 Calculated.STD_sint32_sint32.All_Curves_STD.Curves_Raster_2 Calculated.STD_sint8_sint8.All_Curves_STD.Curves_Raster_2 Calculated.STD_uint16_uint16.All_Curves_STD.Curves_Raster_2 Calculated.STD_uint32_uint32.All_Curves_STD.Curves_Raster_2 Calculated.STD_uint8_uint8.All_Curves_STD.Curves_Raster_2 M_In.STD_sint16_sint16.All_Curves_STD.Curves_Raster_2 M_In.STD_sint32_sint32.All_Curves_STD.Curves_Raster_2 M_In.STD_sint8_sint8.All_Curves_STD.Curves_Raster_2 M_In.STD_uint16_uint16.All_Curves_STD.Curves_Raster_2 M_In.STD_uint32_uint32.All_Curves_STD.Curves_Raster_2 M_In.STD_uint8_uint8.All_Curves_STD.Curves_Raster_2 M_out.STD_sint16_sint16.All_Curves_STD.Curves_Raster_2 M_out.STD_sint32_sint32.All_Curves_STD.Curves_Raster_2 M_out.STD_sint8_sint8.All_Curves_STD.Curves_Raster_2 M_out.STD_uint16_uint16.All_Curves_STD.Curves_Raster_2 M_out.STD_uint32_uint32.All_Curves_STD.Curves_Raster_2 M_out.STD_uint8_uint8.All_Curves_STD.Curves_Raster_2 /end REF_MEASUREMENT
 /begin REF_CHARACTERISTIC One_D.STD_sint16_sint16.All_Curves_STD.Curves_Raster_2 One_D.STD_sint32_sint32.All_Curves_STD.Curves_Raster_2 One_D.STD_sint8_sint8.All_Curves_STD.Curves_Raster_2 One_D.STD_uint16_uint16.All_Curves_STD.Curves_Raster_2 One_D.STD_uint32_uint32.All_Curves_STD.Curves_Raster_2 One_D.STD_uint8_uint8.All_Curves_STD.Curves_Raster_2 P_Do_Active_Std.STD_sint16_sint16.All_Curves_STD.Curves_Raster_2 P_Do_Active_Std.STD_sint32_sint32.All_Curves_STD.Curves_Raster_2 P_Do_Active_Std.STD_sint8_sint8.All_Curves_STD.Curves_Raster_2 P_Do_Active_Std.STD_uint16_uint16.All_Curves_STD.Curves_Raster_2 P_Do_Active_Std.STD_uint32_uint32.All_Curves_STD.Curves_Raster_2 P_Do_Active_Std.STD_uint8_uint8.All_Curves_STD.Curves_Raster_2 P_Do_All_STD_Curves.All_Curves_STD.Curves_Raster_2 P_In.STD_sint16_sint16.All_Curves_STD.Curves_Raster_2 P_In.STD_sint32_sint32.All_Curves_STD.Curves_Raster_2 P_In.STD_sint8_sint8.All_Curves_STD.Curves_Raster_2 P_In.STD_uint16_uint16.All_Curves_STD.Curves_Raster_2 P_In.STD_uint32_uint32.All_Curves_STD.Curves_Raster_2 P_In.STD_uint8_uint8.All_Curves_STD.Curves_Raster_2 /end REF_CHARACTERISTIC
 /begin SUB_GROUP STD_sint16_sint16.All_Curves_STD.Curves_Raster_2 STD_sint32_sint32.All_Curves_STD.Curves_Raster_2 STD_sint8_sint8.All_Curves_STD.Curves_Raster_2 STD_uint16_uint16.All_Curves_STD.Curves_Raster_2 STD_uint32_uint32.All_Curves_STD.Curves_Raster_2 STD_uint8_uint8.All_Curves_STD.Curves_Raster_2 /end SUB_GROUP
/end GROUP
/begin GROUP All_Curves_STD.Curves_Raster_3 ""
 /begin REF_MEASUREMENT Calculated.STD_sint16_sint16.All_Curves_STD.Curves_Raster_3 Calculated.STD_sint32_sint32.All_Curves_STD.Curves_Raster_3 Calculated.STD_sint8_sint8.All_Curves_STD.Curves_Raster_3 Calculated.STD_uint16_uint16.All_Curves_STD.Curves_Raster_3 Calculated.STD_uint32_uint32.All_Curves_STD.Curves_Raster_3 Calculated.STD_uint8_uint8.All_Curves_STD.Curves_Raster_3 M_In.STD_sint16_sint16.All_Curves_STD.Curves_Raster_3 M_In.STD_sint32_sint32.All_Curves_STD.Curves_Raster_3 M_In.STD_sint8_sint8.All_Curves_STD.Curves_Raster_3 M_In.STD_uint16_uint16.All_Curves_STD.Curves_Raster_3 M_In.STD_uint32_uint32.All_Curves_STD.Curves_Raster_3 M_In.STD_uint8_uint8.All_Curves_STD.Curves_Raster_3 M_out.STD_sint16_sint16.All_Curves_STD.Curves_Raster_3 M_out.STD_sint32_sint32.All_Curves_STD.Curves_Raster_3 M_out.STD_sint8_sint8.All_Curves_STD.Curves_Raster_3 M_out.STD_uint16_uint16.All_Curves_STD.Curves_Raster_3 M_out.STD_uint32_uint32.All_Curves_STD.Curves_Raster_3 M_out.STD_uint8_uint8.All_Curves_STD.Curves_Raster_3 /end REF_MEASUREMENT
 /begin REF_CHARACTERISTIC One_D.STD_sint16_sint16.All_Curves_STD.Curves_Raster_3 One_D.STD_sint32_sint32.All_Curves_STD.Curves_Raster_3 One_D.STD_sint8_sint8.All_Curves_STD.Curves_Raster_3 One_D.STD_uint16_uint16.All_Curves_STD.Curves_Raster_3 One_D.STD_uint32_uint32.All_Curves_STD.Curves_Raster_3 One_D.STD_uint8_uint8.All_Curves_STD.Curves_Raster_3 P_Do_Active_Std.STD_sint16_sint16.All_Curves_STD.Curves_Raster_3 P_Do_Active_Std.STD_sint32_sint32.All_Curves_STD.Curves_Raster_3 P_Do_Active_Std.STD_sint8_sint8.All_Curves_STD.Curves_Raster_3 P_Do_Active_Std.STD_uint16_uint16.All_Curves_STD.Curves_Raster_3 P_Do_Active_Std.STD_uint32_uint32.All_Curves_STD.Curves_Raster_3 P_Do_Active_Std.STD_uint8_uint8.All_Curves_STD.Curves_Raster_3 P_Do_All_STD_Curves.All_Curves_STD.Curves_Raster_3 P_In.STD_sint16_sint16.All_Curves_STD.Curves_Raster_3 P_In.STD_sint32_sint32.All_Curves_STD.Curves_Raster_3 P_In.STD_sint8_sint8.All_Curves_STD.Curves_Raster_3 P_In.STD_uint16_uint16.All_Curves_STD.Curves_Raster_3 P_In.STD_uint32_uint32.All_Curves_STD.Curves_Raster_3 P_In.STD_uint8_uint8.All_Curves_STD.Curves_Raster_3 /end REF_CHARACTERISTIC
 /begin SUB_GROUP STD_sint16_sint16.All_Curves_STD.Curves_Raster_3 STD_sint32_sint32.All_Curves_STD.Curves_Raster_3 STD_sint8_sint8.All_Curves_STD.Curves_Raster_3 STD_uint16_uint16.All_Curves_STD.Curves_Raster_3 STD_uint32_uint32.All_Curves_STD.Curves_Raster_3 STD_uint8_uint8.All_Curves_STD.Curves_Raster_3 /end SUB_GROUP
/end GROUP
/begin GROUP BASE "" ROOT
 /begin REF_MEASUREMENT ebCtrNewT_ASD.AS.BASE ebCtrNewY_ASD.AS.BASE ebCtrOldT_ASD.AS.BASE ebCtrOldY_ASD.AS.BASE r100msTaskCtr.AS.BASE /end REF_MEASUREMENT
 /begin REF_CHARACTERISTIC EBEN_ASD.AS.BASE /end REF_CHARACTERISTIC
/end GROUP
/begin GROUP Curves_Raster_1 "" ROOT
 /begin REF_MEASUREMENT Calculated.FIX_sint16_sint16.All_Curves_FIX.Curves_Raster_1 Calculated.FIX_sint32_sint32.All_Curves_FIX.Curves_Raster_1 Calculated.FIX_sint8_sint8.All_Curves_FIX.Curves_Raster_1 Calculated.FIX_uint16_uint16.All_Curves_FIX.Curves_Raster_1 Calculated.FIX_uint32_uint32.All_Curves_FIX.Curves_Raster_1 Calculated.FIX_uint8_uint8.All_Curves_FIX.Curves_Raster_1 Calculated.GRP_sint16_sint16.All_Curves_GRP.Curves_Raster_1 Calculated.GRP_sint32_sint32.All_Curves_GRP.Curves_Raster_1 Calculated.GRP_sint8_sint8.All_Curves_GRP.Curves_Raster_1 Calculated.GRP_uint16_uint16.All_Curves_GRP.Curves_Raster_1 Calculated.GRP_uint32_uint32.All_Curves_GRP.Curves_Raster_1 Calculated.GRP_uint8_uint8.All_Curves_GRP.Curves_Raster_1 Calculated.STD_sint16_sint16.All_Curves_STD.Curves_Raster_1 Calculated.STD_sint32_sint32.All_Curves_STD.Curves_Raster_1 Calculated.STD_sint8_sint8.All_Curves_STD.Curves_Raster_1 Calculated.STD_uint16_uint16.All_Curves_STD.Curves_Raster_1 Calculated.STD_uint32_uint32.All_Curves_STD.Curves_Raster_1 Calculated.STD_uint8_uint8.All_Curves_STD.Curves_Raster_1 Distr_Set.GRP_sint16_sint16.All_Curves_GRP.Curves_Raster_1 Distr_Set.GRP_sint32_sint32.All_Curves_GRP.Curves_Raster_1 Distr_Set.GRP_sint8_sint8.All_Curves_GRP.Curves_Raster_1 Distr_Set.GRP_uint16_uint16.All_Curves_GRP.Curves_Raster_1 Distr_Set.GRP_uint32_uint32.All_Curves_GRP.Curves_Raster_1 Distr_Set.GRP_uint8_uint8.All_Curves_GRP.Curves_Raster_1 M_In.FIX_sint16_sint16.All_Curves_FIX.Curves_Raster_1 M_In.FIX_sint32_sint32.All_Curves_FIX.Curves_Raster_1 M_In.FIX_sint8_sint8.All_Curves_FIX.Curves_Raster_1 M_In.FIX_uint16_uint16.All_Curves_FIX.Curves_Raster_1 M_In.FIX_uint32_uint32.All_Curves_FIX.Curves_Raster_1 M_In.FIX_uint8_uint8.All_Curves_FIX.Curves_Raster_1 M_In.GRP_sint16_sint16.All_Curves_GRP.Curves_Raster_1 M_In.GRP_sint32_sint32.All_Curves_GRP.Curves_Raster_1 M_In.GRP_sint8_sint8.All_Curves_GRP.Curves_Raster_1 M_In.GRP_uint16_uint16.All_Curves_GRP.Curves_Raster_1 M_In.GRP_uint32_uint32.All_Curves_GRP.Curves_Raster_1 M_In.GRP_uint8_uint8.All_Curves_GRP.Curves_Raster_1 M_In.STD_sint16_sint16.All_Curves_STD.Curves_Raster_1 M_In.STD_sint32_sint32.All_Curves_STD.Curves_Raster_1 M_In.STD_sint8_sint8.All_Curves_STD.Curves_Raster_1 M_In.STD_uint16_uint16.All_Curves_STD.Curves_Raster_1 M_In.STD_uint32_uint32.All_Curves_STD.Curves_Raster_1 M_In.STD_uint8_uint8.All_Curves_STD.Curves_Raster_1 M_out.FIX_sint16_sint16.All_Curves_FIX.Curves_Raster_1 M_out.FIX_sint32_sint32.All_Curves_FIX.Curves_Raster_1 M_out.FIX_sint8_sint8.All_Curves_FIX.Curves_Raster_1 M_out.FIX_uint16_uint16.All_Curves_FIX.Curves_Raster_1 M_out.FIX_uint32_uint32.All_Curves_FIX.Curves_Raster_1 M_out.FIX_uint8_uint8.All_Curves_FIX.Curves_Raster_1 M_out.GRP_sint16_sint16.All_Curves_GRP.Curves_Raster_1 M_out.GRP_sint32_sint32.All_Curves_GRP.Curves_Raster_1 M_out.GRP_sint8_sint8.All_Curves_GRP.Curves_Raster_1 M_out.GRP_uint16_uint16.All_Curves_GRP.Curves_Raster_1 M_out.GRP_uint32_uint32.All_Curves_GRP.Curves_Raster_1 M_out.GRP_uint8_uint8.All_Curves_GRP.Curves_Raster_1 M_out.STD_sint16_sint16.All_Curves_STD.Curves_Raster_1 M_out.STD_sint32_sint32.All_Curves_STD.Curves_Raster_1 M_out.STD_sint8_sint8.All_Curves_STD.Curves_Raster_1 M_out.STD_uint16_uint16.All_Curves_STD.Curves_Raster_1 M_out.STD_uint32_uint32.All_Curves_STD.Curves_Raster_1 M_out.STD_uint8_uint8.All_Curves_STD.Curves_Raster_1 /end REF_MEASUREMENT
 /begin REF_CHARACTERISTIC One_D.STD_sint16_sint16.All_Curves_STD.Curves_Raster_1 One_D.STD_sint32_sint32.All_Curves_STD.Curves_Raster_1 One_D.STD_sint8_sint8.All_Curves_STD.Curves_Raster_1 One_D.STD_uint16_uint16.All_Curves_STD.Curves_Raster_1 One_D.STD_uint32_uint32.All_Curves_STD.Curves_Raster_1 One_D.STD_uint8_uint8.All_Curves_STD.Curves_Raster_1 One_D_1.GRP_sint16_sint16.All_Curves_GRP.Curves_Raster_1 One_D_1.GRP_sint32_sint32.All_Curves_GRP.Curves_Raster_1 One_D_1.GRP_sint8_sint8.All_Curves_GRP.Curves_Raster_1 One_D_1.GRP_uint16_uint16.All_Curves_GRP.Curves_Raster_1 One_D_1.GRP_uint32_uint32.All_Curves_GRP.Curves_Raster_1 One_D_1.GRP_uint8_uint8.All_Curves_GRP.Curves_Raster_1 One_D_Fix.FIX_sint16_sint16.All_Curves_FIX.Curves_Raster_1 One_D_Fix.FIX_sint32_sint32.All_Curves_FIX.Curves_Raster_1 One_D_Fix.FIX_sint8_sint8.All_Curves_FIX.Curves_Raster_1 One_D_Fix.FIX_uint16_uint16.All_Curves_FIX.Curves_Raster_1 One_D_Fix.FIX_uint32_uint32.All_Curves_FIX.Curves_Raster_1 One_D_Fix.FIX_uint8_uint8.All_Curves_FIX.Curves_Raster_1 P_Do_Active_Fix.FIX_sint16_sint16.All_Curves_FIX.Curves_Raster_1 P_Do_Active_Fix.FIX_sint32_sint32.All_Curves_FIX.Curves_Raster_1 P_Do_Active_Fix.FIX_sint8_sint8.All_Curves_FIX.Curves_Raster_1 P_Do_Active_Fix.FIX_uint16_uint16.All_Curves_FIX.Curves_Raster_1 P_Do_Active_Fix.FIX_uint32_uint32.All_Curves_FIX.Curves_Raster_1 P_Do_Active_Fix.FIX_uint8_uint8.All_Curves_FIX.Curves_Raster_1 P_Do_Active_Grp.GRP_sint16_sint16.All_Curves_GRP.Curves_Raster_1 P_Do_Active_Grp.GRP_sint32_sint32.All_Curves_GRP.Curves_Raster_1 P_Do_Active_Grp.GRP_sint8_sint8.All_Curves_GRP.Curves_Raster_1 P_Do_Active_Grp.GRP_uint16_uint16.All_Curves_GRP.Curves_Raster_1 P_Do_Active_Grp.GRP_uint32_uint32.All_Curves_GRP.Curves_Raster_1 P_Do_Active_Grp.GRP_uint8_uint8.All_Curves_GRP.Curves_Raster_1 P_Do_Active_Std.STD_sint16_sint16.All_Curves_STD.Curves_Raster_1 P_Do_Active_Std.STD_sint32_sint32.All_Curves_STD.Curves_Raster_1 P_Do_Active_Std.STD_sint8_sint8.All_Curves_STD.Curves_Raster_1 P_Do_Active_Std.STD_uint16_uint16.All_Curves_STD.Curves_Raster_1 P_Do_Active_Std.STD_uint32_uint32.All_Curves_STD.Curves_Raster_1 P_Do_Active_Std.STD_uint8_uint8.All_Curves_STD.Curves_Raster_1 P_Do_All_FIX_Curves.All_Curves_FIX.Curves_Raster_1 P_Do_All_GRP_Curves.All_Curves_GRP.Curves_Raster_1 P_Do_All_STD_Curves.All_Curves_STD.Curves_Raster_1 P_Do_Grp_get.GRP_sint16_sint16.All_Curves_GRP.Curves_Raster_1 P_Do_Grp_get.GRP_sint32_sint32.All_Curves_GRP.Curves_Raster_1 P_Do_Grp_get.GRP_sint8_sint8.All_Curves_GRP.Curves_Raster_1 P_Do_Grp_get.GRP_uint16_uint16.All_Curves_GRP.Curves_Raster_1 P_Do_Grp_get.GRP_uint32_uint32.All_Curves_GRP.Curves_Raster_1 P_Do_Grp_get.GRP_uint8_uint8.All_Curves_GRP.Curves_Raster_1 P_Do_Grp_set.GRP_sint16_sint16.All_Curves_GRP.Curves_Raster_1 P_Do_Grp_set.GRP_sint32_sint32.All_Curves_GRP.Curves_Raster_1 P_Do_Grp_set.GRP_sint8_sint8.All_Curves_GRP.Curves_Raster_1 P_Do_Grp_set.GRP_uint16_uint16.All_Curves_GRP.Curves_Raster_1 P_Do_Grp_set.GRP_uint32_uint32.All_Curves_GRP.Curves_Raster_1 P_Do_Grp_set.GRP_uint8_uint8.All_Curves_GRP.Curves_Raster_1 P_In.FIX_sint16_sint16.All_Curves_FIX.Curves_Raster_1 P_In.FIX_sint32_sint32.All_Curves_FIX.Curves_Raster_1 P_In.FIX_sint8_sint8.All_Curves_FIX.Curves_Raster_1 P_In.FIX_uint16_uint16.All_Curves_FIX.Curves_Raster_1 P_In.FIX_uint32_uint32.All_Curves_FIX.Curves_Raster_1 P_In.FIX_uint8_uint8.All_Curves_FIX.Curves_Raster_1 P_In.GRP_sint16_sint16.All_Curves_GRP.Curves_Raster_1 P_In.GRP_sint32_sint32.All_Curves_GRP.Curves_Raster_1 P_In.GRP_sint8_sint8.All_Curves_GRP.Curves_Raster_1 P_In.GRP_uint16_uint16.All_Curves_GRP.Curves_Raster_1 P_In.GRP_uint32_uint32.All_Curves_GRP.Curves_Raster_1 P_In.GRP_uint8_uint8.All_Curves_GRP.Curves_Raster_1 P_In.STD_sint16_sint16.All_Curves_STD.Curves_Raster_1 P_In.STD_sint32_sint32.All_Curves_STD.Curves_Raster_1 P_In.STD_sint8_sint8.All_Curves_STD.Curves_Raster_1 P_In.STD_uint16_uint16.All_Curves_STD.Curves_Raster_1 P_In.STD_uint32_uint32.All_Curves_STD.Curves_Raster_1 P_In.STD_uint8_uint8.All_Curves_STD.Curves_Raster_1 /end REF_CHARACTERISTIC
/end GROUP
/begin GROUP Curves_Raster_2 "" ROOT
 /begin REF_MEASUREMENT Calculated.FIX_sint16_sint16.All_Curves_FIX.Curves_Raster_2 Calculated.FIX_sint32_sint32.All_Curves_FIX.Curves_Raster_2 Calculated.FIX_sint8_sint8.All_Curves_FIX.Curves_Raster_2 Calculated.FIX_uint16_uint16.All_Curves_FIX.Curves_Raster_2 Calculated.FIX_uint32_uint32.All_Curves_FIX.Curves_Raster_2 Calculated.FIX_uint8_uint8.All_Curves_FIX.Curves_Raster_2 Calculated.GRP_sint16_sint16.All_Curves_GRP.Curves_Raster_2 Calculated.GRP_sint32_sint32.All_Curves_GRP.Curves_Raster_2 Calculated.GRP_sint8_sint8.All_Curves_GRP.Curves_Raster_2 Calculated.GRP_uint16_uint16.All_Curves_GRP.Curves_Raster_2 Calculated.GRP_uint32_uint32.All_Curves_GRP.Curves_Raster_2 Calculated.GRP_uint8_uint8.All_Curves_GRP.Curves_Raster_2 Calculated.STD_sint16_sint16.All_Curves_STD.Curves_Raster_2 Calculated.STD_sint32_sint32.All_Curves_STD.Curves_Raster_2 Calculated.STD_sint8_sint8.All_Curves_STD.Curves_Raster_2 Calculated.STD_uint16_uint16.All_Curves_STD.Curves_Raster_2 Calculated.STD_uint32_uint32.All_Curves_STD.Curves_Raster_2 Calculated.STD_uint8_uint8.All_Curves_STD.Curves_Raster_2 Distr_Set.GRP_sint16_sint16.All_Curves_GRP.Curves_Raster_2 Distr_Set.GRP_sint32_sint32.All_Curves_GRP.Curves_Raster_2 Distr_Set.GRP_sint8_sint8.All_Curves_GRP.Curves_Raster_2 Distr_Set.GRP_uint16_uint16.All_Curves_GRP.Curves_Raster_2 Distr_Set.GRP_uint32_uint32.All_Curves_GRP.Curves_Raster_2 Distr_Set.GRP_uint8_uint8.All_Curves_GRP.Curves_Raster_2 M_In.FIX_sint16_sint16.All_Curves_FIX.Curves_Raster_2 M_In.FIX_sint32_sint32.All_Curves_FIX.Curves_Raster_2 M_In.FIX_sint8_sint8.All_Curves_FIX.Curves_Raster_2 M_In.FIX_uint16_uint16.All_Curves_FIX.Curves_Raster_2 M_In.FIX_uint32_uint32.All_Curves_FIX.Curves_Raster_2 M_In.FIX_uint8_uint8.All_Curves_FIX.Curves_Raster_2 M_In.GRP_sint16_sint16.All_Curves_GRP.Curves_Raster_2 M_In.GRP_sint32_sint32.All_Curves_GRP.Curves_Raster_2 M_In.GRP_sint8_sint8.All_Curves_GRP.Curves_Raster_2 M_In.GRP_uint16_uint16.All_Curves_GRP.Curves_Raster_2 M_In.GRP_uint32_uint32.All_Curves_GRP.Curves_Raster_2 M_In.GRP_uint8_uint8.All_Curves_GRP.Curves_Raster_2 M_In.STD_sint16_sint16.All_Curves_STD.Curves_Raster_2 M_In.STD_sint32_sint32.All_Curves_STD.Curves_Raster_2 M_In.STD_sint8_sint8.All_Curves_STD.Curves_Raster_2 M_In.STD_uint16_uint16.All_Curves_STD.Curves_Raster_2 M_In.STD_uint32_uint32.All_Curves_STD.Curves_Raster_2 M_In.STD_uint8_uint8.All_Curves_STD.Curves_Raster_2 M_out.FIX_sint16_sint16.All_Curves_FIX.Curves_Raster_2 M_out.FIX_sint32_sint32.All_Curves_FIX.Curves_Raster_2 M_out.FIX_sint8_sint8.All_Curves_FIX.Curves_Raster_2 M_out.FIX_uint16_uint16.All_Curves_FIX.Curves_Raster_2 M_out.FIX_uint32_uint32.All_Curves_FIX.Curves_Raster_2 M_out.FIX_uint8_uint8.All_Curves_FIX.Curves_Raster_2 M_out.GRP_sint16_sint16.All_Curves_GRP.Curves_Raster_2 M_out.GRP_sint32_sint32.All_Curves_GRP.Curves_Raster_2 M_out.GRP_sint8_sint8.All_Curves_GRP.Curves_Raster_2 M_out.GRP_uint16_uint16.All_Curves_GRP.Curves_Raster_2 M_out.GRP_uint32_uint32.All_Curves_GRP.Curves_Raster_2 M_out.GRP_uint8_uint8.All_Curves_GRP.Curves_Raster_2 M_out.STD_sint16_sint16.All_Curves_STD.Curves_Raster_2 M_out.STD_sint32_sint32.All_Curves_STD.Curves_Raster_2 M_out.STD_sint8_sint8.All_Curves_STD.Curves_Raster_2 M_out.STD_uint16_uint16.All_Curves_STD.Curves_Raster_2 M_out.STD_uint32_uint32.All_Curves_STD.Curves_Raster_2 M_out.STD_uint8_uint8.All_Curves_STD.Curves_Raster_2 /end REF_MEASUREMENT
 /begin REF_CHARACTERISTIC One_D.STD_sint16_sint16.All_Curves_STD.Curves_Raster_2 One_D.STD_sint32_sint32.All_Curves_STD.Curves_Raster_2 One_D.STD_sint8_sint8.All_Curves_STD.Curves_Raster_2 One_D.STD_uint16_uint16.All_Curves_STD.Curves_Raster_2 One_D.STD_uint32_uint32.All_Curves_STD.Curves_Raster_2 One_D.STD_uint8_uint8.All_Curves_STD.Curves_Raster_2 One_D_1.GRP_sint16_sint16.All_Curves_GRP.Curves_Raster_2 One_D_1.GRP_sint32_sint32.All_Curves_GRP.Curves_Raster_2 One_D_1.GRP_sint8_sint8.All_Curves_GRP.Curves_Raster_2 One_D_1.GRP_uint16_uint16.All_Curves_GRP.Curves_Raster_2 One_D_1.GRP_uint32_uint32.All_Curves_GRP.Curves_Raster_2 One_D_1.GRP_uint8_uint8.All_Curves_GRP.Curves_Raster_2 One_D_Fix.FIX_sint16_sint16.All_Curves_FIX.Curves_Raster_2 One_D_Fix.FIX_sint32_sint32.All_Curves_FIX.Curves_Raster_2 One_D_Fix.FIX_sint8_sint8.All_Curves_FIX.Curves_Raster_2 One_D_Fix.FIX_uint16_uint16.All_Curves_FIX.Curves_Raster_2 One_D_Fix.FIX_uint32_uint32.All_Curves_FIX.Curves_Raster_2 One_D_Fix.FIX_uint8_uint8.All_Curves_FIX.Curves_Raster_2 P_Do_Active_Fix.FIX_sint16_sint16.All_Curves_FIX.Curves_Raster_2 P_Do_Active_Fix.FIX_sint32_sint32.All_Curves_FIX.Curves_Raster_2 P_Do_Active_Fix.FIX_sint8_sint8.All_Curves_FIX.Curves_Raster_2 P_Do_Active_Fix.FIX_uint16_uint16.All_Curves_FIX.Curves_Raster_2 P_Do_Active_Fix.FIX_uint32_uint32.All_Curves_FIX.Curves_Raster_2 P_Do_Active_Fix.FIX_uint8_uint8.All_Curves_FIX.Curves_Raster_2 P_Do_Active_Grp.GRP_sint16_sint16.All_Curves_GRP.Curves_Raster_2 P_Do_Active_Grp.GRP_sint32_sint32.All_Curves_GRP.Curves_Raster_2 P_Do_Active_Grp.GRP_sint8_sint8.All_Curves_GRP.Curves_Raster_2 P_Do_Active_Grp.GRP_uint16_uint16.All_Curves_GRP.Curves_Raster_2 P_Do_Active_Grp.GRP_uint32_uint32.All_Curves_GRP.Curves_Raster_2 P_Do_Active_Grp.GRP_uint8_uint8.All_Curves_GRP.Curves_Raster_2 P_Do_Active_Std.STD_sint16_sint16.All_Curves_STD.Curves_Raster_2 P_Do_Active_Std.STD_sint32_sint32.All_Curves_STD.Curves_Raster_2 P_Do_Active_Std.STD_sint8_sint8.All_Curves_STD.Curves_Raster_2 P_Do_Active_Std.STD_uint16_uint16.All_Curves_STD.Curves_Raster_2 P_Do_Active_Std.STD_uint32_uint32.All_Curves_STD.Curves_Raster_2 P_Do_Active_Std.STD_uint8_uint8.All_Curves_STD.Curves_Raster_2 P_Do_All_FIX_Curves.All_Curves_FIX.Curves_Raster_2 P_Do_All_GRP_Curves.All_Curves_GRP.Curves_Raster_2 P_Do_All_STD_Curves.All_Curves_STD.Curves_Raster_2 P_Do_Grp_get.GRP_sint16_sint16.All_Curves_GRP.Curves_Raster_2 P_Do_Grp_get.GRP_sint32_sint32.All_Curves_GRP.Curves_Raster_2 P_Do_Grp_get.GRP_sint8_sint8.All_Curves_GRP.Curves_Raster_2 P_Do_Grp_get.GRP_uint16_uint16.All_Curves_GRP.Curves_Raster_2 P_Do_Grp_get.GRP_uint32_uint32.All_Curves_GRP.Curves_Raster_2 P_Do_Grp_get.GRP_uint8_uint8.All_Curves_GRP.Curves_Raster_2 P_Do_Grp_set.GRP_sint16_sint16.All_Curves_GRP.Curves_Raster_2 P_Do_Grp_set.GRP_sint32_sint32.All_Curves_GRP.Curves_Raster_2 P_Do_Grp_set.GRP_sint8_sint8.All_Curves_GRP.Curves_Raster_2 P_Do_Grp_set.GRP_uint16_uint16.All_Curves_GRP.Curves_Raster_2 P_Do_Grp_set.GRP_uint32_uint32.All_Curves_GRP.Curves_Raster_2 P_Do_Grp_set.GRP_uint8_uint8.All_Curves_GRP.Curves_Raster_2 P_In.FIX_sint16_sint16.All_Curves_FIX.Curves_Raster_2 P_In.FIX_sint32_sint32.All_Curves_FIX.Curves_Raster_2 P_In.FIX_sint8_sint8.All_Curves_FIX.Curves_Raster_2 P_In.FIX_uint16_uint16.All_Curves_FIX.Curves_Raster_2 P_In.FIX_uint32_uint32.All_Curves_FIX.Curves_Raster_2 P_In.FIX_uint8_uint8.All_Curves_FIX.Curves_Raster_2 P_In.GRP_sint16_sint16.All_Curves_GRP.Curves_Raster_2 P_In.GRP_sint32_sint32.All_Curves_GRP.Curves_Raster_2 P_In.GRP_sint8_sint8.All_Curves_GRP.Curves_Raster_2 P_In.GRP_uint16_uint16.All_Curves_GRP.Curves_Raster_2 P_In.GRP_uint32_uint32.All_Curves_GRP.Curves_Raster_2 P_In.GRP_uint8_uint8.All_Curves_GRP.Curves_Raster_2 P_In.STD_sint16_sint16.All_Curves_STD.Curves_Raster_2 P_In.STD_sint32_sint32.All_Curves_STD.Curves_Raster_2 P_In.STD_sint8_sint8.All_Curves_STD.Curves_Raster_2 P_In.STD_uint16_uint16.All_Curves_STD.Curves_Raster_2 P_In.STD_uint32_uint32.All_Curves_STD.Curves_Raster_2 P_In.STD_uint8_uint8.All_Curves_STD.Curves_Raster_2 /end REF_CHARACTERISTIC
/end GROUP
/begin GROUP Curves_Raster_3 "" ROOT
 /begin REF_MEASUREMENT Calculated.FIX_sint16_sint16.All_Curves_FIX.Curves_Raster_3 Calculated.FIX_sint32_sint32.All_Curves_FIX.Curves_Raster_3 Calculated.FIX_sint8_sint8.All_Curves_FIX.Curves_Raster_3 Calculated.FIX_uint16_uint16.All_Curves_FIX.Curves_Raster_3 Calculated.FIX_uint32_uint32.All_Curves_FIX.Curves_Raster_3 Calculated.FIX_uint8_uint8.All_Curves_FIX.Curves_Raster_3 Calculated.GRP_sint16_sint16.All_Curves_GRP.Curves_Raster_3 Calculated.GRP_sint32_sint32.All_Curves_GRP.Curves_Raster_3 Calculated.GRP_sint8_sint8.All_Curves_GRP.Curves_Raster_3 Calculated.GRP_uint16_uint16.All_Curves_GRP.Curves_Raster_3 Calculated.GRP_uint32_uint32.All_Curves_GRP.Curves_Raster_3 Calculated.GRP_uint8_uint8.All_Curves_GRP.Curves_Raster_3 Calculated.STD_sint16_sint16.All_Curves_STD.Curves_Raster_3 Calculated.STD_sint32_sint32.All_Curves_STD.Curves_Raster_3 Calculated.STD_sint8_sint8.All_Curves_STD.Curves_Raster_3 Calculated.STD_uint16_uint16.All_Curves_STD.Curves_Raster_3 Calculated.STD_uint32_uint32.All_Curves_STD.Curves_Raster_3 Calculated.STD_uint8_uint8.All_Curves_STD.Curves_Raster_3 Distr_Set.GRP_sint16_sint16.All_Curves_GRP.Curves_Raster_3 Distr_Set.GRP_sint32_sint32.All_Curves_GRP.Curves_Raster_3 Distr_Set.GRP_sint8_sint8.All_Curves_GRP.Curves_Raster_3 Distr_Set.GRP_uint16_uint16.All_Curves_GRP.Curves_Raster_3 Distr_Set.GRP_uint32_uint32.All_Curves_GRP.Curves_Raster_3 Distr_Set.GRP_uint8_uint8.All_Curves_GRP.Curves_Raster_3 M_In.FIX_sint16_sint16.All_Curves_FIX.Curves_Raster_3 M_In.FIX_sint32_sint32.All_Curves_FIX.Curves_Raster_3 M_In.FIX_sint8_sint8.All_Curves_FIX.Curves_Raster_3 M_In.FIX_uint16_uint16.All_Curves_FIX.Curves_Raster_3 M_In.FIX_uint32_uint32.All_Curves_FIX.Curves_Raster_3 M_In.FIX_uint8_uint8.All_Curves_FIX.Curves_Raster_3 M_In.GRP_sint16_sint16.All_Curves_GRP.Curves_Raster_3 M_In.GRP_sint32_sint32.All_Curves_GRP.Curves_Raster_3 M_In.GRP_sint8_sint8.All_Curves_GRP.Curves_Raster_3 M_In.GRP_uint16_uint16.All_Curves_GRP.Curves_Raster_3 M_In.GRP_uint32_uint32.All_Curves_GRP.Curves_Raster_3 M_In.GRP_uint8_uint8.All_Curves_GRP.Curves_Raster_3 M_In.STD_sint16_sint16.All_Curves_STD.Curves_Raster_3 M_In.STD_sint32_sint32.All_Curves_STD.Curves_Raster_3 M_In.STD_sint8_sint8.All_Curves_STD.Curves_Raster_3 M_In.STD_uint16_uint16.All_Curves_STD.Curves_Raster_3 M_In.STD_uint32_uint32.All_Curves_STD.Curves_Raster_3 M_In.STD_uint8_uint8.All_Curves_STD.Curves_Raster_3 M_out.FIX_sint16_sint16.All_Curves_FIX.Curves_Raster_3 M_out.FIX_sint32_sint32.All_Curves_FIX.Curves_Raster_3 M_out.FIX_sint8_sint8.All_Curves_FIX.Curves_Raster_3 M_out.FIX_uint16_uint16.All_Curves_FIX.Curves_Raster_3 M_out.FIX_uint32_uint32.All_Curves_FIX.Curves_Raster_3 M_out.FIX_uint8_uint8.All_Curves_FIX.Curves_Raster_3 M_out.GRP_sint16_sint16.All_Curves_GRP.Curves_Raster_3 M_out.GRP_sint32_sint32.All_Curves_GRP.Curves_Raster_3 M_out.GRP_sint8_sint8.All_Curves_GRP.Curves_Raster_3 M_out.GRP_uint16_uint16.All_Curves_GRP.Curves_Raster_3 M_out.GRP_uint32_uint32.All_Curves_GRP.Curves_Raster_3 M_out.GRP_uint8_uint8.All_Curves_GRP.Curves_Raster_3 M_out.STD_sint16_sint16.All_Curves_STD.Curves_Raster_3 M_out.STD_sint32_sint32.All_Curves_STD.Curves_Raster_3 M_out.STD_sint8_sint8.All_Curves_STD.Curves_Raster_3 M_out.STD_uint16_uint16.All_Curves_STD.Curves_Raster_3 M_out.STD_uint32_uint32.All_Curves_STD.Curves_Raster_3 M_out.STD_uint8_uint8.All_Curves_STD.Curves_Raster_3 /end REF_MEASUREMENT
 /begin REF_CHARACTERISTIC One_D.STD_sint16_sint16.All_Curves_STD.Curves_Raster_3 One_D.STD_sint32_sint32.All_Curves_STD.Curves_Raster_3 One_D.STD_sint8_sint8.All_Curves_STD.Curves_Raster_3 One_D.STD_uint16_uint16.All_Curves_STD.Curves_Raster_3 One_D.STD_uint32_uint32.All_Curves_STD.Curves_Raster_3 One_D.STD_uint8_uint8.All_Curves_STD.Curves_Raster_3 One_D_1.GRP_sint16_sint16.All_Curves_GRP.Curves_Raster_3 One_D_1.GRP_sint32_sint32.All_Curves_GRP.Curves_Raster_3 One_D_1.GRP_sint8_sint8.All_Curves_GRP.Curves_Raster_3 One_D_1.GRP_uint16_uint16.All_Curves_GRP.Curves_Raster_3 One_D_1.GRP_uint32_uint32.All_Curves_GRP.Curves_Raster_3 One_D_1.GRP_uint8_uint8.All_Curves_GRP.Curves_Raster_3 One_D_Fix.FIX_sint16_sint16.All_Curves_FIX.Curves_Raster_3 One_D_Fix.FIX_sint32_sint32.All_Curves_FIX.Curves_Raster_3 One_D_Fix.FIX_sint8_sint8.All_Curves_FIX.Curves_Raster_3 One_D_Fix.FIX_uint16_uint16.All_Curves_FIX.Curves_Raster_3 One_D_Fix.FIX_uint32_uint32.All_Curves_FIX.Curves_Raster_3 One_D_Fix.FIX_uint8_uint8.All_Curves_FIX.Curves_Raster_3 P_Do_Active_Fix.FIX_sint16_sint16.All_Curves_FIX.Curves_Raster_3 P_Do_Active_Fix.FIX_sint32_sint32.All_Curves_FIX.Curves_Raster_3 P_Do_Active_Fix.FIX_sint8_sint8.All_Curves_FIX.Curves_Raster_3 P_Do_Active_Fix.FIX_uint16_uint16.All_Curves_FIX.Curves_Raster_3 P_Do_Active_Fix.FIX_uint32_uint32.All_Curves_FIX.Curves_Raster_3 P_Do_Active_Fix.FIX_uint8_uint8.All_Curves_FIX.Curves_Raster_3 P_Do_Active_Grp.GRP_sint16_sint16.All_Curves_GRP.Curves_Raster_3 P_Do_Active_Grp.GRP_sint32_sint32.All_Curves_GRP.Curves_Raster_3 P_Do_Active_Grp.GRP_sint8_sint8.All_Curves_GRP.Curves_Raster_3 P_Do_Active_Grp.GRP_uint16_uint16.All_Curves_GRP.Curves_Raster_3 P_Do_Active_Grp.GRP_uint32_uint32.All_Curves_GRP.Curves_Raster_3 P_Do_Active_Grp.GRP_uint8_uint8.All_Curves_GRP.Curves_Raster_3 P_Do_Active_Std.STD_sint16_sint16.All_Curves_STD.Curves_Raster_3 P_Do_Active_Std.STD_sint32_sint32.All_Curves_STD.Curves_Raster_3 P_Do_Active_Std.STD_sint8_sint8.All_Curves_STD.Curves_Raster_3 P_Do_Active_Std.STD_uint16_uint16.All_Curves_STD.Curves_Raster_3 P_Do_Active_Std.STD_uint32_uint32.All_Curves_STD.Curves_Raster_3 P_Do_Active_Std.STD_uint8_uint8.All_Curves_STD.Curves_Raster_3 P_Do_All_FIX_Curves.All_Curves_FIX.Curves_Raster_3 P_Do_All_GRP_Curves.All_Curves_GRP.Curves_Raster_3 P_Do_All_STD_Curves.All_Curves_STD.Curves_Raster_3 P_Do_Grp_get.GRP_sint16_sint16.All_Curves_GRP.Curves_Raster_3 P_Do_Grp_get.GRP_sint32_sint32.All_Curves_GRP.Curves_Raster_3 P_Do_Grp_get.GRP_sint8_sint8.All_Curves_GRP.Curves_Raster_3 P_Do_Grp_get.GRP_uint16_uint16.All_Curves_GRP.Curves_Raster_3 P_Do_Grp_get.GRP_uint32_uint32.All_Curves_GRP.Curves_Raster_3 P_Do_Grp_get.GRP_uint8_uint8.All_Curves_GRP.Curves_Raster_3 P_Do_Grp_set.GRP_sint16_sint16.All_Curves_GRP.Curves_Raster_3 P_Do_Grp_set.GRP_sint32_sint32.All_Curves_GRP.Curves_Raster_3 P_Do_Grp_set.GRP_sint8_sint8.All_Curves_GRP.Curves_Raster_3 P_Do_Grp_set.GRP_uint16_uint16.All_Curves_GRP.Curves_Raster_3 P_Do_Grp_set.GRP_uint32_uint32.All_Curves_GRP.Curves_Raster_3 P_Do_Grp_set.GRP_uint8_uint8.All_Curves_GRP.Curves_Raster_3 P_In.FIX_sint16_sint16.All_Curves_FIX.Curves_Raster_3 P_In.FIX_sint32_sint32.All_Curves_FIX.Curves_Raster_3 P_In.FIX_sint8_sint8.All_Curves_FIX.Curves_Raster_3 P_In.FIX_uint16_uint16.All_Curves_FIX.Curves_Raster_3 P_In.FIX_uint32_uint32.All_Curves_FIX.Curves_Raster_3 P_In.FIX_uint8_uint8.All_Curves_FIX.Curves_Raster_3 P_In.GRP_sint16_sint16.All_Curves_GRP.Curves_Raster_3 P_In.GRP_sint32_sint32.All_Curves_GRP.Curves_Raster_3 P_In.GRP_sint8_sint8.All_Curves_GRP.Curves_Raster_3 P_In.GRP_uint16_uint16.All_Curves_GRP.Curves_Raster_3 P_In.GRP_uint32_uint32.All_Curves_GRP.Curves_Raster_3 P_In.GRP_uint8_uint8.All_Curves_GRP.Curves_Raster_3 P_In.STD_sint16_sint16.All_Curves_STD.Curves_Raster_3 P_In.STD_sint32_sint32.All_Curves_STD.Curves_Raster_3 P_In.STD_sint8_sint8.All_Curves_STD.Curves_Raster_3 P_In.STD_uint16_uint16.All_Curves_STD.Curves_Raster_3 P_In.STD_uint32_uint32.All_Curves_STD.Curves_Raster_3 P_In.STD_uint8_uint8.All_Curves_STD.Curves_Raster_3 /end REF_CHARACTERISTIC
/end GROUP
/begin GROUP FIX_sint16_sint16.All_Curves_FIX.Curves_Raster_1 ""
 /begin REF_MEASUREMENT Calculated.FIX_sint16_sint16.All_Curves_FIX.Curves_Raster_1 M_In.FIX_sint16_sint16.All_Curves_FIX.Curves_Raster_1 M_out.FIX_sint16_sint16.All_Curves_FIX.Curves_Raster_1 /end REF_MEASUREMENT
 /begin REF_CHARACTERISTIC One_D_Fix.FIX_sint16_sint16.All_Curves_FIX.Curves_Raster_1 P_Do_Active_Fix.FIX_sint16_sint16.All_Curves_FIX.Curves_Raster_1 P_In.FIX_sint16_sint16.All_Curves_FIX.Curves_Raster_1 /end REF_CHARACTERISTIC
/end GROUP
/begin GROUP FIX_sint16_sint16.All_Curves_FIX.Curves_Raster_2 ""
 /begin REF_MEASUREMENT Calculated.FIX_sint16_sint16.All_Curves_FIX.Curves_Raster_2 M_In.FIX_sint16_sint16.All_Curves_FIX.Curves_Raster_2 M_out.FIX_sint16_sint16.All_Curves_FIX.Curves_Raster_2 /end REF_MEASUREMENT
 /begin REF_CHARACTERISTIC One_D_Fix.FIX_sint16_sint16.All_Curves_FIX.Curves_Raster_2 P_Do_Active_Fix.FIX_sint16_sint16.All_Curves_FIX.Curves_Raster_2 P_In.FIX_sint16_sint16.All_Curves_FIX.Curves_Raster_2 /end REF_CHARACTERISTIC
/end GROUP
/begin GROUP FIX_sint16_sint16.All_Curves_FIX.Curves_Raster_3 ""
 /begin REF_MEASUREMENT Calculated.FIX_sint16_sint16.All_Curves_FIX.Curves_Raster_3 M_In.FIX_sint16_sint16.All_Curves_FIX.Curves_Raster_3 M_out.FIX_sint16_sint16.All_Curves_FIX.Curves_Raster_3 /end REF_MEASUREMENT
 /begin REF_CHARACTERISTIC One_D_Fix.FIX_sint16_sint16.All_Curves_FIX.Curves_Raster_3 P_Do_Active_Fix.FIX_sint16_sint16.All_Curves_FIX.Curves_Raster_3 P_In.FIX_sint16_sint16.All_Curves_FIX.Curves_Raster_3 /end REF_CHARACTERISTIC
/end GROUP
/begin GROUP FIX_sint32_sint32.All_Curves_FIX.Curves_Raster_1 ""
 /begin REF_MEASUREMENT Calculated.FIX_sint32_sint32.All_Curves_FIX.Curves_Raster_1 M_In.FIX_sint32_sint32.All_Curves_FIX.Curves_Raster_1 M_out.FIX_sint32_sint32.All_Curves_FIX.Curves_Raster_1 /end REF_MEASUREMENT
 /begin REF_CHARACTERISTIC One_D_Fix.FIX_sint32_sint32.All_Curves_FIX.Curves_Raster_1 P_Do_Active_Fix.FIX_sint32_sint32.All_Curves_FIX.Curves_Raster_1 P_In.FIX_sint32_sint32.All_Curves_FIX.Curves_Raster_1 /end REF_CHARACTERISTIC
/end GROUP
/begin GROUP FIX_sint32_sint32.All_Curves_FIX.Curves_Raster_2 ""
 /begin REF_MEASUREMENT Calculated.FIX_sint32_sint32.All_Curves_FIX.Curves_Raster_2 M_In.FIX_sint32_sint32.All_Curves_FIX.Curves_Raster_2 M_out.FIX_sint32_sint32.All_Curves_FIX.Curves_Raster_2 /end REF_MEASUREMENT
 /begin REF_CHARACTERISTIC One_D_Fix.FIX_sint32_sint32.All_Curves_FIX.Curves_Raster_2 P_Do_Active_Fix.FIX_sint32_sint32.All_Curves_FIX.Curves_Raster_2 P_In.FIX_sint32_sint32.All_Curves_FIX.Curves_Raster_2 /end REF_CHARACTERISTIC
/end GROUP
/begin GROUP FIX_sint32_sint32.All_Curves_FIX.Curves_Raster_3 ""
 /begin REF_MEASUREMENT Calculated.FIX_sint32_sint32.All_Curves_FIX.Curves_Raster_3 M_In.FIX_sint32_sint32.All_Curves_FIX.Curves_Raster_3 M_out.FIX_sint32_sint32.All_Curves_FIX.Curves_Raster_3 /end REF_MEASUREMENT
 /begin REF_CHARACTERISTIC One_D_Fix.FIX_sint32_sint32.All_Curves_FIX.Curves_Raster_3 P_Do_Active_Fix.FIX_sint32_sint32.All_Curves_FIX.Curves_Raster_3 P_In.FIX_sint32_sint32.All_Curves_FIX.Curves_Raster_3 /end REF_CHARACTERISTIC
/end GROUP
/begin GROUP FIX_sint8_sint8.All_Curves_FIX.Curves_Raster_1 ""
 /begin REF_MEASUREMENT Calculated.FIX_sint8_sint8.All_Curves_FIX.Curves_Raster_1 M_In.FIX_sint8_sint8.All_Curves_FIX.Curves_Raster_1 M_out.FIX_sint8_sint8.All_Curves_FIX.Curves_Raster_1 /end REF_MEASUREMENT
 /begin REF_CHARACTERISTIC One_D_Fix.FIX_sint8_sint8.All_Curves_FIX.Curves_Raster_1 P_Do_Active_Fix.FIX_sint8_sint8.All_Curves_FIX.Curves_Raster_1 P_In.FIX_sint8_sint8.All_Curves_FIX.Curves_Raster_1 /end REF_CHARACTERISTIC
/end GROUP
/begin GROUP FIX_sint8_sint8.All_Curves_FIX.Curves_Raster_2 ""
 /begin REF_MEASUREMENT Calculated.FIX_sint8_sint8.All_Curves_FIX.Curves_Raster_2 M_In.FIX_sint8_sint8.All_Curves_FIX.Curves_Raster_2 M_out.FIX_sint8_sint8.All_Curves_FIX.Curves_Raster_2 /end REF_MEASUREMENT
 /begin REF_CHARACTERISTIC One_D_Fix.FIX_sint8_sint8.All_Curves_FIX.Curves_Raster_2 P_Do_Active_Fix.FIX_sint8_sint8.All_Curves_FIX.Curves_Raster_2 P_In.FIX_sint8_sint8.All_Curves_FIX.Curves_Raster_2 /end REF_CHARACTERISTIC
/end GROUP
/begin GROUP FIX_sint8_sint8.All_Curves_FIX.Curves_Raster_3 ""
 /begin REF_MEASUREMENT Calculated.FIX_sint8_sint8.All_Curves_FIX.Curves_Raster_3 M_In.FIX_sint8_sint8.All_Curves_FIX.Curves_Raster_3 M_out.FIX_sint8_sint8.All_Curves_FIX.Curves_Raster_3 /end REF_MEASUREMENT
 /begin REF_CHARACTERISTIC One_D_Fix.FIX_sint8_sint8.All_Curves_FIX.Curves_Raster_3 P_Do_Active_Fix.FIX_sint8_sint8.All_Curves_FIX.Curves_Raster_3 P_In.FIX_sint8_sint8.All_Curves_FIX.Curves_Raster_3 /end REF_CHARACTERISTIC
/end GROUP
/begin GROUP FIX_uint16_uint16.All_Curves_FIX.Curves_Raster_1 ""
 /begin REF_MEASUREMENT Calculated.FIX_uint16_uint16.All_Curves_FIX.Curves_Raster_1 M_In.FIX_uint16_uint16.All_Curves_FIX.Curves_Raster_1 M_out.FIX_uint16_uint16.All_Curves_FIX.Curves_Raster_1 /end REF_MEASUREMENT
 /begin REF_CHARACTERISTIC One_D_Fix.FIX_uint16_uint16.All_Curves_FIX.Curves_Raster_1 P_Do_Active_Fix.FIX_uint16_uint16.All_Curves_FIX.Curves_Raster_1 P_In.FIX_uint16_uint16.All_Curves_FIX.Curves_Raster_1 /end REF_CHARACTERISTIC
/end GROUP
/begin GROUP FIX_uint16_uint16.All_Curves_FIX.Curves_Raster_2 ""
 /begin REF_MEASUREMENT Calculated.FIX_uint16_uint16.All_Curves_FIX.Curves_Raster_2 M_In.FIX_uint16_uint16.All_Curves_FIX.Curves_Raster_2 M_out.FIX_uint16_uint16.All_Curves_FIX.Curves_Raster_2 /end REF_MEASUREMENT
 /begin REF_CHARACTERISTIC One_D_Fix.FIX_uint16_uint16.All_Curves_FIX.Curves_Raster_2 P_Do_Active_Fix.FIX_uint16_uint16.All_Curves_FIX.Curves_Raster_2 P_In.FIX_uint16_uint16.All_Curves_FIX.Curves_Raster_2 /end REF_CHARACTERISTIC
/end GROUP
/begin GROUP FIX_uint16_uint16.All_Curves_FIX.Curves_Raster_3 ""
 /begin REF_MEASUREMENT Calculated.FIX_uint16_uint16.All_Curves_FIX.Curves_Raster_3 M_In.FIX_uint16_uint16.All_Curves_FIX.Curves_Raster_3 M_out.FIX_uint16_uint16.All_Curves_FIX.Curves_Raster_3 /end REF_MEASUREMENT
 /begin REF_CHARACTERISTIC One_D_Fix.FIX_uint16_uint16.All_Curves_FIX.Curves_Raster_3 P_Do_Active_Fix.FIX_uint16_uint16.All_Curves_FIX.Curves_Raster_3 P_In.FIX_uint16_uint16.All_Curves_FIX.Curves_Raster_3 /end REF_CHARACTERISTIC
/end GROUP
/begin GROUP FIX_uint32_uint32.All_Curves_FIX.Curves_Raster_1 ""
 /begin REF_MEASUREMENT Calculated.FIX_uint32_uint32.All_Curves_FIX.Curves_Raster_1 M_In.FIX_uint32_uint32.All_Curves_FIX.Curves_Raster_1 M_out.FIX_uint32_uint32.All_Curves_FIX.Curves_Raster_1 /end REF_MEASUREMENT
 /begin REF_CHARACTERISTIC One_D_Fix.FIX_uint32_uint32.All_Curves_FIX.Curves_Raster_1 P_Do_Active_Fix.FIX_uint32_uint32.All_Curves_FIX.Curves_Raster_1 P_In.FIX_uint32_uint32.All_Curves_FIX.Curves_Raster_1 /end REF_CHARACTERISTIC
/end GROUP
/begin GROUP FIX_uint32_uint32.All_Curves_FIX.Curves_Raster_2 ""
 /begin REF_MEASUREMENT Calculated.FIX_uint32_uint32.All_Curves_FIX.Curves_Raster_2 M_In.FIX_uint32_uint32.All_Curves_FIX.Curves_Raster_2 M_out.FIX_uint32_uint32.All_Curves_FIX.Curves_Raster_2 /end REF_MEASUREMENT
 /begin REF_CHARACTERISTIC One_D_Fix.FIX_uint32_uint32.All_Curves_FIX.Curves_Raster_2 P_Do_Active_Fix.FIX_uint32_uint32.All_Curves_FIX.Curves_Raster_2 P_In.FIX_uint32_uint32.All_Curves_FIX.Curves_Raster_2 /end REF_CHARACTERISTIC
/end GROUP
/begin GROUP FIX_uint32_uint32.All_Curves_FIX.Curves_Raster_3 ""
 /begin REF_MEASUREMENT Calculated.FIX_uint32_uint32.All_Curves_FIX.Curves_Raster_3 M_In.FIX_uint32_uint32.All_Curves_FIX.Curves_Raster_3 M_out.FIX_uint32_uint32.All_Curves_FIX.Curves_Raster_3 /end REF_MEASUREMENT
 /begin REF_CHARACTERISTIC One_D_Fix.FIX_uint32_uint32.All_Curves_FIX.Curves_Raster_3 P_Do_Active_Fix.FIX_uint32_uint32.All_Curves_FIX.Curves_Raster_3 P_In.FIX_uint32_uint32.All_Curves_FIX.Curves_Raster_3 /end REF_CHARACTERISTIC
/end GROUP
/begin GROUP FIX_uint8_uint8.All_Curves_FIX.Curves_Raster_1 ""
 /begin REF_MEASUREMENT Calculated.FIX_uint8_uint8.All_Curves_FIX.Curves_Raster_1 M_In.FIX_uint8_uint8.All_Curves_FIX.Curves_Raster_1 M_out.FIX_uint8_uint8.All_Curves_FIX.Curves_Raster_1 /end REF_MEASUREMENT
 /begin REF_CHARACTERISTIC One_D_Fix.FIX_uint8_uint8.All_Curves_FIX.Curves_Raster_1 P_Do_Active_Fix.FIX_uint8_uint8.All_Curves_FIX.Curves_Raster_1 P_In.FIX_uint8_uint8.All_Curves_FIX.Curves_Raster_1 /end REF_CHARACTERISTIC
/end GROUP
/begin GROUP FIX_uint8_uint8.All_Curves_FIX.Curves_Raster_2 ""
 /begin REF_MEASUREMENT Calculated.FIX_uint8_uint8.All_Curves_FIX.Curves_Raster_2 M_In.FIX_uint8_uint8.All_Curves_FIX.Curves_Raster_2 M_out.FIX_uint8_uint8.All_Curves_FIX.Curves_Raster_2 /end REF_MEASUREMENT
 /begin REF_CHARACTERISTIC One_D_Fix.FIX_uint8_uint8.All_Curves_FIX.Curves_Raster_2 P_Do_Active_Fix.FIX_uint8_uint8.All_Curves_FIX.Curves_Raster_2 P_In.FIX_uint8_uint8.All_Curves_FIX.Curves_Raster_2 /end REF_CHARACTERISTIC
/end GROUP
/begin GROUP FIX_uint8_uint8.All_Curves_FIX.Curves_Raster_3 ""
 /begin REF_MEASUREMENT Calculated.FIX_uint8_uint8.All_Curves_FIX.Curves_Raster_3 M_In.FIX_uint8_uint8.All_Curves_FIX.Curves_Raster_3 M_out.FIX_uint8_uint8.All_Curves_FIX.Curves_Raster_3 /end REF_MEASUREMENT
 /begin REF_CHARACTERISTIC One_D_Fix.FIX_uint8_uint8.All_Curves_FIX.Curves_Raster_3 P_Do_Active_Fix.FIX_uint8_uint8.All_Curves_FIX.Curves_Raster_3 P_In.FIX_uint8_uint8.All_Curves_FIX.Curves_Raster_3 /end REF_CHARACTERISTIC
/end GROUP
/begin GROUP GRP_sint16_sint16.All_Curves_GRP.Curves_Raster_1 ""
 /begin REF_MEASUREMENT Calculated.GRP_sint16_sint16.All_Curves_GRP.Curves_Raster_1 Distr_Set.GRP_sint16_sint16.All_Curves_GRP.Curves_Raster_1 M_In.GRP_sint16_sint16.All_Curves_GRP.Curves_Raster_1 M_out.GRP_sint16_sint16.All_Curves_GRP.Curves_Raster_1 /end REF_MEASUREMENT
 /begin REF_CHARACTERISTIC One_D_1.GRP_sint16_sint16.All_Curves_GRP.Curves_Raster_1 P_Do_Active_Grp.GRP_sint16_sint16.All_Curves_GRP.Curves_Raster_1 P_Do_Grp_get.GRP_sint16_sint16.All_Curves_GRP.Curves_Raster_1 P_Do_Grp_set.GRP_sint16_sint16.All_Curves_GRP.Curves_Raster_1 P_In.GRP_sint16_sint16.All_Curves_GRP.Curves_Raster_1 /end REF_CHARACTERISTIC
/end GROUP
/begin GROUP GRP_sint16_sint16.All_Curves_GRP.Curves_Raster_2 ""
 /begin REF_MEASUREMENT Calculated.GRP_sint16_sint16.All_Curves_GRP.Curves_Raster_2 Distr_Set.GRP_sint16_sint16.All_Curves_GRP.Curves_Raster_2 M_In.GRP_sint16_sint16.All_Curves_GRP.Curves_Raster_2 M_out.GRP_sint16_sint16.All_Curves_GRP.Curves_Raster_2 /end REF_MEASUREMENT
 /begin REF_CHARACTERISTIC One_D_1.GRP_sint16_sint16.All_Curves_GRP.Curves_Raster_2 P_Do_Active_Grp.GRP_sint16_sint16.All_Curves_GRP.Curves_Raster_2 P_Do_Grp_get.GRP_sint16_sint16.All_Curves_GRP.Curves_Raster_2 P_Do_Grp_set.GRP_sint16_sint16.All_Curves_GRP.Curves_Raster_2 P_In.GRP_sint16_sint16.All_Curves_GRP.Curves_Raster_2 /end REF_CHARACTERISTIC
/end GROUP
/begin GROUP GRP_sint16_sint16.All_Curves_GRP.Curves_Raster_3 ""
 /begin REF_MEASUREMENT Calculated.GRP_sint16_sint16.All_Curves_GRP.Curves_Raster_3 Distr_Set.GRP_sint16_sint16.All_Curves_GRP.Curves_Raster_3 M_In.GRP_sint16_sint16.All_Curves_GRP.Curves_Raster_3 M_out.GRP_sint16_sint16.All_Curves_GRP.Curves_Raster_3 /end REF_MEASUREMENT
 /begin REF_CHARACTERISTIC One_D_1.GRP_sint16_sint16.All_Curves_GRP.Curves_Raster_3 P_Do_Active_Grp.GRP_sint16_sint16.All_Curves_GRP.Curves_Raster_3 P_Do_Grp_get.GRP_sint16_sint16.All_Curves_GRP.Curves_Raster_3 P_Do_Grp_set.GRP_sint16_sint16.All_Curves_GRP.Curves_Raster_3 P_In.GRP_sint16_sint16.All_Curves_GRP.Curves_Raster_3 /end REF_CHARACTERISTIC
/end GROUP
/begin GROUP GRP_sint32_sint32.All_Curves_GRP.Curves_Raster_1 ""
 /begin REF_MEASUREMENT Calculated.GRP_sint32_sint32.All_Curves_GRP.Curves_Raster_1 Distr_Set.GRP_sint32_sint32.All_Curves_GRP.Curves_Raster_1 M_In.GRP_sint32_sint32.All_Curves_GRP.Curves_Raster_1 M_out.GRP_sint32_sint32.All_Curves_GRP.Curves_Raster_1 /end REF_MEASUREMENT
 /begin REF_CHARACTERISTIC One_D_1.GRP_sint32_sint32.All_Curves_GRP.Curves_Raster_1 P_Do_Active_Grp.GRP_sint32_sint32.All_Curves_GRP.Curves_Raster_1 P_Do_Grp_get.GRP_sint32_sint32.All_Curves_GRP.Curves_Raster_1 P_Do_Grp_set.GRP_sint32_sint32.All_Curves_GRP.Curves_Raster_1 P_In.GRP_sint32_sint32.All_Curves_GRP.Curves_Raster_1 /end REF_CHARACTERISTIC
/end GROUP
/begin GROUP GRP_sint32_sint32.All_Curves_GRP.Curves_Raster_2 ""
 /begin REF_MEASUREMENT Calculated.GRP_sint32_sint32.All_Curves_GRP.Curves_Raster_2 Distr_Set.GRP_sint32_sint32.All_Curves_GRP.Curves_Raster_2 M_In.GRP_sint32_sint32.All_Curves_GRP.Curves_Raster_2 M_out.GRP_sint32_sint32.All_Curves_GRP.Curves_Raster_2 /end REF_MEASUREMENT
 /begin REF_CHARACTERISTIC One_D_1.GRP_sint32_sint32.All_Curves_GRP.Curves_Raster_2 P_Do_Active_Grp.GRP_sint32_sint32.All_Curves_GRP.Curves_Raster_2 P_Do_Grp_get.GRP_sint32_sint32.All_Curves_GRP.Curves_Raster_2 P_Do_Grp_set.GRP_sint32_sint32.All_Curves_GRP.Curves_Raster_2 P_In.GRP_sint32_sint32.All_Curves_GRP.Curves_Raster_2 /end REF_CHARACTERISTIC
/end GROUP
/begin GROUP GRP_sint32_sint32.All_Curves_GRP.Curves_Raster_3 ""
 /begin REF_MEASUREMENT Calculated.GRP_sint32_sint32.All_Curves_GRP.Curves_Raster_3 Distr_Set.GRP_sint32_sint32.All_Curves_GRP.Curves_Raster_3 M_In.GRP_sint32_sint32.All_Curves_GRP.Curves_Raster_3 M_out.GRP_sint32_sint32.All_Curves_GRP.Curves_Raster_3 /end REF_MEASUREMENT
 /begin REF_CHARACTERISTIC One_D_1.GRP_sint32_sint32.All_Curves_GRP.Curves_Raster_3 P_Do_Active_Grp.GRP_sint32_sint32.All_Curves_GRP.Curves_Raster_3 P_Do_Grp_get.GRP_sint32_sint32.All_Curves_GRP.Curves_Raster_3 P_Do_Grp_set.GRP_sint32_sint32.All_Curves_GRP.Curves_Raster_3 P_In.GRP_sint32_sint32.All_Curves_GRP.Curves_Raster_3 /end REF_CHARACTERISTIC
/end GROUP
/begin GROUP GRP_sint8_sint8.All_Curves_GRP.Curves_Raster_1 ""
 /begin REF_MEASUREMENT Calculated.GRP_sint8_sint8.All_Curves_GRP.Curves_Raster_1 Distr_Set.GRP_sint8_sint8.All_Curves_GRP.Curves_Raster_1 M_In.GRP_sint8_sint8.All_Curves_GRP.Curves_Raster_1 M_out.GRP_sint8_sint8.All_Curves_GRP.Curves_Raster_1 /end REF_MEASUREMENT
 /begin REF_CHARACTERISTIC One_D_1.GRP_sint8_sint8.All_Curves_GRP.Curves_Raster_1 P_Do_Active_Grp.GRP_sint8_sint8.All_Curves_GRP.Curves_Raster_1 P_Do_Grp_get.GRP_sint8_sint8.All_Curves_GRP.Curves_Raster_1 P_Do_Grp_set.GRP_sint8_sint8.All_Curves_GRP.Curves_Raster_1 P_In.GRP_sint8_sint8.All_Curves_GRP.Curves_Raster_1 /end REF_CHARACTERISTIC
/end GROUP
/begin GROUP GRP_sint8_sint8.All_Curves_GRP.Curves_Raster_2 ""
 /begin REF_MEASUREMENT Calculated.GRP_sint8_sint8.All_Curves_GRP.Curves_Raster_2 Distr_Set.GRP_sint8_sint8.All_Curves_GRP.Curves_Raster_2 M_In.GRP_sint8_sint8.All_Curves_GRP.Curves_Raster_2 M_out.GRP_sint8_sint8.All_Curves_GRP.Curves_Raster_2 /end REF_MEASUREMENT
 /begin REF_CHARACTERISTIC One_D_1.GRP_sint8_sint8.All_Curves_GRP.Curves_Raster_2 P_Do_Active_Grp.GRP_sint8_sint8.All_Curves_GRP.Curves_Raster_2 P_Do_Grp_get.GRP_sint8_sint8.All_Curves_GRP.Curves_Raster_2 P_Do_Grp_set.GRP_sint8_sint8.All_Curves_GRP.Curves_Raster_2 P_In.GRP_sint8_sint8.All_Curves_GRP.Curves_Raster_2 /end REF_CHARACTERISTIC
/end GROUP
/begin GROUP GRP_sint8_sint8.All_Curves_GRP.Curves_Raster_3 ""
 /begin REF_MEASUREMENT Calculated.GRP_sint8_sint8.All_Curves_GRP.Curves_Raster_3 Distr_Set.GRP_sint8_sint8.All_Curves_GRP.Curves_Raster_3 M_In.GRP_sint8_sint8.All_Curves_GRP.Curves_Raster_3 M_out.GRP_sint8_sint8.All_Curves_GRP.Curves_Raster_3 /end REF_MEASUREMENT
 /begin REF_CHARACTERISTIC One_D_1.GRP_sint8_sint8.All_Curves_GRP.Curves_Raster_3 P_Do_Active_Grp.GRP_sint8_sint8.All_Curves_GRP.Curves_Raster_3 P_Do_Grp_get.GRP_sint8_sint8.All_Curves_GRP.Curves_Raster_3 P_Do_Grp_set.GRP_sint8_sint8.All_Curves_GRP.Curves_Raster_3 P_In.GRP_sint8_sint8.All_Curves_GRP.Curves_Raster_3 /end REF_CHARACTERISTIC
/end GROUP
/begin GROUP GRP_uint16_uint16.All_Curves_GRP.Curves_Raster_1 ""
 /begin REF_MEASUREMENT Calculated.GRP_uint16_uint16.All_Curves_GRP.Curves_Raster_1 Distr_Set.GRP_uint16_uint16.All_Curves_GRP.Curves_Raster_1 M_In.GRP_uint16_uint16.All_Curves_GRP.Curves_Raster_1 M_out.GRP_uint16_uint16.All_Curves_GRP.Curves_Raster_1 /end REF_MEASUREMENT
 /begin REF_CHARACTERISTIC One_D_1.GRP_uint16_uint16.All_Curves_GRP.Curves_Raster_1 P_Do_Active_Grp.GRP_uint16_uint16.All_Curves_GRP.Curves_Raster_1 P_Do_Grp_get.GRP_uint16_uint16.All_Curves_GRP.Curves_Raster_1 P_Do_Grp_set.GRP_uint16_uint16.All_Curves_GRP.Curves_Raster_1 P_In.GRP_uint16_uint16.All_Curves_GRP.Curves_Raster_1 /end REF_CHARACTERISTIC
/end GROUP
/begin GROUP GRP_uint16_uint16.All_Curves_GRP.Curves_Raster_2 ""
 /begin REF_MEASUREMENT Calculated.GRP_uint16_uint16.All_Curves_GRP.Curves_Raster_2 Distr_Set.GRP_uint16_uint16.All_Curves_GRP.Curves_Raster_2 M_In.GRP_uint16_uint16.All_Curves_GRP.Curves_Raster_2 M_out.GRP_uint16_uint16.All_Curves_GRP.Curves_Raster_2 /end REF_MEASUREMENT
 /begin REF_CHARACTERISTIC One_D_1.GRP_uint16_uint16.All_Curves_GRP.Curves_Raster_2 P_Do_Active_Grp.GRP_uint16_uint16.All_Curves_GRP.Curves_Raster_2 P_Do_Grp_get.GRP_uint16_uint16.All_Curves_GRP.Curves_Raster_2 P_Do_Grp_set.GRP_uint16_uint16.All_Curves_GRP.Curves_Raster_2 P_In.GRP_uint16_uint16.All_Curves_GRP.Curves_Raster_2 /end REF_CHARACTERISTIC
/end GROUP
/begin GROUP GRP_uint16_uint16.All_Curves_GRP.Curves_Raster_3 ""
 /begin REF_MEASUREMENT Calculated.GRP_uint16_uint16.All_Curves_GRP.Curves_Raster_3 Distr_Set.GRP_uint16_uint16.All_Curves_GRP.Curves_Raster_3 M_In.GRP_uint16_uint16.All_Curves_GRP.Curves_Raster_3 M_out.GRP_uint16_uint16.All_Curves_GRP.Curves_Raster_3 /end REF_MEASUREMENT
 /begin REF_CHARACTERISTIC One_D_1.GRP_uint16_uint16.All_Curves_GRP.Curves_Raster_3 P_Do_Active_Grp.GRP_uint16_uint16.All_Curves_GRP.Curves_Raster_3 P_Do_Grp_get.GRP_uint16_uint16.All_Curves_GRP.Curves_Raster_3 P_Do_Grp_set.GRP_uint16_uint16.All_Curves_GRP.Curves_Raster_3 P_In.GRP_uint16_uint16.All_Curves_GRP.Curves_Raster_3 /end REF_CHARACTERISTIC
/end GROUP
/begin GROUP GRP_uint32_uint32.All_Curves_GRP.Curves_Raster_1 ""
 /begin REF_MEASUREMENT Calculated.GRP_uint32_uint32.All_Curves_GRP.Curves_Raster_1 Distr_Set.GRP_uint32_uint32.All_Curves_GRP.Curves_Raster_1 M_In.GRP_uint32_uint32.All_Curves_GRP.Curves_Raster_1 M_out.GRP_uint32_uint32.All_Curves_GRP.Curves_Raster_1 /end REF_MEASUREMENT
 /begin REF_CHARACTERISTIC One_D_1.GRP_uint32_uint32.All_Curves_GRP.Curves_Raster_1 P_Do_Active_Grp.GRP_uint32_uint32.All_Curves_GRP.Curves_Raster_1 P_Do_Grp_get.GRP_uint32_uint32.All_Curves_GRP.Curves_Raster_1 P_Do_Grp_set.GRP_uint32_uint32.All_Curves_GRP.Curves_Raster_1 P_In.GRP_uint32_uint32.All_Curves_GRP.Curves_Raster_1 /end REF_CHARACTERISTIC
/end GROUP
/begin GROUP GRP_uint32_uint32.All_Curves_GRP.Curves_Raster_2 ""
 /begin REF_MEASUREMENT Calculated.GRP_uint32_uint32.All_Curves_GRP.Curves_Raster_2 Distr_Set.GRP_uint32_uint32.All_Curves_GRP.Curves_Raster_2 M_In.GRP_uint32_uint32.All_Curves_GRP.Curves_Raster_2 M_out.GRP_uint32_uint32.All_Curves_GRP.Curves_Raster_2 /end REF_MEASUREMENT
 /begin REF_CHARACTERISTIC One_D_1.GRP_uint32_uint32.All_Curves_GRP.Curves_Raster_2 P_Do_Active_Grp.GRP_uint32_uint32.All_Curves_GRP.Curves_Raster_2 P_Do_Grp_get.GRP_uint32_uint32.All_Curves_GRP.Curves_Raster_2 P_Do_Grp_set.GRP_uint32_uint32.All_Curves_GRP.Curves_Raster_2 P_In.GRP_uint32_uint32.All_Curves_GRP.Curves_Raster_2 /end REF_CHARACTERISTIC
/end GROUP
/begin GROUP GRP_uint32_uint32.All_Curves_GRP.Curves_Raster_3 ""
 /begin REF_MEASUREMENT Calculated.GRP_uint32_uint32.All_Curves_GRP.Curves_Raster_3 Distr_Set.GRP_uint32_uint32.All_Curves_GRP.Curves_Raster_3 M_In.GRP_uint32_uint32.All_Curves_GRP.Curves_Raster_3 M_out.GRP_uint32_uint32.All_Curves_GRP.Curves_Raster_3 /end REF_MEASUREMENT
 /begin REF_CHARACTERISTIC One_D_1.GRP_uint32_uint32.All_Curves_GRP.Curves_Raster_3 P_Do_Active_Grp.GRP_uint32_uint32.All_Curves_GRP.Curves_Raster_3 P_Do_Grp_get.GRP_uint32_uint32.All_Curves_GRP.Curves_Raster_3 P_Do_Grp_set.GRP_uint32_uint32.All_Curves_GRP.Curves_Raster_3 P_In.GRP_uint32_uint32.All_Curves_GRP.Curves_Raster_3 /end REF_CHARACTERISTIC
/end GROUP
/begin GROUP GRP_uint8_uint8.All_Curves_GRP.Curves_Raster_1 ""
 /begin REF_MEASUREMENT Calculated.GRP_uint8_uint8.All_Curves_GRP.Curves_Raster_1 Distr_Set.GRP_uint8_uint8.All_Curves_GRP.Curves_Raster_1 M_In.GRP_uint8_uint8.All_Curves_GRP.Curves_Raster_1 M_out.GRP_uint8_uint8.All_Curves_GRP.Curves_Raster_1 /end REF_MEASUREMENT
 /begin REF_CHARACTERISTIC One_D_1.GRP_uint8_uint8.All_Curves_GRP.Curves_Raster_1 P_Do_Active_Grp.GRP_uint8_uint8.All_Curves_GRP.Curves_Raster_1 P_Do_Grp_get.GRP_uint8_uint8.All_Curves_GRP.Curves_Raster_1 P_Do_Grp_set.GRP_uint8_uint8.All_Curves_GRP.Curves_Raster_1 P_In.GRP_uint8_uint8.All_Curves_GRP.Curves_Raster_1 /end REF_CHARACTERISTIC
/end GROUP
/begin GROUP GRP_uint8_uint8.All_Curves_GRP.Curves_Raster_2 ""
 /begin REF_MEASUREMENT Calculated.GRP_uint8_uint8.All_Curves_GRP.Curves_Raster_2 Distr_Set.GRP_uint8_uint8.All_Curves_GRP.Curves_Raster_2 M_In.GRP_uint8_uint8.All_Curves_GRP.Curves_Raster_2 M_out.GRP_uint8_uint8.All_Curves_GRP.Curves_Raster_2 /end REF_MEASUREMENT
 /begin REF_CHARACTERISTIC One_D_1.GRP_uint8_uint8.All_Curves_GRP.Curves_Raster_2 P_Do_Active_Grp.GRP_uint8_uint8.All_Curves_GRP.Curves_Raster_2 P_Do_Grp_get.GRP_uint8_uint8.All_Curves_GRP.Curves_Raster_2 P_Do_Grp_set.GRP_uint8_uint8.All_Curves_GRP.Curves_Raster_2 P_In.GRP_uint8_uint8.All_Curves_GRP.Curves_Raster_2 /end REF_CHARACTERISTIC
/end GROUP
/begin GROUP GRP_uint8_uint8.All_Curves_GRP.Curves_Raster_3 ""
 /begin REF_MEASUREMENT Calculated.GRP_uint8_uint8.All_Curves_GRP.Curves_Raster_3 Distr_Set.GRP_uint8_uint8.All_Curves_GRP.Curves_Raster_3 M_In.GRP_uint8_uint8.All_Curves_GRP.Curves_Raster_3 M_out.GRP_uint8_uint8.All_Curves_GRP.Curves_Raster_3 /end REF_MEASUREMENT
 /begin REF_CHARACTERISTIC One_D_1.GRP_uint8_uint8.All_Curves_GRP.Curves_Raster_3 P_Do_Active_Grp.GRP_uint8_uint8.All_Curves_GRP.Curves_Raster_3 P_Do_Grp_get.GRP_uint8_uint8.All_Curves_GRP.Curves_Raster_3 P_Do_Grp_set.GRP_uint8_uint8.All_Curves_GRP.Curves_Raster_3 P_In.GRP_uint8_uint8.All_Curves_GRP.Curves_Raster_3 /end REF_CHARACTERISTIC
/end GROUP
/begin GROUP STD_sint16_sint16.All_Curves_STD.Curves_Raster_1 ""
 /begin REF_MEASUREMENT Calculated.STD_sint16_sint16.All_Curves_STD.Curves_Raster_1 M_In.STD_sint16_sint16.All_Curves_STD.Curves_Raster_1 M_out.STD_sint16_sint16.All_Curves_STD.Curves_Raster_1 /end REF_MEASUREMENT
 /begin REF_CHARACTERISTIC One_D.STD_sint16_sint16.All_Curves_STD.Curves_Raster_1 P_Do_Active_Std.STD_sint16_sint16.All_Curves_STD.Curves_Raster_1 P_In.STD_sint16_sint16.All_Curves_STD.Curves_Raster_1 /end REF_CHARACTERISTIC
/end GROUP
/begin GROUP STD_sint16_sint16.All_Curves_STD.Curves_Raster_2 ""
 /begin REF_MEASUREMENT Calculated.STD_sint16_sint16.All_Curves_STD.Curves_Raster_2 M_In.STD_sint16_sint16.All_Curves_STD.Curves_Raster_2 M_out.STD_sint16_sint16.All_Curves_STD.Curves_Raster_2 /end REF_MEASUREMENT
 /begin REF_CHARACTERISTIC One_D.STD_sint16_sint16.All_Curves_STD.Curves_Raster_2 P_Do_Active_Std.STD_sint16_sint16.All_Curves_STD.Curves_Raster_2 P_In.STD_sint16_sint16.All_Curves_STD.Curves_Raster_2 /end REF_CHARACTERISTIC
/end GROUP
/begin GROUP STD_sint16_sint16.All_Curves_STD.Curves_Raster_3 ""
 /begin REF_MEASUREMENT Calculated.STD_sint16_sint16.All_Curves_STD.Curves_Raster_3 M_In.STD_sint16_sint16.All_Curves_STD.Curves_Raster_3 M_out.STD_sint16_sint16.All_Curves_STD.Curves_Raster_3 /end REF_MEASUREMENT
 /begin REF_CHARACTERISTIC One_D.STD_sint16_sint16.All_Curves_STD.Curves_Raster_3 P_Do_Active_Std.STD_sint16_sint16.All_Curves_STD.Curves_Raster_3 P_In.STD_sint16_sint16.All_Curves_STD.Curves_Raster_3 /end REF_CHARACTERISTIC
/end GROUP
/begin GROUP STD_sint32_sint32.All_Curves_STD.Curves_Raster_1 ""
 /begin REF_MEASUREMENT Calculated.STD_sint32_sint32.All_Curves_STD.Curves_Raster_1 M_In.STD_sint32_sint32.All_Curves_STD.Curves_Raster_1 M_out.STD_sint32_sint32.All_Curves_STD.Curves_Raster_1 /end REF_MEASUREMENT
 /begin REF_CHARACTERISTIC One_D.STD_sint32_sint32.All_Curves_STD.Curves_Raster_1 P_Do_Active_Std.STD_sint32_sint32.All_Curves_STD.Curves_Raster_1 P_In.STD_sint32_sint32.All_Curves_STD.Curves_Raster_1 /end REF_CHARACTERISTIC
/end GROUP
/begin GROUP STD_sint32_sint32.All_Curves_STD.Curves_Raster_2 ""
 /begin REF_MEASUREMENT Calculated.STD_sint32_sint32.All_Curves_STD.Curves_Raster_2 M_In.STD_sint32_sint32.All_Curves_STD.Curves_Raster_2 M_out.STD_sint32_sint32.All_Curves_STD.Curves_Raster_2 /end REF_MEASUREMENT
 /begin REF_CHARACTERISTIC One_D.STD_sint32_sint32.All_Curves_STD.Curves_Raster_2 P_Do_Active_Std.STD_sint32_sint32.All_Curves_STD.Curves_Raster_2 P_In.STD_sint32_sint32.All_Curves_STD.Curves_Raster_2 /end REF_CHARACTERISTIC
/end GROUP
/begin GROUP STD_sint32_sint32.All_Curves_STD.Curves_Raster_3 ""
 /begin REF_MEASUREMENT Calculated.STD_sint32_sint32.All_Curves_STD.Curves_Raster_3 M_In.STD_sint32_sint32.All_Curves_STD.Curves_Raster_3 M_out.STD_sint32_sint32.All_Curves_STD.Curves_Raster_3 /end REF_MEASUREMENT
 /begin REF_CHARACTERISTIC One_D.STD_sint32_sint32.All_Curves_STD.Curves_Raster_3 P_Do_Active_Std.STD_sint32_sint32.All_Curves_STD.Curves_Raster_3 P_In.STD_sint32_sint32.All_Curves_STD.Curves_Raster_3 /end REF_CHARACTERISTIC
/end GROUP
/begin GROUP STD_sint8_sint8.All_Curves_STD.Curves_Raster_1 ""
 /begin REF_MEASUREMENT Calculated.STD_sint8_sint8.All_Curves_STD.Curves_Raster_1 M_In.STD_sint8_sint8.All_Curves_STD.Curves_Raster_1 M_out.STD_sint8_sint8.All_Curves_STD.Curves_Raster_1 /end REF_MEASUREMENT
 /begin REF_CHARACTERISTIC One_D.STD_sint8_sint8.All_Curves_STD.Curves_Raster_1 P_Do_Active_Std.STD_sint8_sint8.All_Curves_STD.Curves_Raster_1 P_In.STD_sint8_sint8.All_Curves_STD.Curves_Raster_1 /end REF_CHARACTERISTIC
/end GROUP
/begin GROUP STD_sint8_sint8.All_Curves_STD.Curves_Raster_2 ""
 /begin REF_MEASUREMENT Calculated.STD_sint8_sint8.All_Curves_STD.Curves_Raster_2 M_In.STD_sint8_sint8.All_Curves_STD.Curves_Raster_2 M_out.STD_sint8_sint8.All_Curves_STD.Curves_Raster_2 /end REF_MEASUREMENT
 /begin REF_CHARACTERISTIC One_D.STD_sint8_sint8.All_Curves_STD.Curves_Raster_2 P_Do_Active_Std.STD_sint8_sint8.All_Curves_STD.Curves_Raster_2 P_In.STD_sint8_sint8.All_Curves_STD.Curves_Raster_2 /end REF_CHARACTERISTIC
/end GROUP
/begin GROUP STD_sint8_sint8.All_Curves_STD.Curves_Raster_3 ""
 /begin REF_MEASUREMENT Calculated.STD_sint8_sint8.All_Curves_STD.Curves_Raster_3 M_In.STD_sint8_sint8.All_Curves_STD.Curves_Raster_3 M_out.STD_sint8_sint8.All_Curves_STD.Curves_Raster_3 /end REF_MEASUREMENT
 /begin REF_CHARACTERISTIC One_D.STD_sint8_sint8.All_Curves_STD.Curves_Raster_3 P_Do_Active_Std.STD_sint8_sint8.All_Curves_STD.Curves_Raster_3 P_In.STD_sint8_sint8.All_Curves_STD.Curves_Raster_3 /end REF_CHARACTERISTIC
/end GROUP
/begin GROUP STD_uint16_uint16.All_Curves_STD.Curves_Raster_1 ""
 /begin REF_MEASUREMENT Calculated.STD_uint16_uint16.All_Curves_STD.Curves_Raster_1 M_In.STD_uint16_uint16.All_Curves_STD.Curves_Raster_1 M_out.STD_uint16_uint16.All_Curves_STD.Curves_Raster_1 /end REF_MEASUREMENT
 /begin REF_CHARACTERISTIC One_D.STD_uint16_uint16.All_Curves_STD.Curves_Raster_1 P_Do_Active_Std.STD_uint16_uint16.All_Curves_STD.Curves_Raster_1 P_In.STD_uint16_uint16.All_Curves_STD.Curves_Raster_1 /end REF_CHARACTERISTIC
/end GROUP
/begin GROUP STD_uint16_uint16.All_Curves_STD.Curves_Raster_2 ""
 /begin REF_MEASUREMENT Calculated.STD_uint16_uint16.All_Curves_STD.Curves_Raster_2 M_In.STD_uint16_uint16.All_Curves_STD.Curves_Raster_2 M_out.STD_uint16_uint16.All_Curves_STD.Curves_Raster_2 /end REF_MEASUREMENT
 /begin REF_CHARACTERISTIC One_D.STD_uint16_uint16.All_Curves_STD.Curves_Raster_2 P_Do_Active_Std.STD_uint16_uint16.All_Curves_STD.Curves_Raster_2 P_In.STD_uint16_uint16.All_Curves_STD.Curves_Raster_2 /end REF_CHARACTERISTIC
/end GROUP
/begin GROUP STD_uint16_uint16.All_Curves_STD.Curves_Raster_3 ""
 /begin REF_MEASUREMENT Calculated.STD_uint16_uint16.All_Curves_STD.Curves_Raster_3 M_In.STD_uint16_uint16.All_Curves_STD.Curves_Raster_3 M_out.STD_uint16_uint16.All_Curves_STD.Curves_Raster_3 /end REF_MEASUREMENT
 /begin REF_CHARACTERISTIC One_D.STD_uint16_uint16.All_Curves_STD.Curves_Raster_3 P_Do_Active_Std.STD_uint16_uint16.All_Curves_STD.Curves_Raster_3 P_In.STD_uint16_uint16.All_Curves_STD.Curves_Raster_3 /end REF_CHARACTERISTIC
/end GROUP
/begin GROUP STD_uint32_uint32.All_Curves_STD.Curves_Raster_1 ""
 /begin REF_MEASUREMENT Calculated.STD_uint32_uint32.All_Curves_STD.Curves_Raster_1 M_In.STD_uint32_uint32.All_Curves_STD.Curves_Raster_1 M_out.STD_uint32_uint32.All_Curves_STD.Curves_Raster_1 /end REF_MEASUREMENT
 /begin REF_CHARACTERISTIC One_D.STD_uint32_uint32.All_Curves_STD.Curves_Raster_1 P_Do_Active_Std.STD_uint32_uint32.All_Curves_STD.Curves_Raster_1 P_In.STD_uint32_uint32.All_Curves_STD.Curves_Raster_1 /end REF_CHARACTERISTIC
/end GROUP
/begin GROUP STD_uint32_uint32.All_Curves_STD.Curves_Raster_2 ""
 /begin REF_MEASUREMENT Calculated.STD_uint32_uint32.All_Curves_STD.Curves_Raster_2 M_In.STD_uint32_uint32.All_Curves_STD.Curves_Raster_2 M_out.STD_uint32_uint32.All_Curves_STD.Curves_Raster_2 /end REF_MEASUREMENT
 /begin REF_CHARACTERISTIC One_D.STD_uint32_uint32.All_Curves_STD.Curves_Raster_2 P_Do_Active_Std.STD_uint32_uint32.All_Curves_STD.Curves_Raster_2 P_In.STD_uint32_uint32.All_Curves_STD.Curves_Raster_2 /end REF_CHARACTERISTIC
/end GROUP
/begin GROUP STD_uint32_uint32.All_Curves_STD.Curves_Raster_3 ""
 /begin REF_MEASUREMENT Calculated.STD_uint32_uint32.All_Curves_STD.Curves_Raster_3 M_In.STD_uint32_uint32.All_Curves_STD.Curves_Raster_3 M_out.STD_uint32_uint32.All_Curves_STD.Curves_Raster_3 /end REF_MEASUREMENT
 /begin REF_CHARACTERISTIC One_D.STD_uint32_uint32.All_Curves_STD.Curves_Raster_3 P_Do_Active_Std.STD_uint32_uint32.All_Curves_STD.Curves_Raster_3 P_In.STD_uint32_uint32.All_Curves_STD.Curves_Raster_3 /end REF_CHARACTERISTIC
/end GROUP
/begin GROUP STD_uint8_uint8.All_Curves_STD.Curves_Raster_1 ""
 /begin REF_MEASUREMENT Calculated.STD_uint8_uint8.All_Curves_STD.Curves_Raster_1 M_In.STD_uint8_uint8.All_Curves_STD.Curves_Raster_1 M_out.STD_uint8_uint8.All_Curves_STD.Curves_Raster_1 /end REF_MEASUREMENT
 /begin REF_CHARACTERISTIC One_D.STD_uint8_uint8.All_Curves_STD.Curves_Raster_1 P_Do_Active_Std.STD_uint8_uint8.All_Curves_STD.Curves_Raster_1 P_In.STD_uint8_uint8.All_Curves_STD.Curves_Raster_1 /end REF_CHARACTERISTIC
/end GROUP
/begin GROUP STD_uint8_uint8.All_Curves_STD.Curves_Raster_2 ""
 /begin REF_MEASUREMENT Calculated.STD_uint8_uint8.All_Curves_STD.Curves_Raster_2 M_In.STD_uint8_uint8.All_Curves_STD.Curves_Raster_2 M_out.STD_uint8_uint8.All_Curves_STD.Curves_Raster_2 /end REF_MEASUREMENT
 /begin REF_CHARACTERISTIC One_D.STD_uint8_uint8.All_Curves_STD.Curves_Raster_2 P_Do_Active_Std.STD_uint8_uint8.All_Curves_STD.Curves_Raster_2 P_In.STD_uint8_uint8.All_Curves_STD.Curves_Raster_2 /end REF_CHARACTERISTIC
/end GROUP
/begin GROUP STD_uint8_uint8.All_Curves_STD.Curves_Raster_3 ""
 /begin REF_MEASUREMENT Calculated.STD_uint8_uint8.All_Curves_STD.Curves_Raster_3 M_In.STD_uint8_uint8.All_Curves_STD.Curves_Raster_3 M_out.STD_uint8_uint8.All_Curves_STD.Curves_Raster_3 /end REF_MEASUREMENT
 /begin REF_CHARACTERISTIC One_D.STD_uint8_uint8.All_Curves_STD.Curves_Raster_3 P_Do_Active_Std.STD_uint8_uint8.All_Curves_STD.Curves_Raster_3 P_In.STD_uint8_uint8.All_Curves_STD.Curves_Raster_3 /end REF_CHARACTERISTIC
/end GROUP
/begin RECORD_LAYOUT STANDARD_CURVE_S16S16 FNC_VALUES 3 SWORD COLUMN_DIR DIRECT AXIS_PTS_X 2 SWORD INDEX_INCR DIRECT NO_AXIS_PTS_X 1 UWORD /end RECORD_LAYOUT
/begin RECORD_LAYOUT STANDARD_CURVE_S32S32 FNC_VALUES 3 SLONG COLUMN_DIR DIRECT AXIS_PTS_X 2 SLONG INDEX_INCR DIRECT NO_AXIS_PTS_X 1 UWORD /end RECORD_LAYOUT
/begin RECORD_LAYOUT STANDARD_CURVE_S8S8 FNC_VALUES 3 SBYTE COLUMN_DIR DIRECT AXIS_PTS_X 2 SBYTE INDEX_INCR DIRECT NO_AXIS_PTS_X 1 UBYTE /end RECORD_LAYOUT
/begin RECORD_LAYOUT STANDARD_CURVE_U16U16 FNC_VALUES 3 UWORD COLUMN_DIR DIRECT AXIS_PTS_X 2 UWORD INDEX_INCR DIRECT NO_AXIS_PTS_X 1 UWORD /end RECORD_LAYOUT
/begin RECORD_LAYOUT STANDARD_CURVE_U32U32 FNC_VALUES 3 ULONG COLUMN_DIR DIRECT AXIS_PTS_X 2 ULONG INDEX_INCR DIRECT NO_AXIS_PTS_X 1 UWORD /end RECORD_LAYOUT
/begin RECORD_LAYOUT STANDARD_CURVE_U8U8 FNC_VALUES 3 UBYTE COLUMN_DIR DIRECT AXIS_PTS_X 2 UBYTE INDEX_INCR DIRECT NO_AXIS_PTS_X 1 UBYTE /end RECORD_LAYOUT
/begin RECORD_LAYOUT STANDARD_DIST_S16 AXIS_PTS_X 2 SWORD INDEX_INCR DIRECT NO_AXIS_PTS_X 1 UWORD /end RECORD_LAYOUT
/begin RECORD_LAYOUT STANDARD_DIST_S32 AXIS_PTS_X 2 SLONG INDEX_INCR DIRECT NO_AXIS_PTS_X 1 UWORD /end RECORD_LAYOUT
/begin RECORD_LAYOUT STANDARD_DIST_S8 AXIS_PTS_X 2 SBYTE INDEX_INCR DIRECT NO_AXIS_PTS_X 1 UBYTE /end RECORD_LAYOUT
/begin RECORD_LAYOUT STANDARD_DIST_U16 AXIS_PTS_X 2 UWORD INDEX_INCR DIRECT NO_AXIS_PTS_X 1 UWORD /end RECORD_LAYOUT
/begin RECORD_LAYOUT STANDARD_DIST_U32 AXIS_PTS_X 2 ULONG INDEX_INCR DIRECT NO_AXIS_PTS_X 1 UWORD /end RECORD_LAYOUT
/begin RECORD_LAYOUT STANDARD_DIST_U8 AXIS_PTS_X 2 UBYTE INDEX_INCR DIRECT NO_AXIS_PTS_X 1 UBYTE /end RECORD_LAYOUT
/begin RECORD_LAYOUT STANDARD_FIXED_S16 FNC_VALUES 1 SWORD COLUMN_DIR DIRECT /end RECORD_LAYOUT
/begin RECORD_LAYOUT STANDARD_FIXED_S32 FNC_VALUES 1 SLONG COLUMN_DIR DIRECT /end RECORD_LAYOUT
/begin RECORD_LAYOUT STANDARD_FIXED_S8 FNC_VALUES 1 SBYTE COLUMN_DIR DIRECT /end RECORD_LAYOUT
/begin RECORD_LAYOUT STANDARD_FIXED_U16 FNC_VALUES 1 UWORD COLUMN_DIR DIRECT /end RECORD_LAYOUT
/begin RECORD_LAYOUT STANDARD_FIXED_U32 FNC_VALUES 1 ULONG COLUMN_DIR DIRECT /end RECORD_LAYOUT
/begin RECORD_LAYOUT STANDARD_FIXED_U8 FNC_VALUES 1 UBYTE COLUMN_DIR DIRECT /end RECORD_LAYOUT
/begin RECORD_LAYOUT STANDARD_GROUP_S16 FNC_VALUES 1 SWORD COLUMN_DIR DIRECT /end RECORD_LAYOUT
/begin RECORD_LAYOUT STANDARD_GROUP_S32 FNC_VALUES 1 SLONG COLUMN_DIR DIRECT /end RECORD_LAYOUT
/begin RECORD_LAYOUT STANDARD_GROUP_S8 FNC_VALUES 1 SBYTE COLUMN_DIR DIRECT /end RECORD_LAYOUT
/begin RECORD_LAYOUT STANDARD_GROUP_U16 FNC_VALUES 1 UWORD COLUMN_DIR DIRECT /end RECORD_LAYOUT
/begin RECORD_LAYOUT STANDARD_GROUP_U32 FNC_VALUES 1 ULONG COLUMN_DIR DIRECT /end RECORD_LAYOUT
/begin RECORD_LAYOUT STANDARD_GROUP_U8 FNC_VALUES 1 UBYTE COLUMN_DIR DIRECT /end RECORD_LAYOUT
/begin RECORD_LAYOUT STANDARD_VALUE_S16 FNC_VALUES 1 SWORD COLUMN_DIR DIRECT /end RECORD_LAYOUT
/begin RECORD_LAYOUT STANDARD_VALUE_S32 FNC_VALUES 1 SLONG COLUMN_DIR DIRECT /end RECORD_LAYOUT
/begin RECORD_LAYOUT STANDARD_VALUE_S8 FNC_VALUES 1 SBYTE COLUMN_DIR DIRECT /end RECORD_LAYOUT
/begin RECORD_LAYOUT STANDARD_VALUE_U16 FNC_VALUES 1 UWORD COLUMN_DIR DIRECT /end RECORD_LAYOUT
/begin RECORD_LAYOUT STANDARD_VALUE_U32 FNC_VALUES 1 ULONG COLUMN_DIR DIRECT /end RECORD_LAYOUT
/begin RECORD_LAYOUT STANDARD_VALUE_U8 FNC_VALUES 1 UBYTE COLUMN_DIR DIRECT /end RECORD_LAYOUT
/end MODULE
/end PROJECT

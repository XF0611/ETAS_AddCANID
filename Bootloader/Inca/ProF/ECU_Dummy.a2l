ASAP2_VERSION 1 40
/begin PROJECT ECU_Base_Prj_CAN3Mon_UdsFlashing "Generated by ETAS from Project ECU_Base_Prj_CAN3Mon_UdsFlashing"
/begin HEADER "" VERSION "000" PROJECT_NO ASD /end HEADER
/begin MODULE ECU_Base_Prj_CAN3Mon_UdsFlashing "Generated by ETAS from Project ECU_Base_Prj_CAN3Mon_UdsFlashing"
/begin MOD_COMMON "2009-04-06 10:39:06	create by ETASHexVirtualAddressTableHeaderV2" BYTE_ORDER MSB_FIRST ALIGNMENT_BYTE 1 ALIGNMENT_WORD 2 ALIGNMENT_LONG 4 ALIGNMENT_FLOAT32_IEEE 4 ALIGNMENT_FLOAT64_IEEE 8 /end MOD_COMMON
/begin CHARACTERISTIC curve_table.Curve_Calc_16.Curve_Module "" CURVE 0x1D0A16 STANDARD_CURVE_U16U16 0.0 ident 0.0 65535.0
 /begin AXIS_DESCR STD_AXIS input_array.Curve_Calc_16.Curve_Module ident 10 0.0 65535.0 /end AXIS_DESCR
/end CHARACTERISTIC
/begin CHARACTERISTIC iflag_mask.CCP_SHELL "" VAL_BLK 0x1D08D4 STANDARD_VALUE_U8 0.0 ident 0 255 MATRIX_DIM 4 1 1 /end CHARACTERISTIC
/begin CHARACTERISTIC ip_NumEntries_u8.C_ClassUdsVIN.UdsLocIDs "" VALUE 0x1D99B0 STANDARD_VALUE_U8 0.0 ident 0 255 /end CHARACTERISTIC
/begin CHARACTERISTIC ip_NumEntries_u8.C_ClassUdsVIN2.UdsLocIDs "" VALUE 0x1D99B1 STANDARD_VALUE_U8 0.0 ident 0 255 /end CHARACTERISTIC
/begin CHARACTERISTIC nr_of_cells.Curve_Calc_16.Curve_Module "" VALUE 0x1D0A14 STANDARD_VALUE_U8 0.0 ident 0 255 /end CHARACTERISTIC
/begin CHARACTERISTIC P_Bit_Sint16.Extern_MEM.Bit_Test "" VALUE 0x1D007C STANDARD_VALUE_S16 0.0 ident -32768 32767 /end CHARACTERISTIC
/begin CHARACTERISTIC P_Bit_Sint16.Intern_MEM.Bit_Test "" VALUE 0x1D0090 STANDARD_VALUE_S16 0.0 ident -32768 32767 /end CHARACTERISTIC
/begin CHARACTERISTIC P_Bit_Sint16_Bit_00.P_Bit.Bit_Test "" VALUE 0x1D0068 STANDARD_VALUE_S16 0.0 ident 0 1 BIT_MASK 0x0001 DISPLAY_IDENTIFIER P_Bit_Sint16_Bit_00.P_Bit.Bit_Test_DISP_ID /end CHARACTERISTIC
/begin CHARACTERISTIC P_Bit_Sint16_Bit_01.P_Bit.Bit_Test "" VALUE 0x1D0068 STANDARD_VALUE_S16 0.0 ident 0 1 BIT_MASK 0x0002 DISPLAY_IDENTIFIER P_Bit_Sint16_Bit_01.P_Bit.Bit_Test_DISP_ID /end CHARACTERISTIC
/begin CHARACTERISTIC P_Bit_Sint16_Bit_02.P_Bit.Bit_Test "" VALUE 0x1D0068 STANDARD_VALUE_S16 0.0 ident 0 1 BIT_MASK 0x0004 DISPLAY_IDENTIFIER P_Bit_Sint16_Bit_02.P_Bit.Bit_Test_DISP_ID /end CHARACTERISTIC
/begin CHARACTERISTIC P_Bit_Sint16_Bit_03.P_Bit.Bit_Test "" VALUE 0x1D0068 STANDARD_VALUE_S16 0.0 ident 0 1 BIT_MASK 0x0008 DISPLAY_IDENTIFIER P_Bit_Sint16_Bit_03.P_Bit.Bit_Test_DISP_ID /end CHARACTERISTIC
/begin CHARACTERISTIC P_Bit_Sint16_Bit_04.P_Bit.Bit_Test "" VALUE 0x1D0068 STANDARD_VALUE_S16 0.0 ident 0 1 BIT_MASK 0x0010 DISPLAY_IDENTIFIER P_Bit_Sint16_Bit_04.P_Bit.Bit_Test_DISP_ID /end CHARACTERISTIC
/begin CHARACTERISTIC P_Bit_Sint16_Bit_05.P_Bit.Bit_Test "" VALUE 0x1D0068 STANDARD_VALUE_S16 0.0 ident 0 1 BIT_MASK 0x0020 DISPLAY_IDENTIFIER P_Bit_Sint16_Bit_05.P_Bit.Bit_Test_DISP_ID /end CHARACTERISTIC
/begin CHARACTERISTIC P_Bit_Sint16_Bit_06.P_Bit.Bit_Test "" VALUE 0x1D0068 STANDARD_VALUE_S16 0.0 ident 0 1 BIT_MASK 0x0040 DISPLAY_IDENTIFIER P_Bit_Sint16_Bit_06.P_Bit.Bit_Test_DISP_ID /end CHARACTERISTIC
/begin CHARACTERISTIC P_Bit_Sint16_Bit_07.P_Bit.Bit_Test "" VALUE 0x1D0068 STANDARD_VALUE_S16 0.0 ident 0 1 BIT_MASK 0x0080 DISPLAY_IDENTIFIER P_Bit_Sint16_Bit_07.P_Bit.Bit_Test_DISP_ID /end CHARACTERISTIC
/begin CHARACTERISTIC P_Bit_Sint16_Bit_08.P_Bit.Bit_Test "" VALUE 0x1D0068 STANDARD_VALUE_S16 0.0 ident 0 1 BIT_MASK 0x0100 DISPLAY_IDENTIFIER P_Bit_Sint16_Bit_08.P_Bit.Bit_Test_DISP_ID /end CHARACTERISTIC
/begin CHARACTERISTIC P_Bit_Sint16_Bit_09.P_Bit.Bit_Test "" VALUE 0x1D0068 STANDARD_VALUE_S16 0.0 ident 0 1 BIT_MASK 0x0200 DISPLAY_IDENTIFIER P_Bit_Sint16_Bit_09.P_Bit.Bit_Test_DISP_ID /end CHARACTERISTIC
/begin CHARACTERISTIC P_Bit_Sint16_Bit_10.P_Bit.Bit_Test "" VALUE 0x1D0068 STANDARD_VALUE_S16 0.0 ident 0 1 BIT_MASK 0x0400 DISPLAY_IDENTIFIER P_Bit_Sint16_Bit_10.P_Bit.Bit_Test_DISP_ID /end CHARACTERISTIC
/begin CHARACTERISTIC P_Bit_Sint16_Bit_11.P_Bit.Bit_Test "" VALUE 0x1D0068 STANDARD_VALUE_S16 0.0 ident 0 1 BIT_MASK 0x0800 DISPLAY_IDENTIFIER P_Bit_Sint16_Bit_11.P_Bit.Bit_Test_DISP_ID /end CHARACTERISTIC
/begin CHARACTERISTIC P_Bit_Sint16_Bit_12.P_Bit.Bit_Test "" VALUE 0x1D0068 STANDARD_VALUE_S16 0.0 ident 0 1 BIT_MASK 0x1000 DISPLAY_IDENTIFIER P_Bit_Sint16_Bit_12.P_Bit.Bit_Test_DISP_ID /end CHARACTERISTIC
/begin CHARACTERISTIC P_Bit_Sint16_Bit_13.P_Bit.Bit_Test "" VALUE 0x1D0068 STANDARD_VALUE_S16 0.0 ident 0 1 BIT_MASK 0x2000 DISPLAY_IDENTIFIER P_Bit_Sint16_Bit_13.P_Bit.Bit_Test_DISP_ID /end CHARACTERISTIC
/begin CHARACTERISTIC P_Bit_Sint16_Bit_14.P_Bit.Bit_Test "" VALUE 0x1D0068 STANDARD_VALUE_S16 0.0 ident 0 1 BIT_MASK 0x4000 DISPLAY_IDENTIFIER P_Bit_Sint16_Bit_14.P_Bit.Bit_Test_DISP_ID /end CHARACTERISTIC
/begin CHARACTERISTIC P_Bit_Sint16_Bit_15.P_Bit.Bit_Test "" VALUE 0x1D0068 STANDARD_VALUE_S16 0.0 ident 0 1 BIT_MASK 0x8000 DISPLAY_IDENTIFIER P_Bit_Sint16_Bit_15.P_Bit.Bit_Test_DISP_ID /end CHARACTERISTIC
/begin CHARACTERISTIC P_Bit_Sint32.Extern_MEM.Bit_Test "" VALUE 0x1D0074 STANDARD_VALUE_S32 0.0 ident -2147483648 2147483647 /end CHARACTERISTIC
/begin CHARACTERISTIC P_Bit_Sint32.Intern_MEM.Bit_Test "" VALUE 0x1D0088 STANDARD_VALUE_S32 0.0 ident -2147483648 2147483647 /end CHARACTERISTIC
/begin CHARACTERISTIC P_Bit_Sint32_Bit_00.P_Bit.Bit_Test "" VALUE 0x1D0060 STANDARD_VALUE_S32 0.0 ident 0 1 BIT_MASK 0x00000001 /end CHARACTERISTIC
/begin CHARACTERISTIC P_Bit_Sint32_Bit_01.P_Bit.Bit_Test "" VALUE 0x1D0060 STANDARD_VALUE_S32 0.0 ident 0 1 BIT_MASK 0x00000002 /end CHARACTERISTIC
/begin CHARACTERISTIC P_Bit_Sint32_Bit_02.P_Bit.Bit_Test "" VALUE 0x1D0060 STANDARD_VALUE_S32 0.0 ident 0 1 BIT_MASK 0x00000004 /end CHARACTERISTIC
/begin CHARACTERISTIC P_Bit_Sint32_Bit_03.P_Bit.Bit_Test "" VALUE 0x1D0060 STANDARD_VALUE_S32 0.0 ident 0 1 BIT_MASK 0x00000008 /end CHARACTERISTIC
/begin CHARACTERISTIC P_Bit_Sint32_Bit_04.P_Bit.Bit_Test "" VALUE 0x1D0060 STANDARD_VALUE_S32 0.0 ident 0 1 BIT_MASK 0x00000010 /end CHARACTERISTIC
/begin CHARACTERISTIC P_Bit_Sint32_Bit_05.P_Bit.Bit_Test "" VALUE 0x1D0060 STANDARD_VALUE_S32 0.0 ident 0 1 BIT_MASK 0x00000020 /end CHARACTERISTIC
/begin CHARACTERISTIC P_Bit_Sint32_Bit_06.P_Bit.Bit_Test "" VALUE 0x1D0060 STANDARD_VALUE_S32 0.0 ident 0 1 BIT_MASK 0x00000040 /end CHARACTERISTIC
/begin CHARACTERISTIC P_Bit_Sint32_Bit_07.P_Bit.Bit_Test "" VALUE 0x1D0060 STANDARD_VALUE_S32 0.0 ident 0 1 BIT_MASK 0x00000080 /end CHARACTERISTIC
/begin CHARACTERISTIC P_Bit_Sint32_Bit_08.P_Bit.Bit_Test "" VALUE 0x1D0060 STANDARD_VALUE_S32 0.0 ident 0 1 BIT_MASK 0x00000100 /end CHARACTERISTIC
/begin CHARACTERISTIC P_Bit_Sint32_Bit_09.P_Bit.Bit_Test "" VALUE 0x1D0060 STANDARD_VALUE_S32 0.0 ident 0 1 BIT_MASK 0x00000200 /end CHARACTERISTIC
/begin CHARACTERISTIC P_Bit_Sint32_Bit_10.P_Bit.Bit_Test "" VALUE 0x1D0060 STANDARD_VALUE_S32 0.0 ident 0 1 BIT_MASK 0x00000400 /end CHARACTERISTIC
/begin CHARACTERISTIC P_Bit_Sint32_Bit_11.P_Bit.Bit_Test "" VALUE 0x1D0060 STANDARD_VALUE_S32 0.0 ident 0 1 BIT_MASK 0x00000800 /end CHARACTERISTIC
/begin CHARACTERISTIC P_Bit_Sint32_Bit_12.P_Bit.Bit_Test "" VALUE 0x1D0060 STANDARD_VALUE_S32 0.0 ident 0 1 BIT_MASK 0x00001000 /end CHARACTERISTIC
/begin CHARACTERISTIC P_Bit_Sint32_Bit_13.P_Bit.Bit_Test "" VALUE 0x1D0060 STANDARD_VALUE_S32 0.0 ident 0 1 BIT_MASK 0x00002000 /end CHARACTERISTIC
/begin CHARACTERISTIC P_Bit_Sint32_Bit_14.P_Bit.Bit_Test "" VALUE 0x1D0060 STANDARD_VALUE_S32 0.0 ident 0 1 BIT_MASK 0x00004000 /end CHARACTERISTIC
/begin CHARACTERISTIC P_Bit_Sint32_Bit_15.P_Bit.Bit_Test "" VALUE 0x1D0060 STANDARD_VALUE_S32 0.0 ident 0 1 BIT_MASK 0x00008000 /end CHARACTERISTIC
/begin CHARACTERISTIC P_Bit_Sint32_Bit_16.P_Bit.Bit_Test "" VALUE 0x1D0060 STANDARD_VALUE_S32 0.0 ident 0 1 BIT_MASK 0x00010000 /end CHARACTERISTIC
/begin CHARACTERISTIC P_Bit_Sint32_Bit_17.P_Bit.Bit_Test "" VALUE 0x1D0060 STANDARD_VALUE_S32 0.0 ident 0 1 BIT_MASK 0x00020000 /end CHARACTERISTIC
/begin CHARACTERISTIC P_Bit_Sint32_Bit_18.P_Bit.Bit_Test "" VALUE 0x1D0060 STANDARD_VALUE_S32 0.0 ident 0 1 BIT_MASK 0x00040000 /end CHARACTERISTIC
/begin CHARACTERISTIC P_Bit_Sint32_Bit_19.P_Bit.Bit_Test "" VALUE 0x1D0060 STANDARD_VALUE_S32 0.0 ident 0 1 BIT_MASK 0x00080000 /end CHARACTERISTIC
/begin CHARACTERISTIC P_Bit_Sint32_Bit_20.P_Bit.Bit_Test "" VALUE 0x1D0060 STANDARD_VALUE_S32 0.0 ident 0 1 BIT_MASK 0x00100000 /end CHARACTERISTIC
/begin CHARACTERISTIC P_Bit_Sint32_Bit_21.P_Bit.Bit_Test "" VALUE 0x1D0060 STANDARD_VALUE_S32 0.0 ident 0 1 BIT_MASK 0x00200000 /end CHARACTERISTIC
/begin CHARACTERISTIC P_Bit_Sint32_Bit_22.P_Bit.Bit_Test "" VALUE 0x1D0060 STANDARD_VALUE_S32 0.0 ident 0 1 BIT_MASK 0x00400000 /end CHARACTERISTIC
/begin CHARACTERISTIC P_Bit_Sint32_Bit_23.P_Bit.Bit_Test "" VALUE 0x1D0060 STANDARD_VALUE_S32 0.0 ident 0 1 BIT_MASK 0x00800000 /end CHARACTERISTIC
/begin CHARACTERISTIC P_Bit_Sint32_Bit_24.P_Bit.Bit_Test "" VALUE 0x1D0060 STANDARD_VALUE_S32 0.0 ident 0 1 BIT_MASK 0x01000000 /end CHARACTERISTIC
/begin CHARACTERISTIC P_Bit_Sint32_Bit_25.P_Bit.Bit_Test "" VALUE 0x1D0060 STANDARD_VALUE_S32 0.0 ident 0 1 BIT_MASK 0x02000000 /end CHARACTERISTIC
/begin CHARACTERISTIC P_Bit_Sint32_Bit_26.P_Bit.Bit_Test "" VALUE 0x1D0060 STANDARD_VALUE_S32 0.0 ident 0 1 BIT_MASK 0x04000000 /end CHARACTERISTIC
/begin CHARACTERISTIC P_Bit_Sint32_Bit_27.P_Bit.Bit_Test "" VALUE 0x1D0060 STANDARD_VALUE_S32 0.0 ident 0 1 BIT_MASK 0x08000000 /end CHARACTERISTIC
/begin CHARACTERISTIC P_Bit_Sint32_Bit_28.P_Bit.Bit_Test "" VALUE 0x1D0060 STANDARD_VALUE_S32 0.0 ident 0 1 BIT_MASK 0x10000000 /end CHARACTERISTIC
/begin CHARACTERISTIC P_Bit_Sint32_Bit_29.P_Bit.Bit_Test "" VALUE 0x1D0060 STANDARD_VALUE_S32 0.0 ident 0 1 BIT_MASK 0x20000000 /end CHARACTERISTIC
/begin CHARACTERISTIC P_Bit_Sint32_Bit_30.P_Bit.Bit_Test "" VALUE 0x1D0060 STANDARD_VALUE_S32 0.0 ident 0 1 BIT_MASK 0x40000000 /end CHARACTERISTIC
/begin CHARACTERISTIC P_Bit_Sint32_Bit_31.P_Bit.Bit_Test "" VALUE 0x1D0060 STANDARD_VALUE_S32 0.0 ident 0 1 BIT_MASK 0x80000000 /end CHARACTERISTIC
/begin CHARACTERISTIC P_Bit_Sint8_Bit_0.P_Bit.Bit_Test "" VALUE 0x1D006C STANDARD_VALUE_S8 0.0 ident 0 1 BIT_MASK 0x01 /end CHARACTERISTIC
/begin CHARACTERISTIC P_Bit_Sint8_Bit_1.P_Bit.Bit_Test "" VALUE 0x1D006C STANDARD_VALUE_S8 0.0 ident 0 1 BIT_MASK 0x02 /end CHARACTERISTIC
/begin CHARACTERISTIC P_Bit_Sint8_Bit_2.P_Bit.Bit_Test "" VALUE 0x1D006C STANDARD_VALUE_S8 0.0 ident 0 1 BIT_MASK 0x04 /end CHARACTERISTIC
/begin CHARACTERISTIC P_Bit_Sint8_Bit_3.P_Bit.Bit_Test "" VALUE 0x1D006C STANDARD_VALUE_S8 0.0 ident 0 1 BIT_MASK 0x08 /end CHARACTERISTIC
/begin CHARACTERISTIC P_Bit_Sint8_Bit_4.P_Bit.Bit_Test "" VALUE 0x1D006C STANDARD_VALUE_S8 0.0 ident 0 1 BIT_MASK 0x10 /end CHARACTERISTIC
/begin CHARACTERISTIC P_Bit_Sint8_Bit_5.P_Bit.Bit_Test "" VALUE 0x1D006C STANDARD_VALUE_S8 0.0 ident 0 1 BIT_MASK 0x20 /end CHARACTERISTIC
/begin CHARACTERISTIC P_Bit_Sint8_Bit_6.P_Bit.Bit_Test "" VALUE 0x1D006C STANDARD_VALUE_S8 0.0 ident 0 1 BIT_MASK 0x40 /end CHARACTERISTIC
/begin CHARACTERISTIC P_Bit_Sint8_Bit_7.P_Bit.Bit_Test "" VALUE 0x1D006C STANDARD_VALUE_S8 0.0 ident 0 1 BIT_MASK 0x80 /end CHARACTERISTIC
/begin CHARACTERISTIC P_Bit_Sint8_E.Extern_MEM.Bit_Test "" VALUE 0x1D0080 STANDARD_VALUE_S8 0.0 ident -128 127 /end CHARACTERISTIC
/begin CHARACTERISTIC P_Bit_Sint8_E.Intern_MEM.Bit_Test "" VALUE 0x1D0094 STANDARD_VALUE_S8 0.0 ident -128 127 /end CHARACTERISTIC
/begin CHARACTERISTIC P_Bit_Sint8_O.Extern_MEM.Bit_Test "" VALUE 0x1D0081 STANDARD_VALUE_S8 0.0 ident -128 127 /end CHARACTERISTIC
/begin CHARACTERISTIC P_Bit_Sint8_O.Intern_MEM.Bit_Test "" VALUE 0x1D0095 STANDARD_VALUE_S8 0.0 ident -128 127 /end CHARACTERISTIC
/begin CHARACTERISTIC P_Bit_Uint16.Extern_MEM.Bit_Test "" VALUE 0x1D007E STANDARD_VALUE_U16 0.0 ident 0 65535 /end CHARACTERISTIC
/begin CHARACTERISTIC P_Bit_Uint16.Intern_MEM.Bit_Test "" VALUE 0x1D0092 STANDARD_VALUE_U16 0.0 ident 0 65535 /end CHARACTERISTIC
/begin CHARACTERISTIC P_Bit_Uint16_Bit_00.P_Bit.Bit_Test "" VALUE 0x1D006A STANDARD_VALUE_U16 0.0 ident 0 65535 BIT_MASK 0x0001 /end CHARACTERISTIC
/begin CHARACTERISTIC P_Bit_Uint16_Bit_01.P_Bit.Bit_Test "" VALUE 0x1D006A STANDARD_VALUE_U16 0.0 ident 0 65535 BIT_MASK 0x0002 /end CHARACTERISTIC
/begin CHARACTERISTIC P_Bit_Uint16_Bit_02.P_Bit.Bit_Test "" VALUE 0x1D006A STANDARD_VALUE_U16 0.0 ident 0 65535 BIT_MASK 0x0004 /end CHARACTERISTIC
/begin CHARACTERISTIC P_Bit_Uint16_Bit_03.P_Bit.Bit_Test "" VALUE 0x1D006A STANDARD_VALUE_U16 0.0 ident 0 65535 BIT_MASK 0x0008 /end CHARACTERISTIC
/begin CHARACTERISTIC P_Bit_Uint16_Bit_04.P_Bit.Bit_Test "" VALUE 0x1D006A STANDARD_VALUE_U16 0.0 ident 0 65535 BIT_MASK 0x0010 /end CHARACTERISTIC
/begin CHARACTERISTIC P_Bit_Uint16_Bit_05.P_Bit.Bit_Test "" VALUE 0x1D006A STANDARD_VALUE_U16 0.0 ident 0 65535 BIT_MASK 0x0020 /end CHARACTERISTIC
/begin CHARACTERISTIC P_Bit_Uint16_Bit_06.P_Bit.Bit_Test "" VALUE 0x1D006A STANDARD_VALUE_U16 0.0 ident 0 65535 BIT_MASK 0x0040 /end CHARACTERISTIC
/begin CHARACTERISTIC P_Bit_Uint16_Bit_07.P_Bit.Bit_Test "" VALUE 0x1D006A STANDARD_VALUE_U16 0.0 ident 0 65535 BIT_MASK 0x0080 /end CHARACTERISTIC
/begin CHARACTERISTIC P_Bit_Uint16_Bit_08.P_Bit.Bit_Test "" VALUE 0x1D006A STANDARD_VALUE_U16 0.0 ident 0 65535 BIT_MASK 0x0100 /end CHARACTERISTIC
/begin CHARACTERISTIC P_Bit_Uint16_Bit_09.P_Bit.Bit_Test "" VALUE 0x1D006A STANDARD_VALUE_U16 0.0 ident 0 65535 BIT_MASK 0x0200 /end CHARACTERISTIC
/begin CHARACTERISTIC P_Bit_Uint16_Bit_10.P_Bit.Bit_Test "" VALUE 0x1D006A STANDARD_VALUE_U16 0.0 ident 0 65535 BIT_MASK 0x0400 /end CHARACTERISTIC
/begin CHARACTERISTIC P_Bit_Uint16_Bit_11.P_Bit.Bit_Test "" VALUE 0x1D006A STANDARD_VALUE_U16 0.0 ident 0 65535 BIT_MASK 0x0800 /end CHARACTERISTIC
/begin CHARACTERISTIC P_Bit_Uint16_Bit_12.P_Bit.Bit_Test "" VALUE 0x1D006A STANDARD_VALUE_U16 0.0 ident 0 65535 BIT_MASK 0x1000 /end CHARACTERISTIC
/begin CHARACTERISTIC P_Bit_Uint16_Bit_13.P_Bit.Bit_Test "" VALUE 0x1D006A STANDARD_VALUE_U16 0.0 ident 0 65535 BIT_MASK 0x2000 /end CHARACTERISTIC
/begin CHARACTERISTIC P_Bit_Uint16_Bit_14.P_Bit.Bit_Test "" VALUE 0x1D006A STANDARD_VALUE_U16 0.0 ident 0 65535 BIT_MASK 0x4000 /end CHARACTERISTIC
/begin CHARACTERISTIC P_Bit_Uint16_Bit_15.P_Bit.Bit_Test "" VALUE 0x1D006A STANDARD_VALUE_U16 0.0 ident 0 65535 BIT_MASK 0x8000 /end CHARACTERISTIC
/begin CHARACTERISTIC P_Bit_Uint32.Extern_MEM.Bit_Test "" VALUE 0x1D0078 STANDARD_VALUE_U32 0.0 ident 0 4294967295 /end CHARACTERISTIC
/begin CHARACTERISTIC P_Bit_Uint32.Intern_MEM.Bit_Test "" VALUE 0x1D008C STANDARD_VALUE_U32 0.0 ident 0 4294967295 /end CHARACTERISTIC
/begin CHARACTERISTIC P_Bit_Uint32_Bit_00.P_Bit.Bit_Test "" VALUE 0x1D0064 STANDARD_VALUE_U32 0.0 ident 0 4294967295 BIT_MASK 0x00000001 /end CHARACTERISTIC
/begin CHARACTERISTIC P_Bit_Uint32_Bit_01.P_Bit.Bit_Test "" VALUE 0x1D0064 STANDARD_VALUE_U32 0.0 ident 0 4294967295 BIT_MASK 0x00000002 /end CHARACTERISTIC
/begin CHARACTERISTIC P_Bit_Uint32_Bit_02.P_Bit.Bit_Test "" VALUE 0x1D0064 STANDARD_VALUE_U32 0.0 ident 0 4294967295 BIT_MASK 0x00000004 /end CHARACTERISTIC
/begin CHARACTERISTIC P_Bit_Uint32_Bit_03.P_Bit.Bit_Test "" VALUE 0x1D0064 STANDARD_VALUE_U32 0.0 ident 0 4294967295 BIT_MASK 0x00000008 /end CHARACTERISTIC
/begin CHARACTERISTIC P_Bit_Uint32_Bit_04.P_Bit.Bit_Test "" VALUE 0x1D0064 STANDARD_VALUE_U32 0.0 ident 0 4294967295 BIT_MASK 0x00000010 /end CHARACTERISTIC
/begin CHARACTERISTIC P_Bit_Uint32_Bit_05.P_Bit.Bit_Test "" VALUE 0x1D0064 STANDARD_VALUE_U32 0.0 ident 0 4294967295 BIT_MASK 0x00000020 /end CHARACTERISTIC
/begin CHARACTERISTIC P_Bit_Uint32_Bit_06.P_Bit.Bit_Test "" VALUE 0x1D0064 STANDARD_VALUE_U32 0.0 ident 0 4294967295 BIT_MASK 0x00000040 /end CHARACTERISTIC
/begin CHARACTERISTIC P_Bit_Uint32_Bit_07.P_Bit.Bit_Test "" VALUE 0x1D0064 STANDARD_VALUE_U32 0.0 ident 0 4294967295 BIT_MASK 0x00000080 /end CHARACTERISTIC
/begin CHARACTERISTIC P_Bit_Uint32_Bit_08.P_Bit.Bit_Test "" VALUE 0x1D0064 STANDARD_VALUE_U32 0.0 ident 0 4294967295 BIT_MASK 0x00000100 /end CHARACTERISTIC
/begin CHARACTERISTIC P_Bit_Uint32_Bit_09.P_Bit.Bit_Test "" VALUE 0x1D0064 STANDARD_VALUE_U32 0.0 ident 0 4294967295 BIT_MASK 0x00000200 /end CHARACTERISTIC
/begin CHARACTERISTIC P_Bit_Uint32_Bit_10.P_Bit.Bit_Test "" VALUE 0x1D0064 STANDARD_VALUE_U32 0.0 ident 0 4294967295 BIT_MASK 0x00000400 /end CHARACTERISTIC
/begin CHARACTERISTIC P_Bit_Uint32_Bit_11.P_Bit.Bit_Test "" VALUE 0x1D0064 STANDARD_VALUE_U32 0.0 ident 0 4294967295 BIT_MASK 0x00000800 /end CHARACTERISTIC
/begin CHARACTERISTIC P_Bit_Uint32_Bit_12.P_Bit.Bit_Test "" VALUE 0x1D0064 STANDARD_VALUE_U32 0.0 ident 0 4294967295 BIT_MASK 0x00001000 /end CHARACTERISTIC
/begin CHARACTERISTIC P_Bit_Uint32_Bit_13.P_Bit.Bit_Test "" VALUE 0x1D0064 STANDARD_VALUE_U32 0.0 ident 0 4294967295 BIT_MASK 0x00002000 /end CHARACTERISTIC
/begin CHARACTERISTIC P_Bit_Uint32_Bit_14.P_Bit.Bit_Test "" VALUE 0x1D0064 STANDARD_VALUE_U32 0.0 ident 0 4294967295 BIT_MASK 0x00004000 /end CHARACTERISTIC
/begin CHARACTERISTIC P_Bit_Uint32_Bit_15.P_Bit.Bit_Test "" VALUE 0x1D0064 STANDARD_VALUE_U32 0.0 ident 0 4294967295 BIT_MASK 0x00008000 /end CHARACTERISTIC
/begin CHARACTERISTIC P_Bit_Uint32_Bit_16.P_Bit.Bit_Test "" VALUE 0x1D0064 STANDARD_VALUE_U32 0.0 ident 0 4294967295 BIT_MASK 0x00010000 /end CHARACTERISTIC
/begin CHARACTERISTIC P_Bit_Uint32_Bit_17.P_Bit.Bit_Test "" VALUE 0x1D0064 STANDARD_VALUE_U32 0.0 ident 0 4294967295 BIT_MASK 0x00020000 /end CHARACTERISTIC
/begin CHARACTERISTIC P_Bit_Uint32_Bit_18.P_Bit.Bit_Test "" VALUE 0x1D0064 STANDARD_VALUE_U32 0.0 ident 0 4294967295 BIT_MASK 0x00040000 /end CHARACTERISTIC
/begin CHARACTERISTIC P_Bit_Uint32_Bit_19.P_Bit.Bit_Test "" VALUE 0x1D0064 STANDARD_VALUE_U32 0.0 ident 0 4294967295 BIT_MASK 0x00080000 /end CHARACTERISTIC
/begin CHARACTERISTIC P_Bit_Uint32_Bit_20.P_Bit.Bit_Test "" VALUE 0x1D0064 STANDARD_VALUE_U32 0.0 ident 0 4294967295 BIT_MASK 0x00100000 /end CHARACTERISTIC
/begin CHARACTERISTIC P_Bit_Uint32_Bit_21.P_Bit.Bit_Test "" VALUE 0x1D0064 STANDARD_VALUE_U32 0.0 ident 0 4294967295 BIT_MASK 0x00200000 /end CHARACTERISTIC
/begin CHARACTERISTIC P_Bit_Uint32_Bit_22.P_Bit.Bit_Test "" VALUE 0x1D0064 STANDARD_VALUE_U32 0.0 ident 0 4294967295 BIT_MASK 0x00400000 /end CHARACTERISTIC
/begin CHARACTERISTIC P_Bit_Uint32_Bit_23.P_Bit.Bit_Test "" VALUE 0x1D0064 STANDARD_VALUE_U32 0.0 ident 0 4294967295 BIT_MASK 0x00800000 /end CHARACTERISTIC
/begin CHARACTERISTIC P_Bit_Uint32_Bit_24.P_Bit.Bit_Test "" VALUE 0x1D0064 STANDARD_VALUE_U32 0.0 ident 0 4294967295 BIT_MASK 0x01000000 /end CHARACTERISTIC
/begin CHARACTERISTIC P_Bit_Uint32_Bit_25.P_Bit.Bit_Test "" VALUE 0x1D0064 STANDARD_VALUE_U32 0.0 ident 0 4294967295 BIT_MASK 0x02000000 /end CHARACTERISTIC
/begin CHARACTERISTIC P_Bit_Uint32_Bit_26.P_Bit.Bit_Test "" VALUE 0x1D0064 STANDARD_VALUE_U32 0.0 ident 0 4294967295 BIT_MASK 0x04000000 /end CHARACTERISTIC
/begin CHARACTERISTIC P_Bit_Uint32_Bit_27.P_Bit.Bit_Test "" VALUE 0x1D0064 STANDARD_VALUE_U32 0.0 ident 0 4294967295 BIT_MASK 0x08000000 /end CHARACTERISTIC
/begin CHARACTERISTIC P_Bit_Uint32_Bit_28.P_Bit.Bit_Test "" VALUE 0x1D0064 STANDARD_VALUE_U32 0.0 ident 0 4294967295 BIT_MASK 0x10000000 /end CHARACTERISTIC
/begin CHARACTERISTIC P_Bit_Uint32_Bit_29.P_Bit.Bit_Test "" VALUE 0x1D0064 STANDARD_VALUE_U32 0.0 ident 0 4294967295 BIT_MASK 0x20000000 /end CHARACTERISTIC
/begin CHARACTERISTIC P_Bit_Uint32_Bit_30.P_Bit.Bit_Test "" VALUE 0x1D0064 STANDARD_VALUE_U32 0.0 ident 0 4294967295 BIT_MASK 0x40000000 /end CHARACTERISTIC
/begin CHARACTERISTIC P_Bit_Uint32_Bit_31.P_Bit.Bit_Test "" VALUE 0x1D0064 STANDARD_VALUE_U32 0.0 ident 0 4294967295 BIT_MASK 0x80000000 /end CHARACTERISTIC
/begin CHARACTERISTIC P_Bit_Uint8_Bit_0.P_Bit.Bit_Test "" VALUE 0x1D006D STANDARD_VALUE_U8 0.0 ident 0 255 BIT_MASK 0x01 /end CHARACTERISTIC
/begin CHARACTERISTIC P_Bit_Uint8_Bit_1.P_Bit.Bit_Test "" VALUE 0x1D006D STANDARD_VALUE_U8 0.0 ident 0 255 BIT_MASK 0x02 /end CHARACTERISTIC
/begin CHARACTERISTIC P_Bit_Uint8_Bit_2.P_Bit.Bit_Test "" VALUE 0x1D006D STANDARD_VALUE_U8 0.0 ident 0 255 BIT_MASK 0x04 /end CHARACTERISTIC
/begin CHARACTERISTIC P_Bit_Uint8_Bit_3.P_Bit.Bit_Test "" VALUE 0x1D006D STANDARD_VALUE_U8 0.0 ident 0 255 BIT_MASK 0x08 /end CHARACTERISTIC
/begin CHARACTERISTIC P_Bit_Uint8_Bit_4.P_Bit.Bit_Test "" VALUE 0x1D006D STANDARD_VALUE_U8 0.0 ident 0 255 BIT_MASK 0x10 /end CHARACTERISTIC
/begin CHARACTERISTIC P_Bit_Uint8_Bit_5.P_Bit.Bit_Test "" VALUE 0x1D006D STANDARD_VALUE_U8 0.0 ident 0 255 BIT_MASK 0x20 /end CHARACTERISTIC
/begin CHARACTERISTIC P_Bit_Uint8_Bit_6.P_Bit.Bit_Test "" VALUE 0x1D006D STANDARD_VALUE_U8 0.0 ident 0 255 BIT_MASK 0x40 /end CHARACTERISTIC
/begin CHARACTERISTIC P_Bit_Uint8_Bit_7.P_Bit.Bit_Test "" VALUE 0x1D006D STANDARD_VALUE_U8 0.0 ident 0 255 BIT_MASK 0x80 /end CHARACTERISTIC
/begin CHARACTERISTIC P_Bit_Uint8_E.Extern_MEM.Bit_Test "" VALUE 0x1D0082 STANDARD_VALUE_U8 0.0 ident 0 255 /end CHARACTERISTIC
/begin CHARACTERISTIC P_Bit_Uint8_E.Intern_MEM.Bit_Test "" VALUE 0x1D0096 STANDARD_VALUE_U8 0.0 ident 0 255 /end CHARACTERISTIC
/begin CHARACTERISTIC P_Bit_Uint8_O.Extern_MEM.Bit_Test "" VALUE 0x1D0083 STANDARD_VALUE_U8 0.0 ident 0 255 /end CHARACTERISTIC
/begin CHARACTERISTIC P_Bit_Uint8_O.Intern_MEM.Bit_Test "" VALUE 0x1D0097 STANDARD_VALUE_U8 0.0 ident 0 255 /end CHARACTERISTIC
/begin CHARACTERISTIC P_CAN_C_Buf.CanDriver "" VAL_BLK 0x1D0558 STANDARD_VALUE_U32 0.0 ident 0 4294967295 MATRIX_DIM 64 1 1 /end CHARACTERISTIC
/begin CHARACTERISTIC P_CAN_C_IdTyp.CanDriver "" VAL_BLK 0x1D0658 STANDARD_VALUE_U32 0.0 ident 0 4294967295 MATRIX_DIM 64 1 1 /end CHARACTERISTIC
/begin CHARACTERISTIC P_CAN_DataSwitch.CanDriver "" VALUE 0x1D0870 STANDARD_VALUE_U8 0.0 ident 0 1 BIT_MASK 0x1 /end CHARACTERISTIC
/begin CHARACTERISTIC P_CAN_IDs.CanDriver "" VAL_BLK 0x1D0758 STANDARD_VALUE_U32 0.0 ident 0 4294967295 MATRIX_DIM 65 1 1 /end CHARACTERISTIC
/begin CHARACTERISTIC P_CAN_IDs_fast.CanDriver "" VAL_BLK 0x1D085C STANDARD_VALUE_U32 0.0 ident 0 4294967295 MATRIX_DIM 5 1 1 /end CHARACTERISTIC
/begin CHARACTERISTIC P_CAN_Length.CanDriver "" VAL_BLK 0x1D0871 STANDARD_VALUE_U8 0.0 ident 1 8 MATRIX_DIM 64 1 1 /end CHARACTERISTIC
/begin CHARACTERISTIC P_CAN_Length_fast.CanDriver "" VAL_BLK 0x1D08B1 STANDARD_VALUE_U8 0.0 ident 1 8 MATRIX_DIM 5 1 1 /end CHARACTERISTIC
/begin CHARACTERISTIC P_can_on_off.CanDriver "" VALUE 0x1D08C6 STANDARD_VALUE_U8 0.0 ident 0 1 BIT_MASK 0x1 /end CHARACTERISTIC
/begin CHARACTERISTIC P_CAN_R01_Enable.CanDriver "" VALUE 0x1D08B6 STANDARD_VALUE_U8 0.0 ident 0 1 BIT_MASK 0x1 /end CHARACTERISTIC
/begin CHARACTERISTIC P_CAN_R02_Enable.CanDriver "" VALUE 0x1D08B7 STANDARD_VALUE_U8 0.0 ident 0 1 BIT_MASK 0x1 /end CHARACTERISTIC
/begin CHARACTERISTIC P_CAN_R03_Enable.CanDriver "" VALUE 0x1D08B8 STANDARD_VALUE_U8 0.0 ident 0 1 BIT_MASK 0x1 /end CHARACTERISTIC
/begin CHARACTERISTIC P_CAN_R04_Enable.CanDriver "" VALUE 0x1D08B9 STANDARD_VALUE_U8 0.0 ident 0 1 BIT_MASK 0x1 /end CHARACTERISTIC
/begin CHARACTERISTIC P_CAN_R05_Enable.CanDriver "" VALUE 0x1D08BA STANDARD_VALUE_U8 0.0 ident 0 1 BIT_MASK 0x1 /end CHARACTERISTIC
/begin CHARACTERISTIC P_CAN_R06_Enable.CanDriver "" VALUE 0x1D08BB STANDARD_VALUE_U8 0.0 ident 0 1 BIT_MASK 0x1 /end CHARACTERISTIC
/begin CHARACTERISTIC P_CAN_R07_Enable.CanDriver "" VALUE 0x1D08BC STANDARD_VALUE_U8 0.0 ident 0 1 BIT_MASK 0x1 /end CHARACTERISTIC
/begin CHARACTERISTIC P_CAN_R08_Enable.CanDriver "" VALUE 0x1D08BD STANDARD_VALUE_U8 0.0 ident 0 1 BIT_MASK 0x1 /end CHARACTERISTIC
/begin CHARACTERISTIC P_CAN_R09_Enable.CanDriver "" VALUE 0x1D08BE STANDARD_VALUE_U8 0.0 ident 0 1 BIT_MASK 0x1 /end CHARACTERISTIC
/begin CHARACTERISTIC P_CAN_R10_Enable.CanDriver "" VALUE 0x1D08BF STANDARD_VALUE_U8 0.0 ident 0 1 BIT_MASK 0x1 /end CHARACTERISTIC
/begin CHARACTERISTIC P_CAN_R11_Enable.CanDriver "" VALUE 0x1D08C0 STANDARD_VALUE_U8 0.0 ident 0 1 BIT_MASK 0x1 /end CHARACTERISTIC
/begin CHARACTERISTIC P_CAN_R12_Enable.CanDriver "" VALUE 0x1D08C1 STANDARD_VALUE_U8 0.0 ident 0 1 BIT_MASK 0x1 /end CHARACTERISTIC
/begin CHARACTERISTIC P_CAN_R13_Enable.CanDriver "" VALUE 0x1D08C2 STANDARD_VALUE_U8 0.0 ident 0 1 BIT_MASK 0x1 /end CHARACTERISTIC
/begin CHARACTERISTIC P_CAN_R14_Enable.CanDriver "" VALUE 0x1D08C3 STANDARD_VALUE_U8 0.0 ident 0 1 BIT_MASK 0x1 /end CHARACTERISTIC
/begin CHARACTERISTIC P_CAN_R15_Enable.CanDriver "" VALUE 0x1D08C4 STANDARD_VALUE_U8 0.0 ident 0 1 BIT_MASK 0x1 /end CHARACTERISTIC
/begin CHARACTERISTIC P_CAN_R16_Enable.CanDriver "" VALUE 0x1D08C5 STANDARD_VALUE_U8 0.0 ident 0 1 BIT_MASK 0x1 /end CHARACTERISTIC
/begin CHARACTERISTIC p_CarbPID05_deltaEnCoTemp40_u8.CRB_OBD "" VALUE 0x1D0910 STANDARD_VALUE_S8 0.0 ident 0 127 /end CHARACTERISTIC
/begin CHARACTERISTIC p_CarbPID0C_deltaEngineRPM_u8.CRB_OBD "" VALUE 0x1D090D STANDARD_VALUE_S8 0.0 ident 0 127 /end CHARACTERISTIC
/begin CHARACTERISTIC P_Card01PID01_MIL_b.CRB_OBD "" VALUE 0x1D090E STANDARD_VALUE_U8 0.0 ident 0 1 BIT_MASK 0x1 /end CHARACTERISTIC
/begin CHARACTERISTIC p_CcpByteOrder_u8.CCP_SHELL "" VALUE 0x1D08F5 STANDARD_VALUE_U8 0.0 enum_XCP_ByteOrder_e 0 1 /end CHARACTERISTIC
/begin CHARACTERISTIC p_CcpModComByteOrder_u8.CCP_SHELL "" VALUE 0x1D08F4 STANDARD_VALUE_U8 0.0 enum_XCP_ByteOrder_e 0 1 /end CHARACTERISTIC
/begin CHARACTERISTIC P_counter_1_delta.Counter_module_Mle "" VALUE 0x1D0900 STANDARD_VALUE_U8 0.0 ident 0 255 /end CHARACTERISTIC
/begin CHARACTERISTIC P_counter_1_updown.Counter_module_Mle "" VALUE 0x1D0901 STANDARD_VALUE_U8 0.0 enum_UPDOWN_ENUM 0 1 /end CHARACTERISTIC
/begin CHARACTERISTIC P_DetectDTCDuringDriveCycle_b.CRB_OBD "" VALUE 0x1D090C STANDARD_VALUE_U8 0.0 ident 0 1 BIT_MASK 0x1 /end CHARACTERISTIC
/begin CHARACTERISTIC P_EmissionRelatedDTCStored_b.CRB_OBD "" VALUE 0x1D090B STANDARD_VALUE_U8 0.0 ident 0 1 BIT_MASK 0x1 /end CHARACTERISTIC
/begin CHARACTERISTIC P_extended_on_off.CanDriver "" VALUE 0x1D08C7 STANDARD_VALUE_U8 0.0 ident 0 1 BIT_MASK 0x1 /end CHARACTERISTIC
/begin CHARACTERISTIC P_F32_1.Cal_Measure "" VALUE 0x1D00E0 STANDARD_VALUE_R32 0.0 ident -1.e+037 1.e+037 /end CHARACTERISTIC
/begin CHARACTERISTIC P_F32_2.Cal_Measure "" VALUE 0x1D00E4 STANDARD_VALUE_R32 0.0 ident -1.e+037 1.e+037 /end CHARACTERISTIC
/begin CHARACTERISTIC P_F64_1.Cal_Measure "" VALUE 0x1D00D0 STANDARD_VALUE_R64 0.0 ident -1.e+037 1.e+037 /end CHARACTERISTIC
/begin CHARACTERISTIC P_F64_2.Cal_Measure "" VALUE 0x1D00D8 STANDARD_VALUE_R64 0.0 ident -1.e+037 1.e+037 /end CHARACTERISTIC
/begin CHARACTERISTIC P_fast_on_off.CanDriver "" VALUE 0x1D08C8 STANDARD_VALUE_U8 0.0 ident 0 1 BIT_MASK 0x1 /end CHARACTERISTIC
/begin CHARACTERISTIC P_Fl32_array.Cal_Measure_Blocks "" VAL_BLK 0x1D0118 STANDARD_VALUE_R64 0.0 ident -1.e+037 1.e+037 MATRIX_DIM 6 1 1 DISPLAY_IDENTIFIER P_Fl32_array.Cal_Measure_Blocks_DISP_ID /end CHARACTERISTIC
/begin CHARACTERISTIC P_Fl32_matrix.Cal_Measure_Blocks "" VAL_BLK 0x1D0148 STANDARD_VALUE_R64 0.0 ident -1.e+037 1.e+037 MATRIX_DIM 5 6 1 DISPLAY_IDENTIFIER P_Fl32_matrix.Cal_Measure_Blocks_DISP_ID /end CHARACTERISTIC
/begin CHARACTERISTIC P_Fl64_array.Cal_Measure_Blocks "" VAL_BLK 0x1D0238 STANDARD_VALUE_R64 0.0 ident -1.e+037 1.e+037 MATRIX_DIM 6 1 1 DISPLAY_IDENTIFIER P_Fl64_array.Cal_Measure_Blocks_DISP_ID /end CHARACTERISTIC
/begin CHARACTERISTIC P_Fl64_matrix.Cal_Measure_Blocks "" VAL_BLK 0x1D0268 STANDARD_VALUE_R64 0.0 ident -1.e+037 1.e+037 MATRIX_DIM 5 6 1 DISPLAY_IDENTIFIER P_Fl64_matrix.Cal_Measure_Blocks_DISP_ID /end CHARACTERISTIC
/begin CHARACTERISTIC P_FreezeFrameDataStored_b.CRB_OBD "" VALUE 0x1D090F STANDARD_VALUE_U8 0.0 ident 0 1 BIT_MASK 0x1 /end CHARACTERISTIC
/begin CHARACTERISTIC p_MaxTxDTCinBlock_u8.CRB_OBD "" VALUE 0x1D090A STANDARD_VALUE_U8 0.0 ident 0 255 /end CHARACTERISTIC
/begin CHARACTERISTIC p_NumDTC_u16.CRB_OBD "" VALUE 0x1D0908 STANDARD_VALUE_U16 0.0 ident 0 65535 /end CHARACTERISTIC
/begin CHARACTERISTIC P_PageSwitch.CCP_Page "" VALUE 0x1c3A50 STANDARD_VALUE_U8 0.0 enum_CCP_Page_ENUM 0 2 /end CHARACTERISTIC
/begin CHARACTERISTIC P_Reset_CAN_Err_Counter.CanDriver "" VALUE 0x1D08CA STANDARD_VALUE_BIT 0.0 ident 0 1 BIT_MASK 0x80 /end CHARACTERISTIC
/begin CHARACTERISTIC P_reset_counter.Counter_module_Mle "" VALUE 0x1D0902 STANDARD_VALUE_U8 0.0 ident 0 1 BIT_MASK 0x1 /end CHARACTERISTIC
/begin CHARACTERISTIC p_ResetTimer_b.DAQ2_Sample.CCP_SHELL "" VALUE 0x1D08DC STANDARD_VALUE_U8 0.0 ident 0 1 BIT_MASK 0x1 /end CHARACTERISTIC
/begin CHARACTERISTIC p_ResetTimer_b.DAQ2_Tx.CCP_SHELL "" VALUE 0x1D08E8 STANDARD_VALUE_U8 0.0 ident 0 1 BIT_MASK 0x1 /end CHARACTERISTIC
/begin CHARACTERISTIC P_S16_1.Cal_Measure "" VALUE 0x1D00F8 STANDARD_VALUE_S16 0.0 ident -32768.0 32767.0 /end CHARACTERISTIC
/begin CHARACTERISTIC P_S16_2.Cal_Measure "" VALUE 0x1D00FA STANDARD_VALUE_S16 0.0 ident -32768.0 32767.0 /end CHARACTERISTIC
/begin CHARACTERISTIC P_S16_3.Cal_Measure "" VALUE 0x1D00FC STANDARD_VALUE_S16 0.0 ident -32768.0 32767.0 /end CHARACTERISTIC
/begin CHARACTERISTIC P_S32_1.Cal_Measure "" VALUE 0x1D00E8 STANDARD_VALUE_S32 0.0 ident -2147483648.0 2147483647.0 /end CHARACTERISTIC
/begin CHARACTERISTIC P_S32_2.Cal_Measure "" VALUE 0x1D00EC STANDARD_VALUE_S32 0.0 ident -2147483648.0 2147483647.0 /end CHARACTERISTIC
/begin CHARACTERISTIC P_S8_1.Cal_Measure "" VALUE 0x1D0104 STANDARD_VALUE_S8 0.0 ident -128.0 127.0 /end CHARACTERISTIC
/begin CHARACTERISTIC P_S8_2.Cal_Measure "" VALUE 0x1D0105 STANDARD_VALUE_S8 0.0 ident -128.0 127.0 /end CHARACTERISTIC
/begin CHARACTERISTIC P_S8_3.Cal_Measure "" VALUE 0x1D0106 STANDARD_VALUE_S8 0.0 ident -128.0 127.0 /end CHARACTERISTIC
/begin CHARACTERISTIC P_S8_4.Cal_Measure "" VALUE 0x1D0107 STANDARD_VALUE_S8 0.0 ident -128.0 127.0 /end CHARACTERISTIC
/begin CHARACTERISTIC p_SeramCheckParamRange_u8.CCP_Page "" VALUE 0x1D08CC STANDARD_VALUE_U8 0.0 ident 0 255 /end CHARACTERISTIC
/begin CHARACTERISTIC P_Sint16_array.Cal_Measure_Blocks "" VAL_BLK 0x1D0478 STANDARD_VALUE_S16 0.0 ident -32768.0 32767.0 MATRIX_DIM 6 1 1 DISPLAY_IDENTIFIER P_Sint16_array.Cal_Measure_Blocks_DISP_ID /end CHARACTERISTIC
/begin CHARACTERISTIC P_Sint16_matrix.Cal_Measure_Blocks "" VAL_BLK 0x1D0484 STANDARD_VALUE_S16 0.0 ident -32768.0 32767.0 MATRIX_DIM 5 6 1 DISPLAY_IDENTIFIER P_Sint16_matrix.Cal_Measure_Blocks_DISP_ID /end CHARACTERISTIC
/begin CHARACTERISTIC P_Sint32_array.Cal_Measure_Blocks "" VAL_BLK 0x1D0358 STANDARD_VALUE_S32 0.0 ident -2147483648.0 2147483647.0 MATRIX_DIM 6 1 1 DISPLAY_IDENTIFIER P_Sint32_array.Cal_Measure_Blocks_DISP_ID /end CHARACTERISTIC
/begin CHARACTERISTIC P_Sint32_matrix.Cal_Measure_Blocks "" VAL_BLK 0x1D0370 STANDARD_VALUE_S32 0.0 ident -2147483648.0 2147483647.0 MATRIX_DIM 5 6 1 DISPLAY_IDENTIFIER P_Sint32_matrix.Cal_Measure_Blocks_DISP_ID /end CHARACTERISTIC
/begin CHARACTERISTIC P_Sint8_array.Cal_Measure_Blocks "" VAL_BLK 0x1D0508 STANDARD_VALUE_S8 0.0 ident -128.0 127.0 MATRIX_DIM 6 1 1 DISPLAY_IDENTIFIER P_Sint8_array.Cal_Measure_Blocks_DISP_ID /end CHARACTERISTIC
/begin CHARACTERISTIC P_Sint8_matrix.Cal_Measure_Blocks "" VAL_BLK 0x1D050E STANDARD_VALUE_S8 0.0 ident -128.0 127.0 MATRIX_DIM 5 6 1 DISPLAY_IDENTIFIER P_Sint8_matrix.Cal_Measure_Blocks_DISP_ID /end CHARACTERISTIC
/begin CHARACTERISTIC P_standard_on_off.CanDriver "" VALUE 0x1D08C9 STANDARD_VALUE_U8 0.0 ident 0 1 BIT_MASK 0x1 /end CHARACTERISTIC
/begin CHARACTERISTIC p_TableDTC_u16.CRB_OBD "" VAL_BLK 0x1D0912 STANDARD_VALUE_U16 0.0 ident 0 65535 MATRIX_DIM 127 1 1 /end CHARACTERISTIC
/begin CHARACTERISTIC P_U16_1.Cal_Measure "" VALUE 0x1D00FE STANDARD_VALUE_U16 0.0 ident 0.0 65535.0 /end CHARACTERISTIC
/begin CHARACTERISTIC P_U16_2.Cal_Measure "" VALUE 0x1D0100 STANDARD_VALUE_U16 0.0 ident 0.0 65535.0 /end CHARACTERISTIC
/begin CHARACTERISTIC P_U16_3.Cal_Measure "" VALUE 0x1D0102 STANDARD_VALUE_U16 0.0 ident 0.0 65535.0 /end CHARACTERISTIC
/begin CHARACTERISTIC P_U32_1.Cal_Measure "" VALUE 0x1D00F0 STANDARD_VALUE_U32 0.0 ident 0.0 4294967295.0 /end CHARACTERISTIC
/begin CHARACTERISTIC P_U32_2.Cal_Measure "" VALUE 0x1D00F4 STANDARD_VALUE_U32 0.0 ident 0.0 4294967295.0 /end CHARACTERISTIC
/begin CHARACTERISTIC P_U8_1.Cal_Measure "" VALUE 0x1D0108 STANDARD_VALUE_U8 0.0 ident 0.0 255.0 /end CHARACTERISTIC
/begin CHARACTERISTIC P_U8_2.Cal_Measure "" VALUE 0x1D0109 STANDARD_VALUE_U8 0.0 ident 0.0 255.0 /end CHARACTERISTIC
/begin CHARACTERISTIC P_U8_3.Cal_Measure "" VALUE 0x1D010A STANDARD_VALUE_U8 0.0 ident 0.0 255.0 /end CHARACTERISTIC
/begin CHARACTERISTIC P_U8_4.Cal_Measure "" VALUE 0x1D010B STANDARD_VALUE_U8 0.0 ident 0.0 255.0 /end CHARACTERISTIC
/begin CHARACTERISTIC P_Uint16_array.Cal_Measure_Blocks "" VAL_BLK 0x1D04C0 STANDARD_VALUE_U16 0.0 ident 0.0 65535.0 MATRIX_DIM 6 1 1 DISPLAY_IDENTIFIER P_Uint16_array.Cal_Measure_Blocks_DISP_ID /end CHARACTERISTIC
/begin CHARACTERISTIC P_Uint16_matrix.Cal_Measure_Blocks "" VAL_BLK 0x1D04CC STANDARD_VALUE_U16 0.0 ident 0.0 65535.0 MATRIX_DIM 5 6 1 DISPLAY_IDENTIFIER P_Uint16_matrix.Cal_Measure_Blocks_DISP_ID /end CHARACTERISTIC
/begin CHARACTERISTIC P_Uint32_array.Cal_Measure_Blocks "" VAL_BLK 0x1D03E8 STANDARD_VALUE_U32 0.0 ident 0.0 4294967295.0 MATRIX_DIM 6 1 1 DISPLAY_IDENTIFIER P_Uint32_array.Cal_Measure_Blocks_DISP_ID /end CHARACTERISTIC
/begin CHARACTERISTIC P_Uint32_matrix.Cal_Measure_Blocks "" VAL_BLK 0x1D0400 STANDARD_VALUE_U32 0.0 ident 0.0 4294967295.0 MATRIX_DIM 5 6 1 DISPLAY_IDENTIFIER P_Uint32_matrix.Cal_Measure_Blocks_DISP_ID /end CHARACTERISTIC
/begin CHARACTERISTIC P_Uint8_array.Cal_Measure_Blocks "" VAL_BLK 0x1D052C STANDARD_VALUE_U8 0.0 ident 0.0 255.0 MATRIX_DIM 6 1 1 DISPLAY_IDENTIFIER P_Uint8_array.Cal_Measure_Blocks_DISP_ID /end CHARACTERISTIC
/begin CHARACTERISTIC P_Uint8_matrix.Cal_Measure_Blocks "" VAL_BLK 0x1D0532 STANDARD_VALUE_U8 0.0 ident 0.0 255.0 MATRIX_DIM 5 6 1 DISPLAY_IDENTIFIER P_Uint8_matrix.Cal_Measure_Blocks_DISP_ID /end CHARACTERISTIC
/begin CHARACTERISTIC p_UpdateBitTest_b.Bit_Test "" VALUE 0x1D0098 STANDARD_VALUE_U8 0.0 ident 0 1 BIT_MASK 0x1 /end CHARACTERISTIC
/begin CHARACTERISTIC pi_ActBdRate_u32.C_ClassDiagInfo.UDS_ISO14229 "" VALUE 0x1D00A4 STANDARD_VALUE_U32 0.0 ident 0 4294967295 /end CHARACTERISTIC
/begin CHARACTERISTIC pi_ComMedium_u8.C_ClassDiagInfo.UDS_ISO14229 "" VALUE 0x1D00C0 STANDARD_VALUE_U8 0.0 ident 0 255 /end CHARACTERISTIC
/begin CHARACTERISTIC pi_ComProtocol_u8.C_ClassDiagInfo.UDS_ISO14229 "" VALUE 0x1D00C1 STANDARD_VALUE_U8 0.0 ident 0 255 /end CHARACTERISTIC
/begin CHARACTERISTIC pi_DiaMode_u8.C_ClassDiagInfo.UDS_ISO14229 "" VALUE 0x1D00C2 STANDARD_VALUE_U8 0.0 ident 0 255 /end CHARACTERISTIC
/begin CHARACTERISTIC pi_P2max_u32.C_ClassDiagInfo.UDS_ISO14229 "" VALUE 0x1D00A8 STANDARD_VALUE_U32 0.0 ident 0 4294967295 /end CHARACTERISTIC
/begin CHARACTERISTIC pi_P2min_u32.C_ClassDiagInfo.UDS_ISO14229 "" VALUE 0x1D00AC STANDARD_VALUE_U32 0.0 ident 0 4294967295 /end CHARACTERISTIC
/begin CHARACTERISTIC pi_P3max_u32.C_ClassDiagInfo.UDS_ISO14229 "" VALUE 0x1D00B0 STANDARD_VALUE_U32 0.0 ident 0 4294967295 /end CHARACTERISTIC
/begin CHARACTERISTIC pi_P3min_u32.C_ClassDiagInfo.UDS_ISO14229 "" VALUE 0x1D00B4 STANDARD_VALUE_U32 0.0 ident 0 4294967295 /end CHARACTERISTIC
/begin CHARACTERISTIC pi_P4min_u32.C_ClassDiagInfo.UDS_ISO14229 "" VALUE 0x1D00B8 STANDARD_VALUE_U32 0.0 ident 0 4294967295 /end CHARACTERISTIC
/begin CHARACTERISTIC pi_PhysEcuAddr_u8.C_ClassDiagInfo.UDS_ISO14229 "" VALUE 0x1D00C3 STANDARD_VALUE_U8 0.0 ident 0 255 /end CHARACTERISTIC
/begin CHARACTERISTIC pi_ReqBdRate_u32.C_ClassDiagInfo.UDS_ISO14229 "" VALUE 0x1D00BC STANDARD_VALUE_U32 0.0 ident 0 4294967295 /end CHARACTERISTIC
/begin CHARACTERISTIC pi_SecLevel_u8.C_ClassDiagInfo.UDS_ISO14229 "" VALUE 0x1D00C4 STANDARD_VALUE_U8 0.0 ident 0 255 /end CHARACTERISTIC
/begin CHARACTERISTIC pi_StimuAddr_u8.C_ClassDiagInfo.UDS_ISO14229 "" VALUE 0x1D00C6 STANDARD_VALUE_U8 0.0 ident 0 255 /end CHARACTERISTIC
/begin CHARACTERISTIC pi_StimuAddrMode_u8.C_ClassDiagInfo.UDS_ISO14229 "" VALUE 0x1D00C5 STANDARD_VALUE_U8 0.0 ident 0 255 /end CHARACTERISTIC
/begin MEASUREMENT B13_Mode.CanDriver "" UBYTE ident 1 100 0.0 255.0 ECU_ADDRESS 0x821570 /end MEASUREMENT
/begin MEASUREMENT B17_Mode.CanDriver "" UBYTE ident 1 100 0.0 255.0 ECU_ADDRESS 0x821571 /end MEASUREMENT
/begin MEASUREMENT B2_Mode.CanDriver "" UBYTE ident 1 100 0.0 255.0 ECU_ADDRESS 0x821576 /end MEASUREMENT
/begin MEASUREMENT B23_Mode.CanDriver "" UBYTE ident 1 100 0.0 255.0 ECU_ADDRESS 0x821572 /end MEASUREMENT
/begin MEASUREMENT B25_Mode.CanDriver "" UBYTE ident 1 100 0.0 255.0 ECU_ADDRESS 0x821573 /end MEASUREMENT
/begin MEASUREMENT B27_Mode.CanDriver "" UBYTE ident 1 100 0.0 255.0 ECU_ADDRESS 0x821574 /end MEASUREMENT
/begin MEASUREMENT B29_Mode.CanDriver "" UBYTE ident 1 100 0.0 255.0 ECU_ADDRESS 0x821575 /end MEASUREMENT
/begin MEASUREMENT B35_Mode.CanDriver "" UBYTE ident 1 100 0.0 255.0 ECU_ADDRESS 0x821577 /end MEASUREMENT
/begin MEASUREMENT B38_Mode.CanDriver "" UBYTE ident 1 100 0.0 255.0 ECU_ADDRESS 0x821578 /end MEASUREMENT
/begin MEASUREMENT B5_Mode.CanDriver "" UBYTE ident 1 100 0.0 255.0 ECU_ADDRESS 0x82157A /end MEASUREMENT
/begin MEASUREMENT B56_Mode.CanDriver "" UBYTE ident 1 100 0.0 255.0 ECU_ADDRESS 0x821579 /end MEASUREMENT
/begin MEASUREMENT B9_Mode.CanDriver "" UBYTE ident 1 100 0.0 255.0 ECU_ADDRESS 0x82157B /end MEASUREMENT
/begin MEASUREMENT Bit_Sint16.P_Bit.Bit_Test "" SWORD ident 1 100 -32768 32767 ECU_ADDRESS 0x7FAFBC /end MEASUREMENT
/begin MEASUREMENT Bit_Sint16_Bit_x.Extern_MEM.Bit_Test "" SWORD ident 1 100 -32768 32767 ECU_ADDRESS 0x82112C DISPLAY_IDENTIFIER Bit_Sint16_Bit_x.Extern_MEM.Bit_Test_DISP_ID /end MEASUREMENT
/begin MEASUREMENT Bit_Sint16_Bit_00.Extern_MEM.Bit_Test "" SWORD ident 1 100 -32768 32767 ECU_ADDRESS 0x82112C BIT_MASK 0x0001 DISPLAY_IDENTIFIER Bit_Sint16_Bit_00.Extern_MEM.Bit_Test_DISP_ID /end MEASUREMENT
/begin MEASUREMENT Bit_Sint16_Bit_01.Extern_MEM.Bit_Test "" SWORD ident 1 100 -32768 32767 ECU_ADDRESS 0x82112C BIT_MASK 0x0002 DISPLAY_IDENTIFIER Bit_Sint16_Bit_01.Extern_MEM.Bit_Test_DISP_ID /end MEASUREMENT
/begin MEASUREMENT Bit_Sint16_Bit_02.Extern_MEM.Bit_Test "" SWORD ident 1 100 -32768 32767 ECU_ADDRESS 0x82112C BIT_MASK 0x0004 DISPLAY_IDENTIFIER Bit_Sint16_Bit_02.Extern_MEM.Bit_Test_DISP_ID /end MEASUREMENT
/begin MEASUREMENT Bit_Sint16_Bit_03.Extern_MEM.Bit_Test "" SWORD ident 1 100 -32768 32767 ECU_ADDRESS 0x82112C BIT_MASK 0x0008 DISPLAY_IDENTIFIER Bit_Sint16_Bit_03.Extern_MEM.Bit_Test_DISP_ID /end MEASUREMENT
/begin MEASUREMENT Bit_Sint16_Bit_04.Extern_MEM.Bit_Test "" SWORD ident 1 100 -32768 32767 ECU_ADDRESS 0x82112C BIT_MASK 0x0010 DISPLAY_IDENTIFIER Bit_Sint16_Bit_04.Extern_MEM.Bit_Test_DISP_ID /end MEASUREMENT
/begin MEASUREMENT Bit_Sint16_Bit_05.Extern_MEM.Bit_Test "" SWORD ident 1 100 -32768 32767 ECU_ADDRESS 0x82112C BIT_MASK 0x0020 DISPLAY_IDENTIFIER Bit_Sint16_Bit_05.Extern_MEM.Bit_Test_DISP_ID /end MEASUREMENT
/begin MEASUREMENT Bit_Sint16_Bit_06.Extern_MEM.Bit_Test "" SWORD ident 1 100 -32768 32767 ECU_ADDRESS 0x82112C BIT_MASK 0x0040 DISPLAY_IDENTIFIER Bit_Sint16_Bit_06.Extern_MEM.Bit_Test_DISP_ID /end MEASUREMENT
/begin MEASUREMENT Bit_Sint16_Bit_07.Extern_MEM.Bit_Test "" SWORD ident 1 100 -32768 32767 ECU_ADDRESS 0x82112C BIT_MASK 0x0080 DISPLAY_IDENTIFIER Bit_Sint16_Bit_07.Extern_MEM.Bit_Test_DISP_ID /end MEASUREMENT
/begin MEASUREMENT Bit_Sint16_Bit_08.Extern_MEM.Bit_Test "" SWORD ident 1 100 -32768 32767 ECU_ADDRESS 0x82112C BIT_MASK 0x0100 DISPLAY_IDENTIFIER Bit_Sint16_Bit_08.Extern_MEM.Bit_Test_DISP_ID /end MEASUREMENT
/begin MEASUREMENT Bit_Sint16_Bit_09.Extern_MEM.Bit_Test "" SWORD ident 1 100 -32768 32767 ECU_ADDRESS 0x82112C BIT_MASK 0x0200 DISPLAY_IDENTIFIER Bit_Sint16_Bit_09.Extern_MEM.Bit_Test_DISP_ID /end MEASUREMENT
/begin MEASUREMENT Bit_Sint16_Bit_10.Extern_MEM.Bit_Test "" SWORD ident 1 100 -32768 32767 ECU_ADDRESS 0x82112C BIT_MASK 0x0400 DISPLAY_IDENTIFIER Bit_Sint16_Bit_10.Extern_MEM.Bit_Test_DISP_ID /end MEASUREMENT
/begin MEASUREMENT Bit_Sint16_Bit_11.Extern_MEM.Bit_Test "" SWORD ident 1 100 -32768 32767 ECU_ADDRESS 0x82112C BIT_MASK 0x0800 DISPLAY_IDENTIFIER Bit_Sint16_Bit_11.Extern_MEM.Bit_Test_DISP_ID /end MEASUREMENT
/begin MEASUREMENT Bit_Sint16_Bit_12.Extern_MEM.Bit_Test "" SWORD ident 1 100 -32768 32767 ECU_ADDRESS 0x82112C BIT_MASK 0x1000 DISPLAY_IDENTIFIER Bit_Sint16_Bit_12.Extern_MEM.Bit_Test_DISP_ID /end MEASUREMENT
/begin MEASUREMENT Bit_Sint16_Bit_13.Extern_MEM.Bit_Test "" SWORD ident 1 100 -32768 32767 ECU_ADDRESS 0x82112C BIT_MASK 0x2000 DISPLAY_IDENTIFIER Bit_Sint16_Bit_13.Extern_MEM.Bit_Test_DISP_ID /end MEASUREMENT
/begin MEASUREMENT Bit_Sint16_Bit_14.Extern_MEM.Bit_Test "" SWORD ident 1 100 -32768 32767 ECU_ADDRESS 0x82112C BIT_MASK 0x4000 DISPLAY_IDENTIFIER Bit_Sint16_Bit_14.Extern_MEM.Bit_Test_DISP_ID /end MEASUREMENT
/begin MEASUREMENT Bit_Sint16_Bit_15.Extern_MEM.Bit_Test "" SWORD ident 1 100 -32768 32767 ECU_ADDRESS 0x82112C BIT_MASK 0x8000 DISPLAY_IDENTIFIER Bit_Sint16_Bit_15.Extern_MEM.Bit_Test_DISP_ID /end MEASUREMENT
/begin MEASUREMENT Bit_Sint16_Bit_x.Intern_MEM.Bit_Test "" SWORD ident 1 100 -32768 32767 ECU_ADDRESS 0x7FAFCC /end MEASUREMENT
/begin MEASUREMENT Bit_Sint16_Bit_00.Intern_MEM.Bit_Test "" SWORD ident 1 100 -32768 32767 ECU_ADDRESS 0x7FAFCC BIT_MASK 0x0001 /end MEASUREMENT
/begin MEASUREMENT Bit_Sint16_Bit_01.Intern_MEM.Bit_Test "" SWORD ident 1 100 -32768 32767 ECU_ADDRESS 0x7FAFCC BIT_MASK 0x0002 /end MEASUREMENT
/begin MEASUREMENT Bit_Sint16_Bit_02.Intern_MEM.Bit_Test "" SWORD ident 1 100 -32768 32767 ECU_ADDRESS 0x7FAFCC BIT_MASK 0x0004 /end MEASUREMENT
/begin MEASUREMENT Bit_Sint16_Bit_03.Intern_MEM.Bit_Test "" SWORD ident 1 100 -32768 32767 ECU_ADDRESS 0x7FAFCC BIT_MASK 0x0008 /end MEASUREMENT
/begin MEASUREMENT Bit_Sint16_Bit_04.Intern_MEM.Bit_Test "" SWORD ident 1 100 -32768 32767 ECU_ADDRESS 0x7FAFCC BIT_MASK 0x0010 /end MEASUREMENT
/begin MEASUREMENT Bit_Sint16_Bit_05.Intern_MEM.Bit_Test "" SWORD ident 1 100 -32768 32767 ECU_ADDRESS 0x7FAFCC BIT_MASK 0x0020 /end MEASUREMENT
/begin MEASUREMENT Bit_Sint16_Bit_06.Intern_MEM.Bit_Test "" SWORD ident 1 100 -32768 32767 ECU_ADDRESS 0x7FAFCC BIT_MASK 0x0040 /end MEASUREMENT
/begin MEASUREMENT Bit_Sint16_Bit_07.Intern_MEM.Bit_Test "" SWORD ident 1 100 -32768 32767 ECU_ADDRESS 0x7FAFCC BIT_MASK 0x0080 /end MEASUREMENT
/begin MEASUREMENT Bit_Sint16_Bit_08.Intern_MEM.Bit_Test "" SWORD ident 1 100 -32768 32767 ECU_ADDRESS 0x7FAFCC BIT_MASK 0x0100 /end MEASUREMENT
/begin MEASUREMENT Bit_Sint16_Bit_09.Intern_MEM.Bit_Test "" SWORD ident 1 100 -32768 32767 ECU_ADDRESS 0x7FAFCC BIT_MASK 0x0200 /end MEASUREMENT
/begin MEASUREMENT Bit_Sint16_Bit_10.Intern_MEM.Bit_Test "" SWORD ident 1 100 -32768 32767 ECU_ADDRESS 0x7FAFCC BIT_MASK 0x0400 /end MEASUREMENT
/begin MEASUREMENT Bit_Sint16_Bit_11.Intern_MEM.Bit_Test "" SWORD ident 1 100 -32768 32767 ECU_ADDRESS 0x7FAFCC BIT_MASK 0x0800 /end MEASUREMENT
/begin MEASUREMENT Bit_Sint16_Bit_12.Intern_MEM.Bit_Test "" SWORD ident 1 100 -32768 32767 ECU_ADDRESS 0x7FAFCC BIT_MASK 0x1000 /end MEASUREMENT
/begin MEASUREMENT Bit_Sint16_Bit_13.Intern_MEM.Bit_Test "" SWORD ident 1 100 -32768 32767 ECU_ADDRESS 0x7FAFCC BIT_MASK 0x2000 /end MEASUREMENT
/begin MEASUREMENT Bit_Sint16_Bit_14.Intern_MEM.Bit_Test "" SWORD ident 1 100 -32768 32767 ECU_ADDRESS 0x7FAFCC BIT_MASK 0x4000 /end MEASUREMENT
/begin MEASUREMENT Bit_Sint16_Bit_15.Intern_MEM.Bit_Test "" SWORD ident 1 100 -32768 32767 ECU_ADDRESS 0x7FAFCC BIT_MASK 0x8000 /end MEASUREMENT
/begin MEASUREMENT Bit_Sint32.P_Bit.Bit_Test "" SLONG ident 1 100 -2147483648 2147483647 ECU_ADDRESS 0x7FAFB4 /end MEASUREMENT
/begin MEASUREMENT Bit_Sint32_Bit_x.Extern_MEM.Bit_Test "" SLONG ident 1 100 -2147483648 2147483647 ECU_ADDRESS 0x821124 /end MEASUREMENT
/begin MEASUREMENT Bit_Sint32_Bit_00.Extern_MEM.Bit_Test "" SLONG ident 1 100 -2147483648 2147483647 ECU_ADDRESS 0x821124 BIT_MASK 0x00000001 /end MEASUREMENT
/begin MEASUREMENT Bit_Sint32_Bit_01.Extern_MEM.Bit_Test "" SLONG ident 1 100 -2147483648 2147483647 ECU_ADDRESS 0x821124 BIT_MASK 0x00000002 /end MEASUREMENT
/begin MEASUREMENT Bit_Sint32_Bit_02.Extern_MEM.Bit_Test "" SLONG ident 1 100 -2147483648 2147483647 ECU_ADDRESS 0x821124 BIT_MASK 0x00000004 /end MEASUREMENT
/begin MEASUREMENT Bit_Sint32_Bit_03.Extern_MEM.Bit_Test "" SLONG ident 1 100 -2147483648 2147483647 ECU_ADDRESS 0x821124 BIT_MASK 0x00000008 /end MEASUREMENT
/begin MEASUREMENT Bit_Sint32_Bit_04.Extern_MEM.Bit_Test "" SLONG ident 1 100 -2147483648 2147483647 ECU_ADDRESS 0x821124 BIT_MASK 0x00000010 /end MEASUREMENT
/begin MEASUREMENT Bit_Sint32_Bit_05.Extern_MEM.Bit_Test "" SLONG ident 1 100 -2147483648 2147483647 ECU_ADDRESS 0x821124 BIT_MASK 0x00000020 /end MEASUREMENT
/begin MEASUREMENT Bit_Sint32_Bit_06.Extern_MEM.Bit_Test "" SLONG ident 1 100 -2147483648 2147483647 ECU_ADDRESS 0x821124 BIT_MASK 0x00000040 /end MEASUREMENT
/begin MEASUREMENT Bit_Sint32_Bit_07.Extern_MEM.Bit_Test "" SLONG ident 1 100 -2147483648 2147483647 ECU_ADDRESS 0x821124 BIT_MASK 0x00000080 /end MEASUREMENT
/begin MEASUREMENT Bit_Sint32_Bit_08.Extern_MEM.Bit_Test "" SLONG ident 1 100 -2147483648 2147483647 ECU_ADDRESS 0x821124 BIT_MASK 0x00000100 /end MEASUREMENT
/begin MEASUREMENT Bit_Sint32_Bit_09.Extern_MEM.Bit_Test "" SLONG ident 1 100 -2147483648 2147483647 ECU_ADDRESS 0x821124 BIT_MASK 0x00000200 /end MEASUREMENT
/begin MEASUREMENT Bit_Sint32_Bit_10.Extern_MEM.Bit_Test "" SLONG ident 1 100 -2147483648 2147483647 ECU_ADDRESS 0x821124 BIT_MASK 0x00000400 /end MEASUREMENT
/begin MEASUREMENT Bit_Sint32_Bit_11.Extern_MEM.Bit_Test "" SLONG ident 1 100 -2147483648 2147483647 ECU_ADDRESS 0x821124 BIT_MASK 0x00000800 /end MEASUREMENT
/begin MEASUREMENT Bit_Sint32_Bit_12.Extern_MEM.Bit_Test "" SLONG ident 1 100 -2147483648 2147483647 ECU_ADDRESS 0x821124 BIT_MASK 0x00001000 /end MEASUREMENT
/begin MEASUREMENT Bit_Sint32_Bit_13.Extern_MEM.Bit_Test "" SLONG ident 1 100 -2147483648 2147483647 ECU_ADDRESS 0x821124 BIT_MASK 0x00002000 /end MEASUREMENT
/begin MEASUREMENT Bit_Sint32_Bit_14.Extern_MEM.Bit_Test "" SLONG ident 1 100 -2147483648 2147483647 ECU_ADDRESS 0x821124 BIT_MASK 0x00004000 /end MEASUREMENT
/begin MEASUREMENT Bit_Sint32_Bit_15.Extern_MEM.Bit_Test "" SLONG ident 1 100 -2147483648 2147483647 ECU_ADDRESS 0x821124 BIT_MASK 0x00008000 /end MEASUREMENT
/begin MEASUREMENT Bit_Sint32_Bit_16.Extern_MEM.Bit_Test "" SLONG ident 1 100 -2147483648 2147483647 ECU_ADDRESS 0x821124 BIT_MASK 0x00010000 /end MEASUREMENT
/begin MEASUREMENT Bit_Sint32_Bit_17.Extern_MEM.Bit_Test "" SLONG ident 1 100 -2147483648 2147483647 ECU_ADDRESS 0x821124 BIT_MASK 0x00020000 /end MEASUREMENT
/begin MEASUREMENT Bit_Sint32_Bit_18.Extern_MEM.Bit_Test "" SLONG ident 1 100 -2147483648 2147483647 ECU_ADDRESS 0x821124 BIT_MASK 0x00040000 /end MEASUREMENT
/begin MEASUREMENT Bit_Sint32_Bit_19.Extern_MEM.Bit_Test "" SLONG ident 1 100 -2147483648 2147483647 ECU_ADDRESS 0x821124 BIT_MASK 0x00080000 /end MEASUREMENT
/begin MEASUREMENT Bit_Sint32_Bit_20.Extern_MEM.Bit_Test "" SLONG ident 1 100 -2147483648 2147483647 ECU_ADDRESS 0x821124 BIT_MASK 0x00100000 /end MEASUREMENT
/begin MEASUREMENT Bit_Sint32_Bit_21.Extern_MEM.Bit_Test "" SLONG ident 1 100 -2147483648 2147483647 ECU_ADDRESS 0x821124 BIT_MASK 0x00200000 /end MEASUREMENT
/begin MEASUREMENT Bit_Sint32_Bit_22.Extern_MEM.Bit_Test "" SLONG ident 1 100 -2147483648 2147483647 ECU_ADDRESS 0x821124 BIT_MASK 0x00400000 /end MEASUREMENT
/begin MEASUREMENT Bit_Sint32_Bit_23.Extern_MEM.Bit_Test "" SLONG ident 1 100 -2147483648 2147483647 ECU_ADDRESS 0x821124 BIT_MASK 0x00800000 /end MEASUREMENT
/begin MEASUREMENT Bit_Sint32_Bit_24.Extern_MEM.Bit_Test "" SLONG ident 1 100 -2147483648 2147483647 ECU_ADDRESS 0x821124 BIT_MASK 0x01000000 /end MEASUREMENT
/begin MEASUREMENT Bit_Sint32_Bit_25.Extern_MEM.Bit_Test "" SLONG ident 1 100 -2147483648 2147483647 ECU_ADDRESS 0x821124 BIT_MASK 0x02000000 /end MEASUREMENT
/begin MEASUREMENT Bit_Sint32_Bit_26.Extern_MEM.Bit_Test "" SLONG ident 1 100 -2147483648 2147483647 ECU_ADDRESS 0x821124 BIT_MASK 0x04000000 /end MEASUREMENT
/begin MEASUREMENT Bit_Sint32_Bit_27.Extern_MEM.Bit_Test "" SLONG ident 1 100 -2147483648 2147483647 ECU_ADDRESS 0x821124 BIT_MASK 0x08000000 /end MEASUREMENT
/begin MEASUREMENT Bit_Sint32_Bit_28.Extern_MEM.Bit_Test "" SLONG ident 1 100 -2147483648 2147483647 ECU_ADDRESS 0x821124 BIT_MASK 0x10000000 /end MEASUREMENT
/begin MEASUREMENT Bit_Sint32_Bit_29.Extern_MEM.Bit_Test "" SLONG ident 1 100 -2147483648 2147483647 ECU_ADDRESS 0x821124 BIT_MASK 0x20000000 /end MEASUREMENT
/begin MEASUREMENT Bit_Sint32_Bit_30.Extern_MEM.Bit_Test "" SLONG ident 1 100 -2147483648 2147483647 ECU_ADDRESS 0x821124 BIT_MASK 0x40000000 /end MEASUREMENT
/begin MEASUREMENT Bit_Sint32_Bit_31.Extern_MEM.Bit_Test "" SLONG ident 1 100 -2147483648 2147483647 ECU_ADDRESS 0x821124 BIT_MASK 0x80000000 /end MEASUREMENT
/begin MEASUREMENT Bit_Sint32_Bit_x.Intern_MEM.Bit_Test "" SLONG ident 1 100 -2147483648 2147483647 ECU_ADDRESS 0x7FAFC4 /end MEASUREMENT
/begin MEASUREMENT Bit_Sint32_Bit_00.Intern_MEM.Bit_Test "" SLONG ident 1 100 -2147483648 2147483647 ECU_ADDRESS 0x7FAFC4 BIT_MASK 0x00000001 /end MEASUREMENT
/begin MEASUREMENT Bit_Sint32_Bit_01.Intern_MEM.Bit_Test "" SLONG ident 1 100 -2147483648 2147483647 ECU_ADDRESS 0x7FAFC4 BIT_MASK 0x00000002 /end MEASUREMENT
/begin MEASUREMENT Bit_Sint32_Bit_02.Intern_MEM.Bit_Test "" SLONG ident 1 100 -2147483648 2147483647 ECU_ADDRESS 0x7FAFC4 BIT_MASK 0x00000004 /end MEASUREMENT
/begin MEASUREMENT Bit_Sint32_Bit_03.Intern_MEM.Bit_Test "" SLONG ident 1 100 -2147483648 2147483647 ECU_ADDRESS 0x7FAFC4 BIT_MASK 0x00000008 /end MEASUREMENT
/begin MEASUREMENT Bit_Sint32_Bit_04.Intern_MEM.Bit_Test "" SLONG ident 1 100 -2147483648 2147483647 ECU_ADDRESS 0x7FAFC4 BIT_MASK 0x00000010 /end MEASUREMENT
/begin MEASUREMENT Bit_Sint32_Bit_05.Intern_MEM.Bit_Test "" SLONG ident 1 100 -2147483648 2147483647 ECU_ADDRESS 0x7FAFC4 BIT_MASK 0x00000020 /end MEASUREMENT
/begin MEASUREMENT Bit_Sint32_Bit_06.Intern_MEM.Bit_Test "" SLONG ident 1 100 -2147483648 2147483647 ECU_ADDRESS 0x7FAFC4 BIT_MASK 0x00000040 /end MEASUREMENT
/begin MEASUREMENT Bit_Sint32_Bit_07.Intern_MEM.Bit_Test "" SLONG ident 1 100 -2147483648 2147483647 ECU_ADDRESS 0x7FAFC4 BIT_MASK 0x00000080 /end MEASUREMENT
/begin MEASUREMENT Bit_Sint32_Bit_08.Intern_MEM.Bit_Test "" SLONG ident 1 100 -2147483648 2147483647 ECU_ADDRESS 0x7FAFC4 BIT_MASK 0x00000100 /end MEASUREMENT
/begin MEASUREMENT Bit_Sint32_Bit_09.Intern_MEM.Bit_Test "" SLONG ident 1 100 -2147483648 2147483647 ECU_ADDRESS 0x7FAFC4 BIT_MASK 0x00000200 /end MEASUREMENT
/begin MEASUREMENT Bit_Sint32_Bit_10.Intern_MEM.Bit_Test "" SLONG ident 1 100 -2147483648 2147483647 ECU_ADDRESS 0x7FAFC4 BIT_MASK 0x00000400 /end MEASUREMENT
/begin MEASUREMENT Bit_Sint32_Bit_11.Intern_MEM.Bit_Test "" SLONG ident 1 100 -2147483648 2147483647 ECU_ADDRESS 0x7FAFC4 BIT_MASK 0x00000800 /end MEASUREMENT
/begin MEASUREMENT Bit_Sint32_Bit_12.Intern_MEM.Bit_Test "" SLONG ident 1 100 -2147483648 2147483647 ECU_ADDRESS 0x7FAFC4 BIT_MASK 0x00001000 /end MEASUREMENT
/begin MEASUREMENT Bit_Sint32_Bit_13.Intern_MEM.Bit_Test "" SLONG ident 1 100 -2147483648 2147483647 ECU_ADDRESS 0x7FAFC4 BIT_MASK 0x00002000 /end MEASUREMENT
/begin MEASUREMENT Bit_Sint32_Bit_14.Intern_MEM.Bit_Test "" SLONG ident 1 100 -2147483648 2147483647 ECU_ADDRESS 0x7FAFC4 BIT_MASK 0x00004000 /end MEASUREMENT
/begin MEASUREMENT Bit_Sint32_Bit_15.Intern_MEM.Bit_Test "" SLONG ident 1 100 -2147483648 2147483647 ECU_ADDRESS 0x7FAFC4 BIT_MASK 0x00008000 /end MEASUREMENT
/begin MEASUREMENT Bit_Sint32_Bit_16.Intern_MEM.Bit_Test "" SLONG ident 1 100 -2147483648 2147483647 ECU_ADDRESS 0x7FAFC4 BIT_MASK 0x00010000 /end MEASUREMENT
/begin MEASUREMENT Bit_Sint32_Bit_17.Intern_MEM.Bit_Test "" SLONG ident 1 100 -2147483648 2147483647 ECU_ADDRESS 0x7FAFC4 BIT_MASK 0x00020000 /end MEASUREMENT
/begin MEASUREMENT Bit_Sint32_Bit_18.Intern_MEM.Bit_Test "" SLONG ident 1 100 -2147483648 2147483647 ECU_ADDRESS 0x7FAFC4 BIT_MASK 0x00040000 /end MEASUREMENT
/begin MEASUREMENT Bit_Sint32_Bit_19.Intern_MEM.Bit_Test "" SLONG ident 1 100 -2147483648 2147483647 ECU_ADDRESS 0x7FAFC4 BIT_MASK 0x00080000 /end MEASUREMENT
/begin MEASUREMENT Bit_Sint32_Bit_20.Intern_MEM.Bit_Test "" SLONG ident 1 100 -2147483648 2147483647 ECU_ADDRESS 0x7FAFC4 BIT_MASK 0x00100000 /end MEASUREMENT
/begin MEASUREMENT Bit_Sint32_Bit_21.Intern_MEM.Bit_Test "" SLONG ident 1 100 -2147483648 2147483647 ECU_ADDRESS 0x7FAFC4 BIT_MASK 0x00200000 /end MEASUREMENT
/begin MEASUREMENT Bit_Sint32_Bit_22.Intern_MEM.Bit_Test "" SLONG ident 1 100 -2147483648 2147483647 ECU_ADDRESS 0x7FAFC4 BIT_MASK 0x00400000 /end MEASUREMENT
/begin MEASUREMENT Bit_Sint32_Bit_23.Intern_MEM.Bit_Test "" SLONG ident 1 100 -2147483648 2147483647 ECU_ADDRESS 0x7FAFC4 BIT_MASK 0x00800000 /end MEASUREMENT
/begin MEASUREMENT Bit_Sint32_Bit_24.Intern_MEM.Bit_Test "" SLONG ident 1 100 -2147483648 2147483647 ECU_ADDRESS 0x7FAFC4 BIT_MASK 0x01000000 /end MEASUREMENT
/begin MEASUREMENT Bit_Sint32_Bit_25.Intern_MEM.Bit_Test "" SLONG ident 1 100 -2147483648 2147483647 ECU_ADDRESS 0x7FAFC4 BIT_MASK 0x02000000 /end MEASUREMENT
/begin MEASUREMENT Bit_Sint32_Bit_26.Intern_MEM.Bit_Test "" SLONG ident 1 100 -2147483648 2147483647 ECU_ADDRESS 0x7FAFC4 BIT_MASK 0x04000000 /end MEASUREMENT
/begin MEASUREMENT Bit_Sint32_Bit_27.Intern_MEM.Bit_Test "" SLONG ident 1 100 -2147483648 2147483647 ECU_ADDRESS 0x7FAFC4 BIT_MASK 0x08000000 /end MEASUREMENT
/begin MEASUREMENT Bit_Sint32_Bit_28.Intern_MEM.Bit_Test "" SLONG ident 1 100 -2147483648 2147483647 ECU_ADDRESS 0x7FAFC4 BIT_MASK 0x10000000 /end MEASUREMENT
/begin MEASUREMENT Bit_Sint32_Bit_29.Intern_MEM.Bit_Test "" SLONG ident 1 100 -2147483648 2147483647 ECU_ADDRESS 0x7FAFC4 BIT_MASK 0x20000000 /end MEASUREMENT
/begin MEASUREMENT Bit_Sint32_Bit_30.Intern_MEM.Bit_Test "" SLONG ident 1 100 -2147483648 2147483647 ECU_ADDRESS 0x7FAFC4 BIT_MASK 0x40000000 /end MEASUREMENT
/begin MEASUREMENT Bit_Sint32_Bit_31.Intern_MEM.Bit_Test "" SLONG ident 1 100 -2147483648 2147483647 ECU_ADDRESS 0x7FAFC4 BIT_MASK 0x80000000 /end MEASUREMENT
/begin MEASUREMENT Bit_Sint8.P_Bit.Bit_Test "" SBYTE ident 1 100 -128 127 ECU_ADDRESS 0x7FAFC0 /end MEASUREMENT
/begin MEASUREMENT Bit_Sint8_E_Bit_x.Extern_MEM.Bit_Test "" SBYTE ident 1 100 -128 127 ECU_ADDRESS 0x821130 /end MEASUREMENT
/begin MEASUREMENT Bit_Sint8_E_Bit_0.Extern_MEM.Bit_Test "" SBYTE ident 1 100 -128 127 ECU_ADDRESS 0x821130 BIT_MASK 0x01 /end MEASUREMENT
/begin MEASUREMENT Bit_Sint8_E_Bit_1.Extern_MEM.Bit_Test "" SBYTE ident 1 100 -128 127 ECU_ADDRESS 0x821130 BIT_MASK 0x02 /end MEASUREMENT
/begin MEASUREMENT Bit_Sint8_E_Bit_2.Extern_MEM.Bit_Test "" SBYTE ident 1 100 -128 127 ECU_ADDRESS 0x821130 BIT_MASK 0x04 /end MEASUREMENT
/begin MEASUREMENT Bit_Sint8_E_Bit_3.Extern_MEM.Bit_Test "" SBYTE ident 1 100 -128 127 ECU_ADDRESS 0x821130 BIT_MASK 0x08 /end MEASUREMENT
/begin MEASUREMENT Bit_Sint8_E_Bit_4.Extern_MEM.Bit_Test "" SBYTE ident 1 100 -128 127 ECU_ADDRESS 0x821130 BIT_MASK 0x10 /end MEASUREMENT
/begin MEASUREMENT Bit_Sint8_E_Bit_5.Extern_MEM.Bit_Test "" SBYTE ident 1 100 -128 127 ECU_ADDRESS 0x821130 BIT_MASK 0x20 /end MEASUREMENT
/begin MEASUREMENT Bit_Sint8_E_Bit_6.Extern_MEM.Bit_Test "" SBYTE ident 1 100 -128 127 ECU_ADDRESS 0x821130 BIT_MASK 0x40 /end MEASUREMENT
/begin MEASUREMENT Bit_Sint8_E_Bit_7.Extern_MEM.Bit_Test "" SBYTE ident 1 100 -128 127 ECU_ADDRESS 0x821130 BIT_MASK 0x80 /end MEASUREMENT
/begin MEASUREMENT Bit_Sint8_E_Bit_x.Intern_MEM.Bit_Test "" SBYTE ident 1 100 -128 127 ECU_ADDRESS 0x7FAFD0 /end MEASUREMENT
/begin MEASUREMENT Bit_Sint8_E_Bit_0.Intern_MEM.Bit_Test "" SBYTE ident 1 100 -128 127 ECU_ADDRESS 0x7FAFD0 BIT_MASK 0x01 /end MEASUREMENT
/begin MEASUREMENT Bit_Sint8_E_Bit_1.Intern_MEM.Bit_Test "" SBYTE ident 1 100 -128 127 ECU_ADDRESS 0x7FAFD0 BIT_MASK 0x02 /end MEASUREMENT
/begin MEASUREMENT Bit_Sint8_E_Bit_2.Intern_MEM.Bit_Test "" SBYTE ident 1 100 -128 127 ECU_ADDRESS 0x7FAFD0 BIT_MASK 0x04 /end MEASUREMENT
/begin MEASUREMENT Bit_Sint8_E_Bit_3.Intern_MEM.Bit_Test "" SBYTE ident 1 100 -128 127 ECU_ADDRESS 0x7FAFD0 BIT_MASK 0x08 /end MEASUREMENT
/begin MEASUREMENT Bit_Sint8_E_Bit_4.Intern_MEM.Bit_Test "" SBYTE ident 1 100 -128 127 ECU_ADDRESS 0x7FAFD0 BIT_MASK 0x10 /end MEASUREMENT
/begin MEASUREMENT Bit_Sint8_E_Bit_5.Intern_MEM.Bit_Test "" SBYTE ident 1 100 -128 127 ECU_ADDRESS 0x7FAFD0 BIT_MASK 0x20 /end MEASUREMENT
/begin MEASUREMENT Bit_Sint8_E_Bit_6.Intern_MEM.Bit_Test "" SBYTE ident 1 100 -128 127 ECU_ADDRESS 0x7FAFD0 BIT_MASK 0x40 /end MEASUREMENT
/begin MEASUREMENT Bit_Sint8_E_Bit_7.Intern_MEM.Bit_Test "" SBYTE ident 1 100 -128 127 ECU_ADDRESS 0x7FAFD0 BIT_MASK 0x80 /end MEASUREMENT
/begin MEASUREMENT Bit_Sint8_O_Bit_x.Extern_MEM.Bit_Test "" SBYTE ident 1 100 -128 127 ECU_ADDRESS 0x821131 /end MEASUREMENT
/begin MEASUREMENT Bit_Sint8_O_Bit_0.Extern_MEM.Bit_Test "" SBYTE ident 1 100 -128 127 ECU_ADDRESS 0x821131 BIT_MASK 0x01 /end MEASUREMENT
/begin MEASUREMENT Bit_Sint8_O_Bit_1.Extern_MEM.Bit_Test "" SBYTE ident 1 100 -128 127 ECU_ADDRESS 0x821131 BIT_MASK 0x02 /end MEASUREMENT
/begin MEASUREMENT Bit_Sint8_O_Bit_2.Extern_MEM.Bit_Test "" SBYTE ident 1 100 -128 127 ECU_ADDRESS 0x821131 BIT_MASK 0x04 /end MEASUREMENT
/begin MEASUREMENT Bit_Sint8_O_Bit_3.Extern_MEM.Bit_Test "" SBYTE ident 1 100 -128 127 ECU_ADDRESS 0x821131 BIT_MASK 0x08 /end MEASUREMENT
/begin MEASUREMENT Bit_Sint8_O_Bit_4.Extern_MEM.Bit_Test "" SBYTE ident 1 100 -128 127 ECU_ADDRESS 0x821131 BIT_MASK 0x10 /end MEASUREMENT
/begin MEASUREMENT Bit_Sint8_O_Bit_5.Extern_MEM.Bit_Test "" SBYTE ident 1 100 -128 127 ECU_ADDRESS 0x821131 BIT_MASK 0x20 /end MEASUREMENT
/begin MEASUREMENT Bit_Sint8_O_Bit_6.Extern_MEM.Bit_Test "" SBYTE ident 1 100 -128 127 ECU_ADDRESS 0x821131 BIT_MASK 0x40 /end MEASUREMENT
/begin MEASUREMENT Bit_Sint8_O_Bit_7.Extern_MEM.Bit_Test "" SBYTE ident 1 100 -128 127 ECU_ADDRESS 0x821131 BIT_MASK 0x80 /end MEASUREMENT
/begin MEASUREMENT Bit_Sint8_O_Bit_x.Intern_MEM.Bit_Test "" SBYTE ident 1 100 -128 127 ECU_ADDRESS 0x7FAFD1 /end MEASUREMENT
/begin MEASUREMENT Bit_Sint8_O_Bit_0.Intern_MEM.Bit_Test "" SBYTE ident 1 100 -128 127 ECU_ADDRESS 0x7FAFD1 BIT_MASK 0x01 /end MEASUREMENT
/begin MEASUREMENT Bit_Sint8_O_Bit_1.Intern_MEM.Bit_Test "" SBYTE ident 1 100 -128 127 ECU_ADDRESS 0x7FAFD1 BIT_MASK 0x02 /end MEASUREMENT
/begin MEASUREMENT Bit_Sint8_O_Bit_2.Intern_MEM.Bit_Test "" SBYTE ident 1 100 -128 127 ECU_ADDRESS 0x7FAFD1 BIT_MASK 0x04 /end MEASUREMENT
/begin MEASUREMENT Bit_Sint8_O_Bit_3.Intern_MEM.Bit_Test "" SBYTE ident 1 100 -128 127 ECU_ADDRESS 0x7FAFD1 BIT_MASK 0x08 /end MEASUREMENT
/begin MEASUREMENT Bit_Sint8_O_Bit_4.Intern_MEM.Bit_Test "" SBYTE ident 1 100 -128 127 ECU_ADDRESS 0x7FAFD1 BIT_MASK 0x10 /end MEASUREMENT
/begin MEASUREMENT Bit_Sint8_O_Bit_5.Intern_MEM.Bit_Test "" SBYTE ident 1 100 -128 127 ECU_ADDRESS 0x7FAFD1 BIT_MASK 0x20 /end MEASUREMENT
/begin MEASUREMENT Bit_Sint8_O_Bit_6.Intern_MEM.Bit_Test "" SBYTE ident 1 100 -128 127 ECU_ADDRESS 0x7FAFD1 BIT_MASK 0x40 /end MEASUREMENT
/begin MEASUREMENT Bit_Sint8_O_Bit_7.Intern_MEM.Bit_Test "" SBYTE ident 1 100 -128 127 ECU_ADDRESS 0x7FAFD1 BIT_MASK 0x80 /end MEASUREMENT
/begin MEASUREMENT Bit_Uint16.P_Bit.Bit_Test "" UWORD ident 1 100 0 65535 ECU_ADDRESS 0x7FAFBE /end MEASUREMENT
/begin MEASUREMENT Bit_Uint16_Bit_x.Extern_MEM.Bit_Test "" UWORD ident 1 100 0 65535 ECU_ADDRESS 0x82112E /end MEASUREMENT
/begin MEASUREMENT Bit_Uint16_Bit_00.Extern_MEM.Bit_Test "" UWORD ident 1 100 0 65535 ECU_ADDRESS 0x82112E BIT_MASK 0x0001 /end MEASUREMENT
/begin MEASUREMENT Bit_Uint16_Bit_01.Extern_MEM.Bit_Test "" UWORD ident 1 100 0 65535 ECU_ADDRESS 0x82112E BIT_MASK 0x0002 /end MEASUREMENT
/begin MEASUREMENT Bit_Uint16_Bit_02.Extern_MEM.Bit_Test "" UWORD ident 1 100 0 65535 ECU_ADDRESS 0x82112E BIT_MASK 0x0004 /end MEASUREMENT
/begin MEASUREMENT Bit_Uint16_Bit_03.Extern_MEM.Bit_Test "" UWORD ident 1 100 0 65535 ECU_ADDRESS 0x82112E BIT_MASK 0x0008 /end MEASUREMENT
/begin MEASUREMENT Bit_Uint16_Bit_04.Extern_MEM.Bit_Test "" UWORD ident 1 100 0 65535 ECU_ADDRESS 0x82112E BIT_MASK 0x0010 /end MEASUREMENT
/begin MEASUREMENT Bit_Uint16_Bit_05.Extern_MEM.Bit_Test "" UWORD ident 1 100 0 65535 ECU_ADDRESS 0x82112E BIT_MASK 0x0020 /end MEASUREMENT
/begin MEASUREMENT Bit_Uint16_Bit_06.Extern_MEM.Bit_Test "" UWORD ident 1 100 0 65535 ECU_ADDRESS 0x82112E BIT_MASK 0x0040 /end MEASUREMENT
/begin MEASUREMENT Bit_Uint16_Bit_07.Extern_MEM.Bit_Test "" UWORD ident 1 100 0 65535 ECU_ADDRESS 0x82112E BIT_MASK 0x0080 /end MEASUREMENT
/begin MEASUREMENT Bit_Uint16_Bit_08.Extern_MEM.Bit_Test "" UWORD ident 1 100 0 65535 ECU_ADDRESS 0x82112E BIT_MASK 0x0100 /end MEASUREMENT
/begin MEASUREMENT Bit_Uint16_Bit_09.Extern_MEM.Bit_Test "" UWORD ident 1 100 0 65535 ECU_ADDRESS 0x82112E BIT_MASK 0x0200 /end MEASUREMENT
/begin MEASUREMENT Bit_Uint16_Bit_10.Extern_MEM.Bit_Test "" UWORD ident 1 100 0 65535 ECU_ADDRESS 0x82112E BIT_MASK 0x0400 /end MEASUREMENT
/begin MEASUREMENT Bit_Uint16_Bit_11.Extern_MEM.Bit_Test "" UWORD ident 1 100 0 65535 ECU_ADDRESS 0x82112E BIT_MASK 0x0800 /end MEASUREMENT
/begin MEASUREMENT Bit_Uint16_Bit_12.Extern_MEM.Bit_Test "" UWORD ident 1 100 0 65535 ECU_ADDRESS 0x82112E BIT_MASK 0x1000 /end MEASUREMENT
/begin MEASUREMENT Bit_Uint16_Bit_13.Extern_MEM.Bit_Test "" UWORD ident 1 100 0 65535 ECU_ADDRESS 0x82112E BIT_MASK 0x2000 /end MEASUREMENT
/begin MEASUREMENT Bit_Uint16_Bit_14.Extern_MEM.Bit_Test "" UWORD ident 1 100 0 65535 ECU_ADDRESS 0x82112E BIT_MASK 0x4000 /end MEASUREMENT
/begin MEASUREMENT Bit_Uint16_Bit_15.Extern_MEM.Bit_Test "" UWORD ident 1 100 0 65535 ECU_ADDRESS 0x82112E BIT_MASK 0x8000 /end MEASUREMENT
/begin MEASUREMENT Bit_Uint16_Bit_x.Intern_MEM.Bit_Test "" UWORD ident 1 100 0 65535 ECU_ADDRESS 0x7FAFCE /end MEASUREMENT
/begin MEASUREMENT Bit_Uint16_Bit_00.Intern_MEM.Bit_Test "" UWORD ident 1 100 0 65535 ECU_ADDRESS 0x7FAFCE BIT_MASK 0x0001 /end MEASUREMENT
/begin MEASUREMENT Bit_Uint16_Bit_01.Intern_MEM.Bit_Test "" UWORD ident 1 100 0 65535 ECU_ADDRESS 0x7FAFCE BIT_MASK 0x0002 /end MEASUREMENT
/begin MEASUREMENT Bit_Uint16_Bit_02.Intern_MEM.Bit_Test "" UWORD ident 1 100 0 65535 ECU_ADDRESS 0x7FAFCE BIT_MASK 0x0004 /end MEASUREMENT
/begin MEASUREMENT Bit_Uint16_Bit_03.Intern_MEM.Bit_Test "" UWORD ident 1 100 0 65535 ECU_ADDRESS 0x7FAFCE BIT_MASK 0x0008 /end MEASUREMENT
/begin MEASUREMENT Bit_Uint16_Bit_04.Intern_MEM.Bit_Test "" UWORD ident 1 100 0 65535 ECU_ADDRESS 0x7FAFCE BIT_MASK 0x0010 /end MEASUREMENT
/begin MEASUREMENT Bit_Uint16_Bit_05.Intern_MEM.Bit_Test "" UWORD ident 1 100 0 65535 ECU_ADDRESS 0x7FAFCE BIT_MASK 0x0020 /end MEASUREMENT
/begin MEASUREMENT Bit_Uint16_Bit_06.Intern_MEM.Bit_Test "" UWORD ident 1 100 0 65535 ECU_ADDRESS 0x7FAFCE BIT_MASK 0x0040 /end MEASUREMENT
/begin MEASUREMENT Bit_Uint16_Bit_07.Intern_MEM.Bit_Test "" UWORD ident 1 100 0 65535 ECU_ADDRESS 0x7FAFCE BIT_MASK 0x0080 /end MEASUREMENT
/begin MEASUREMENT Bit_Uint16_Bit_08.Intern_MEM.Bit_Test "" UWORD ident 1 100 0 65535 ECU_ADDRESS 0x7FAFCE BIT_MASK 0x0100 /end MEASUREMENT
/begin MEASUREMENT Bit_Uint16_Bit_09.Intern_MEM.Bit_Test "" UWORD ident 1 100 0 65535 ECU_ADDRESS 0x7FAFCE BIT_MASK 0x0200 /end MEASUREMENT
/begin MEASUREMENT Bit_Uint16_Bit_10.Intern_MEM.Bit_Test "" UWORD ident 1 100 0 65535 ECU_ADDRESS 0x7FAFCE BIT_MASK 0x0400 /end MEASUREMENT
/begin MEASUREMENT Bit_Uint16_Bit_11.Intern_MEM.Bit_Test "" UWORD ident 1 100 0 65535 ECU_ADDRESS 0x7FAFCE BIT_MASK 0x0800 /end MEASUREMENT
/begin MEASUREMENT Bit_Uint16_Bit_12.Intern_MEM.Bit_Test "" UWORD ident 1 100 0 65535 ECU_ADDRESS 0x7FAFCE BIT_MASK 0x1000 /end MEASUREMENT
/begin MEASUREMENT Bit_Uint16_Bit_13.Intern_MEM.Bit_Test "" UWORD ident 1 100 0 65535 ECU_ADDRESS 0x7FAFCE BIT_MASK 0x2000 /end MEASUREMENT
/begin MEASUREMENT Bit_Uint16_Bit_14.Intern_MEM.Bit_Test "" UWORD ident 1 100 0 65535 ECU_ADDRESS 0x7FAFCE BIT_MASK 0x4000 /end MEASUREMENT
/begin MEASUREMENT Bit_Uint16_Bit_15.Intern_MEM.Bit_Test "" UWORD ident 1 100 0 65535 ECU_ADDRESS 0x7FAFCE BIT_MASK 0x8000 /end MEASUREMENT
/begin MEASUREMENT Bit_Uint32.P_Bit.Bit_Test "" ULONG ident 1 100 0 4294967295 ECU_ADDRESS 0x7FAFB8 /end MEASUREMENT
/begin MEASUREMENT Bit_Uint32_Bit_x.Extern_MEM.Bit_Test "" ULONG ident 1 100 0 4294967295 ECU_ADDRESS 0x821128 /end MEASUREMENT
/begin MEASUREMENT Bit_Uint32_Bit_00.Extern_MEM.Bit_Test "" ULONG ident 1 100 0 4294967295 ECU_ADDRESS 0x821128 BIT_MASK 0x00000001 /end MEASUREMENT
/begin MEASUREMENT Bit_Uint32_Bit_01.Extern_MEM.Bit_Test "" ULONG ident 1 100 0 4294967295 ECU_ADDRESS 0x821128 BIT_MASK 0x00000002 /end MEASUREMENT
/begin MEASUREMENT Bit_Uint32_Bit_02.Extern_MEM.Bit_Test "" ULONG ident 1 100 0 4294967295 ECU_ADDRESS 0x821128 BIT_MASK 0x00000004 /end MEASUREMENT
/begin MEASUREMENT Bit_Uint32_Bit_03.Extern_MEM.Bit_Test "" ULONG ident 1 100 0 4294967295 ECU_ADDRESS 0x821128 BIT_MASK 0x00000008 /end MEASUREMENT
/begin MEASUREMENT Bit_Uint32_Bit_04.Extern_MEM.Bit_Test "" ULONG ident 1 100 0 4294967295 ECU_ADDRESS 0x821128 BIT_MASK 0x00000010 /end MEASUREMENT
/begin MEASUREMENT Bit_Uint32_Bit_05.Extern_MEM.Bit_Test "" ULONG ident 1 100 0 4294967295 ECU_ADDRESS 0x821128 BIT_MASK 0x00000020 /end MEASUREMENT
/begin MEASUREMENT Bit_Uint32_Bit_06.Extern_MEM.Bit_Test "" ULONG ident 1 100 0 4294967295 ECU_ADDRESS 0x821128 BIT_MASK 0x00000040 /end MEASUREMENT
/begin MEASUREMENT Bit_Uint32_Bit_07.Extern_MEM.Bit_Test "" ULONG ident 1 100 0 4294967295 ECU_ADDRESS 0x821128 BIT_MASK 0x00000080 /end MEASUREMENT
/begin MEASUREMENT Bit_Uint32_Bit_08.Extern_MEM.Bit_Test "" ULONG ident 1 100 0 4294967295 ECU_ADDRESS 0x821128 BIT_MASK 0x00000100 /end MEASUREMENT
/begin MEASUREMENT Bit_Uint32_Bit_09.Extern_MEM.Bit_Test "" ULONG ident 1 100 0 4294967295 ECU_ADDRESS 0x821128 BIT_MASK 0x00000200 /end MEASUREMENT
/begin MEASUREMENT Bit_Uint32_Bit_10.Extern_MEM.Bit_Test "" ULONG ident 1 100 0 4294967295 ECU_ADDRESS 0x821128 BIT_MASK 0x00000400 /end MEASUREMENT
/begin MEASUREMENT Bit_Uint32_Bit_11.Extern_MEM.Bit_Test "" ULONG ident 1 100 0 4294967295 ECU_ADDRESS 0x821128 BIT_MASK 0x00000800 /end MEASUREMENT
/begin MEASUREMENT Bit_Uint32_Bit_12.Extern_MEM.Bit_Test "" ULONG ident 1 100 0 4294967295 ECU_ADDRESS 0x821128 BIT_MASK 0x00001000 /end MEASUREMENT
/begin MEASUREMENT Bit_Uint32_Bit_13.Extern_MEM.Bit_Test "" ULONG ident 1 100 0 4294967295 ECU_ADDRESS 0x821128 BIT_MASK 0x00002000 /end MEASUREMENT
/begin MEASUREMENT Bit_Uint32_Bit_14.Extern_MEM.Bit_Test "" ULONG ident 1 100 0 4294967295 ECU_ADDRESS 0x821128 BIT_MASK 0x00004000 /end MEASUREMENT
/begin MEASUREMENT Bit_Uint32_Bit_15.Extern_MEM.Bit_Test "" ULONG ident 1 100 0 4294967295 ECU_ADDRESS 0x821128 BIT_MASK 0x00008000 /end MEASUREMENT
/begin MEASUREMENT Bit_Uint32_Bit_16.Extern_MEM.Bit_Test "" ULONG ident 1 100 0 4294967295 ECU_ADDRESS 0x821128 BIT_MASK 0x00010000 /end MEASUREMENT
/begin MEASUREMENT Bit_Uint32_Bit_17.Extern_MEM.Bit_Test "" ULONG ident 1 100 0 4294967295 ECU_ADDRESS 0x821128 BIT_MASK 0x00020000 /end MEASUREMENT
/begin MEASUREMENT Bit_Uint32_Bit_18.Extern_MEM.Bit_Test "" ULONG ident 1 100 0 4294967295 ECU_ADDRESS 0x821128 BIT_MASK 0x00040000 /end MEASUREMENT
/begin MEASUREMENT Bit_Uint32_Bit_19.Extern_MEM.Bit_Test "" ULONG ident 1 100 0 4294967295 ECU_ADDRESS 0x821128 BIT_MASK 0x00080000 /end MEASUREMENT
/begin MEASUREMENT Bit_Uint32_Bit_20.Extern_MEM.Bit_Test "" ULONG ident 1 100 0 4294967295 ECU_ADDRESS 0x821128 BIT_MASK 0x00100000 /end MEASUREMENT
/begin MEASUREMENT Bit_Uint32_Bit_21.Extern_MEM.Bit_Test "" ULONG ident 1 100 0 4294967295 ECU_ADDRESS 0x821128 BIT_MASK 0x00200000 /end MEASUREMENT
/begin MEASUREMENT Bit_Uint32_Bit_22.Extern_MEM.Bit_Test "" ULONG ident 1 100 0 4294967295 ECU_ADDRESS 0x821128 BIT_MASK 0x00400000 /end MEASUREMENT
/begin MEASUREMENT Bit_Uint32_Bit_23.Extern_MEM.Bit_Test "" ULONG ident 1 100 0 4294967295 ECU_ADDRESS 0x821128 BIT_MASK 0x00800000 /end MEASUREMENT
/begin MEASUREMENT Bit_Uint32_Bit_24.Extern_MEM.Bit_Test "" ULONG ident 1 100 0 4294967295 ECU_ADDRESS 0x821128 BIT_MASK 0x01000000 /end MEASUREMENT
/begin MEASUREMENT Bit_Uint32_Bit_25.Extern_MEM.Bit_Test "" ULONG ident 1 100 0 4294967295 ECU_ADDRESS 0x821128 BIT_MASK 0x02000000 /end MEASUREMENT
/begin MEASUREMENT Bit_Uint32_Bit_26.Extern_MEM.Bit_Test "" ULONG ident 1 100 0 4294967295 ECU_ADDRESS 0x821128 BIT_MASK 0x04000000 /end MEASUREMENT
/begin MEASUREMENT Bit_Uint32_Bit_27.Extern_MEM.Bit_Test "" ULONG ident 1 100 0 4294967295 ECU_ADDRESS 0x821128 BIT_MASK 0x08000000 /end MEASUREMENT
/begin MEASUREMENT Bit_Uint32_Bit_28.Extern_MEM.Bit_Test "" ULONG ident 1 100 0 4294967295 ECU_ADDRESS 0x821128 BIT_MASK 0x10000000 /end MEASUREMENT
/begin MEASUREMENT Bit_Uint32_Bit_29.Extern_MEM.Bit_Test "" ULONG ident 1 100 0 4294967295 ECU_ADDRESS 0x821128 BIT_MASK 0x20000000 /end MEASUREMENT
/begin MEASUREMENT Bit_Uint32_Bit_30.Extern_MEM.Bit_Test "" ULONG ident 1 100 0 4294967295 ECU_ADDRESS 0x821128 BIT_MASK 0x40000000 /end MEASUREMENT
/begin MEASUREMENT Bit_Uint32_Bit_31.Extern_MEM.Bit_Test "" ULONG ident 1 100 0 4294967295 ECU_ADDRESS 0x821128 BIT_MASK 0x80000000 /end MEASUREMENT
/begin MEASUREMENT Bit_Uint32_Bit_x.Intern_MEM.Bit_Test "" ULONG ident 1 100 0 4294967295 ECU_ADDRESS 0x7FAFC8 /end MEASUREMENT
/begin MEASUREMENT Bit_Uint32_Bit_00.Intern_MEM.Bit_Test "" ULONG ident 1 100 0 4294967295 ECU_ADDRESS 0x7FAFC8 BIT_MASK 0x00000001 /end MEASUREMENT
/begin MEASUREMENT Bit_Uint32_Bit_01.Intern_MEM.Bit_Test "" ULONG ident 1 100 0 4294967295 ECU_ADDRESS 0x7FAFC8 BIT_MASK 0x00000002 /end MEASUREMENT
/begin MEASUREMENT Bit_Uint32_Bit_02.Intern_MEM.Bit_Test "" ULONG ident 1 100 0 4294967295 ECU_ADDRESS 0x7FAFC8 BIT_MASK 0x00000004 /end MEASUREMENT
/begin MEASUREMENT Bit_Uint32_Bit_03.Intern_MEM.Bit_Test "" ULONG ident 1 100 0 4294967295 ECU_ADDRESS 0x7FAFC8 BIT_MASK 0x00000008 /end MEASUREMENT
/begin MEASUREMENT Bit_Uint32_Bit_04.Intern_MEM.Bit_Test "" ULONG ident 1 100 0 4294967295 ECU_ADDRESS 0x7FAFC8 BIT_MASK 0x00000010 /end MEASUREMENT
/begin MEASUREMENT Bit_Uint32_Bit_05.Intern_MEM.Bit_Test "" ULONG ident 1 100 0 4294967295 ECU_ADDRESS 0x7FAFC8 BIT_MASK 0x00000020 /end MEASUREMENT
/begin MEASUREMENT Bit_Uint32_Bit_06.Intern_MEM.Bit_Test "" ULONG ident 1 100 0 4294967295 ECU_ADDRESS 0x7FAFC8 BIT_MASK 0x00000040 /end MEASUREMENT
/begin MEASUREMENT Bit_Uint32_Bit_07.Intern_MEM.Bit_Test "" ULONG ident 1 100 0 4294967295 ECU_ADDRESS 0x7FAFC8 BIT_MASK 0x00000080 /end MEASUREMENT
/begin MEASUREMENT Bit_Uint32_Bit_08.Intern_MEM.Bit_Test "" ULONG ident 1 100 0 4294967295 ECU_ADDRESS 0x7FAFC8 BIT_MASK 0x00000100 /end MEASUREMENT
/begin MEASUREMENT Bit_Uint32_Bit_09.Intern_MEM.Bit_Test "" ULONG ident 1 100 0 4294967295 ECU_ADDRESS 0x7FAFC8 BIT_MASK 0x00000200 /end MEASUREMENT
/begin MEASUREMENT Bit_Uint32_Bit_10.Intern_MEM.Bit_Test "" ULONG ident 1 100 0 4294967295 ECU_ADDRESS 0x7FAFC8 BIT_MASK 0x00000400 /end MEASUREMENT
/begin MEASUREMENT Bit_Uint32_Bit_11.Intern_MEM.Bit_Test "" ULONG ident 1 100 0 4294967295 ECU_ADDRESS 0x7FAFC8 BIT_MASK 0x00000800 /end MEASUREMENT
/begin MEASUREMENT Bit_Uint32_Bit_12.Intern_MEM.Bit_Test "" ULONG ident 1 100 0 4294967295 ECU_ADDRESS 0x7FAFC8 BIT_MASK 0x00001000 /end MEASUREMENT
/begin MEASUREMENT Bit_Uint32_Bit_13.Intern_MEM.Bit_Test "" ULONG ident 1 100 0 4294967295 ECU_ADDRESS 0x7FAFC8 BIT_MASK 0x00002000 /end MEASUREMENT
/begin MEASUREMENT Bit_Uint32_Bit_14.Intern_MEM.Bit_Test "" ULONG ident 1 100 0 4294967295 ECU_ADDRESS 0x7FAFC8 BIT_MASK 0x00004000 /end MEASUREMENT
/begin MEASUREMENT Bit_Uint32_Bit_15.Intern_MEM.Bit_Test "" ULONG ident 1 100 0 4294967295 ECU_ADDRESS 0x7FAFC8 BIT_MASK 0x00008000 /end MEASUREMENT
/begin MEASUREMENT Bit_Uint32_Bit_16.Intern_MEM.Bit_Test "" ULONG ident 1 100 0 4294967295 ECU_ADDRESS 0x7FAFC8 BIT_MASK 0x00010000 /end MEASUREMENT
/begin MEASUREMENT Bit_Uint32_Bit_17.Intern_MEM.Bit_Test "" ULONG ident 1 100 0 4294967295 ECU_ADDRESS 0x7FAFC8 BIT_MASK 0x00020000 /end MEASUREMENT
/begin MEASUREMENT Bit_Uint32_Bit_18.Intern_MEM.Bit_Test "" ULONG ident 1 100 0 4294967295 ECU_ADDRESS 0x7FAFC8 BIT_MASK 0x00040000 /end MEASUREMENT
/begin MEASUREMENT Bit_Uint32_Bit_19.Intern_MEM.Bit_Test "" ULONG ident 1 100 0 4294967295 ECU_ADDRESS 0x7FAFC8 BIT_MASK 0x00080000 /end MEASUREMENT
/begin MEASUREMENT Bit_Uint32_Bit_20.Intern_MEM.Bit_Test "" ULONG ident 1 100 0 4294967295 ECU_ADDRESS 0x7FAFC8 BIT_MASK 0x00100000 /end MEASUREMENT
/begin MEASUREMENT Bit_Uint32_Bit_21.Intern_MEM.Bit_Test "" ULONG ident 1 100 0 4294967295 ECU_ADDRESS 0x7FAFC8 BIT_MASK 0x00200000 /end MEASUREMENT
/begin MEASUREMENT Bit_Uint32_Bit_22.Intern_MEM.Bit_Test "" ULONG ident 1 100 0 4294967295 ECU_ADDRESS 0x7FAFC8 BIT_MASK 0x00400000 /end MEASUREMENT
/begin MEASUREMENT Bit_Uint32_Bit_23.Intern_MEM.Bit_Test "" ULONG ident 1 100 0 4294967295 ECU_ADDRESS 0x7FAFC8 BIT_MASK 0x00800000 /end MEASUREMENT
/begin MEASUREMENT Bit_Uint32_Bit_24.Intern_MEM.Bit_Test "" ULONG ident 1 100 0 4294967295 ECU_ADDRESS 0x7FAFC8 BIT_MASK 0x01000000 /end MEASUREMENT
/begin MEASUREMENT Bit_Uint32_Bit_25.Intern_MEM.Bit_Test "" ULONG ident 1 100 0 4294967295 ECU_ADDRESS 0x7FAFC8 BIT_MASK 0x02000000 /end MEASUREMENT
/begin MEASUREMENT Bit_Uint32_Bit_26.Intern_MEM.Bit_Test "" ULONG ident 1 100 0 4294967295 ECU_ADDRESS 0x7FAFC8 BIT_MASK 0x04000000 /end MEASUREMENT
/begin MEASUREMENT Bit_Uint32_Bit_27.Intern_MEM.Bit_Test "" ULONG ident 1 100 0 4294967295 ECU_ADDRESS 0x7FAFC8 BIT_MASK 0x08000000 /end MEASUREMENT
/begin MEASUREMENT Bit_Uint32_Bit_28.Intern_MEM.Bit_Test "" ULONG ident 1 100 0 4294967295 ECU_ADDRESS 0x7FAFC8 BIT_MASK 0x10000000 /end MEASUREMENT
/begin MEASUREMENT Bit_Uint32_Bit_29.Intern_MEM.Bit_Test "" ULONG ident 1 100 0 4294967295 ECU_ADDRESS 0x7FAFC8 BIT_MASK 0x20000000 /end MEASUREMENT
/begin MEASUREMENT Bit_Uint32_Bit_30.Intern_MEM.Bit_Test "" ULONG ident 1 100 0 4294967295 ECU_ADDRESS 0x7FAFC8 BIT_MASK 0x40000000 /end MEASUREMENT
/begin MEASUREMENT Bit_Uint32_Bit_31.Intern_MEM.Bit_Test "" ULONG ident 1 100 0 4294967295 ECU_ADDRESS 0x7FAFC8 BIT_MASK 0x80000000 /end MEASUREMENT
/begin MEASUREMENT Bit_Uint8.P_Bit.Bit_Test "" UBYTE ident 1 100 0 255 ECU_ADDRESS 0x7FAFC1 /end MEASUREMENT
/begin MEASUREMENT Bit_Uint8_E_Bit_x.Extern_MEM.Bit_Test "" UBYTE ident 1 100 0 255 ECU_ADDRESS 0x821132 /end MEASUREMENT
/begin MEASUREMENT Bit_Uint8_E_Bit_0.Extern_MEM.Bit_Test "" UBYTE ident 1 100 0 255 ECU_ADDRESS 0x821132 BIT_MASK 0x01 /end MEASUREMENT
/begin MEASUREMENT Bit_Uint8_E_Bit_1.Extern_MEM.Bit_Test "" UBYTE ident 1 100 0 255 ECU_ADDRESS 0x821132 BIT_MASK 0x02 /end MEASUREMENT
/begin MEASUREMENT Bit_Uint8_E_Bit_2.Extern_MEM.Bit_Test "" UBYTE ident 1 100 0 255 ECU_ADDRESS 0x821132 BIT_MASK 0x04 /end MEASUREMENT
/begin MEASUREMENT Bit_Uint8_E_Bit_3.Extern_MEM.Bit_Test "" UBYTE ident 1 100 0 255 ECU_ADDRESS 0x821132 BIT_MASK 0x08 /end MEASUREMENT
/begin MEASUREMENT Bit_Uint8_E_Bit_4.Extern_MEM.Bit_Test "" UBYTE ident 1 100 0 255 ECU_ADDRESS 0x821132 BIT_MASK 0x10 /end MEASUREMENT
/begin MEASUREMENT Bit_Uint8_E_Bit_5.Extern_MEM.Bit_Test "" UBYTE ident 1 100 0 255 ECU_ADDRESS 0x821132 BIT_MASK 0x20 /end MEASUREMENT
/begin MEASUREMENT Bit_Uint8_E_Bit_6.Extern_MEM.Bit_Test "" UBYTE ident 1 100 0 255 ECU_ADDRESS 0x821132 BIT_MASK 0x40 /end MEASUREMENT
/begin MEASUREMENT Bit_Uint8_E_Bit_7.Extern_MEM.Bit_Test "" UBYTE ident 1 100 0 255 ECU_ADDRESS 0x821132 BIT_MASK 0x80 /end MEASUREMENT
/begin MEASUREMENT Bit_Uint8_E_Bit_x.Intern_MEM.Bit_Test "" UBYTE ident 1 100 0 255 ECU_ADDRESS 0x7FAFD2 /end MEASUREMENT
/begin MEASUREMENT Bit_Uint8_E_Bit_0.Intern_MEM.Bit_Test "" UBYTE ident 1 100 0 255 ECU_ADDRESS 0x7FAFD2 BIT_MASK 0x01 /end MEASUREMENT
/begin MEASUREMENT Bit_Uint8_E_Bit_1.Intern_MEM.Bit_Test "" UBYTE ident 1 100 0 255 ECU_ADDRESS 0x7FAFD2 BIT_MASK 0x02 /end MEASUREMENT
/begin MEASUREMENT Bit_Uint8_E_Bit_2.Intern_MEM.Bit_Test "" UBYTE ident 1 100 0 255 ECU_ADDRESS 0x7FAFD2 BIT_MASK 0x04 /end MEASUREMENT
/begin MEASUREMENT Bit_Uint8_E_Bit_3.Intern_MEM.Bit_Test "" UBYTE ident 1 100 0 255 ECU_ADDRESS 0x7FAFD2 BIT_MASK 0x08 /end MEASUREMENT
/begin MEASUREMENT Bit_Uint8_E_Bit_4.Intern_MEM.Bit_Test "" UBYTE ident 1 100 0 255 ECU_ADDRESS 0x7FAFD2 BIT_MASK 0x10 /end MEASUREMENT
/begin MEASUREMENT Bit_Uint8_E_Bit_5.Intern_MEM.Bit_Test "" UBYTE ident 1 100 0 255 ECU_ADDRESS 0x7FAFD2 BIT_MASK 0x20 /end MEASUREMENT
/begin MEASUREMENT Bit_Uint8_E_Bit_6.Intern_MEM.Bit_Test "" UBYTE ident 1 100 0 255 ECU_ADDRESS 0x7FAFD2 BIT_MASK 0x40 /end MEASUREMENT
/begin MEASUREMENT Bit_Uint8_E_Bit_7.Intern_MEM.Bit_Test "" UBYTE ident 1 100 0 255 ECU_ADDRESS 0x7FAFD2 BIT_MASK 0x80 /end MEASUREMENT
/begin MEASUREMENT Bit_Uint8_O_Bit_x.Extern_MEM.Bit_Test "" UBYTE ident 1 100 0 255 ECU_ADDRESS 0x821133 /end MEASUREMENT
/begin MEASUREMENT Bit_Uint8_O_Bit_0.Extern_MEM.Bit_Test "" UBYTE ident 1 100 0 255 ECU_ADDRESS 0x821133 BIT_MASK 0x01 /end MEASUREMENT
/begin MEASUREMENT Bit_Uint8_O_Bit_1.Extern_MEM.Bit_Test "" UBYTE ident 1 100 0 255 ECU_ADDRESS 0x821133 BIT_MASK 0x02 /end MEASUREMENT
/begin MEASUREMENT Bit_Uint8_O_Bit_2.Extern_MEM.Bit_Test "" UBYTE ident 1 100 0 255 ECU_ADDRESS 0x821133 BIT_MASK 0x04 /end MEASUREMENT
/begin MEASUREMENT Bit_Uint8_O_Bit_3.Extern_MEM.Bit_Test "" UBYTE ident 1 100 0 255 ECU_ADDRESS 0x821133 BIT_MASK 0x08 /end MEASUREMENT
/begin MEASUREMENT Bit_Uint8_O_Bit_4.Extern_MEM.Bit_Test "" UBYTE ident 1 100 0 255 ECU_ADDRESS 0x821133 BIT_MASK 0x10 /end MEASUREMENT
/begin MEASUREMENT Bit_Uint8_O_Bit_5.Extern_MEM.Bit_Test "" UBYTE ident 1 100 0 255 ECU_ADDRESS 0x821133 BIT_MASK 0x20 /end MEASUREMENT
/begin MEASUREMENT Bit_Uint8_O_Bit_6.Extern_MEM.Bit_Test "" UBYTE ident 1 100 0 255 ECU_ADDRESS 0x821133 BIT_MASK 0x40 /end MEASUREMENT
/begin MEASUREMENT Bit_Uint8_O_Bit_7.Extern_MEM.Bit_Test "" UBYTE ident 1 100 0 255 ECU_ADDRESS 0x821133 BIT_MASK 0x80 /end MEASUREMENT
/begin MEASUREMENT Bit_Uint8_O_Bit_x.Intern_MEM.Bit_Test "" UBYTE ident 1 100 0 255 ECU_ADDRESS 0x7FAFD3 /end MEASUREMENT
/begin MEASUREMENT Bit_Uint8_O_Bit_0.Intern_MEM.Bit_Test "" UBYTE ident 1 100 0 255 ECU_ADDRESS 0x7FAFD3 BIT_MASK 0x01 /end MEASUREMENT
/begin MEASUREMENT Bit_Uint8_O_Bit_1.Intern_MEM.Bit_Test "" UBYTE ident 1 100 0 255 ECU_ADDRESS 0x7FAFD3 BIT_MASK 0x02 /end MEASUREMENT
/begin MEASUREMENT Bit_Uint8_O_Bit_2.Intern_MEM.Bit_Test "" UBYTE ident 1 100 0 255 ECU_ADDRESS 0x7FAFD3 BIT_MASK 0x04 /end MEASUREMENT
/begin MEASUREMENT Bit_Uint8_O_Bit_3.Intern_MEM.Bit_Test "" UBYTE ident 1 100 0 255 ECU_ADDRESS 0x7FAFD3 BIT_MASK 0x08 /end MEASUREMENT
/begin MEASUREMENT Bit_Uint8_O_Bit_4.Intern_MEM.Bit_Test "" UBYTE ident 1 100 0 255 ECU_ADDRESS 0x7FAFD3 BIT_MASK 0x10 /end MEASUREMENT
/begin MEASUREMENT Bit_Uint8_O_Bit_5.Intern_MEM.Bit_Test "" UBYTE ident 1 100 0 255 ECU_ADDRESS 0x7FAFD3 BIT_MASK 0x20 /end MEASUREMENT
/begin MEASUREMENT Bit_Uint8_O_Bit_6.Intern_MEM.Bit_Test "" UBYTE ident 1 100 0 255 ECU_ADDRESS 0x7FAFD3 BIT_MASK 0x40 /end MEASUREMENT
/begin MEASUREMENT Bit_Uint8_O_Bit_7.Intern_MEM.Bit_Test "" UBYTE ident 1 100 0 255 ECU_ADDRESS 0x7FAFD3 BIT_MASK 0x80 /end MEASUREMENT
/begin MEASUREMENT CAN_Stat_Bx.CanDriver "" ULONG ident 1 100 0 4294967295 ECU_ADDRESS 0x7F820C MATRIX_DIM 64 1 1 /end MEASUREMENT
/begin MEASUREMENT CAN_Status.CanDriver "" UBYTE ident 1 100 0.0 255.0 ECU_ADDRESS 0x82157C /end MEASUREMENT
/begin MEASUREMENT CCP_current_Page.CCP_Page "" UBYTE enum_CCP_Page_ENUM 1 100 0 2 ECU_ADDRESS 0x7FB082 /end MEASUREMENT
/begin MEASUREMENT CCP_overload_counter_1.CCP_SHELL "" UBYTE ident 1 100 0 255 ECU_ADDRESS 0x7F8522 /end MEASUREMENT
/begin MEASUREMENT CCP_overload_counter_2.CCP_SHELL "" UBYTE ident 1 100 0 255 ECU_ADDRESS 0x7F8523 /end MEASUREMENT
/begin MEASUREMENT CCP_overload_counter_3.CCP_SHELL "" UBYTE ident 1 100 0 255 ECU_ADDRESS 0x7F8524 /end MEASUREMENT
/begin MEASUREMENT cell_nr.Curve_Calc_16.Curve_Module "" UBYTE ident 1 100 0 255 ECU_ADDRESS 0x7F8590 /end MEASUREMENT
/begin MEASUREMENT ctrBypassB01.BypassCounter "" ULONG ident 1 100 0 4294967295 ECU_ADDRESS 0x7FAFD4 /end MEASUREMENT
/begin MEASUREMENT ctrBypassB01_H.BypassCounter "" UWORD ident 1 100 0 65535 ECU_ADDRESS 0x7FAFF4 /end MEASUREMENT
/begin MEASUREMENT ctrBypassB01_L.BypassCounter "" UWORD ident 1 100 0 65535 ECU_ADDRESS 0x7FAFF6 /end MEASUREMENT
/begin MEASUREMENT ctrBypassB02.BypassCounter "" ULONG ident 1 100 0 4294967295 ECU_ADDRESS 0x7FAFD8 /end MEASUREMENT
/begin MEASUREMENT ctrBypassB02_H.BypassCounter "" UWORD ident 1 100 0 65535 ECU_ADDRESS 0x7FAFF8 /end MEASUREMENT
/begin MEASUREMENT ctrBypassB02_L.BypassCounter "" UWORD ident 1 100 0 65535 ECU_ADDRESS 0x7FAFFA /end MEASUREMENT
/begin MEASUREMENT ctrBypassB03.BypassCounter "" ULONG ident 1 100 0 4294967295 ECU_ADDRESS 0x7FAFDC /end MEASUREMENT
/begin MEASUREMENT ctrBypassB03_H.BypassCounter "" UWORD ident 1 100 0 65535 ECU_ADDRESS 0x7FAFFC /end MEASUREMENT
/begin MEASUREMENT ctrBypassB03_L.BypassCounter "" UWORD ident 1 100 0 65535 ECU_ADDRESS 0x7FAFFE /end MEASUREMENT
/begin MEASUREMENT ctrBypassB04.BypassCounter "" ULONG ident 1 100 0 4294967295 ECU_ADDRESS 0x7FAFE0 /end MEASUREMENT
/begin MEASUREMENT ctrBypassB04_H.BypassCounter "" UWORD ident 1 100 0 65535 ECU_ADDRESS 0x7FB000 /end MEASUREMENT
/begin MEASUREMENT ctrBypassB04_L.BypassCounter "" UWORD ident 1 100 0 65535 ECU_ADDRESS 0x7FB002 /end MEASUREMENT
/begin MEASUREMENT curve_out.Curve_Calc_16.Curve_Module "" UWORD ident 1 100 0.0 65535.0 ECU_ADDRESS 0x7F857A /end MEASUREMENT
/begin MEASUREMENT Err_Count_DAQ_SAMPLE.CCP_SHELL "" ULONG ident 1 100 0 4294967295 ECU_ADDRESS 0x7FB088 MATRIX_DIM 3 1 1 /end MEASUREMENT
/begin MEASUREMENT Err_Current_DAQ_SAMPLE.CCP_SHELL "" UBYTE ident 1 100 0 1 ECU_ADDRESS 0x7FB094 MATRIX_DIM 3 1 1 /end MEASUREMENT
/begin MEASUREMENT Err_Current_DAQ_SAMPLE_TYP.CCP_SHELL "" UBYTE ident 1 100 0 255 ECU_ADDRESS 0x7FB084 MATRIX_DIM 3 1 1 /end MEASUREMENT
/begin MEASUREMENT Err_State_DAQ_SAMPLE.CCP_SHELL "" UBYTE ident 1 100 0 1 ECU_ADDRESS 0x7F8568 MATRIX_DIM 3 1 1 /end MEASUREMENT
/begin MEASUREMENT g_CanError_au8.CanDriver "" ULONG ident 1 100 0 4294967295 ECU_ADDRESS 0x7F830C MATRIX_DIM 64 1 1 /end MEASUREMENT
/begin MEASUREMENT g_CarbPID05_deltaEnCoTemp40_u8.CRB_OBD "" UBYTE ident 1 100 0 255 ECU_ADDRESS 0x7FB09E /end MEASUREMENT
/begin MEASUREMENT g_CarbPID05_EnCoTemp40_u8.CRB_OBD "" UBYTE ident 1 100 0 255 ECU_ADDRESS 0x7F8576 /end MEASUREMENT
/begin MEASUREMENT g_CarbPID0C_deltaEngineRPM_u8.CRB_OBD "" UBYTE ident 1 100 0 255 ECU_ADDRESS 0x7FB09F /end MEASUREMENT
/begin MEASUREMENT g_CarbPID0C_EngineRPM_u16.CRB_OBD "" UWORD ident 1 100 0 65535 ECU_ADDRESS 0x7F8578 /end MEASUREMENT
/begin MEASUREMENT g_CcpByteOrder_u8.CCP_SHELL "" UBYTE enum_XCP_ByteOrder_e 1 100 0 1 ECU_ADDRESS 0x7F856B /end MEASUREMENT
/begin MEASUREMENT g_CcpModComByteOrder_u8.CCP_SHELL "" UBYTE enum_XCP_ByteOrder_e 1 100 0 1 ECU_ADDRESS 0x7F856C /end MEASUREMENT
/begin MEASUREMENT g_CcpMuxRaster_u32.CCP_SHELL "" ULONG ident 1 100 0 4294967295 ECU_ADDRESS 0x7F8510 /end MEASUREMENT
/begin MEASUREMENT g_fast_on_off_b.CanDriver "" UBYTE ident 1 100 0 1 BIT_MASK 0x1 ECU_ADDRESS 0x7F850C /end MEASUREMENT
/begin MEASUREMENT g_MaxTxDTCinBlock_u8.CRB_OBD "" UBYTE ident 1 100 0 255 ECU_ADDRESS 0x7FB0A0 /end MEASUREMENT
/begin MEASUREMENT g_NumDTC_u16.CRB_OBD "" UWORD ident 1 100 0 65535 ECU_ADDRESS 0x7FB09C /end MEASUREMENT
/begin MEASUREMENT g_Ringbuffer_au8.CanDriver "" ULONG ident 1 100 0 4294967295 ECU_ADDRESS 0x7F840C MATRIX_DIM 64 1 1 /end MEASUREMENT
/begin MEASUREMENT g_RingBufRead_u8.CanDriver "" UBYTE ident 1 100 0 255 ECU_ADDRESS 0x82157D /end MEASUREMENT
/begin MEASUREMENT g_RingBufWrite_u8.CanDriver "" UBYTE ident 1 100 0 255 ECU_ADDRESS 0x82157E /end MEASUREMENT
/begin MEASUREMENT i_ActBdRate_u32.C_ClassDiagInfo.UDS_ISO14229 "" ULONG ident 1 100 0 4294967295 ECU_ADDRESS 0x7FB018 /end MEASUREMENT
/begin MEASUREMENT i_CanID_u32.C_ClassUdsSendList01.UdsSendList "" ULONG ident 1 100 0 4294967295 ECU_ADDRESS 0x7F9014 /end MEASUREMENT
/begin MEASUREMENT i_CanID_u32.C_ClassUdsSendList02.UdsSendList "" ULONG ident 1 100 0 4294967295 ECU_ADDRESS 0x7F902C /end MEASUREMENT
/begin MEASUREMENT i_CanID_u32.C_ClassUdsSendList03.UdsSendList "" ULONG ident 1 100 0 4294967295 ECU_ADDRESS 0x7F9044 /end MEASUREMENT
/begin MEASUREMENT i_CanID_u32.C_ClassUdsSendList04.UdsSendList "" ULONG ident 1 100 0 4294967295 ECU_ADDRESS 0x7F905C /end MEASUREMENT
/begin MEASUREMENT i_CanID_u32.C_ClassUdsSendList05.UdsSendList "" ULONG ident 1 100 0 4294967295 ECU_ADDRESS 0x7F9074 /end MEASUREMENT
/begin MEASUREMENT i_CanID_u32.C_ClassUdsSendList06.UdsSendList "" ULONG ident 1 100 0 4294967295 ECU_ADDRESS 0x7F908C /end MEASUREMENT
/begin MEASUREMENT i_CanID_u32.C_ClassUdsSendList07.UdsSendList "" ULONG ident 1 100 0 4294967295 ECU_ADDRESS 0x7F90A4 /end MEASUREMENT
/begin MEASUREMENT i_CanID_u32.C_ClassUdsSendList08.UdsSendList "" ULONG ident 1 100 0 4294967295 ECU_ADDRESS 0x7F90BC /end MEASUREMENT
/begin MEASUREMENT i_CanID_u32.C_ClassUdsSendList09.UdsSendList "" ULONG ident 1 100 0 4294967295 ECU_ADDRESS 0x7F90D4 /end MEASUREMENT
/begin MEASUREMENT i_CanID_u32.C_ClassUdsSendList10.UdsSendList "" ULONG ident 1 100 0 4294967295 ECU_ADDRESS 0x7F90EC /end MEASUREMENT
/begin MEASUREMENT i_CanID_u32.C_ClassUdsSendList11.UdsSendList "" ULONG ident 1 100 0 4294967295 ECU_ADDRESS 0x7F9104 /end MEASUREMENT
/begin MEASUREMENT i_CanID_u32.C_ClassUdsSendList12.UdsSendList "" ULONG ident 1 100 0 4294967295 ECU_ADDRESS 0x7F911C /end MEASUREMENT
/begin MEASUREMENT i_CanID_u32.C_ClassUdsSendList13.UdsSendList "" ULONG ident 1 100 0 4294967295 ECU_ADDRESS 0x7F9134 /end MEASUREMENT
/begin MEASUREMENT i_CanID_u32.C_ClassUdsSendList14.UdsSendList "" ULONG ident 1 100 0 4294967295 ECU_ADDRESS 0x7F914C /end MEASUREMENT
/begin MEASUREMENT i_CanID_u32.C_ClassUdsSendList15.UdsSendList "" ULONG ident 1 100 0 4294967295 ECU_ADDRESS 0x7F9164 /end MEASUREMENT
/begin MEASUREMENT i_CanID_u32.C_ClassUdsSendList16.UdsSendList "" ULONG ident 1 100 0 4294967295 ECU_ADDRESS 0x7F917C /end MEASUREMENT
/begin MEASUREMENT i_CanID_u32.C_ClassUdsSendList17.UdsSendList "" ULONG ident 1 100 0 4294967295 ECU_ADDRESS 0x7F9194 /end MEASUREMENT
/begin MEASUREMENT i_CanID_u32.C_ClassUdsSendList18.UdsSendList "" ULONG ident 1 100 0 4294967295 ECU_ADDRESS 0x7F91AC /end MEASUREMENT
/begin MEASUREMENT i_CanID_u32.C_ClassUdsSendList19.UdsSendList "" ULONG ident 1 100 0 4294967295 ECU_ADDRESS 0x7F91C4 /end MEASUREMENT
/begin MEASUREMENT i_CanID_u32.C_ClassUdsSendList20.UdsSendList "" ULONG ident 1 100 0 4294967295 ECU_ADDRESS 0x7F91DC /end MEASUREMENT
/begin MEASUREMENT i_CanID_u32.C_ClassUdsSendList21.UdsSendList "" ULONG ident 1 100 0 4294967295 ECU_ADDRESS 0x7F91F4 /end MEASUREMENT
/begin MEASUREMENT i_CanID_u32.C_ClassUdsSendList22.UdsSendList "" ULONG ident 1 100 0 4294967295 ECU_ADDRESS 0x7F920C /end MEASUREMENT
/begin MEASUREMENT i_CanID_u32.C_ClassUdsSendList23.UdsSendList "" ULONG ident 1 100 0 4294967295 ECU_ADDRESS 0x7F9224 /end MEASUREMENT
/begin MEASUREMENT i_CanID_u32.C_ClassUdsSendList24.UdsSendList "" ULONG ident 1 100 0 4294967295 ECU_ADDRESS 0x7F923C /end MEASUREMENT
/begin MEASUREMENT i_ComMedium_u8.C_ClassDiagInfo.UDS_ISO14229 "" UBYTE ident 1 100 0 255 ECU_ADDRESS 0x7FB034 /end MEASUREMENT
/begin MEASUREMENT i_ComProtocol_u8.C_ClassDiagInfo.UDS_ISO14229 "" UBYTE ident 1 100 0 255 ECU_ADDRESS 0x7FB035 /end MEASUREMENT
/begin MEASUREMENT i_DiaMode_u8.C_ClassDiagInfo.UDS_ISO14229 "" UBYTE ident 1 100 0 255 ECU_ADDRESS 0x7FB036 /end MEASUREMENT
/begin MEASUREMENT i_LocalId_u16.C_ClassUdsVIN.UdsLocIDs "" UWORD ident 1 100 0 65535 ECU_ADDRESS 0x7F8F44 /end MEASUREMENT
/begin MEASUREMENT i_LocalId_u16.C_ClassUdsVIN2.UdsLocIDs "" UWORD ident 1 100 0 65535 ECU_ADDRESS 0x7F8FA0 /end MEASUREMENT
/begin MEASUREMENT i_LocalIdData_au8.C_ClassUdsVIN.UdsLocIDs "" ULONG ident 1 100 0 4294967295 ECU_ADDRESS 0x7F8EF0 MATRIX_DIM 20 1 1 /end MEASUREMENT
/begin MEASUREMENT i_LocalIdData_au8.C_ClassUdsVIN2.UdsLocIDs "" ULONG ident 1 100 0 4294967295 ECU_ADDRESS 0x7F8F4C MATRIX_DIM 20 1 1 /end MEASUREMENT
/begin MEASUREMENT i_LocalIds_pu32.C_ClassUdsVIN.UdsLocIDs "" ULONG ident 1 100 0 4294967295 ECU_ADDRESS 0x7F8F40 /end MEASUREMENT
/begin MEASUREMENT i_LocalIds_pu32.C_ClassUdsVIN2.UdsLocIDs "" ULONG ident 1 100 0 4294967295 ECU_ADDRESS 0x7F8F9C /end MEASUREMENT
/begin MEASUREMENT i_NumEntries_u8.C_ClassUdsSendList01.UdsSendList "" UBYTE ident 1 100 0 255 ECU_ADDRESS 0x7F901E /end MEASUREMENT
/begin MEASUREMENT i_NumEntries_u8.C_ClassUdsSendList02.UdsSendList "" UBYTE ident 1 100 0 255 ECU_ADDRESS 0x7F9036 /end MEASUREMENT
/begin MEASUREMENT i_NumEntries_u8.C_ClassUdsSendList03.UdsSendList "" UBYTE ident 1 100 0 255 ECU_ADDRESS 0x7F904E /end MEASUREMENT
/begin MEASUREMENT i_NumEntries_u8.C_ClassUdsSendList04.UdsSendList "" UBYTE ident 1 100 0 255 ECU_ADDRESS 0x7F9066 /end MEASUREMENT
/begin MEASUREMENT i_NumEntries_u8.C_ClassUdsSendList05.UdsSendList "" UBYTE ident 1 100 0 255 ECU_ADDRESS 0x7F907E /end MEASUREMENT
/begin MEASUREMENT i_NumEntries_u8.C_ClassUdsSendList06.UdsSendList "" UBYTE ident 1 100 0 255 ECU_ADDRESS 0x7F9096 /end MEASUREMENT
/begin MEASUREMENT i_NumEntries_u8.C_ClassUdsSendList07.UdsSendList "" UBYTE ident 1 100 0 255 ECU_ADDRESS 0x7F90AE /end MEASUREMENT
/begin MEASUREMENT i_NumEntries_u8.C_ClassUdsSendList08.UdsSendList "" UBYTE ident 1 100 0 255 ECU_ADDRESS 0x7F90C6 /end MEASUREMENT
/begin MEASUREMENT i_NumEntries_u8.C_ClassUdsSendList09.UdsSendList "" UBYTE ident 1 100 0 255 ECU_ADDRESS 0x7F90DE /end MEASUREMENT
/begin MEASUREMENT i_NumEntries_u8.C_ClassUdsSendList10.UdsSendList "" UBYTE ident 1 100 0 255 ECU_ADDRESS 0x7F90F6 /end MEASUREMENT
/begin MEASUREMENT i_NumEntries_u8.C_ClassUdsSendList11.UdsSendList "" UBYTE ident 1 100 0 255 ECU_ADDRESS 0x7F910E /end MEASUREMENT
/begin MEASUREMENT i_NumEntries_u8.C_ClassUdsSendList12.UdsSendList "" UBYTE ident 1 100 0 255 ECU_ADDRESS 0x7F9126 /end MEASUREMENT
/begin MEASUREMENT i_NumEntries_u8.C_ClassUdsSendList13.UdsSendList "" UBYTE ident 1 100 0 255 ECU_ADDRESS 0x7F913E /end MEASUREMENT
/begin MEASUREMENT i_NumEntries_u8.C_ClassUdsSendList14.UdsSendList "" UBYTE ident 1 100 0 255 ECU_ADDRESS 0x7F9156 /end MEASUREMENT
/begin MEASUREMENT i_NumEntries_u8.C_ClassUdsSendList15.UdsSendList "" UBYTE ident 1 100 0 255 ECU_ADDRESS 0x7F916E /end MEASUREMENT
/begin MEASUREMENT i_NumEntries_u8.C_ClassUdsSendList16.UdsSendList "" UBYTE ident 1 100 0 255 ECU_ADDRESS 0x7F9186 /end MEASUREMENT
/begin MEASUREMENT i_NumEntries_u8.C_ClassUdsSendList17.UdsSendList "" UBYTE ident 1 100 0 255 ECU_ADDRESS 0x7F919E /end MEASUREMENT
/begin MEASUREMENT i_NumEntries_u8.C_ClassUdsSendList18.UdsSendList "" UBYTE ident 1 100 0 255 ECU_ADDRESS 0x7F91B6 /end MEASUREMENT
/begin MEASUREMENT i_NumEntries_u8.C_ClassUdsSendList19.UdsSendList "" UBYTE ident 1 100 0 255 ECU_ADDRESS 0x7F91CE /end MEASUREMENT
/begin MEASUREMENT i_NumEntries_u8.C_ClassUdsSendList20.UdsSendList "" UBYTE ident 1 100 0 255 ECU_ADDRESS 0x7F91E6 /end MEASUREMENT
/begin MEASUREMENT i_NumEntries_u8.C_ClassUdsSendList21.UdsSendList "" UBYTE ident 1 100 0 255 ECU_ADDRESS 0x7F91FE /end MEASUREMENT
/begin MEASUREMENT i_NumEntries_u8.C_ClassUdsSendList22.UdsSendList "" UBYTE ident 1 100 0 255 ECU_ADDRESS 0x7F9216 /end MEASUREMENT
/begin MEASUREMENT i_NumEntries_u8.C_ClassUdsSendList23.UdsSendList "" UBYTE ident 1 100 0 255 ECU_ADDRESS 0x7F922E /end MEASUREMENT
/begin MEASUREMENT i_NumEntries_u8.C_ClassUdsSendList24.UdsSendList "" UBYTE ident 1 100 0 255 ECU_ADDRESS 0x7F9246 /end MEASUREMENT
/begin MEASUREMENT i_P2max_u32.C_ClassDiagInfo.UDS_ISO14229 "" ULONG ident 1 100 0 4294967295 ECU_ADDRESS 0x7FB01C /end MEASUREMENT
/begin MEASUREMENT i_P2min_u32.C_ClassDiagInfo.UDS_ISO14229 "" ULONG ident 1 100 0 4294967295 ECU_ADDRESS 0x7FB020 /end MEASUREMENT
/begin MEASUREMENT i_P3max_u32.C_ClassDiagInfo.UDS_ISO14229 "" ULONG ident 1 100 0 4294967295 ECU_ADDRESS 0x7FB024 /end MEASUREMENT
/begin MEASUREMENT i_P3min_u32.C_ClassDiagInfo.UDS_ISO14229 "" ULONG ident 1 100 0 4294967295 ECU_ADDRESS 0x7FB028 /end MEASUREMENT
/begin MEASUREMENT i_P4min_u32.C_ClassDiagInfo.UDS_ISO14229 "" ULONG ident 1 100 0 4294967295 ECU_ADDRESS 0x7FB02C /end MEASUREMENT
/begin MEASUREMENT i_PeriodicID_u16.C_ClassUdsSendList01.UdsSendList "" UWORD ident 1 100 0 65535 ECU_ADDRESS 0x7F901C /end MEASUREMENT
/begin MEASUREMENT i_PeriodicID_u16.C_ClassUdsSendList02.UdsSendList "" UWORD ident 1 100 0 65535 ECU_ADDRESS 0x7F9034 /end MEASUREMENT
/begin MEASUREMENT i_PeriodicID_u16.C_ClassUdsSendList03.UdsSendList "" UWORD ident 1 100 0 65535 ECU_ADDRESS 0x7F904C /end MEASUREMENT
/begin MEASUREMENT i_PeriodicID_u16.C_ClassUdsSendList04.UdsSendList "" UWORD ident 1 100 0 65535 ECU_ADDRESS 0x7F9064 /end MEASUREMENT
/begin MEASUREMENT i_PeriodicID_u16.C_ClassUdsSendList05.UdsSendList "" UWORD ident 1 100 0 65535 ECU_ADDRESS 0x7F907C /end MEASUREMENT
/begin MEASUREMENT i_PeriodicID_u16.C_ClassUdsSendList06.UdsSendList "" UWORD ident 1 100 0 65535 ECU_ADDRESS 0x7F9094 /end MEASUREMENT
/begin MEASUREMENT i_PeriodicID_u16.C_ClassUdsSendList07.UdsSendList "" UWORD ident 1 100 0 65535 ECU_ADDRESS 0x7F90AC /end MEASUREMENT
/begin MEASUREMENT i_PeriodicID_u16.C_ClassUdsSendList08.UdsSendList "" UWORD ident 1 100 0 65535 ECU_ADDRESS 0x7F90C4 /end MEASUREMENT
/begin MEASUREMENT i_PeriodicID_u16.C_ClassUdsSendList09.UdsSendList "" UWORD ident 1 100 0 65535 ECU_ADDRESS 0x7F90DC /end MEASUREMENT
/begin MEASUREMENT i_PeriodicID_u16.C_ClassUdsSendList10.UdsSendList "" UWORD ident 1 100 0 65535 ECU_ADDRESS 0x7F90F4 /end MEASUREMENT
/begin MEASUREMENT i_PeriodicID_u16.C_ClassUdsSendList11.UdsSendList "" UWORD ident 1 100 0 65535 ECU_ADDRESS 0x7F910C /end MEASUREMENT
/begin MEASUREMENT i_PeriodicID_u16.C_ClassUdsSendList12.UdsSendList "" UWORD ident 1 100 0 65535 ECU_ADDRESS 0x7F9124 /end MEASUREMENT
/begin MEASUREMENT i_PeriodicID_u16.C_ClassUdsSendList13.UdsSendList "" UWORD ident 1 100 0 65535 ECU_ADDRESS 0x7F913C /end MEASUREMENT
/begin MEASUREMENT i_PeriodicID_u16.C_ClassUdsSendList14.UdsSendList "" UWORD ident 1 100 0 65535 ECU_ADDRESS 0x7F9154 /end MEASUREMENT
/begin MEASUREMENT i_PeriodicID_u16.C_ClassUdsSendList15.UdsSendList "" UWORD ident 1 100 0 65535 ECU_ADDRESS 0x7F916C /end MEASUREMENT
/begin MEASUREMENT i_PeriodicID_u16.C_ClassUdsSendList16.UdsSendList "" UWORD ident 1 100 0 65535 ECU_ADDRESS 0x7F9184 /end MEASUREMENT
/begin MEASUREMENT i_PeriodicID_u16.C_ClassUdsSendList17.UdsSendList "" UWORD ident 1 100 0 65535 ECU_ADDRESS 0x7F919C /end MEASUREMENT
/begin MEASUREMENT i_PeriodicID_u16.C_ClassUdsSendList18.UdsSendList "" UWORD ident 1 100 0 65535 ECU_ADDRESS 0x7F91B4 /end MEASUREMENT
/begin MEASUREMENT i_PeriodicID_u16.C_ClassUdsSendList19.UdsSendList "" UWORD ident 1 100 0 65535 ECU_ADDRESS 0x7F91CC /end MEASUREMENT
/begin MEASUREMENT i_PeriodicID_u16.C_ClassUdsSendList20.UdsSendList "" UWORD ident 1 100 0 65535 ECU_ADDRESS 0x7F91E4 /end MEASUREMENT
/begin MEASUREMENT i_PeriodicID_u16.C_ClassUdsSendList21.UdsSendList "" UWORD ident 1 100 0 65535 ECU_ADDRESS 0x7F91FC /end MEASUREMENT
/begin MEASUREMENT i_PeriodicID_u16.C_ClassUdsSendList22.UdsSendList "" UWORD ident 1 100 0 65535 ECU_ADDRESS 0x7F9214 /end MEASUREMENT
/begin MEASUREMENT i_PeriodicID_u16.C_ClassUdsSendList23.UdsSendList "" UWORD ident 1 100 0 65535 ECU_ADDRESS 0x7F922C /end MEASUREMENT
/begin MEASUREMENT i_PeriodicID_u16.C_ClassUdsSendList24.UdsSendList "" UWORD ident 1 100 0 65535 ECU_ADDRESS 0x7F9244 /end MEASUREMENT
/begin MEASUREMENT i_PhysEcuAddr_u8.C_ClassDiagInfo.UDS_ISO14229 "" UBYTE ident 1 100 0 255 ECU_ADDRESS 0x7FB037 /end MEASUREMENT
/begin MEASUREMENT i_RasterMode_u8.C_ClassUdsSendList01.UdsSendList "" UBYTE ident 1 100 0 255 ECU_ADDRESS 0x7F901F /end MEASUREMENT
/begin MEASUREMENT i_RasterMode_u8.C_ClassUdsSendList02.UdsSendList "" UBYTE ident 1 100 0 255 ECU_ADDRESS 0x7F9037 /end MEASUREMENT
/begin MEASUREMENT i_RasterMode_u8.C_ClassUdsSendList03.UdsSendList "" UBYTE ident 1 100 0 255 ECU_ADDRESS 0x7F904F /end MEASUREMENT
/begin MEASUREMENT i_RasterMode_u8.C_ClassUdsSendList04.UdsSendList "" UBYTE ident 1 100 0 255 ECU_ADDRESS 0x7F9067 /end MEASUREMENT
/begin MEASUREMENT i_RasterMode_u8.C_ClassUdsSendList05.UdsSendList "" UBYTE ident 1 100 0 255 ECU_ADDRESS 0x7F907F /end MEASUREMENT
/begin MEASUREMENT i_RasterMode_u8.C_ClassUdsSendList06.UdsSendList "" UBYTE ident 1 100 0 255 ECU_ADDRESS 0x7F9097 /end MEASUREMENT
/begin MEASUREMENT i_RasterMode_u8.C_ClassUdsSendList07.UdsSendList "" UBYTE ident 1 100 0 255 ECU_ADDRESS 0x7F90AF /end MEASUREMENT
/begin MEASUREMENT i_RasterMode_u8.C_ClassUdsSendList08.UdsSendList "" UBYTE ident 1 100 0 255 ECU_ADDRESS 0x7F90C7 /end MEASUREMENT
/begin MEASUREMENT i_RasterMode_u8.C_ClassUdsSendList09.UdsSendList "" UBYTE ident 1 100 0 255 ECU_ADDRESS 0x7F90DF /end MEASUREMENT
/begin MEASUREMENT i_RasterMode_u8.C_ClassUdsSendList10.UdsSendList "" UBYTE ident 1 100 0 255 ECU_ADDRESS 0x7F90F7 /end MEASUREMENT
/begin MEASUREMENT i_RasterMode_u8.C_ClassUdsSendList11.UdsSendList "" UBYTE ident 1 100 0 255 ECU_ADDRESS 0x7F910F /end MEASUREMENT
/begin MEASUREMENT i_RasterMode_u8.C_ClassUdsSendList12.UdsSendList "" UBYTE ident 1 100 0 255 ECU_ADDRESS 0x7F9127 /end MEASUREMENT
/begin MEASUREMENT i_RasterMode_u8.C_ClassUdsSendList13.UdsSendList "" UBYTE ident 1 100 0 255 ECU_ADDRESS 0x7F913F /end MEASUREMENT
/begin MEASUREMENT i_RasterMode_u8.C_ClassUdsSendList14.UdsSendList "" UBYTE ident 1 100 0 255 ECU_ADDRESS 0x7F9157 /end MEASUREMENT
/begin MEASUREMENT i_RasterMode_u8.C_ClassUdsSendList15.UdsSendList "" UBYTE ident 1 100 0 255 ECU_ADDRESS 0x7F916F /end MEASUREMENT
/begin MEASUREMENT i_RasterMode_u8.C_ClassUdsSendList16.UdsSendList "" UBYTE ident 1 100 0 255 ECU_ADDRESS 0x7F9187 /end MEASUREMENT
/begin MEASUREMENT i_RasterMode_u8.C_ClassUdsSendList17.UdsSendList "" UBYTE ident 1 100 0 255 ECU_ADDRESS 0x7F919F /end MEASUREMENT
/begin MEASUREMENT i_RasterMode_u8.C_ClassUdsSendList18.UdsSendList "" UBYTE ident 1 100 0 255 ECU_ADDRESS 0x7F91B7 /end MEASUREMENT
/begin MEASUREMENT i_RasterMode_u8.C_ClassUdsSendList19.UdsSendList "" UBYTE ident 1 100 0 255 ECU_ADDRESS 0x7F91CF /end MEASUREMENT
/begin MEASUREMENT i_RasterMode_u8.C_ClassUdsSendList20.UdsSendList "" UBYTE ident 1 100 0 255 ECU_ADDRESS 0x7F91E7 /end MEASUREMENT
/begin MEASUREMENT i_RasterMode_u8.C_ClassUdsSendList21.UdsSendList "" UBYTE ident 1 100 0 255 ECU_ADDRESS 0x7F91FF /end MEASUREMENT
/begin MEASUREMENT i_RasterMode_u8.C_ClassUdsSendList22.UdsSendList "" UBYTE ident 1 100 0 255 ECU_ADDRESS 0x7F9217 /end MEASUREMENT
/begin MEASUREMENT i_RasterMode_u8.C_ClassUdsSendList23.UdsSendList "" UBYTE ident 1 100 0 255 ECU_ADDRESS 0x7F922F /end MEASUREMENT
/begin MEASUREMENT i_RasterMode_u8.C_ClassUdsSendList24.UdsSendList "" UBYTE ident 1 100 0 255 ECU_ADDRESS 0x7F9247 /end MEASUREMENT
/begin MEASUREMENT i_ReqBdRate_u32.C_ClassDiagInfo.UDS_ISO14229 "" ULONG ident 1 100 0 4294967295 ECU_ADDRESS 0x7FB030 /end MEASUREMENT
/begin MEASUREMENT i_ResponceType_u8.C_ClassUdsSendList01.UdsSendList "" UBYTE ident 1 100 0 255 ECU_ADDRESS 0x7F9020 /end MEASUREMENT
/begin MEASUREMENT i_ResponceType_u8.C_ClassUdsSendList02.UdsSendList "" UBYTE ident 1 100 0 255 ECU_ADDRESS 0x7F9038 /end MEASUREMENT
/begin MEASUREMENT i_ResponceType_u8.C_ClassUdsSendList03.UdsSendList "" UBYTE ident 1 100 0 255 ECU_ADDRESS 0x7F9050 /end MEASUREMENT
/begin MEASUREMENT i_ResponceType_u8.C_ClassUdsSendList04.UdsSendList "" UBYTE ident 1 100 0 255 ECU_ADDRESS 0x7F9068 /end MEASUREMENT
/begin MEASUREMENT i_ResponceType_u8.C_ClassUdsSendList05.UdsSendList "" UBYTE ident 1 100 0 255 ECU_ADDRESS 0x7F9080 /end MEASUREMENT
/begin MEASUREMENT i_ResponceType_u8.C_ClassUdsSendList06.UdsSendList "" UBYTE ident 1 100 0 255 ECU_ADDRESS 0x7F9098 /end MEASUREMENT
/begin MEASUREMENT i_ResponceType_u8.C_ClassUdsSendList07.UdsSendList "" UBYTE ident 1 100 0 255 ECU_ADDRESS 0x7F90B0 /end MEASUREMENT
/begin MEASUREMENT i_ResponceType_u8.C_ClassUdsSendList08.UdsSendList "" UBYTE ident 1 100 0 255 ECU_ADDRESS 0x7F90C8 /end MEASUREMENT
/begin MEASUREMENT i_ResponceType_u8.C_ClassUdsSendList09.UdsSendList "" UBYTE ident 1 100 0 255 ECU_ADDRESS 0x7F90E0 /end MEASUREMENT
/begin MEASUREMENT i_ResponceType_u8.C_ClassUdsSendList10.UdsSendList "" UBYTE ident 1 100 0 255 ECU_ADDRESS 0x7F90F8 /end MEASUREMENT
/begin MEASUREMENT i_ResponceType_u8.C_ClassUdsSendList11.UdsSendList "" UBYTE ident 1 100 0 255 ECU_ADDRESS 0x7F9110 /end MEASUREMENT
/begin MEASUREMENT i_ResponceType_u8.C_ClassUdsSendList12.UdsSendList "" UBYTE ident 1 100 0 255 ECU_ADDRESS 0x7F9128 /end MEASUREMENT
/begin MEASUREMENT i_ResponceType_u8.C_ClassUdsSendList13.UdsSendList "" UBYTE ident 1 100 0 255 ECU_ADDRESS 0x7F9140 /end MEASUREMENT
/begin MEASUREMENT i_ResponceType_u8.C_ClassUdsSendList14.UdsSendList "" UBYTE ident 1 100 0 255 ECU_ADDRESS 0x7F9158 /end MEASUREMENT
/begin MEASUREMENT i_ResponceType_u8.C_ClassUdsSendList15.UdsSendList "" UBYTE ident 1 100 0 255 ECU_ADDRESS 0x7F9170 /end MEASUREMENT
/begin MEASUREMENT i_ResponceType_u8.C_ClassUdsSendList16.UdsSendList "" UBYTE ident 1 100 0 255 ECU_ADDRESS 0x7F9188 /end MEASUREMENT
/begin MEASUREMENT i_ResponceType_u8.C_ClassUdsSendList17.UdsSendList "" UBYTE ident 1 100 0 255 ECU_ADDRESS 0x7F91A0 /end MEASUREMENT
/begin MEASUREMENT i_ResponceType_u8.C_ClassUdsSendList18.UdsSendList "" UBYTE ident 1 100 0 255 ECU_ADDRESS 0x7F91B8 /end MEASUREMENT
/begin MEASUREMENT i_ResponceType_u8.C_ClassUdsSendList19.UdsSendList "" UBYTE ident 1 100 0 255 ECU_ADDRESS 0x7F91D0 /end MEASUREMENT
/begin MEASUREMENT i_ResponceType_u8.C_ClassUdsSendList20.UdsSendList "" UBYTE ident 1 100 0 255 ECU_ADDRESS 0x7F91E8 /end MEASUREMENT
/begin MEASUREMENT i_ResponceType_u8.C_ClassUdsSendList21.UdsSendList "" UBYTE ident 1 100 0 255 ECU_ADDRESS 0x7F9200 /end MEASUREMENT
/begin MEASUREMENT i_ResponceType_u8.C_ClassUdsSendList22.UdsSendList "" UBYTE ident 1 100 0 255 ECU_ADDRESS 0x7F9218 /end MEASUREMENT
/begin MEASUREMENT i_ResponceType_u8.C_ClassUdsSendList23.UdsSendList "" UBYTE ident 1 100 0 255 ECU_ADDRESS 0x7F9230 /end MEASUREMENT
/begin MEASUREMENT i_ResponceType_u8.C_ClassUdsSendList24.UdsSendList "" UBYTE ident 1 100 0 255 ECU_ADDRESS 0x7F9248 /end MEASUREMENT
/begin MEASUREMENT i_SampleBuf_au8.C_ClassUdsSendList01.UdsSendList "" UBYTE ident 1 100 0 255 ECU_ADDRESS 0x7F9021 MATRIX_DIM 9 1 1 /end MEASUREMENT
/begin MEASUREMENT i_SampleBuf_au8.C_ClassUdsSendList02.UdsSendList "" UBYTE ident 1 100 0 255 ECU_ADDRESS 0x7F9039 MATRIX_DIM 9 1 1 /end MEASUREMENT
/begin MEASUREMENT i_SampleBuf_au8.C_ClassUdsSendList03.UdsSendList "" UBYTE ident 1 100 0 255 ECU_ADDRESS 0x7F9051 MATRIX_DIM 9 1 1 /end MEASUREMENT
/begin MEASUREMENT i_SampleBuf_au8.C_ClassUdsSendList04.UdsSendList "" UBYTE ident 1 100 0 255 ECU_ADDRESS 0x7F9069 MATRIX_DIM 9 1 1 /end MEASUREMENT
/begin MEASUREMENT i_SampleBuf_au8.C_ClassUdsSendList05.UdsSendList "" UBYTE ident 1 100 0 255 ECU_ADDRESS 0x7F9081 MATRIX_DIM 9 1 1 /end MEASUREMENT
/begin MEASUREMENT i_SampleBuf_au8.C_ClassUdsSendList06.UdsSendList "" UBYTE ident 1 100 0 255 ECU_ADDRESS 0x7F9099 MATRIX_DIM 9 1 1 /end MEASUREMENT
/begin MEASUREMENT i_SampleBuf_au8.C_ClassUdsSendList07.UdsSendList "" UBYTE ident 1 100 0 255 ECU_ADDRESS 0x7F90B1 MATRIX_DIM 9 1 1 /end MEASUREMENT
/begin MEASUREMENT i_SampleBuf_au8.C_ClassUdsSendList08.UdsSendList "" UBYTE ident 1 100 0 255 ECU_ADDRESS 0x7F90C9 MATRIX_DIM 9 1 1 /end MEASUREMENT
/begin MEASUREMENT i_SampleBuf_au8.C_ClassUdsSendList09.UdsSendList "" UBYTE ident 1 100 0 255 ECU_ADDRESS 0x7F90E1 MATRIX_DIM 9 1 1 /end MEASUREMENT
/begin MEASUREMENT i_SampleBuf_au8.C_ClassUdsSendList10.UdsSendList "" UBYTE ident 1 100 0 255 ECU_ADDRESS 0x7F90F9 MATRIX_DIM 9 1 1 /end MEASUREMENT
/begin MEASUREMENT i_SampleBuf_au8.C_ClassUdsSendList11.UdsSendList "" UBYTE ident 1 100 0 255 ECU_ADDRESS 0x7F9111 MATRIX_DIM 9 1 1 /end MEASUREMENT
/begin MEASUREMENT i_SampleBuf_au8.C_ClassUdsSendList12.UdsSendList "" UBYTE ident 1 100 0 255 ECU_ADDRESS 0x7F9129 MATRIX_DIM 9 1 1 /end MEASUREMENT
/begin MEASUREMENT i_SampleBuf_au8.C_ClassUdsSendList13.UdsSendList "" UBYTE ident 1 100 0 255 ECU_ADDRESS 0x7F9141 MATRIX_DIM 9 1 1 /end MEASUREMENT
/begin MEASUREMENT i_SampleBuf_au8.C_ClassUdsSendList14.UdsSendList "" UBYTE ident 1 100 0 255 ECU_ADDRESS 0x7F9159 MATRIX_DIM 9 1 1 /end MEASUREMENT
/begin MEASUREMENT i_SampleBuf_au8.C_ClassUdsSendList15.UdsSendList "" UBYTE ident 1 100 0 255 ECU_ADDRESS 0x7F9171 MATRIX_DIM 9 1 1 /end MEASUREMENT
/begin MEASUREMENT i_SampleBuf_au8.C_ClassUdsSendList16.UdsSendList "" UBYTE ident 1 100 0 255 ECU_ADDRESS 0x7F9189 MATRIX_DIM 9 1 1 /end MEASUREMENT
/begin MEASUREMENT i_SampleBuf_au8.C_ClassUdsSendList17.UdsSendList "" UBYTE ident 1 100 0 255 ECU_ADDRESS 0x7F91A1 MATRIX_DIM 9 1 1 /end MEASUREMENT
/begin MEASUREMENT i_SampleBuf_au8.C_ClassUdsSendList18.UdsSendList "" UBYTE ident 1 100 0 255 ECU_ADDRESS 0x7F91B9 MATRIX_DIM 9 1 1 /end MEASUREMENT
/begin MEASUREMENT i_SampleBuf_au8.C_ClassUdsSendList19.UdsSendList "" UBYTE ident 1 100 0 255 ECU_ADDRESS 0x7F91D1 MATRIX_DIM 9 1 1 /end MEASUREMENT
/begin MEASUREMENT i_SampleBuf_au8.C_ClassUdsSendList20.UdsSendList "" UBYTE ident 1 100 0 255 ECU_ADDRESS 0x7F91E9 MATRIX_DIM 9 1 1 /end MEASUREMENT
/begin MEASUREMENT i_SampleBuf_au8.C_ClassUdsSendList21.UdsSendList "" UBYTE ident 1 100 0 255 ECU_ADDRESS 0x7F9201 MATRIX_DIM 9 1 1 /end MEASUREMENT
/begin MEASUREMENT i_SampleBuf_au8.C_ClassUdsSendList22.UdsSendList "" UBYTE ident 1 100 0 255 ECU_ADDRESS 0x7F9219 MATRIX_DIM 9 1 1 /end MEASUREMENT
/begin MEASUREMENT i_SampleBuf_au8.C_ClassUdsSendList23.UdsSendList "" UBYTE ident 1 100 0 255 ECU_ADDRESS 0x7F9231 MATRIX_DIM 9 1 1 /end MEASUREMENT
/begin MEASUREMENT i_SampleBuf_au8.C_ClassUdsSendList24.UdsSendList "" UBYTE ident 1 100 0 255 ECU_ADDRESS 0x7F9249 MATRIX_DIM 9 1 1 /end MEASUREMENT
/begin MEASUREMENT i_SecLevel_u8.C_ClassDiagInfo.UDS_ISO14229 "" UBYTE ident 1 100 0 255 ECU_ADDRESS 0x7FB038 /end MEASUREMENT
/begin MEASUREMENT i_StimuAddr_u8.C_ClassDiagInfo.UDS_ISO14229 "" UBYTE ident 1 100 0 255 ECU_ADDRESS 0x7FB03A /end MEASUREMENT
/begin MEASUREMENT i_StimuAddrMode_u8.C_ClassDiagInfo.UDS_ISO14229 "" UBYTE ident 1 100 0 255 ECU_ADDRESS 0x7FB039 /end MEASUREMENT
/begin MEASUREMENT i_UdsDaqList_pu32.C_ClassUdsSendList01.UdsSendList "" ULONG ident 1 100 0 4294967295 ECU_ADDRESS 0x7F9018 /end MEASUREMENT
/begin MEASUREMENT i_UdsDaqList_pu32.C_ClassUdsSendList02.UdsSendList "" ULONG ident 1 100 0 4294967295 ECU_ADDRESS 0x7F9030 /end MEASUREMENT
/begin MEASUREMENT i_UdsDaqList_pu32.C_ClassUdsSendList03.UdsSendList "" ULONG ident 1 100 0 4294967295 ECU_ADDRESS 0x7F9048 /end MEASUREMENT
/begin MEASUREMENT i_UdsDaqList_pu32.C_ClassUdsSendList04.UdsSendList "" ULONG ident 1 100 0 4294967295 ECU_ADDRESS 0x7F9060 /end MEASUREMENT
/begin MEASUREMENT i_UdsDaqList_pu32.C_ClassUdsSendList05.UdsSendList "" ULONG ident 1 100 0 4294967295 ECU_ADDRESS 0x7F9078 /end MEASUREMENT
/begin MEASUREMENT i_UdsDaqList_pu32.C_ClassUdsSendList06.UdsSendList "" ULONG ident 1 100 0 4294967295 ECU_ADDRESS 0x7F9090 /end MEASUREMENT
/begin MEASUREMENT i_UdsDaqList_pu32.C_ClassUdsSendList07.UdsSendList "" ULONG ident 1 100 0 4294967295 ECU_ADDRESS 0x7F90A8 /end MEASUREMENT
/begin MEASUREMENT i_UdsDaqList_pu32.C_ClassUdsSendList08.UdsSendList "" ULONG ident 1 100 0 4294967295 ECU_ADDRESS 0x7F90C0 /end MEASUREMENT
/begin MEASUREMENT i_UdsDaqList_pu32.C_ClassUdsSendList09.UdsSendList "" ULONG ident 1 100 0 4294967295 ECU_ADDRESS 0x7F90D8 /end MEASUREMENT
/begin MEASUREMENT i_UdsDaqList_pu32.C_ClassUdsSendList10.UdsSendList "" ULONG ident 1 100 0 4294967295 ECU_ADDRESS 0x7F90F0 /end MEASUREMENT
/begin MEASUREMENT i_UdsDaqList_pu32.C_ClassUdsSendList11.UdsSendList "" ULONG ident 1 100 0 4294967295 ECU_ADDRESS 0x7F9108 /end MEASUREMENT
/begin MEASUREMENT i_UdsDaqList_pu32.C_ClassUdsSendList12.UdsSendList "" ULONG ident 1 100 0 4294967295 ECU_ADDRESS 0x7F9120 /end MEASUREMENT
/begin MEASUREMENT i_UdsDaqList_pu32.C_ClassUdsSendList13.UdsSendList "" ULONG ident 1 100 0 4294967295 ECU_ADDRESS 0x7F9138 /end MEASUREMENT
/begin MEASUREMENT i_UdsDaqList_pu32.C_ClassUdsSendList14.UdsSendList "" ULONG ident 1 100 0 4294967295 ECU_ADDRESS 0x7F9150 /end MEASUREMENT
/begin MEASUREMENT i_UdsDaqList_pu32.C_ClassUdsSendList15.UdsSendList "" ULONG ident 1 100 0 4294967295 ECU_ADDRESS 0x7F9168 /end MEASUREMENT
/begin MEASUREMENT i_UdsDaqList_pu32.C_ClassUdsSendList16.UdsSendList "" ULONG ident 1 100 0 4294967295 ECU_ADDRESS 0x7F9180 /end MEASUREMENT
/begin MEASUREMENT i_UdsDaqList_pu32.C_ClassUdsSendList17.UdsSendList "" ULONG ident 1 100 0 4294967295 ECU_ADDRESS 0x7F9198 /end MEASUREMENT
/begin MEASUREMENT i_UdsDaqList_pu32.C_ClassUdsSendList18.UdsSendList "" ULONG ident 1 100 0 4294967295 ECU_ADDRESS 0x7F91B0 /end MEASUREMENT
/begin MEASUREMENT i_UdsDaqList_pu32.C_ClassUdsSendList19.UdsSendList "" ULONG ident 1 100 0 4294967295 ECU_ADDRESS 0x7F91C8 /end MEASUREMENT
/begin MEASUREMENT i_UdsDaqList_pu32.C_ClassUdsSendList20.UdsSendList "" ULONG ident 1 100 0 4294967295 ECU_ADDRESS 0x7F91E0 /end MEASUREMENT
/begin MEASUREMENT i_UdsDaqList_pu32.C_ClassUdsSendList21.UdsSendList "" ULONG ident 1 100 0 4294967295 ECU_ADDRESS 0x7F91F8 /end MEASUREMENT
/begin MEASUREMENT i_UdsDaqList_pu32.C_ClassUdsSendList22.UdsSendList "" ULONG ident 1 100 0 4294967295 ECU_ADDRESS 0x7F9210 /end MEASUREMENT
/begin MEASUREMENT i_UdsDaqList_pu32.C_ClassUdsSendList23.UdsSendList "" ULONG ident 1 100 0 4294967295 ECU_ADDRESS 0x7F9228 /end MEASUREMENT
/begin MEASUREMENT i_UdsDaqList_pu32.C_ClassUdsSendList24.UdsSendList "" ULONG ident 1 100 0 4294967295 ECU_ADDRESS 0x7F9240 /end MEASUREMENT
/begin MEASUREMENT i_UdsSendListState_u8.C_ClassUdsSendList01.UdsSendList "" UBYTE enum_UDS_SENDLISTSTATE_E 1 100 0 2 ECU_ADDRESS 0x7F902A /end MEASUREMENT
/begin MEASUREMENT i_UdsSendListState_u8.C_ClassUdsSendList02.UdsSendList "" UBYTE enum_UDS_SENDLISTSTATE_E 1 100 0 2 ECU_ADDRESS 0x7F9042 /end MEASUREMENT
/begin MEASUREMENT i_UdsSendListState_u8.C_ClassUdsSendList03.UdsSendList "" UBYTE enum_UDS_SENDLISTSTATE_E 1 100 0 2 ECU_ADDRESS 0x7F905A /end MEASUREMENT
/begin MEASUREMENT i_UdsSendListState_u8.C_ClassUdsSendList04.UdsSendList "" UBYTE enum_UDS_SENDLISTSTATE_E 1 100 0 2 ECU_ADDRESS 0x7F9072 /end MEASUREMENT
/begin MEASUREMENT i_UdsSendListState_u8.C_ClassUdsSendList05.UdsSendList "" UBYTE enum_UDS_SENDLISTSTATE_E 1 100 0 2 ECU_ADDRESS 0x7F908A /end MEASUREMENT
/begin MEASUREMENT i_UdsSendListState_u8.C_ClassUdsSendList06.UdsSendList "" UBYTE enum_UDS_SENDLISTSTATE_E 1 100 0 2 ECU_ADDRESS 0x7F90A2 /end MEASUREMENT
/begin MEASUREMENT i_UdsSendListState_u8.C_ClassUdsSendList07.UdsSendList "" UBYTE enum_UDS_SENDLISTSTATE_E 1 100 0 2 ECU_ADDRESS 0x7F90BA /end MEASUREMENT
/begin MEASUREMENT i_UdsSendListState_u8.C_ClassUdsSendList08.UdsSendList "" UBYTE enum_UDS_SENDLISTSTATE_E 1 100 0 2 ECU_ADDRESS 0x7F90D2 /end MEASUREMENT
/begin MEASUREMENT i_UdsSendListState_u8.C_ClassUdsSendList09.UdsSendList "" UBYTE enum_UDS_SENDLISTSTATE_E 1 100 0 2 ECU_ADDRESS 0x7F90EA /end MEASUREMENT
/begin MEASUREMENT i_UdsSendListState_u8.C_ClassUdsSendList10.UdsSendList "" UBYTE enum_UDS_SENDLISTSTATE_E 1 100 0 2 ECU_ADDRESS 0x7F9102 /end MEASUREMENT
/begin MEASUREMENT i_UdsSendListState_u8.C_ClassUdsSendList11.UdsSendList "" UBYTE enum_UDS_SENDLISTSTATE_E 1 100 0 2 ECU_ADDRESS 0x7F911A /end MEASUREMENT
/begin MEASUREMENT i_UdsSendListState_u8.C_ClassUdsSendList12.UdsSendList "" UBYTE enum_UDS_SENDLISTSTATE_E 1 100 0 2 ECU_ADDRESS 0x7F9132 /end MEASUREMENT
/begin MEASUREMENT i_UdsSendListState_u8.C_ClassUdsSendList13.UdsSendList "" UBYTE enum_UDS_SENDLISTSTATE_E 1 100 0 2 ECU_ADDRESS 0x7F914A /end MEASUREMENT
/begin MEASUREMENT i_UdsSendListState_u8.C_ClassUdsSendList14.UdsSendList "" UBYTE enum_UDS_SENDLISTSTATE_E 1 100 0 2 ECU_ADDRESS 0x7F9162 /end MEASUREMENT
/begin MEASUREMENT i_UdsSendListState_u8.C_ClassUdsSendList15.UdsSendList "" UBYTE enum_UDS_SENDLISTSTATE_E 1 100 0 2 ECU_ADDRESS 0x7F917A /end MEASUREMENT
/begin MEASUREMENT i_UdsSendListState_u8.C_ClassUdsSendList16.UdsSendList "" UBYTE enum_UDS_SENDLISTSTATE_E 1 100 0 2 ECU_ADDRESS 0x7F9192 /end MEASUREMENT
/begin MEASUREMENT i_UdsSendListState_u8.C_ClassUdsSendList17.UdsSendList "" UBYTE enum_UDS_SENDLISTSTATE_E 1 100 0 2 ECU_ADDRESS 0x7F91AA /end MEASUREMENT
/begin MEASUREMENT i_UdsSendListState_u8.C_ClassUdsSendList18.UdsSendList "" UBYTE enum_UDS_SENDLISTSTATE_E 1 100 0 2 ECU_ADDRESS 0x7F91C2 /end MEASUREMENT
/begin MEASUREMENT i_UdsSendListState_u8.C_ClassUdsSendList19.UdsSendList "" UBYTE enum_UDS_SENDLISTSTATE_E 1 100 0 2 ECU_ADDRESS 0x7F91DA /end MEASUREMENT
/begin MEASUREMENT i_UdsSendListState_u8.C_ClassUdsSendList20.UdsSendList "" UBYTE enum_UDS_SENDLISTSTATE_E 1 100 0 2 ECU_ADDRESS 0x7F91F2 /end MEASUREMENT
/begin MEASUREMENT i_UdsSendListState_u8.C_ClassUdsSendList21.UdsSendList "" UBYTE enum_UDS_SENDLISTSTATE_E 1 100 0 2 ECU_ADDRESS 0x7F920A /end MEASUREMENT
/begin MEASUREMENT i_UdsSendListState_u8.C_ClassUdsSendList22.UdsSendList "" UBYTE enum_UDS_SENDLISTSTATE_E 1 100 0 2 ECU_ADDRESS 0x7F9222 /end MEASUREMENT
/begin MEASUREMENT i_UdsSendListState_u8.C_ClassUdsSendList23.UdsSendList "" UBYTE enum_UDS_SENDLISTSTATE_E 1 100 0 2 ECU_ADDRESS 0x7F923A /end MEASUREMENT
/begin MEASUREMENT i_UdsSendListState_u8.C_ClassUdsSendList24.UdsSendList "" UBYTE enum_UDS_SENDLISTSTATE_E 1 100 0 2 ECU_ADDRESS 0x7F9252 /end MEASUREMENT
/begin MEASUREMENT Index_x.Cal_Measure_Blocks "" UBYTE ident 1 100 0 255 ECU_ADDRESS 0x7FB080 DISPLAY_IDENTIFIER Index_x.Cal_Measure_Blocks_DISP_ID /end MEASUREMENT
/begin MEASUREMENT Index_y.Cal_Measure_Blocks "" UBYTE ident 1 100 0 255 ECU_ADDRESS 0x7FB081 DISPLAY_IDENTIFIER Index_y.Cal_Measure_Blocks_DISP_ID /end MEASUREMENT
/begin MEASUREMENT input_array.Curve_Calc_16.Curve_Module "" UWORD ident 1 100 0.0 65535.0 ECU_ADDRESS 0x7F857C MATRIX_DIM 10 1 1 /end MEASUREMENT
/begin MEASUREMENT l_ResetTimer_b.DAQ2_Sample.CCP_SHELL "" UBYTE ident 1 100 0 1 BIT_MASK 0x1 ECU_ADDRESS 0x7F8530 /end MEASUREMENT
/begin MEASUREMENT l_ResetTimer_b.DAQ2_Tx.CCP_SHELL "" UBYTE ident 1 100 0 1 BIT_MASK 0x1 ECU_ADDRESS 0x7F854C /end MEASUREMENT
/begin MEASUREMENT l_StartTicks_u32.DAQ2_Sample.CCP_SHELL "" ULONG ident 1 100 0 4294967295 ECU_ADDRESS 0x7F8528 /end MEASUREMENT
/begin MEASUREMENT l_StartTicks_u32.DAQ2_Tx.CCP_SHELL "" ULONG ident 1 100 0 4294967295 ECU_ADDRESS 0x7F8540 /end MEASUREMENT
/begin MEASUREMENT l_StopTicks_u32.DAQ2_Sample.CCP_SHELL "" ULONG ident 1 100 0 4294967295 ECU_ADDRESS 0x7F852C /end MEASUREMENT
/begin MEASUREMENT l_StopTicks_u32.DAQ2_Tx.CCP_SHELL "" ULONG ident 1 100 0 4294967295 ECU_ADDRESS 0x7F8544 /end MEASUREMENT
/begin MEASUREMENT l_Timeout_b.DAQ2_Sample.CCP_SHELL "" UBYTE ident 1 100 0 1 BIT_MASK 0x1 ECU_ADDRESS 0x7F8531 /end MEASUREMENT
/begin MEASUREMENT l_Timeout_b.DAQ2_Tx.CCP_SHELL "" UBYTE ident 1 100 0 1 BIT_MASK 0x1 ECU_ADDRESS 0x7F854D /end MEASUREMENT
/begin MEASUREMENT l_TimerCorrection_u32.CCP_SHELL "" ULONG TickType2ms 1 100 0.0 1227133.512857143 ECU_ADDRESS 0x7F8514 /end MEASUREMENT
/begin MEASUREMENT l_TimeSum_u32.DAQ2_Tx.CCP_SHELL "" ULONG TickType2ms 1 100 0.0 1227133.512857143 ECU_ADDRESS 0x7F8548 /end MEASUREMENT
/begin MEASUREMENT l_UpdateBitTest_b.Bit_Test "" UBYTE ident 1 100 0 1 BIT_MASK 0x1 ECU_ADDRESS 0x7F8208 /end MEASUREMENT
/begin MEASUREMENT lastCtrB01.BypassCounter "" UBYTE ident 1 100 0 255 ECU_ADDRESS 0x7FB014 /end MEASUREMENT
/begin MEASUREMENT lastCtrB02.BypassCounter "" UBYTE ident 1 100 0 255 ECU_ADDRESS 0x7FB015 /end MEASUREMENT
/begin MEASUREMENT lastCtrB03.BypassCounter "" UBYTE ident 1 100 0 255 ECU_ADDRESS 0x7FB016 /end MEASUREMENT
/begin MEASUREMENT lastCtrB04.BypassCounter "" UBYTE ident 1 100 0 255 ECU_ADDRESS 0x7FB017 /end MEASUREMENT
/begin MEASUREMENT M_F32_1.Cal_Measure "" FLOAT32_IEEE ident 1 100 -1.e+037 1.e+037 ECU_ADDRESS 0x7FB050 /end MEASUREMENT
/begin MEASUREMENT M_F32_2.Cal_Measure "" FLOAT32_IEEE ident 1 100 -1.e+037 1.e+037 ECU_ADDRESS 0x7FB054 /end MEASUREMENT
/begin MEASUREMENT M_F64_1.Cal_Measure "" FLOAT64_IEEE ident 1 100 -1.e+037 1.e+037 ECU_ADDRESS 0x7FB040 /end MEASUREMENT
/begin MEASUREMENT M_F64_2.Cal_Measure "" FLOAT64_IEEE ident 1 100 -1.e+037 1.e+037 ECU_ADDRESS 0x7FB048 /end MEASUREMENT
/begin MEASUREMENT M_Fl32_array.Cal_Measure_Blocks "" FLOAT64_IEEE ident 1 100 -1.e+037 1.e+037 ECU_ADDRESS 0x821138 MATRIX_DIM 6 1 1 DISPLAY_IDENTIFIER M_Fl32_array.Cal_Measure_Blocks_DISP_ID /end MEASUREMENT
/begin MEASUREMENT M_Fl32_matrix.Cal_Measure_Blocks "" FLOAT64_IEEE ident 1 100 -1.e+037 1.e+037 ECU_ADDRESS 0x821168 MATRIX_DIM 5 6 1 DISPLAY_IDENTIFIER M_Fl32_matrix.Cal_Measure_Blocks_DISP_ID /end MEASUREMENT
/begin MEASUREMENT M_Fl64_array.Cal_Measure_Blocks "" FLOAT64_IEEE ident 1 100 -1.e+037 1.e+037 ECU_ADDRESS 0x821258 MATRIX_DIM 6 1 1 DISPLAY_IDENTIFIER M_Fl64_array.Cal_Measure_Blocks_DISP_ID /end MEASUREMENT
/begin MEASUREMENT M_Fl64_matrix.Cal_Measure_Blocks "" FLOAT64_IEEE ident 1 100 -1.e+037 1.e+037 ECU_ADDRESS 0x821288 MATRIX_DIM 5 6 1 DISPLAY_IDENTIFIER M_Fl64_matrix.Cal_Measure_Blocks_DISP_ID /end MEASUREMENT
/begin MEASUREMENT M_S16_1.Cal_Measure "" SWORD ident 1 100 -32768.0 32767.0 ECU_ADDRESS 0x7FB068 /end MEASUREMENT
/begin MEASUREMENT M_S16_2.Cal_Measure "" SWORD ident 1 100 -32768.0 32767.0 ECU_ADDRESS 0x7FB06A /end MEASUREMENT
/begin MEASUREMENT M_S16_3.Cal_Measure "" SWORD ident 1 100 -32768.0 32767.0 ECU_ADDRESS 0x7FB06C /end MEASUREMENT
/begin MEASUREMENT M_S32_1.Cal_Measure "" SLONG ident 1 100 -2147483648.0 2147483647.0 ECU_ADDRESS 0x7FB058 /end MEASUREMENT
/begin MEASUREMENT M_S32_2.Cal_Measure "" SLONG ident 1 100 -2147483648.0 2147483647.0 ECU_ADDRESS 0x7FB05C /end MEASUREMENT
/begin MEASUREMENT M_S8_1.Cal_Measure "" SBYTE ident 1 100 -128.0 127.0 ECU_ADDRESS 0x7FB074 /end MEASUREMENT
/begin MEASUREMENT M_S8_2.Cal_Measure "" SBYTE ident 1 100 -128.0 127.0 ECU_ADDRESS 0x7FB075 /end MEASUREMENT
/begin MEASUREMENT M_S8_3.Cal_Measure "" SBYTE ident 1 100 -128.0 127.0 ECU_ADDRESS 0x7FB076 /end MEASUREMENT
/begin MEASUREMENT M_S8_4.Cal_Measure "" SBYTE ident 1 100 -128.0 127.0 ECU_ADDRESS 0x7FB077 /end MEASUREMENT
/begin MEASUREMENT M_Sint16_array.Cal_Measure_Blocks "" SWORD ident 1 100 -32768.0 32767.0 ECU_ADDRESS 0x821498 MATRIX_DIM 6 1 1 DISPLAY_IDENTIFIER M_Sint16_array.Cal_Measure_Blocks_DISP_ID /end MEASUREMENT
/begin MEASUREMENT M_Sint16_matrix.Cal_Measure_Blocks "" SWORD ident 1 100 -32768.0 32767.0 ECU_ADDRESS 0x8214A4 MATRIX_DIM 5 6 1 DISPLAY_IDENTIFIER M_Sint16_matrix.Cal_Measure_Blocks_DISP_ID /end MEASUREMENT
/begin MEASUREMENT M_Sint32_array.Cal_Measure_Blocks "" SLONG ident 1 100 -2147483648.0 2147483647.0 ECU_ADDRESS 0x821378 MATRIX_DIM 6 1 1 DISPLAY_IDENTIFIER M_Sint32_array.Cal_Measure_Blocks_DISP_ID /end MEASUREMENT
/begin MEASUREMENT M_Sint32_matrix.Cal_Measure_Blocks "" SLONG ident 1 100 -2147483648.0 2147483647.0 ECU_ADDRESS 0x821390 MATRIX_DIM 5 6 1 DISPLAY_IDENTIFIER M_Sint32_matrix.Cal_Measure_Blocks_DISP_ID /end MEASUREMENT
/begin MEASUREMENT M_Sint8_array.Cal_Measure_Blocks "" SBYTE ident 1 100 -128.0 127.0 ECU_ADDRESS 0x821528 MATRIX_DIM 6 1 1 DISPLAY_IDENTIFIER M_Sint8_array.Cal_Measure_Blocks_DISP_ID /end MEASUREMENT
/begin MEASUREMENT M_Sint8_matrix.Cal_Measure_Blocks "" SBYTE ident 1 100 -128.0 127.0 ECU_ADDRESS 0x82152E MATRIX_DIM 5 6 1 DISPLAY_IDENTIFIER M_Sint8_matrix.Cal_Measure_Blocks_DISP_ID /end MEASUREMENT
/begin MEASUREMENT M_U16_1.Cal_Measure "" UWORD ident 1 100 0.0 65535.0 ECU_ADDRESS 0x7FB06E /end MEASUREMENT
/begin MEASUREMENT M_U16_2.Cal_Measure "" UWORD ident 1 100 0.0 65535.0 ECU_ADDRESS 0x7FB070 /end MEASUREMENT
/begin MEASUREMENT M_U16_3.Cal_Measure "" UWORD ident 1 100 0.0 65535.0 ECU_ADDRESS 0x7FB072 /end MEASUREMENT
/begin MEASUREMENT M_U32_1.Cal_Measure "" ULONG ident 1 100 0.0 4294967295.0 ECU_ADDRESS 0x7FB060 /end MEASUREMENT
/begin MEASUREMENT M_U32_2.Cal_Measure "" ULONG ident 1 100 0.0 4294967295.0 ECU_ADDRESS 0x7FB064 /end MEASUREMENT
/begin MEASUREMENT M_U8_1.Cal_Measure "" UBYTE ident 1 100 0.0 255.0 ECU_ADDRESS 0x7FB078 /end MEASUREMENT
/begin MEASUREMENT M_U8_2.Cal_Measure "" UBYTE ident 1 100 0.0 255.0 ECU_ADDRESS 0x7FB079 /end MEASUREMENT
/begin MEASUREMENT M_U8_3.Cal_Measure "" UBYTE ident 1 100 0.0 255.0 ECU_ADDRESS 0x7FB07A /end MEASUREMENT
/begin MEASUREMENT M_U8_4.Cal_Measure "" UBYTE ident 1 100 0.0 255.0 ECU_ADDRESS 0x7FB07B /end MEASUREMENT
/begin MEASUREMENT M_Uint16_array.Cal_Measure_Blocks "" UWORD ident 1 100 0.0 65535.0 ECU_ADDRESS 0x8214E0 MATRIX_DIM 6 1 1 DISPLAY_IDENTIFIER M_Uint16_array.Cal_Measure_Blocks_DISP_ID /end MEASUREMENT
/begin MEASUREMENT M_Uint16_matrix.Cal_Measure_Blocks "" UWORD ident 1 100 0.0 65535.0 ECU_ADDRESS 0x8214EC MATRIX_DIM 5 6 1 DISPLAY_IDENTIFIER M_Uint16_matrix.Cal_Measure_Blocks_DISP_ID /end MEASUREMENT
/begin MEASUREMENT M_Uint32_array.Cal_Measure_Blocks "" ULONG ident 1 100 0.0 4294967295.0 ECU_ADDRESS 0x821408 MATRIX_DIM 6 1 1 DISPLAY_IDENTIFIER M_Uint32_array.Cal_Measure_Blocks_DISP_ID /end MEASUREMENT
/begin MEASUREMENT M_Uint32_matrix.Cal_Measure_Blocks "" ULONG ident 1 100 0.0 4294967295.0 ECU_ADDRESS 0x821420 MATRIX_DIM 5 6 1 DISPLAY_IDENTIFIER M_Uint32_matrix.Cal_Measure_Blocks_DISP_ID /end MEASUREMENT
/begin MEASUREMENT M_Uint8_array.Cal_Measure_Blocks "" UBYTE ident 1 100 0.0 255.0 ECU_ADDRESS 0x82154C MATRIX_DIM 6 1 1 DISPLAY_IDENTIFIER M_Uint8_array.Cal_Measure_Blocks_DISP_ID /end MEASUREMENT
/begin MEASUREMENT M_Uint8_matrix.Cal_Measure_Blocks "" UBYTE ident 1 100 0.0 255.0 ECU_ADDRESS 0x821552 MATRIX_DIM 5 6 1 DISPLAY_IDENTIFIER M_Uint8_matrix.Cal_Measure_Blocks_DISP_ID /end MEASUREMENT
/begin MEASUREMENT Max.MIN_MAX_Tick2Time.DAQ2_Sample.CCP_SHELL "" ULONG TickType2ms 1 100 0.0 1227133.512857143 ECU_ADDRESS 0x7F8534 /end MEASUREMENT
/begin MEASUREMENT Max.Time.DAQ2_Tx.CCP_SHELL "" ULONG TickType2ms 1 100 0.0 1227133.512857143 ECU_ADDRESS 0x7F8550 /end MEASUREMENT
/begin MEASUREMENT Max.TimeSum.DAQ2_Tx.CCP_SHELL "" ULONG TickType2ms 1 100 0.0 1227133.512857143 ECU_ADDRESS 0x7F855C /end MEASUREMENT
/begin MEASUREMENT Min.MIN_MAX_Tick2Time.DAQ2_Sample.CCP_SHELL "" ULONG TickType2ms 1 100 0.0 1227133.512857143 ECU_ADDRESS 0x7F8538 /end MEASUREMENT
/begin MEASUREMENT Min.Time.DAQ2_Tx.CCP_SHELL "" ULONG TickType2ms 1 100 0.0 1227133.512857143 ECU_ADDRESS 0x7F8554 /end MEASUREMENT
/begin MEASUREMENT Min.TimeSum.DAQ2_Tx.CCP_SHELL "" ULONG TickType2ms 1 100 0.0 1227133.512857143 ECU_ADDRESS 0x7F8560 /end MEASUREMENT
/begin MEASUREMENT ODT_tx_status.CCP_SHELL "" UBYTE ident 1 100 0 255 ECU_ADDRESS 0x7F8525 MATRIX_DIM 3 1 1 /end MEASUREMENT
/begin MEASUREMENT test_counter.CCP_SHELL "" UWORD ident 1 100 0 50000 ECU_ADDRESS 0x7F8518 MATRIX_DIM 5 1 1 /end MEASUREMENT
/begin MEASUREMENT Time.MIN_MAX_Tick2Time.DAQ2_Sample.CCP_SHELL "" ULONG TickType2ms 1 100 0.0 1227133.512857143 ECU_ADDRESS 0x7F853C /end MEASUREMENT
/begin MEASUREMENT Time.Time.DAQ2_Tx.CCP_SHELL "" ULONG TickType2ms 1 100 0.0 1227133.512857143 ECU_ADDRESS 0x7F8558 /end MEASUREMENT
/begin MEASUREMENT Time.TimeSum.DAQ2_Tx.CCP_SHELL "" ULONG TickType2ms 1 100 0.0 1227133.512857143 ECU_ADDRESS 0x7F8564 /end MEASUREMENT
/begin MEASUREMENT V_counter_1.Counter_R01_1.Counter_module_Mle "" UWORD ident 1 100 0 65535 ECU_ADDRESS 0x7FB098 /end MEASUREMENT
/begin MEASUREMENT V_DetectDTCDuringDriveCycle_b.CRB_OBD "" UBYTE ident 1 100 0 1 BIT_MASK 0x1 ECU_ADDRESS 0x7F8577 /end MEASUREMENT
/begin MEASUREMENT V_EmissionRelatedDTCStored_b.CRB_OBD "" UBYTE ident 1 100 0 1 BIT_MASK 0x1 ECU_ADDRESS 0x7F8575 /end MEASUREMENT
/begin MEASUREMENT V_FreezeFrameDataStored_b.CRB_OBD "" UBYTE ident 1 100 0 1 BIT_MASK 0x1 ECU_ADDRESS 0x7F8574 /end MEASUREMENT
/begin MEASUREMENT waitCtrB01.BypassCounter "" ULONG ident 1 100 0 4294967295 ECU_ADDRESS 0x7FAFE4 /end MEASUREMENT
/begin MEASUREMENT waitCtrB01_H.BypassCounter "" UWORD ident 1 100 0 65535 ECU_ADDRESS 0x7FB004 /end MEASUREMENT
/begin MEASUREMENT waitCtrB01_L.BypassCounter "" UWORD ident 1 100 0 65535 ECU_ADDRESS 0x7FB006 /end MEASUREMENT
/begin MEASUREMENT waitCtrB02.BypassCounter "" ULONG ident 1 100 0 4294967295 ECU_ADDRESS 0x7FAFE8 /end MEASUREMENT
/begin MEASUREMENT waitCtrB02_H.BypassCounter "" UWORD ident 1 100 0 65535 ECU_ADDRESS 0x7FB008 /end MEASUREMENT
/begin MEASUREMENT waitCtrB02_L.BypassCounter "" UWORD ident 1 100 0 65535 ECU_ADDRESS 0x7FB00A /end MEASUREMENT
/begin MEASUREMENT waitCtrB03.BypassCounter "" ULONG ident 1 100 0 4294967295 ECU_ADDRESS 0x7FAFEC /end MEASUREMENT
/begin MEASUREMENT waitCtrB03_H.BypassCounter "" UWORD ident 1 100 0 65535 ECU_ADDRESS 0x7FB00C /end MEASUREMENT
/begin MEASUREMENT waitCtrB03_L.BypassCounter "" UWORD ident 1 100 0 65535 ECU_ADDRESS 0x7FB00E /end MEASUREMENT
/begin MEASUREMENT waitCtrB04.BypassCounter "" ULONG ident 1 100 0 4294967295 ECU_ADDRESS 0x7FAFF0 /end MEASUREMENT
/begin MEASUREMENT waitCtrB04_H.BypassCounter "" UWORD ident 1 100 0 65535 ECU_ADDRESS 0x7FB010 /end MEASUREMENT
/begin MEASUREMENT waitCtrB04_L.BypassCounter "" UWORD ident 1 100 0 65535 ECU_ADDRESS 0x7FB012 /end MEASUREMENT
/begin COMPU_METHOD 1_1000 "" RAT_FUNC "%12.4" "" COEFFS 0 1000 0 0 0 1 /end COMPU_METHOD
/begin COMPU_METHOD enum_CCP_Page_ENUM "" TAB_VERB "%8.4" "" COEFFS 0 1 0 0 0 1 COMPU_TAB_REF enum_CCP_Page_ENUM_tab_ref /end COMPU_METHOD
/begin COMPU_METHOD enum_UDS_SENDLISTSTATE_E "" TAB_VERB "%8.4" "" COEFFS 0 1 0 0 0 1 COMPU_TAB_REF enum_UDS_SENDLISTSTATE_E_tab_ref /end COMPU_METHOD
/begin COMPU_METHOD enum_UPDOWN_ENUM "" TAB_VERB "%8.4" "" COEFFS 0 1 0 0 0 1 COMPU_TAB_REF enum_UPDOWN_ENUM_tab_ref /end COMPU_METHOD
/begin COMPU_METHOD enum_XCP_ByteOrder_e "" TAB_VERB "%8.4" "" COEFFS 0 1 0 0 0 1 COMPU_TAB_REF enum_XCP_ByteOrder_e_tab_ref /end COMPU_METHOD
/begin COMPU_METHOD ident "" RAT_FUNC "%12.4" "" COEFFS 0 1 0 0 0 1 /end COMPU_METHOD
/begin COMPU_METHOD TickType2ms "" RAT_FUNC "%12.4" "ms" COEFFS 0 3500.0 0 0 0 1 /end COMPU_METHOD
/begin COMPU_VTAB enum_CCP_Page_ENUM_tab_ref "" TAB_VERB 3 0 "FLASH" 1 "RAM" 2 "ETK" DEFAULT_VALUE "Error" /end COMPU_VTAB
/begin COMPU_VTAB enum_UDS_SENDLISTSTATE_E_tab_ref "" TAB_VERB 3 0 "FREE_0" 1 "IDLE_1" 2 "SAMPLED_2" DEFAULT_VALUE "Error" /end COMPU_VTAB
/begin COMPU_VTAB enum_UPDOWN_ENUM_tab_ref "" TAB_VERB 2 0 "UP" 1 "DOWN" DEFAULT_VALUE "Error" /end COMPU_VTAB
/begin COMPU_VTAB enum_XCP_ByteOrder_e_tab_ref "" TAB_VERB 2 0 "INTEL_MSB_LAST_0" 1 "MOTOROLA_MSB_FIRST_1" DEFAULT_VALUE "Error" /end COMPU_VTAB
/begin GROUP Bit_Test "" ROOT
 /begin REF_MEASUREMENT Bit_Sint16.P_Bit.Bit_Test Bit_Sint16_Bit_00.Extern_MEM.Bit_Test Bit_Sint16_Bit_00.Intern_MEM.Bit_Test Bit_Sint16_Bit_01.Extern_MEM.Bit_Test Bit_Sint16_Bit_01.Intern_MEM.Bit_Test Bit_Sint16_Bit_02.Extern_MEM.Bit_Test Bit_Sint16_Bit_02.Intern_MEM.Bit_Test Bit_Sint16_Bit_03.Extern_MEM.Bit_Test Bit_Sint16_Bit_03.Intern_MEM.Bit_Test Bit_Sint16_Bit_04.Extern_MEM.Bit_Test Bit_Sint16_Bit_04.Intern_MEM.Bit_Test Bit_Sint16_Bit_05.Extern_MEM.Bit_Test Bit_Sint16_Bit_05.Intern_MEM.Bit_Test Bit_Sint16_Bit_06.Extern_MEM.Bit_Test Bit_Sint16_Bit_06.Intern_MEM.Bit_Test Bit_Sint16_Bit_07.Extern_MEM.Bit_Test Bit_Sint16_Bit_07.Intern_MEM.Bit_Test Bit_Sint16_Bit_08.Extern_MEM.Bit_Test Bit_Sint16_Bit_08.Intern_MEM.Bit_Test Bit_Sint16_Bit_09.Extern_MEM.Bit_Test Bit_Sint16_Bit_09.Intern_MEM.Bit_Test Bit_Sint16_Bit_10.Extern_MEM.Bit_Test Bit_Sint16_Bit_10.Intern_MEM.Bit_Test Bit_Sint16_Bit_11.Extern_MEM.Bit_Test Bit_Sint16_Bit_11.Intern_MEM.Bit_Test Bit_Sint16_Bit_12.Extern_MEM.Bit_Test Bit_Sint16_Bit_12.Intern_MEM.Bit_Test Bit_Sint16_Bit_13.Extern_MEM.Bit_Test Bit_Sint16_Bit_13.Intern_MEM.Bit_Test Bit_Sint16_Bit_14.Extern_MEM.Bit_Test Bit_Sint16_Bit_14.Intern_MEM.Bit_Test Bit_Sint16_Bit_15.Extern_MEM.Bit_Test Bit_Sint16_Bit_15.Intern_MEM.Bit_Test Bit_Sint16_Bit_x.Extern_MEM.Bit_Test Bit_Sint16_Bit_x.Intern_MEM.Bit_Test Bit_Sint32.P_Bit.Bit_Test Bit_Sint32_Bit_00.Extern_MEM.Bit_Test Bit_Sint32_Bit_00.Intern_MEM.Bit_Test Bit_Sint32_Bit_01.Extern_MEM.Bit_Test Bit_Sint32_Bit_01.Intern_MEM.Bit_Test Bit_Sint32_Bit_02.Extern_MEM.Bit_Test Bit_Sint32_Bit_02.Intern_MEM.Bit_Test Bit_Sint32_Bit_03.Extern_MEM.Bit_Test Bit_Sint32_Bit_03.Intern_MEM.Bit_Test Bit_Sint32_Bit_04.Extern_MEM.Bit_Test Bit_Sint32_Bit_04.Intern_MEM.Bit_Test Bit_Sint32_Bit_05.Extern_MEM.Bit_Test Bit_Sint32_Bit_05.Intern_MEM.Bit_Test Bit_Sint32_Bit_06.Extern_MEM.Bit_Test Bit_Sint32_Bit_06.Intern_MEM.Bit_Test Bit_Sint32_Bit_07.Extern_MEM.Bit_Test Bit_Sint32_Bit_07.Intern_MEM.Bit_Test Bit_Sint32_Bit_08.Extern_MEM.Bit_Test Bit_Sint32_Bit_08.Intern_MEM.Bit_Test Bit_Sint32_Bit_09.Extern_MEM.Bit_Test Bit_Sint32_Bit_09.Intern_MEM.Bit_Test Bit_Sint32_Bit_10.Extern_MEM.Bit_Test Bit_Sint32_Bit_10.Intern_MEM.Bit_Test Bit_Sint32_Bit_11.Extern_MEM.Bit_Test Bit_Sint32_Bit_11.Intern_MEM.Bit_Test Bit_Sint32_Bit_12.Extern_MEM.Bit_Test Bit_Sint32_Bit_12.Intern_MEM.Bit_Test Bit_Sint32_Bit_13.Extern_MEM.Bit_Test Bit_Sint32_Bit_13.Intern_MEM.Bit_Test Bit_Sint32_Bit_14.Extern_MEM.Bit_Test Bit_Sint32_Bit_14.Intern_MEM.Bit_Test Bit_Sint32_Bit_15.Extern_MEM.Bit_Test Bit_Sint32_Bit_15.Intern_MEM.Bit_Test Bit_Sint32_Bit_16.Extern_MEM.Bit_Test Bit_Sint32_Bit_16.Intern_MEM.Bit_Test Bit_Sint32_Bit_17.Extern_MEM.Bit_Test Bit_Sint32_Bit_17.Intern_MEM.Bit_Test Bit_Sint32_Bit_18.Extern_MEM.Bit_Test Bit_Sint32_Bit_18.Intern_MEM.Bit_Test Bit_Sint32_Bit_19.Extern_MEM.Bit_Test Bit_Sint32_Bit_19.Intern_MEM.Bit_Test Bit_Sint32_Bit_20.Extern_MEM.Bit_Test Bit_Sint32_Bit_20.Intern_MEM.Bit_Test Bit_Sint32_Bit_21.Extern_MEM.Bit_Test Bit_Sint32_Bit_21.Intern_MEM.Bit_Test Bit_Sint32_Bit_22.Extern_MEM.Bit_Test Bit_Sint32_Bit_22.Intern_MEM.Bit_Test Bit_Sint32_Bit_23.Extern_MEM.Bit_Test Bit_Sint32_Bit_23.Intern_MEM.Bit_Test Bit_Sint32_Bit_24.Extern_MEM.Bit_Test Bit_Sint32_Bit_24.Intern_MEM.Bit_Test Bit_Sint32_Bit_25.Extern_MEM.Bit_Test Bit_Sint32_Bit_25.Intern_MEM.Bit_Test Bit_Sint32_Bit_26.Extern_MEM.Bit_Test Bit_Sint32_Bit_26.Intern_MEM.Bit_Test Bit_Sint32_Bit_27.Extern_MEM.Bit_Test Bit_Sint32_Bit_27.Intern_MEM.Bit_Test Bit_Sint32_Bit_28.Extern_MEM.Bit_Test Bit_Sint32_Bit_28.Intern_MEM.Bit_Test Bit_Sint32_Bit_29.Extern_MEM.Bit_Test Bit_Sint32_Bit_29.Intern_MEM.Bit_Test Bit_Sint32_Bit_30.Extern_MEM.Bit_Test Bit_Sint32_Bit_30.Intern_MEM.Bit_Test Bit_Sint32_Bit_31.Extern_MEM.Bit_Test Bit_Sint32_Bit_31.Intern_MEM.Bit_Test Bit_Sint32_Bit_x.Extern_MEM.Bit_Test Bit_Sint32_Bit_x.Intern_MEM.Bit_Test Bit_Sint8.P_Bit.Bit_Test Bit_Sint8_E_Bit_0.Extern_MEM.Bit_Test Bit_Sint8_E_Bit_0.Intern_MEM.Bit_Test Bit_Sint8_E_Bit_1.Extern_MEM.Bit_Test Bit_Sint8_E_Bit_1.Intern_MEM.Bit_Test Bit_Sint8_E_Bit_2.Extern_MEM.Bit_Test Bit_Sint8_E_Bit_2.Intern_MEM.Bit_Test Bit_Sint8_E_Bit_3.Extern_MEM.Bit_Test Bit_Sint8_E_Bit_3.Intern_MEM.Bit_Test Bit_Sint8_E_Bit_4.Extern_MEM.Bit_Test Bit_Sint8_E_Bit_4.Intern_MEM.Bit_Test Bit_Sint8_E_Bit_5.Extern_MEM.Bit_Test Bit_Sint8_E_Bit_5.Intern_MEM.Bit_Test Bit_Sint8_E_Bit_6.Extern_MEM.Bit_Test Bit_Sint8_E_Bit_6.Intern_MEM.Bit_Test Bit_Sint8_E_Bit_7.Extern_MEM.Bit_Test Bit_Sint8_E_Bit_7.Intern_MEM.Bit_Test Bit_Sint8_E_Bit_x.Extern_MEM.Bit_Test Bit_Sint8_E_Bit_x.Intern_MEM.Bit_Test Bit_Sint8_O_Bit_0.Extern_MEM.Bit_Test Bit_Sint8_O_Bit_0.Intern_MEM.Bit_Test Bit_Sint8_O_Bit_1.Extern_MEM.Bit_Test Bit_Sint8_O_Bit_1.Intern_MEM.Bit_Test Bit_Sint8_O_Bit_2.Extern_MEM.Bit_Test Bit_Sint8_O_Bit_2.Intern_MEM.Bit_Test Bit_Sint8_O_Bit_3.Extern_MEM.Bit_Test Bit_Sint8_O_Bit_3.Intern_MEM.Bit_Test Bit_Sint8_O_Bit_4.Extern_MEM.Bit_Test Bit_Sint8_O_Bit_4.Intern_MEM.Bit_Test Bit_Sint8_O_Bit_5.Extern_MEM.Bit_Test Bit_Sint8_O_Bit_5.Intern_MEM.Bit_Test Bit_Sint8_O_Bit_6.Extern_MEM.Bit_Test Bit_Sint8_O_Bit_6.Intern_MEM.Bit_Test Bit_Sint8_O_Bit_7.Extern_MEM.Bit_Test Bit_Sint8_O_Bit_7.Intern_MEM.Bit_Test Bit_Sint8_O_Bit_x.Extern_MEM.Bit_Test Bit_Sint8_O_Bit_x.Intern_MEM.Bit_Test Bit_Uint16.P_Bit.Bit_Test Bit_Uint16_Bit_00.Extern_MEM.Bit_Test Bit_Uint16_Bit_00.Intern_MEM.Bit_Test Bit_Uint16_Bit_01.Extern_MEM.Bit_Test Bit_Uint16_Bit_01.Intern_MEM.Bit_Test Bit_Uint16_Bit_02.Extern_MEM.Bit_Test Bit_Uint16_Bit_02.Intern_MEM.Bit_Test Bit_Uint16_Bit_03.Extern_MEM.Bit_Test Bit_Uint16_Bit_03.Intern_MEM.Bit_Test Bit_Uint16_Bit_04.Extern_MEM.Bit_Test Bit_Uint16_Bit_04.Intern_MEM.Bit_Test Bit_Uint16_Bit_05.Extern_MEM.Bit_Test Bit_Uint16_Bit_05.Intern_MEM.Bit_Test Bit_Uint16_Bit_06.Extern_MEM.Bit_Test Bit_Uint16_Bit_06.Intern_MEM.Bit_Test Bit_Uint16_Bit_07.Extern_MEM.Bit_Test Bit_Uint16_Bit_07.Intern_MEM.Bit_Test Bit_Uint16_Bit_08.Extern_MEM.Bit_Test Bit_Uint16_Bit_08.Intern_MEM.Bit_Test Bit_Uint16_Bit_09.Extern_MEM.Bit_Test Bit_Uint16_Bit_09.Intern_MEM.Bit_Test Bit_Uint16_Bit_10.Extern_MEM.Bit_Test Bit_Uint16_Bit_10.Intern_MEM.Bit_Test Bit_Uint16_Bit_11.Extern_MEM.Bit_Test Bit_Uint16_Bit_11.Intern_MEM.Bit_Test Bit_Uint16_Bit_12.Extern_MEM.Bit_Test Bit_Uint16_Bit_12.Intern_MEM.Bit_Test Bit_Uint16_Bit_13.Extern_MEM.Bit_Test Bit_Uint16_Bit_13.Intern_MEM.Bit_Test Bit_Uint16_Bit_14.Extern_MEM.Bit_Test Bit_Uint16_Bit_14.Intern_MEM.Bit_Test Bit_Uint16_Bit_15.Extern_MEM.Bit_Test Bit_Uint16_Bit_15.Intern_MEM.Bit_Test Bit_Uint16_Bit_x.Extern_MEM.Bit_Test Bit_Uint16_Bit_x.Intern_MEM.Bit_Test Bit_Uint32.P_Bit.Bit_Test Bit_Uint32_Bit_00.Extern_MEM.Bit_Test Bit_Uint32_Bit_00.Intern_MEM.Bit_Test Bit_Uint32_Bit_01.Extern_MEM.Bit_Test Bit_Uint32_Bit_01.Intern_MEM.Bit_Test Bit_Uint32_Bit_02.Extern_MEM.Bit_Test Bit_Uint32_Bit_02.Intern_MEM.Bit_Test Bit_Uint32_Bit_03.Extern_MEM.Bit_Test Bit_Uint32_Bit_03.Intern_MEM.Bit_Test Bit_Uint32_Bit_04.Extern_MEM.Bit_Test Bit_Uint32_Bit_04.Intern_MEM.Bit_Test Bit_Uint32_Bit_05.Extern_MEM.Bit_Test Bit_Uint32_Bit_05.Intern_MEM.Bit_Test Bit_Uint32_Bit_06.Extern_MEM.Bit_Test Bit_Uint32_Bit_06.Intern_MEM.Bit_Test Bit_Uint32_Bit_07.Extern_MEM.Bit_Test Bit_Uint32_Bit_07.Intern_MEM.Bit_Test Bit_Uint32_Bit_08.Extern_MEM.Bit_Test Bit_Uint32_Bit_08.Intern_MEM.Bit_Test Bit_Uint32_Bit_09.Extern_MEM.Bit_Test Bit_Uint32_Bit_09.Intern_MEM.Bit_Test Bit_Uint32_Bit_10.Extern_MEM.Bit_Test Bit_Uint32_Bit_10.Intern_MEM.Bit_Test Bit_Uint32_Bit_11.Extern_MEM.Bit_Test Bit_Uint32_Bit_11.Intern_MEM.Bit_Test Bit_Uint32_Bit_12.Extern_MEM.Bit_Test Bit_Uint32_Bit_12.Intern_MEM.Bit_Test Bit_Uint32_Bit_13.Extern_MEM.Bit_Test Bit_Uint32_Bit_13.Intern_MEM.Bit_Test Bit_Uint32_Bit_14.Extern_MEM.Bit_Test Bit_Uint32_Bit_14.Intern_MEM.Bit_Test Bit_Uint32_Bit_15.Extern_MEM.Bit_Test Bit_Uint32_Bit_15.Intern_MEM.Bit_Test Bit_Uint32_Bit_16.Extern_MEM.Bit_Test Bit_Uint32_Bit_16.Intern_MEM.Bit_Test Bit_Uint32_Bit_17.Extern_MEM.Bit_Test Bit_Uint32_Bit_17.Intern_MEM.Bit_Test Bit_Uint32_Bit_18.Extern_MEM.Bit_Test Bit_Uint32_Bit_18.Intern_MEM.Bit_Test Bit_Uint32_Bit_19.Extern_MEM.Bit_Test Bit_Uint32_Bit_19.Intern_MEM.Bit_Test Bit_Uint32_Bit_20.Extern_MEM.Bit_Test Bit_Uint32_Bit_20.Intern_MEM.Bit_Test Bit_Uint32_Bit_21.Extern_MEM.Bit_Test Bit_Uint32_Bit_21.Intern_MEM.Bit_Test Bit_Uint32_Bit_22.Extern_MEM.Bit_Test Bit_Uint32_Bit_22.Intern_MEM.Bit_Test Bit_Uint32_Bit_23.Extern_MEM.Bit_Test Bit_Uint32_Bit_23.Intern_MEM.Bit_Test Bit_Uint32_Bit_24.Extern_MEM.Bit_Test Bit_Uint32_Bit_24.Intern_MEM.Bit_Test Bit_Uint32_Bit_25.Extern_MEM.Bit_Test Bit_Uint32_Bit_25.Intern_MEM.Bit_Test Bit_Uint32_Bit_26.Extern_MEM.Bit_Test Bit_Uint32_Bit_26.Intern_MEM.Bit_Test Bit_Uint32_Bit_27.Extern_MEM.Bit_Test Bit_Uint32_Bit_27.Intern_MEM.Bit_Test Bit_Uint32_Bit_28.Extern_MEM.Bit_Test Bit_Uint32_Bit_28.Intern_MEM.Bit_Test Bit_Uint32_Bit_29.Extern_MEM.Bit_Test Bit_Uint32_Bit_29.Intern_MEM.Bit_Test Bit_Uint32_Bit_30.Extern_MEM.Bit_Test Bit_Uint32_Bit_30.Intern_MEM.Bit_Test Bit_Uint32_Bit_31.Extern_MEM.Bit_Test Bit_Uint32_Bit_31.Intern_MEM.Bit_Test Bit_Uint32_Bit_x.Extern_MEM.Bit_Test Bit_Uint32_Bit_x.Intern_MEM.Bit_Test Bit_Uint8.P_Bit.Bit_Test Bit_Uint8_E_Bit_0.Extern_MEM.Bit_Test Bit_Uint8_E_Bit_0.Intern_MEM.Bit_Test Bit_Uint8_E_Bit_1.Extern_MEM.Bit_Test Bit_Uint8_E_Bit_1.Intern_MEM.Bit_Test Bit_Uint8_E_Bit_2.Extern_MEM.Bit_Test Bit_Uint8_E_Bit_2.Intern_MEM.Bit_Test Bit_Uint8_E_Bit_3.Extern_MEM.Bit_Test Bit_Uint8_E_Bit_3.Intern_MEM.Bit_Test Bit_Uint8_E_Bit_4.Extern_MEM.Bit_Test Bit_Uint8_E_Bit_4.Intern_MEM.Bit_Test Bit_Uint8_E_Bit_5.Extern_MEM.Bit_Test Bit_Uint8_E_Bit_5.Intern_MEM.Bit_Test Bit_Uint8_E_Bit_6.Extern_MEM.Bit_Test Bit_Uint8_E_Bit_6.Intern_MEM.Bit_Test Bit_Uint8_E_Bit_7.Extern_MEM.Bit_Test Bit_Uint8_E_Bit_7.Intern_MEM.Bit_Test Bit_Uint8_E_Bit_x.Extern_MEM.Bit_Test Bit_Uint8_E_Bit_x.Intern_MEM.Bit_Test Bit_Uint8_O_Bit_0.Extern_MEM.Bit_Test Bit_Uint8_O_Bit_0.Intern_MEM.Bit_Test Bit_Uint8_O_Bit_1.Extern_MEM.Bit_Test Bit_Uint8_O_Bit_1.Intern_MEM.Bit_Test Bit_Uint8_O_Bit_2.Extern_MEM.Bit_Test Bit_Uint8_O_Bit_2.Intern_MEM.Bit_Test Bit_Uint8_O_Bit_3.Extern_MEM.Bit_Test Bit_Uint8_O_Bit_3.Intern_MEM.Bit_Test Bit_Uint8_O_Bit_4.Extern_MEM.Bit_Test Bit_Uint8_O_Bit_4.Intern_MEM.Bit_Test Bit_Uint8_O_Bit_5.Extern_MEM.Bit_Test Bit_Uint8_O_Bit_5.Intern_MEM.Bit_Test Bit_Uint8_O_Bit_6.Extern_MEM.Bit_Test Bit_Uint8_O_Bit_6.Intern_MEM.Bit_Test Bit_Uint8_O_Bit_7.Extern_MEM.Bit_Test Bit_Uint8_O_Bit_7.Intern_MEM.Bit_Test Bit_Uint8_O_Bit_x.Extern_MEM.Bit_Test Bit_Uint8_O_Bit_x.Intern_MEM.Bit_Test l_UpdateBitTest_b.Bit_Test /end REF_MEASUREMENT
 /begin REF_CHARACTERISTIC P_Bit_Sint16.Extern_MEM.Bit_Test P_Bit_Sint16.Intern_MEM.Bit_Test P_Bit_Sint16_Bit_00.P_Bit.Bit_Test P_Bit_Sint16_Bit_01.P_Bit.Bit_Test P_Bit_Sint16_Bit_02.P_Bit.Bit_Test P_Bit_Sint16_Bit_03.P_Bit.Bit_Test P_Bit_Sint16_Bit_04.P_Bit.Bit_Test P_Bit_Sint16_Bit_05.P_Bit.Bit_Test P_Bit_Sint16_Bit_06.P_Bit.Bit_Test P_Bit_Sint16_Bit_07.P_Bit.Bit_Test P_Bit_Sint16_Bit_08.P_Bit.Bit_Test P_Bit_Sint16_Bit_09.P_Bit.Bit_Test P_Bit_Sint16_Bit_10.P_Bit.Bit_Test P_Bit_Sint16_Bit_11.P_Bit.Bit_Test P_Bit_Sint16_Bit_12.P_Bit.Bit_Test P_Bit_Sint16_Bit_13.P_Bit.Bit_Test P_Bit_Sint16_Bit_14.P_Bit.Bit_Test P_Bit_Sint16_Bit_15.P_Bit.Bit_Test P_Bit_Sint32.Extern_MEM.Bit_Test P_Bit_Sint32.Intern_MEM.Bit_Test P_Bit_Sint32_Bit_00.P_Bit.Bit_Test P_Bit_Sint32_Bit_01.P_Bit.Bit_Test P_Bit_Sint32_Bit_02.P_Bit.Bit_Test P_Bit_Sint32_Bit_03.P_Bit.Bit_Test P_Bit_Sint32_Bit_04.P_Bit.Bit_Test P_Bit_Sint32_Bit_05.P_Bit.Bit_Test P_Bit_Sint32_Bit_06.P_Bit.Bit_Test P_Bit_Sint32_Bit_07.P_Bit.Bit_Test P_Bit_Sint32_Bit_08.P_Bit.Bit_Test P_Bit_Sint32_Bit_09.P_Bit.Bit_Test P_Bit_Sint32_Bit_10.P_Bit.Bit_Test P_Bit_Sint32_Bit_11.P_Bit.Bit_Test P_Bit_Sint32_Bit_12.P_Bit.Bit_Test P_Bit_Sint32_Bit_13.P_Bit.Bit_Test P_Bit_Sint32_Bit_14.P_Bit.Bit_Test P_Bit_Sint32_Bit_15.P_Bit.Bit_Test P_Bit_Sint32_Bit_16.P_Bit.Bit_Test P_Bit_Sint32_Bit_17.P_Bit.Bit_Test P_Bit_Sint32_Bit_18.P_Bit.Bit_Test P_Bit_Sint32_Bit_19.P_Bit.Bit_Test P_Bit_Sint32_Bit_20.P_Bit.Bit_Test P_Bit_Sint32_Bit_21.P_Bit.Bit_Test P_Bit_Sint32_Bit_22.P_Bit.Bit_Test P_Bit_Sint32_Bit_23.P_Bit.Bit_Test P_Bit_Sint32_Bit_24.P_Bit.Bit_Test P_Bit_Sint32_Bit_25.P_Bit.Bit_Test P_Bit_Sint32_Bit_26.P_Bit.Bit_Test P_Bit_Sint32_Bit_27.P_Bit.Bit_Test P_Bit_Sint32_Bit_28.P_Bit.Bit_Test P_Bit_Sint32_Bit_29.P_Bit.Bit_Test P_Bit_Sint32_Bit_30.P_Bit.Bit_Test P_Bit_Sint32_Bit_31.P_Bit.Bit_Test P_Bit_Sint8_Bit_0.P_Bit.Bit_Test P_Bit_Sint8_Bit_1.P_Bit.Bit_Test P_Bit_Sint8_Bit_2.P_Bit.Bit_Test P_Bit_Sint8_Bit_3.P_Bit.Bit_Test P_Bit_Sint8_Bit_4.P_Bit.Bit_Test P_Bit_Sint8_Bit_5.P_Bit.Bit_Test P_Bit_Sint8_Bit_6.P_Bit.Bit_Test P_Bit_Sint8_Bit_7.P_Bit.Bit_Test P_Bit_Sint8_E.Extern_MEM.Bit_Test P_Bit_Sint8_E.Intern_MEM.Bit_Test P_Bit_Sint8_O.Extern_MEM.Bit_Test P_Bit_Sint8_O.Intern_MEM.Bit_Test P_Bit_Uint16.Extern_MEM.Bit_Test P_Bit_Uint16.Intern_MEM.Bit_Test P_Bit_Uint16_Bit_00.P_Bit.Bit_Test P_Bit_Uint16_Bit_01.P_Bit.Bit_Test P_Bit_Uint16_Bit_02.P_Bit.Bit_Test P_Bit_Uint16_Bit_03.P_Bit.Bit_Test P_Bit_Uint16_Bit_04.P_Bit.Bit_Test P_Bit_Uint16_Bit_05.P_Bit.Bit_Test P_Bit_Uint16_Bit_06.P_Bit.Bit_Test P_Bit_Uint16_Bit_07.P_Bit.Bit_Test P_Bit_Uint16_Bit_08.P_Bit.Bit_Test P_Bit_Uint16_Bit_09.P_Bit.Bit_Test P_Bit_Uint16_Bit_10.P_Bit.Bit_Test P_Bit_Uint16_Bit_11.P_Bit.Bit_Test P_Bit_Uint16_Bit_12.P_Bit.Bit_Test P_Bit_Uint16_Bit_13.P_Bit.Bit_Test P_Bit_Uint16_Bit_14.P_Bit.Bit_Test P_Bit_Uint16_Bit_15.P_Bit.Bit_Test P_Bit_Uint32.Extern_MEM.Bit_Test P_Bit_Uint32.Intern_MEM.Bit_Test P_Bit_Uint32_Bit_00.P_Bit.Bit_Test P_Bit_Uint32_Bit_01.P_Bit.Bit_Test P_Bit_Uint32_Bit_02.P_Bit.Bit_Test P_Bit_Uint32_Bit_03.P_Bit.Bit_Test P_Bit_Uint32_Bit_04.P_Bit.Bit_Test P_Bit_Uint32_Bit_05.P_Bit.Bit_Test P_Bit_Uint32_Bit_06.P_Bit.Bit_Test P_Bit_Uint32_Bit_07.P_Bit.Bit_Test P_Bit_Uint32_Bit_08.P_Bit.Bit_Test P_Bit_Uint32_Bit_09.P_Bit.Bit_Test P_Bit_Uint32_Bit_10.P_Bit.Bit_Test P_Bit_Uint32_Bit_11.P_Bit.Bit_Test P_Bit_Uint32_Bit_12.P_Bit.Bit_Test P_Bit_Uint32_Bit_13.P_Bit.Bit_Test P_Bit_Uint32_Bit_14.P_Bit.Bit_Test P_Bit_Uint32_Bit_15.P_Bit.Bit_Test P_Bit_Uint32_Bit_16.P_Bit.Bit_Test P_Bit_Uint32_Bit_17.P_Bit.Bit_Test P_Bit_Uint32_Bit_18.P_Bit.Bit_Test P_Bit_Uint32_Bit_19.P_Bit.Bit_Test P_Bit_Uint32_Bit_20.P_Bit.Bit_Test P_Bit_Uint32_Bit_21.P_Bit.Bit_Test P_Bit_Uint32_Bit_22.P_Bit.Bit_Test P_Bit_Uint32_Bit_23.P_Bit.Bit_Test P_Bit_Uint32_Bit_24.P_Bit.Bit_Test P_Bit_Uint32_Bit_25.P_Bit.Bit_Test P_Bit_Uint32_Bit_26.P_Bit.Bit_Test P_Bit_Uint32_Bit_27.P_Bit.Bit_Test P_Bit_Uint32_Bit_28.P_Bit.Bit_Test P_Bit_Uint32_Bit_29.P_Bit.Bit_Test P_Bit_Uint32_Bit_30.P_Bit.Bit_Test P_Bit_Uint32_Bit_31.P_Bit.Bit_Test P_Bit_Uint8_Bit_0.P_Bit.Bit_Test P_Bit_Uint8_Bit_1.P_Bit.Bit_Test P_Bit_Uint8_Bit_2.P_Bit.Bit_Test P_Bit_Uint8_Bit_3.P_Bit.Bit_Test P_Bit_Uint8_Bit_4.P_Bit.Bit_Test P_Bit_Uint8_Bit_5.P_Bit.Bit_Test P_Bit_Uint8_Bit_6.P_Bit.Bit_Test P_Bit_Uint8_Bit_7.P_Bit.Bit_Test P_Bit_Uint8_E.Extern_MEM.Bit_Test P_Bit_Uint8_E.Intern_MEM.Bit_Test P_Bit_Uint8_O.Extern_MEM.Bit_Test P_Bit_Uint8_O.Intern_MEM.Bit_Test p_UpdateBitTest_b.Bit_Test /end REF_CHARACTERISTIC
 /begin SUB_GROUP Extern_MEM.Bit_Test Intern_MEM.Bit_Test P_Bit.Bit_Test /end SUB_GROUP
/end GROUP
/begin GROUP BypassCounter "" ROOT
 /begin REF_MEASUREMENT ctrBypassB01.BypassCounter ctrBypassB01_H.BypassCounter ctrBypassB01_L.BypassCounter ctrBypassB02.BypassCounter ctrBypassB02_H.BypassCounter ctrBypassB02_L.BypassCounter ctrBypassB03.BypassCounter ctrBypassB03_H.BypassCounter ctrBypassB03_L.BypassCounter ctrBypassB04.BypassCounter ctrBypassB04_H.BypassCounter ctrBypassB04_L.BypassCounter lastCtrB01.BypassCounter lastCtrB02.BypassCounter lastCtrB03.BypassCounter lastCtrB04.BypassCounter waitCtrB01.BypassCounter waitCtrB01_H.BypassCounter waitCtrB01_L.BypassCounter waitCtrB02.BypassCounter waitCtrB02_H.BypassCounter waitCtrB02_L.BypassCounter waitCtrB03.BypassCounter waitCtrB03_H.BypassCounter waitCtrB03_L.BypassCounter waitCtrB04.BypassCounter waitCtrB04_H.BypassCounter waitCtrB04_L.BypassCounter /end REF_MEASUREMENT
/end GROUP
/begin GROUP CCP_Page "" ROOT /begin REF_MEASUREMENT CCP_current_Page.CCP_Page /end REF_MEASUREMENT /begin REF_CHARACTERISTIC P_PageSwitch.CCP_Page p_SeramCheckParamRange_u8.CCP_Page /end REF_CHARACTERISTIC /end GROUP
/begin GROUP CCP_SHELL "" ROOT
 /begin REF_MEASUREMENT CCP_overload_counter_1.CCP_SHELL CCP_overload_counter_2.CCP_SHELL CCP_overload_counter_3.CCP_SHELL Err_Count_DAQ_SAMPLE.CCP_SHELL Err_Current_DAQ_SAMPLE.CCP_SHELL Err_Current_DAQ_SAMPLE_TYP.CCP_SHELL Err_State_DAQ_SAMPLE.CCP_SHELL Max.MIN_MAX_Tick2Time.DAQ2_Sample.CCP_SHELL Max.Time.DAQ2_Tx.CCP_SHELL Max.TimeSum.DAQ2_Tx.CCP_SHELL Min.MIN_MAX_Tick2Time.DAQ2_Sample.CCP_SHELL Min.Time.DAQ2_Tx.CCP_SHELL Min.TimeSum.DAQ2_Tx.CCP_SHELL ODT_tx_status.CCP_SHELL Time.MIN_MAX_Tick2Time.DAQ2_Sample.CCP_SHELL Time.Time.DAQ2_Tx.CCP_SHELL Time.TimeSum.DAQ2_Tx.CCP_SHELL g_CcpByteOrder_u8.CCP_SHELL g_CcpModComByteOrder_u8.CCP_SHELL g_CcpMuxRaster_u32.CCP_SHELL l_ResetTimer_b.DAQ2_Sample.CCP_SHELL l_ResetTimer_b.DAQ2_Tx.CCP_SHELL l_StartTicks_u32.DAQ2_Sample.CCP_SHELL l_StartTicks_u32.DAQ2_Tx.CCP_SHELL l_StopTicks_u32.DAQ2_Sample.CCP_SHELL l_StopTicks_u32.DAQ2_Tx.CCP_SHELL l_TimeSum_u32.DAQ2_Tx.CCP_SHELL l_Timeout_b.DAQ2_Sample.CCP_SHELL l_Timeout_b.DAQ2_Tx.CCP_SHELL l_TimerCorrection_u32.CCP_SHELL test_counter.CCP_SHELL /end REF_MEASUREMENT
 /begin REF_CHARACTERISTIC iflag_mask.CCP_SHELL p_CcpByteOrder_u8.CCP_SHELL p_CcpModComByteOrder_u8.CCP_SHELL p_ResetTimer_b.DAQ2_Sample.CCP_SHELL p_ResetTimer_b.DAQ2_Tx.CCP_SHELL /end REF_CHARACTERISTIC
 /begin SUB_GROUP DAQ2_Sample.CCP_SHELL DAQ2_Tx.CCP_SHELL /end SUB_GROUP
/end GROUP
/begin GROUP CRB_OBD "" ROOT
 /begin REF_MEASUREMENT V_DetectDTCDuringDriveCycle_b.CRB_OBD V_EmissionRelatedDTCStored_b.CRB_OBD V_FreezeFrameDataStored_b.CRB_OBD g_CarbPID05_EnCoTemp40_u8.CRB_OBD g_CarbPID05_deltaEnCoTemp40_u8.CRB_OBD g_CarbPID0C_EngineRPM_u16.CRB_OBD g_CarbPID0C_deltaEngineRPM_u8.CRB_OBD g_MaxTxDTCinBlock_u8.CRB_OBD g_NumDTC_u16.CRB_OBD /end REF_MEASUREMENT
 /begin REF_CHARACTERISTIC P_Card01PID01_MIL_b.CRB_OBD P_DetectDTCDuringDriveCycle_b.CRB_OBD P_EmissionRelatedDTCStored_b.CRB_OBD P_FreezeFrameDataStored_b.CRB_OBD p_CarbPID05_deltaEnCoTemp40_u8.CRB_OBD p_CarbPID0C_deltaEngineRPM_u8.CRB_OBD p_MaxTxDTCinBlock_u8.CRB_OBD p_NumDTC_u16.CRB_OBD p_TableDTC_u16.CRB_OBD /end REF_CHARACTERISTIC
/end GROUP
/begin GROUP CURVE_Axis "" ROOT /begin SUB_GROUP Axis_Input.CURVE_Axis /end SUB_GROUP /end GROUP
/begin GROUP C_ClassDiagInfo.UDS_ISO14229 ""
 /begin REF_MEASUREMENT i_ActBdRate_u32.C_ClassDiagInfo.UDS_ISO14229 i_ComMedium_u8.C_ClassDiagInfo.UDS_ISO14229 i_ComProtocol_u8.C_ClassDiagInfo.UDS_ISO14229 i_DiaMode_u8.C_ClassDiagInfo.UDS_ISO14229 i_P2max_u32.C_ClassDiagInfo.UDS_ISO14229 i_P2min_u32.C_ClassDiagInfo.UDS_ISO14229 i_P3max_u32.C_ClassDiagInfo.UDS_ISO14229 i_P3min_u32.C_ClassDiagInfo.UDS_ISO14229 i_P4min_u32.C_ClassDiagInfo.UDS_ISO14229 i_PhysEcuAddr_u8.C_ClassDiagInfo.UDS_ISO14229 i_ReqBdRate_u32.C_ClassDiagInfo.UDS_ISO14229 i_SecLevel_u8.C_ClassDiagInfo.UDS_ISO14229 i_StimuAddrMode_u8.C_ClassDiagInfo.UDS_ISO14229 i_StimuAddr_u8.C_ClassDiagInfo.UDS_ISO14229 /end REF_MEASUREMENT
 /begin REF_CHARACTERISTIC pi_ActBdRate_u32.C_ClassDiagInfo.UDS_ISO14229 pi_ComMedium_u8.C_ClassDiagInfo.UDS_ISO14229 pi_ComProtocol_u8.C_ClassDiagInfo.UDS_ISO14229 pi_DiaMode_u8.C_ClassDiagInfo.UDS_ISO14229 pi_P2max_u32.C_ClassDiagInfo.UDS_ISO14229 pi_P2min_u32.C_ClassDiagInfo.UDS_ISO14229 pi_P3max_u32.C_ClassDiagInfo.UDS_ISO14229 pi_P3min_u32.C_ClassDiagInfo.UDS_ISO14229 pi_P4min_u32.C_ClassDiagInfo.UDS_ISO14229 pi_PhysEcuAddr_u8.C_ClassDiagInfo.UDS_ISO14229 pi_ReqBdRate_u32.C_ClassDiagInfo.UDS_ISO14229 pi_SecLevel_u8.C_ClassDiagInfo.UDS_ISO14229 pi_StimuAddrMode_u8.C_ClassDiagInfo.UDS_ISO14229 pi_StimuAddr_u8.C_ClassDiagInfo.UDS_ISO14229 /end REF_CHARACTERISTIC
/end GROUP
/begin GROUP C_ClassUdsSendList01.UdsSendList ""
 /begin REF_MEASUREMENT i_CanID_u32.C_ClassUdsSendList01.UdsSendList i_NumEntries_u8.C_ClassUdsSendList01.UdsSendList i_PeriodicID_u16.C_ClassUdsSendList01.UdsSendList i_RasterMode_u8.C_ClassUdsSendList01.UdsSendList i_ResponceType_u8.C_ClassUdsSendList01.UdsSendList i_SampleBuf_au8.C_ClassUdsSendList01.UdsSendList i_UdsDaqList_pu32.C_ClassUdsSendList01.UdsSendList i_UdsSendListState_u8.C_ClassUdsSendList01.UdsSendList /end REF_MEASUREMENT
/end GROUP
/begin GROUP C_ClassUdsSendList02.UdsSendList ""
 /begin REF_MEASUREMENT i_CanID_u32.C_ClassUdsSendList02.UdsSendList i_NumEntries_u8.C_ClassUdsSendList02.UdsSendList i_PeriodicID_u16.C_ClassUdsSendList02.UdsSendList i_RasterMode_u8.C_ClassUdsSendList02.UdsSendList i_ResponceType_u8.C_ClassUdsSendList02.UdsSendList i_SampleBuf_au8.C_ClassUdsSendList02.UdsSendList i_UdsDaqList_pu32.C_ClassUdsSendList02.UdsSendList i_UdsSendListState_u8.C_ClassUdsSendList02.UdsSendList /end REF_MEASUREMENT
/end GROUP
/begin GROUP C_ClassUdsSendList03.UdsSendList ""
 /begin REF_MEASUREMENT i_CanID_u32.C_ClassUdsSendList03.UdsSendList i_NumEntries_u8.C_ClassUdsSendList03.UdsSendList i_PeriodicID_u16.C_ClassUdsSendList03.UdsSendList i_RasterMode_u8.C_ClassUdsSendList03.UdsSendList i_ResponceType_u8.C_ClassUdsSendList03.UdsSendList i_SampleBuf_au8.C_ClassUdsSendList03.UdsSendList i_UdsDaqList_pu32.C_ClassUdsSendList03.UdsSendList i_UdsSendListState_u8.C_ClassUdsSendList03.UdsSendList /end REF_MEASUREMENT
/end GROUP
/begin GROUP C_ClassUdsSendList04.UdsSendList ""
 /begin REF_MEASUREMENT i_CanID_u32.C_ClassUdsSendList04.UdsSendList i_NumEntries_u8.C_ClassUdsSendList04.UdsSendList i_PeriodicID_u16.C_ClassUdsSendList04.UdsSendList i_RasterMode_u8.C_ClassUdsSendList04.UdsSendList i_ResponceType_u8.C_ClassUdsSendList04.UdsSendList i_SampleBuf_au8.C_ClassUdsSendList04.UdsSendList i_UdsDaqList_pu32.C_ClassUdsSendList04.UdsSendList i_UdsSendListState_u8.C_ClassUdsSendList04.UdsSendList /end REF_MEASUREMENT
/end GROUP
/begin GROUP C_ClassUdsSendList05.UdsSendList ""
 /begin REF_MEASUREMENT i_CanID_u32.C_ClassUdsSendList05.UdsSendList i_NumEntries_u8.C_ClassUdsSendList05.UdsSendList i_PeriodicID_u16.C_ClassUdsSendList05.UdsSendList i_RasterMode_u8.C_ClassUdsSendList05.UdsSendList i_ResponceType_u8.C_ClassUdsSendList05.UdsSendList i_SampleBuf_au8.C_ClassUdsSendList05.UdsSendList i_UdsDaqList_pu32.C_ClassUdsSendList05.UdsSendList i_UdsSendListState_u8.C_ClassUdsSendList05.UdsSendList /end REF_MEASUREMENT
/end GROUP
/begin GROUP C_ClassUdsSendList06.UdsSendList ""
 /begin REF_MEASUREMENT i_CanID_u32.C_ClassUdsSendList06.UdsSendList i_NumEntries_u8.C_ClassUdsSendList06.UdsSendList i_PeriodicID_u16.C_ClassUdsSendList06.UdsSendList i_RasterMode_u8.C_ClassUdsSendList06.UdsSendList i_ResponceType_u8.C_ClassUdsSendList06.UdsSendList i_SampleBuf_au8.C_ClassUdsSendList06.UdsSendList i_UdsDaqList_pu32.C_ClassUdsSendList06.UdsSendList i_UdsSendListState_u8.C_ClassUdsSendList06.UdsSendList /end REF_MEASUREMENT
/end GROUP
/begin GROUP C_ClassUdsSendList07.UdsSendList ""
 /begin REF_MEASUREMENT i_CanID_u32.C_ClassUdsSendList07.UdsSendList i_NumEntries_u8.C_ClassUdsSendList07.UdsSendList i_PeriodicID_u16.C_ClassUdsSendList07.UdsSendList i_RasterMode_u8.C_ClassUdsSendList07.UdsSendList i_ResponceType_u8.C_ClassUdsSendList07.UdsSendList i_SampleBuf_au8.C_ClassUdsSendList07.UdsSendList i_UdsDaqList_pu32.C_ClassUdsSendList07.UdsSendList i_UdsSendListState_u8.C_ClassUdsSendList07.UdsSendList /end REF_MEASUREMENT
/end GROUP
/begin GROUP C_ClassUdsSendList08.UdsSendList ""
 /begin REF_MEASUREMENT i_CanID_u32.C_ClassUdsSendList08.UdsSendList i_NumEntries_u8.C_ClassUdsSendList08.UdsSendList i_PeriodicID_u16.C_ClassUdsSendList08.UdsSendList i_RasterMode_u8.C_ClassUdsSendList08.UdsSendList i_ResponceType_u8.C_ClassUdsSendList08.UdsSendList i_SampleBuf_au8.C_ClassUdsSendList08.UdsSendList i_UdsDaqList_pu32.C_ClassUdsSendList08.UdsSendList i_UdsSendListState_u8.C_ClassUdsSendList08.UdsSendList /end REF_MEASUREMENT
/end GROUP
/begin GROUP C_ClassUdsSendList09.UdsSendList ""
 /begin REF_MEASUREMENT i_CanID_u32.C_ClassUdsSendList09.UdsSendList i_NumEntries_u8.C_ClassUdsSendList09.UdsSendList i_PeriodicID_u16.C_ClassUdsSendList09.UdsSendList i_RasterMode_u8.C_ClassUdsSendList09.UdsSendList i_ResponceType_u8.C_ClassUdsSendList09.UdsSendList i_SampleBuf_au8.C_ClassUdsSendList09.UdsSendList i_UdsDaqList_pu32.C_ClassUdsSendList09.UdsSendList i_UdsSendListState_u8.C_ClassUdsSendList09.UdsSendList /end REF_MEASUREMENT
/end GROUP
/begin GROUP C_ClassUdsSendList10.UdsSendList ""
 /begin REF_MEASUREMENT i_CanID_u32.C_ClassUdsSendList10.UdsSendList i_NumEntries_u8.C_ClassUdsSendList10.UdsSendList i_PeriodicID_u16.C_ClassUdsSendList10.UdsSendList i_RasterMode_u8.C_ClassUdsSendList10.UdsSendList i_ResponceType_u8.C_ClassUdsSendList10.UdsSendList i_SampleBuf_au8.C_ClassUdsSendList10.UdsSendList i_UdsDaqList_pu32.C_ClassUdsSendList10.UdsSendList i_UdsSendListState_u8.C_ClassUdsSendList10.UdsSendList /end REF_MEASUREMENT
/end GROUP
/begin GROUP C_ClassUdsSendList11.UdsSendList ""
 /begin REF_MEASUREMENT i_CanID_u32.C_ClassUdsSendList11.UdsSendList i_NumEntries_u8.C_ClassUdsSendList11.UdsSendList i_PeriodicID_u16.C_ClassUdsSendList11.UdsSendList i_RasterMode_u8.C_ClassUdsSendList11.UdsSendList i_ResponceType_u8.C_ClassUdsSendList11.UdsSendList i_SampleBuf_au8.C_ClassUdsSendList11.UdsSendList i_UdsDaqList_pu32.C_ClassUdsSendList11.UdsSendList i_UdsSendListState_u8.C_ClassUdsSendList11.UdsSendList /end REF_MEASUREMENT
/end GROUP
/begin GROUP C_ClassUdsSendList12.UdsSendList ""
 /begin REF_MEASUREMENT i_CanID_u32.C_ClassUdsSendList12.UdsSendList i_NumEntries_u8.C_ClassUdsSendList12.UdsSendList i_PeriodicID_u16.C_ClassUdsSendList12.UdsSendList i_RasterMode_u8.C_ClassUdsSendList12.UdsSendList i_ResponceType_u8.C_ClassUdsSendList12.UdsSendList i_SampleBuf_au8.C_ClassUdsSendList12.UdsSendList i_UdsDaqList_pu32.C_ClassUdsSendList12.UdsSendList i_UdsSendListState_u8.C_ClassUdsSendList12.UdsSendList /end REF_MEASUREMENT
/end GROUP
/begin GROUP C_ClassUdsSendList13.UdsSendList ""
 /begin REF_MEASUREMENT i_CanID_u32.C_ClassUdsSendList13.UdsSendList i_NumEntries_u8.C_ClassUdsSendList13.UdsSendList i_PeriodicID_u16.C_ClassUdsSendList13.UdsSendList i_RasterMode_u8.C_ClassUdsSendList13.UdsSendList i_ResponceType_u8.C_ClassUdsSendList13.UdsSendList i_SampleBuf_au8.C_ClassUdsSendList13.UdsSendList i_UdsDaqList_pu32.C_ClassUdsSendList13.UdsSendList i_UdsSendListState_u8.C_ClassUdsSendList13.UdsSendList /end REF_MEASUREMENT
/end GROUP
/begin GROUP C_ClassUdsSendList14.UdsSendList ""
 /begin REF_MEASUREMENT i_CanID_u32.C_ClassUdsSendList14.UdsSendList i_NumEntries_u8.C_ClassUdsSendList14.UdsSendList i_PeriodicID_u16.C_ClassUdsSendList14.UdsSendList i_RasterMode_u8.C_ClassUdsSendList14.UdsSendList i_ResponceType_u8.C_ClassUdsSendList14.UdsSendList i_SampleBuf_au8.C_ClassUdsSendList14.UdsSendList i_UdsDaqList_pu32.C_ClassUdsSendList14.UdsSendList i_UdsSendListState_u8.C_ClassUdsSendList14.UdsSendList /end REF_MEASUREMENT
/end GROUP
/begin GROUP C_ClassUdsSendList15.UdsSendList ""
 /begin REF_MEASUREMENT i_CanID_u32.C_ClassUdsSendList15.UdsSendList i_NumEntries_u8.C_ClassUdsSendList15.UdsSendList i_PeriodicID_u16.C_ClassUdsSendList15.UdsSendList i_RasterMode_u8.C_ClassUdsSendList15.UdsSendList i_ResponceType_u8.C_ClassUdsSendList15.UdsSendList i_SampleBuf_au8.C_ClassUdsSendList15.UdsSendList i_UdsDaqList_pu32.C_ClassUdsSendList15.UdsSendList i_UdsSendListState_u8.C_ClassUdsSendList15.UdsSendList /end REF_MEASUREMENT
/end GROUP
/begin GROUP C_ClassUdsSendList16.UdsSendList ""
 /begin REF_MEASUREMENT i_CanID_u32.C_ClassUdsSendList16.UdsSendList i_NumEntries_u8.C_ClassUdsSendList16.UdsSendList i_PeriodicID_u16.C_ClassUdsSendList16.UdsSendList i_RasterMode_u8.C_ClassUdsSendList16.UdsSendList i_ResponceType_u8.C_ClassUdsSendList16.UdsSendList i_SampleBuf_au8.C_ClassUdsSendList16.UdsSendList i_UdsDaqList_pu32.C_ClassUdsSendList16.UdsSendList i_UdsSendListState_u8.C_ClassUdsSendList16.UdsSendList /end REF_MEASUREMENT
/end GROUP
/begin GROUP C_ClassUdsSendList17.UdsSendList ""
 /begin REF_MEASUREMENT i_CanID_u32.C_ClassUdsSendList17.UdsSendList i_NumEntries_u8.C_ClassUdsSendList17.UdsSendList i_PeriodicID_u16.C_ClassUdsSendList17.UdsSendList i_RasterMode_u8.C_ClassUdsSendList17.UdsSendList i_ResponceType_u8.C_ClassUdsSendList17.UdsSendList i_SampleBuf_au8.C_ClassUdsSendList17.UdsSendList i_UdsDaqList_pu32.C_ClassUdsSendList17.UdsSendList i_UdsSendListState_u8.C_ClassUdsSendList17.UdsSendList /end REF_MEASUREMENT
/end GROUP
/begin GROUP C_ClassUdsSendList18.UdsSendList ""
 /begin REF_MEASUREMENT i_CanID_u32.C_ClassUdsSendList18.UdsSendList i_NumEntries_u8.C_ClassUdsSendList18.UdsSendList i_PeriodicID_u16.C_ClassUdsSendList18.UdsSendList i_RasterMode_u8.C_ClassUdsSendList18.UdsSendList i_ResponceType_u8.C_ClassUdsSendList18.UdsSendList i_SampleBuf_au8.C_ClassUdsSendList18.UdsSendList i_UdsDaqList_pu32.C_ClassUdsSendList18.UdsSendList i_UdsSendListState_u8.C_ClassUdsSendList18.UdsSendList /end REF_MEASUREMENT
/end GROUP
/begin GROUP C_ClassUdsSendList19.UdsSendList ""
 /begin REF_MEASUREMENT i_CanID_u32.C_ClassUdsSendList19.UdsSendList i_NumEntries_u8.C_ClassUdsSendList19.UdsSendList i_PeriodicID_u16.C_ClassUdsSendList19.UdsSendList i_RasterMode_u8.C_ClassUdsSendList19.UdsSendList i_ResponceType_u8.C_ClassUdsSendList19.UdsSendList i_SampleBuf_au8.C_ClassUdsSendList19.UdsSendList i_UdsDaqList_pu32.C_ClassUdsSendList19.UdsSendList i_UdsSendListState_u8.C_ClassUdsSendList19.UdsSendList /end REF_MEASUREMENT
/end GROUP
/begin GROUP C_ClassUdsSendList20.UdsSendList ""
 /begin REF_MEASUREMENT i_CanID_u32.C_ClassUdsSendList20.UdsSendList i_NumEntries_u8.C_ClassUdsSendList20.UdsSendList i_PeriodicID_u16.C_ClassUdsSendList20.UdsSendList i_RasterMode_u8.C_ClassUdsSendList20.UdsSendList i_ResponceType_u8.C_ClassUdsSendList20.UdsSendList i_SampleBuf_au8.C_ClassUdsSendList20.UdsSendList i_UdsDaqList_pu32.C_ClassUdsSendList20.UdsSendList i_UdsSendListState_u8.C_ClassUdsSendList20.UdsSendList /end REF_MEASUREMENT
/end GROUP
/begin GROUP C_ClassUdsSendList21.UdsSendList ""
 /begin REF_MEASUREMENT i_CanID_u32.C_ClassUdsSendList21.UdsSendList i_NumEntries_u8.C_ClassUdsSendList21.UdsSendList i_PeriodicID_u16.C_ClassUdsSendList21.UdsSendList i_RasterMode_u8.C_ClassUdsSendList21.UdsSendList i_ResponceType_u8.C_ClassUdsSendList21.UdsSendList i_SampleBuf_au8.C_ClassUdsSendList21.UdsSendList i_UdsDaqList_pu32.C_ClassUdsSendList21.UdsSendList i_UdsSendListState_u8.C_ClassUdsSendList21.UdsSendList /end REF_MEASUREMENT
/end GROUP
/begin GROUP C_ClassUdsSendList22.UdsSendList ""
 /begin REF_MEASUREMENT i_CanID_u32.C_ClassUdsSendList22.UdsSendList i_NumEntries_u8.C_ClassUdsSendList22.UdsSendList i_PeriodicID_u16.C_ClassUdsSendList22.UdsSendList i_RasterMode_u8.C_ClassUdsSendList22.UdsSendList i_ResponceType_u8.C_ClassUdsSendList22.UdsSendList i_SampleBuf_au8.C_ClassUdsSendList22.UdsSendList i_UdsDaqList_pu32.C_ClassUdsSendList22.UdsSendList i_UdsSendListState_u8.C_ClassUdsSendList22.UdsSendList /end REF_MEASUREMENT
/end GROUP
/begin GROUP C_ClassUdsSendList23.UdsSendList ""
 /begin REF_MEASUREMENT i_CanID_u32.C_ClassUdsSendList23.UdsSendList i_NumEntries_u8.C_ClassUdsSendList23.UdsSendList i_PeriodicID_u16.C_ClassUdsSendList23.UdsSendList i_RasterMode_u8.C_ClassUdsSendList23.UdsSendList i_ResponceType_u8.C_ClassUdsSendList23.UdsSendList i_SampleBuf_au8.C_ClassUdsSendList23.UdsSendList i_UdsDaqList_pu32.C_ClassUdsSendList23.UdsSendList i_UdsSendListState_u8.C_ClassUdsSendList23.UdsSendList /end REF_MEASUREMENT
/end GROUP
/begin GROUP C_ClassUdsSendList24.UdsSendList ""
 /begin REF_MEASUREMENT i_CanID_u32.C_ClassUdsSendList24.UdsSendList i_NumEntries_u8.C_ClassUdsSendList24.UdsSendList i_PeriodicID_u16.C_ClassUdsSendList24.UdsSendList i_RasterMode_u8.C_ClassUdsSendList24.UdsSendList i_ResponceType_u8.C_ClassUdsSendList24.UdsSendList i_SampleBuf_au8.C_ClassUdsSendList24.UdsSendList i_UdsDaqList_pu32.C_ClassUdsSendList24.UdsSendList i_UdsSendListState_u8.C_ClassUdsSendList24.UdsSendList /end REF_MEASUREMENT
/end GROUP
/begin GROUP C_ClassUdsVIN.UdsLocIDs ""
 /begin REF_MEASUREMENT i_LocalIdData_au8.C_ClassUdsVIN.UdsLocIDs i_LocalId_u16.C_ClassUdsVIN.UdsLocIDs i_LocalIds_pu32.C_ClassUdsVIN.UdsLocIDs /end REF_MEASUREMENT
 /begin REF_CHARACTERISTIC ip_NumEntries_u8.C_ClassUdsVIN.UdsLocIDs /end REF_CHARACTERISTIC
/end GROUP
/begin GROUP C_ClassUdsVIN2.UdsLocIDs ""
 /begin REF_MEASUREMENT i_LocalIdData_au8.C_ClassUdsVIN2.UdsLocIDs i_LocalId_u16.C_ClassUdsVIN2.UdsLocIDs i_LocalIds_pu32.C_ClassUdsVIN2.UdsLocIDs /end REF_MEASUREMENT
 /begin REF_CHARACTERISTIC ip_NumEntries_u8.C_ClassUdsVIN2.UdsLocIDs /end REF_CHARACTERISTIC
/end GROUP
/begin GROUP Cal_Measure "" ROOT
 /begin REF_MEASUREMENT M_F32_1.Cal_Measure M_F32_2.Cal_Measure M_F64_1.Cal_Measure M_F64_2.Cal_Measure M_S16_1.Cal_Measure M_S16_2.Cal_Measure M_S16_3.Cal_Measure M_S32_1.Cal_Measure M_S32_2.Cal_Measure M_S8_1.Cal_Measure M_S8_2.Cal_Measure M_S8_3.Cal_Measure M_S8_4.Cal_Measure M_U16_1.Cal_Measure M_U16_2.Cal_Measure M_U16_3.Cal_Measure M_U32_1.Cal_Measure M_U32_2.Cal_Measure M_U8_1.Cal_Measure M_U8_2.Cal_Measure M_U8_3.Cal_Measure M_U8_4.Cal_Measure /end REF_MEASUREMENT
 /begin REF_CHARACTERISTIC P_F32_1.Cal_Measure P_F32_2.Cal_Measure P_F64_1.Cal_Measure P_F64_2.Cal_Measure P_S16_1.Cal_Measure P_S16_2.Cal_Measure P_S16_3.Cal_Measure P_S32_1.Cal_Measure P_S32_2.Cal_Measure P_S8_1.Cal_Measure P_S8_2.Cal_Measure P_S8_3.Cal_Measure P_S8_4.Cal_Measure P_U16_1.Cal_Measure P_U16_2.Cal_Measure P_U16_3.Cal_Measure P_U32_1.Cal_Measure P_U32_2.Cal_Measure P_U8_1.Cal_Measure P_U8_2.Cal_Measure P_U8_3.Cal_Measure P_U8_4.Cal_Measure /end REF_CHARACTERISTIC
/end GROUP
/begin GROUP Cal_Measure_Blocks "" ROOT
 /begin REF_MEASUREMENT Index_x.Cal_Measure_Blocks Index_y.Cal_Measure_Blocks M_Fl32_array.Cal_Measure_Blocks M_Fl32_matrix.Cal_Measure_Blocks M_Fl64_array.Cal_Measure_Blocks M_Fl64_matrix.Cal_Measure_Blocks M_Sint16_array.Cal_Measure_Blocks M_Sint16_matrix.Cal_Measure_Blocks M_Sint32_array.Cal_Measure_Blocks M_Sint32_matrix.Cal_Measure_Blocks M_Sint8_array.Cal_Measure_Blocks M_Sint8_matrix.Cal_Measure_Blocks M_Uint16_array.Cal_Measure_Blocks M_Uint16_matrix.Cal_Measure_Blocks M_Uint32_array.Cal_Measure_Blocks M_Uint32_matrix.Cal_Measure_Blocks M_Uint8_array.Cal_Measure_Blocks M_Uint8_matrix.Cal_Measure_Blocks /end REF_MEASUREMENT
 /begin REF_CHARACTERISTIC P_Fl32_array.Cal_Measure_Blocks P_Fl32_matrix.Cal_Measure_Blocks P_Fl64_array.Cal_Measure_Blocks P_Fl64_matrix.Cal_Measure_Blocks P_Sint16_array.Cal_Measure_Blocks P_Sint16_matrix.Cal_Measure_Blocks P_Sint32_array.Cal_Measure_Blocks P_Sint32_matrix.Cal_Measure_Blocks P_Sint8_array.Cal_Measure_Blocks P_Sint8_matrix.Cal_Measure_Blocks P_Uint16_array.Cal_Measure_Blocks P_Uint16_matrix.Cal_Measure_Blocks P_Uint32_array.Cal_Measure_Blocks P_Uint32_matrix.Cal_Measure_Blocks P_Uint8_array.Cal_Measure_Blocks P_Uint8_matrix.Cal_Measure_Blocks /end REF_CHARACTERISTIC
/end GROUP
/begin GROUP CanDriver "" ROOT
 /begin REF_MEASUREMENT B13_Mode.CanDriver B17_Mode.CanDriver B23_Mode.CanDriver B25_Mode.CanDriver B27_Mode.CanDriver B29_Mode.CanDriver B2_Mode.CanDriver B35_Mode.CanDriver B38_Mode.CanDriver B56_Mode.CanDriver B5_Mode.CanDriver B9_Mode.CanDriver CAN_Stat_Bx.CanDriver CAN_Status.CanDriver g_CanError_au8.CanDriver g_RingBufRead_u8.CanDriver g_RingBufWrite_u8.CanDriver g_Ringbuffer_au8.CanDriver g_fast_on_off_b.CanDriver /end REF_MEASUREMENT
 /begin REF_CHARACTERISTIC P_CAN_C_Buf.CanDriver P_CAN_C_IdTyp.CanDriver P_CAN_DataSwitch.CanDriver P_CAN_IDs.CanDriver P_CAN_IDs_fast.CanDriver P_CAN_Length.CanDriver P_CAN_Length_fast.CanDriver P_CAN_R01_Enable.CanDriver P_CAN_R02_Enable.CanDriver P_CAN_R03_Enable.CanDriver P_CAN_R04_Enable.CanDriver P_CAN_R05_Enable.CanDriver P_CAN_R06_Enable.CanDriver P_CAN_R07_Enable.CanDriver P_CAN_R08_Enable.CanDriver P_CAN_R09_Enable.CanDriver P_CAN_R10_Enable.CanDriver P_CAN_R11_Enable.CanDriver P_CAN_R12_Enable.CanDriver P_CAN_R13_Enable.CanDriver P_CAN_R14_Enable.CanDriver P_CAN_R15_Enable.CanDriver P_CAN_R16_Enable.CanDriver P_Reset_CAN_Err_Counter.CanDriver P_can_on_off.CanDriver P_extended_on_off.CanDriver P_fast_on_off.CanDriver P_standard_on_off.CanDriver /end REF_CHARACTERISTIC
/end GROUP
/begin GROUP Counter_R01_1.Counter_module_Mle "" /begin REF_MEASUREMENT V_counter_1.Counter_R01_1.Counter_module_Mle /end REF_MEASUREMENT /end GROUP
/begin GROUP Counter_module_Mle "" ROOT /begin REF_MEASUREMENT V_counter_1.Counter_R01_1.Counter_module_Mle /end REF_MEASUREMENT
 /begin REF_CHARACTERISTIC P_counter_1_delta.Counter_module_Mle P_counter_1_updown.Counter_module_Mle P_reset_counter.Counter_module_Mle /end REF_CHARACTERISTIC
 /begin SUB_GROUP Counter_R01_1.Counter_module_Mle /end SUB_GROUP
/end GROUP
/begin GROUP Curve_Calc_16.Curve_Module ""
 /begin REF_MEASUREMENT cell_nr.Curve_Calc_16.Curve_Module curve_out.Curve_Calc_16.Curve_Module input_array.Curve_Calc_16.Curve_Module /end REF_MEASUREMENT
 /begin REF_CHARACTERISTIC curve_table.Curve_Calc_16.Curve_Module nr_of_cells.Curve_Calc_16.Curve_Module /end REF_CHARACTERISTIC
/end GROUP
/begin GROUP Curve_Module "" ROOT
 /begin REF_MEASUREMENT cell_nr.Curve_Calc_16.Curve_Module curve_out.Curve_Calc_16.Curve_Module input_array.Curve_Calc_16.Curve_Module /end REF_MEASUREMENT
 /begin REF_CHARACTERISTIC curve_table.Curve_Calc_16.Curve_Module nr_of_cells.Curve_Calc_16.Curve_Module /end REF_CHARACTERISTIC
/end GROUP
/begin GROUP DAQ2_Sample.CCP_SHELL ""
 /begin REF_MEASUREMENT Max.MIN_MAX_Tick2Time.DAQ2_Sample.CCP_SHELL Min.MIN_MAX_Tick2Time.DAQ2_Sample.CCP_SHELL Time.MIN_MAX_Tick2Time.DAQ2_Sample.CCP_SHELL l_ResetTimer_b.DAQ2_Sample.CCP_SHELL l_StartTicks_u32.DAQ2_Sample.CCP_SHELL l_StopTicks_u32.DAQ2_Sample.CCP_SHELL l_Timeout_b.DAQ2_Sample.CCP_SHELL /end REF_MEASUREMENT
 /begin REF_CHARACTERISTIC p_ResetTimer_b.DAQ2_Sample.CCP_SHELL /end REF_CHARACTERISTIC
/end GROUP
/begin GROUP DAQ2_Tx.CCP_SHELL ""
 /begin REF_MEASUREMENT Max.Time.DAQ2_Tx.CCP_SHELL Max.TimeSum.DAQ2_Tx.CCP_SHELL Min.Time.DAQ2_Tx.CCP_SHELL Min.TimeSum.DAQ2_Tx.CCP_SHELL Time.Time.DAQ2_Tx.CCP_SHELL Time.TimeSum.DAQ2_Tx.CCP_SHELL l_ResetTimer_b.DAQ2_Tx.CCP_SHELL l_StartTicks_u32.DAQ2_Tx.CCP_SHELL l_StopTicks_u32.DAQ2_Tx.CCP_SHELL l_TimeSum_u32.DAQ2_Tx.CCP_SHELL l_Timeout_b.DAQ2_Tx.CCP_SHELL /end REF_MEASUREMENT
 /begin REF_CHARACTERISTIC p_ResetTimer_b.DAQ2_Tx.CCP_SHELL /end REF_CHARACTERISTIC
/end GROUP
/begin GROUP Extern_MEM.Bit_Test ""
 /begin REF_MEASUREMENT Bit_Sint16_Bit_00.Extern_MEM.Bit_Test Bit_Sint16_Bit_01.Extern_MEM.Bit_Test Bit_Sint16_Bit_02.Extern_MEM.Bit_Test Bit_Sint16_Bit_03.Extern_MEM.Bit_Test Bit_Sint16_Bit_04.Extern_MEM.Bit_Test Bit_Sint16_Bit_05.Extern_MEM.Bit_Test Bit_Sint16_Bit_06.Extern_MEM.Bit_Test Bit_Sint16_Bit_07.Extern_MEM.Bit_Test Bit_Sint16_Bit_08.Extern_MEM.Bit_Test Bit_Sint16_Bit_09.Extern_MEM.Bit_Test Bit_Sint16_Bit_10.Extern_MEM.Bit_Test Bit_Sint16_Bit_11.Extern_MEM.Bit_Test Bit_Sint16_Bit_12.Extern_MEM.Bit_Test Bit_Sint16_Bit_13.Extern_MEM.Bit_Test Bit_Sint16_Bit_14.Extern_MEM.Bit_Test Bit_Sint16_Bit_15.Extern_MEM.Bit_Test Bit_Sint16_Bit_x.Extern_MEM.Bit_Test Bit_Sint32_Bit_00.Extern_MEM.Bit_Test Bit_Sint32_Bit_01.Extern_MEM.Bit_Test Bit_Sint32_Bit_02.Extern_MEM.Bit_Test Bit_Sint32_Bit_03.Extern_MEM.Bit_Test Bit_Sint32_Bit_04.Extern_MEM.Bit_Test Bit_Sint32_Bit_05.Extern_MEM.Bit_Test Bit_Sint32_Bit_06.Extern_MEM.Bit_Test Bit_Sint32_Bit_07.Extern_MEM.Bit_Test Bit_Sint32_Bit_08.Extern_MEM.Bit_Test Bit_Sint32_Bit_09.Extern_MEM.Bit_Test Bit_Sint32_Bit_10.Extern_MEM.Bit_Test Bit_Sint32_Bit_11.Extern_MEM.Bit_Test Bit_Sint32_Bit_12.Extern_MEM.Bit_Test Bit_Sint32_Bit_13.Extern_MEM.Bit_Test Bit_Sint32_Bit_14.Extern_MEM.Bit_Test Bit_Sint32_Bit_15.Extern_MEM.Bit_Test Bit_Sint32_Bit_16.Extern_MEM.Bit_Test Bit_Sint32_Bit_17.Extern_MEM.Bit_Test Bit_Sint32_Bit_18.Extern_MEM.Bit_Test Bit_Sint32_Bit_19.Extern_MEM.Bit_Test Bit_Sint32_Bit_20.Extern_MEM.Bit_Test Bit_Sint32_Bit_21.Extern_MEM.Bit_Test Bit_Sint32_Bit_22.Extern_MEM.Bit_Test Bit_Sint32_Bit_23.Extern_MEM.Bit_Test Bit_Sint32_Bit_24.Extern_MEM.Bit_Test Bit_Sint32_Bit_25.Extern_MEM.Bit_Test Bit_Sint32_Bit_26.Extern_MEM.Bit_Test Bit_Sint32_Bit_27.Extern_MEM.Bit_Test Bit_Sint32_Bit_28.Extern_MEM.Bit_Test Bit_Sint32_Bit_29.Extern_MEM.Bit_Test Bit_Sint32_Bit_30.Extern_MEM.Bit_Test Bit_Sint32_Bit_31.Extern_MEM.Bit_Test Bit_Sint32_Bit_x.Extern_MEM.Bit_Test Bit_Sint8_E_Bit_0.Extern_MEM.Bit_Test Bit_Sint8_E_Bit_1.Extern_MEM.Bit_Test Bit_Sint8_E_Bit_2.Extern_MEM.Bit_Test Bit_Sint8_E_Bit_3.Extern_MEM.Bit_Test Bit_Sint8_E_Bit_4.Extern_MEM.Bit_Test Bit_Sint8_E_Bit_5.Extern_MEM.Bit_Test Bit_Sint8_E_Bit_6.Extern_MEM.Bit_Test Bit_Sint8_E_Bit_7.Extern_MEM.Bit_Test Bit_Sint8_E_Bit_x.Extern_MEM.Bit_Test Bit_Sint8_O_Bit_0.Extern_MEM.Bit_Test Bit_Sint8_O_Bit_1.Extern_MEM.Bit_Test Bit_Sint8_O_Bit_2.Extern_MEM.Bit_Test Bit_Sint8_O_Bit_3.Extern_MEM.Bit_Test Bit_Sint8_O_Bit_4.Extern_MEM.Bit_Test Bit_Sint8_O_Bit_5.Extern_MEM.Bit_Test Bit_Sint8_O_Bit_6.Extern_MEM.Bit_Test Bit_Sint8_O_Bit_7.Extern_MEM.Bit_Test Bit_Sint8_O_Bit_x.Extern_MEM.Bit_Test Bit_Uint16_Bit_00.Extern_MEM.Bit_Test Bit_Uint16_Bit_01.Extern_MEM.Bit_Test Bit_Uint16_Bit_02.Extern_MEM.Bit_Test Bit_Uint16_Bit_03.Extern_MEM.Bit_Test Bit_Uint16_Bit_04.Extern_MEM.Bit_Test Bit_Uint16_Bit_05.Extern_MEM.Bit_Test Bit_Uint16_Bit_06.Extern_MEM.Bit_Test Bit_Uint16_Bit_07.Extern_MEM.Bit_Test Bit_Uint16_Bit_08.Extern_MEM.Bit_Test Bit_Uint16_Bit_09.Extern_MEM.Bit_Test Bit_Uint16_Bit_10.Extern_MEM.Bit_Test Bit_Uint16_Bit_11.Extern_MEM.Bit_Test Bit_Uint16_Bit_12.Extern_MEM.Bit_Test Bit_Uint16_Bit_13.Extern_MEM.Bit_Test Bit_Uint16_Bit_14.Extern_MEM.Bit_Test Bit_Uint16_Bit_15.Extern_MEM.Bit_Test Bit_Uint16_Bit_x.Extern_MEM.Bit_Test Bit_Uint32_Bit_00.Extern_MEM.Bit_Test Bit_Uint32_Bit_01.Extern_MEM.Bit_Test Bit_Uint32_Bit_02.Extern_MEM.Bit_Test Bit_Uint32_Bit_03.Extern_MEM.Bit_Test Bit_Uint32_Bit_04.Extern_MEM.Bit_Test Bit_Uint32_Bit_05.Extern_MEM.Bit_Test Bit_Uint32_Bit_06.Extern_MEM.Bit_Test Bit_Uint32_Bit_07.Extern_MEM.Bit_Test Bit_Uint32_Bit_08.Extern_MEM.Bit_Test Bit_Uint32_Bit_09.Extern_MEM.Bit_Test Bit_Uint32_Bit_10.Extern_MEM.Bit_Test Bit_Uint32_Bit_11.Extern_MEM.Bit_Test Bit_Uint32_Bit_12.Extern_MEM.Bit_Test Bit_Uint32_Bit_13.Extern_MEM.Bit_Test Bit_Uint32_Bit_14.Extern_MEM.Bit_Test Bit_Uint32_Bit_15.Extern_MEM.Bit_Test Bit_Uint32_Bit_16.Extern_MEM.Bit_Test Bit_Uint32_Bit_17.Extern_MEM.Bit_Test Bit_Uint32_Bit_18.Extern_MEM.Bit_Test Bit_Uint32_Bit_19.Extern_MEM.Bit_Test Bit_Uint32_Bit_20.Extern_MEM.Bit_Test Bit_Uint32_Bit_21.Extern_MEM.Bit_Test Bit_Uint32_Bit_22.Extern_MEM.Bit_Test Bit_Uint32_Bit_23.Extern_MEM.Bit_Test Bit_Uint32_Bit_24.Extern_MEM.Bit_Test Bit_Uint32_Bit_25.Extern_MEM.Bit_Test Bit_Uint32_Bit_26.Extern_MEM.Bit_Test Bit_Uint32_Bit_27.Extern_MEM.Bit_Test Bit_Uint32_Bit_28.Extern_MEM.Bit_Test Bit_Uint32_Bit_29.Extern_MEM.Bit_Test Bit_Uint32_Bit_30.Extern_MEM.Bit_Test Bit_Uint32_Bit_31.Extern_MEM.Bit_Test Bit_Uint32_Bit_x.Extern_MEM.Bit_Test Bit_Uint8_E_Bit_0.Extern_MEM.Bit_Test Bit_Uint8_E_Bit_1.Extern_MEM.Bit_Test Bit_Uint8_E_Bit_2.Extern_MEM.Bit_Test Bit_Uint8_E_Bit_3.Extern_MEM.Bit_Test Bit_Uint8_E_Bit_4.Extern_MEM.Bit_Test Bit_Uint8_E_Bit_5.Extern_MEM.Bit_Test Bit_Uint8_E_Bit_6.Extern_MEM.Bit_Test Bit_Uint8_E_Bit_7.Extern_MEM.Bit_Test Bit_Uint8_E_Bit_x.Extern_MEM.Bit_Test Bit_Uint8_O_Bit_0.Extern_MEM.Bit_Test Bit_Uint8_O_Bit_1.Extern_MEM.Bit_Test Bit_Uint8_O_Bit_2.Extern_MEM.Bit_Test Bit_Uint8_O_Bit_3.Extern_MEM.Bit_Test Bit_Uint8_O_Bit_4.Extern_MEM.Bit_Test Bit_Uint8_O_Bit_5.Extern_MEM.Bit_Test Bit_Uint8_O_Bit_6.Extern_MEM.Bit_Test Bit_Uint8_O_Bit_7.Extern_MEM.Bit_Test Bit_Uint8_O_Bit_x.Extern_MEM.Bit_Test /end REF_MEASUREMENT
 /begin REF_CHARACTERISTIC P_Bit_Sint16.Extern_MEM.Bit_Test P_Bit_Sint32.Extern_MEM.Bit_Test P_Bit_Sint8_E.Extern_MEM.Bit_Test P_Bit_Sint8_O.Extern_MEM.Bit_Test P_Bit_Uint16.Extern_MEM.Bit_Test P_Bit_Uint32.Extern_MEM.Bit_Test P_Bit_Uint8_E.Extern_MEM.Bit_Test P_Bit_Uint8_O.Extern_MEM.Bit_Test /end REF_CHARACTERISTIC
/end GROUP
/begin GROUP Intern_MEM.Bit_Test ""
 /begin REF_MEASUREMENT Bit_Sint16_Bit_00.Intern_MEM.Bit_Test Bit_Sint16_Bit_01.Intern_MEM.Bit_Test Bit_Sint16_Bit_02.Intern_MEM.Bit_Test Bit_Sint16_Bit_03.Intern_MEM.Bit_Test Bit_Sint16_Bit_04.Intern_MEM.Bit_Test Bit_Sint16_Bit_05.Intern_MEM.Bit_Test Bit_Sint16_Bit_06.Intern_MEM.Bit_Test Bit_Sint16_Bit_07.Intern_MEM.Bit_Test Bit_Sint16_Bit_08.Intern_MEM.Bit_Test Bit_Sint16_Bit_09.Intern_MEM.Bit_Test Bit_Sint16_Bit_10.Intern_MEM.Bit_Test Bit_Sint16_Bit_11.Intern_MEM.Bit_Test Bit_Sint16_Bit_12.Intern_MEM.Bit_Test Bit_Sint16_Bit_13.Intern_MEM.Bit_Test Bit_Sint16_Bit_14.Intern_MEM.Bit_Test Bit_Sint16_Bit_15.Intern_MEM.Bit_Test Bit_Sint16_Bit_x.Intern_MEM.Bit_Test Bit_Sint32_Bit_00.Intern_MEM.Bit_Test Bit_Sint32_Bit_01.Intern_MEM.Bit_Test Bit_Sint32_Bit_02.Intern_MEM.Bit_Test Bit_Sint32_Bit_03.Intern_MEM.Bit_Test Bit_Sint32_Bit_04.Intern_MEM.Bit_Test Bit_Sint32_Bit_05.Intern_MEM.Bit_Test Bit_Sint32_Bit_06.Intern_MEM.Bit_Test Bit_Sint32_Bit_07.Intern_MEM.Bit_Test Bit_Sint32_Bit_08.Intern_MEM.Bit_Test Bit_Sint32_Bit_09.Intern_MEM.Bit_Test Bit_Sint32_Bit_10.Intern_MEM.Bit_Test Bit_Sint32_Bit_11.Intern_MEM.Bit_Test Bit_Sint32_Bit_12.Intern_MEM.Bit_Test Bit_Sint32_Bit_13.Intern_MEM.Bit_Test Bit_Sint32_Bit_14.Intern_MEM.Bit_Test Bit_Sint32_Bit_15.Intern_MEM.Bit_Test Bit_Sint32_Bit_16.Intern_MEM.Bit_Test Bit_Sint32_Bit_17.Intern_MEM.Bit_Test Bit_Sint32_Bit_18.Intern_MEM.Bit_Test Bit_Sint32_Bit_19.Intern_MEM.Bit_Test Bit_Sint32_Bit_20.Intern_MEM.Bit_Test Bit_Sint32_Bit_21.Intern_MEM.Bit_Test Bit_Sint32_Bit_22.Intern_MEM.Bit_Test Bit_Sint32_Bit_23.Intern_MEM.Bit_Test Bit_Sint32_Bit_24.Intern_MEM.Bit_Test Bit_Sint32_Bit_25.Intern_MEM.Bit_Test Bit_Sint32_Bit_26.Intern_MEM.Bit_Test Bit_Sint32_Bit_27.Intern_MEM.Bit_Test Bit_Sint32_Bit_28.Intern_MEM.Bit_Test Bit_Sint32_Bit_29.Intern_MEM.Bit_Test Bit_Sint32_Bit_30.Intern_MEM.Bit_Test Bit_Sint32_Bit_31.Intern_MEM.Bit_Test Bit_Sint32_Bit_x.Intern_MEM.Bit_Test Bit_Sint8_E_Bit_0.Intern_MEM.Bit_Test Bit_Sint8_E_Bit_1.Intern_MEM.Bit_Test Bit_Sint8_E_Bit_2.Intern_MEM.Bit_Test Bit_Sint8_E_Bit_3.Intern_MEM.Bit_Test Bit_Sint8_E_Bit_4.Intern_MEM.Bit_Test Bit_Sint8_E_Bit_5.Intern_MEM.Bit_Test Bit_Sint8_E_Bit_6.Intern_MEM.Bit_Test Bit_Sint8_E_Bit_7.Intern_MEM.Bit_Test Bit_Sint8_E_Bit_x.Intern_MEM.Bit_Test Bit_Sint8_O_Bit_0.Intern_MEM.Bit_Test Bit_Sint8_O_Bit_1.Intern_MEM.Bit_Test Bit_Sint8_O_Bit_2.Intern_MEM.Bit_Test Bit_Sint8_O_Bit_3.Intern_MEM.Bit_Test Bit_Sint8_O_Bit_4.Intern_MEM.Bit_Test Bit_Sint8_O_Bit_5.Intern_MEM.Bit_Test Bit_Sint8_O_Bit_6.Intern_MEM.Bit_Test Bit_Sint8_O_Bit_7.Intern_MEM.Bit_Test Bit_Sint8_O_Bit_x.Intern_MEM.Bit_Test Bit_Uint16_Bit_00.Intern_MEM.Bit_Test Bit_Uint16_Bit_01.Intern_MEM.Bit_Test Bit_Uint16_Bit_02.Intern_MEM.Bit_Test Bit_Uint16_Bit_03.Intern_MEM.Bit_Test Bit_Uint16_Bit_04.Intern_MEM.Bit_Test Bit_Uint16_Bit_05.Intern_MEM.Bit_Test Bit_Uint16_Bit_06.Intern_MEM.Bit_Test Bit_Uint16_Bit_07.Intern_MEM.Bit_Test Bit_Uint16_Bit_08.Intern_MEM.Bit_Test Bit_Uint16_Bit_09.Intern_MEM.Bit_Test Bit_Uint16_Bit_10.Intern_MEM.Bit_Test Bit_Uint16_Bit_11.Intern_MEM.Bit_Test Bit_Uint16_Bit_12.Intern_MEM.Bit_Test Bit_Uint16_Bit_13.Intern_MEM.Bit_Test Bit_Uint16_Bit_14.Intern_MEM.Bit_Test Bit_Uint16_Bit_15.Intern_MEM.Bit_Test Bit_Uint16_Bit_x.Intern_MEM.Bit_Test Bit_Uint32_Bit_00.Intern_MEM.Bit_Test Bit_Uint32_Bit_01.Intern_MEM.Bit_Test Bit_Uint32_Bit_02.Intern_MEM.Bit_Test Bit_Uint32_Bit_03.Intern_MEM.Bit_Test Bit_Uint32_Bit_04.Intern_MEM.Bit_Test Bit_Uint32_Bit_05.Intern_MEM.Bit_Test Bit_Uint32_Bit_06.Intern_MEM.Bit_Test Bit_Uint32_Bit_07.Intern_MEM.Bit_Test Bit_Uint32_Bit_08.Intern_MEM.Bit_Test Bit_Uint32_Bit_09.Intern_MEM.Bit_Test Bit_Uint32_Bit_10.Intern_MEM.Bit_Test Bit_Uint32_Bit_11.Intern_MEM.Bit_Test Bit_Uint32_Bit_12.Intern_MEM.Bit_Test Bit_Uint32_Bit_13.Intern_MEM.Bit_Test Bit_Uint32_Bit_14.Intern_MEM.Bit_Test Bit_Uint32_Bit_15.Intern_MEM.Bit_Test Bit_Uint32_Bit_16.Intern_MEM.Bit_Test Bit_Uint32_Bit_17.Intern_MEM.Bit_Test Bit_Uint32_Bit_18.Intern_MEM.Bit_Test Bit_Uint32_Bit_19.Intern_MEM.Bit_Test Bit_Uint32_Bit_20.Intern_MEM.Bit_Test Bit_Uint32_Bit_21.Intern_MEM.Bit_Test Bit_Uint32_Bit_22.Intern_MEM.Bit_Test Bit_Uint32_Bit_23.Intern_MEM.Bit_Test Bit_Uint32_Bit_24.Intern_MEM.Bit_Test Bit_Uint32_Bit_25.Intern_MEM.Bit_Test Bit_Uint32_Bit_26.Intern_MEM.Bit_Test Bit_Uint32_Bit_27.Intern_MEM.Bit_Test Bit_Uint32_Bit_28.Intern_MEM.Bit_Test Bit_Uint32_Bit_29.Intern_MEM.Bit_Test Bit_Uint32_Bit_30.Intern_MEM.Bit_Test Bit_Uint32_Bit_31.Intern_MEM.Bit_Test Bit_Uint32_Bit_x.Intern_MEM.Bit_Test Bit_Uint8_E_Bit_0.Intern_MEM.Bit_Test Bit_Uint8_E_Bit_1.Intern_MEM.Bit_Test Bit_Uint8_E_Bit_2.Intern_MEM.Bit_Test Bit_Uint8_E_Bit_3.Intern_MEM.Bit_Test Bit_Uint8_E_Bit_4.Intern_MEM.Bit_Test Bit_Uint8_E_Bit_5.Intern_MEM.Bit_Test Bit_Uint8_E_Bit_6.Intern_MEM.Bit_Test Bit_Uint8_E_Bit_7.Intern_MEM.Bit_Test Bit_Uint8_E_Bit_x.Intern_MEM.Bit_Test Bit_Uint8_O_Bit_0.Intern_MEM.Bit_Test Bit_Uint8_O_Bit_1.Intern_MEM.Bit_Test Bit_Uint8_O_Bit_2.Intern_MEM.Bit_Test Bit_Uint8_O_Bit_3.Intern_MEM.Bit_Test Bit_Uint8_O_Bit_4.Intern_MEM.Bit_Test Bit_Uint8_O_Bit_5.Intern_MEM.Bit_Test Bit_Uint8_O_Bit_6.Intern_MEM.Bit_Test Bit_Uint8_O_Bit_7.Intern_MEM.Bit_Test Bit_Uint8_O_Bit_x.Intern_MEM.Bit_Test /end REF_MEASUREMENT
 /begin REF_CHARACTERISTIC P_Bit_Sint16.Intern_MEM.Bit_Test P_Bit_Sint32.Intern_MEM.Bit_Test P_Bit_Sint8_E.Intern_MEM.Bit_Test P_Bit_Sint8_O.Intern_MEM.Bit_Test P_Bit_Uint16.Intern_MEM.Bit_Test P_Bit_Uint32.Intern_MEM.Bit_Test P_Bit_Uint8_E.Intern_MEM.Bit_Test P_Bit_Uint8_O.Intern_MEM.Bit_Test /end REF_CHARACTERISTIC
/end GROUP
/begin GROUP MIN_MAX_Tick2Time.DAQ2_Sample.CCP_SHELL ""
 /begin REF_MEASUREMENT Max.MIN_MAX_Tick2Time.DAQ2_Sample.CCP_SHELL Min.MIN_MAX_Tick2Time.DAQ2_Sample.CCP_SHELL Time.MIN_MAX_Tick2Time.DAQ2_Sample.CCP_SHELL /end REF_MEASUREMENT
/end GROUP
/begin GROUP P_Bit.Bit_Test ""
 /begin REF_MEASUREMENT Bit_Sint16.P_Bit.Bit_Test Bit_Sint32.P_Bit.Bit_Test Bit_Sint8.P_Bit.Bit_Test Bit_Uint16.P_Bit.Bit_Test Bit_Uint32.P_Bit.Bit_Test Bit_Uint8.P_Bit.Bit_Test /end REF_MEASUREMENT
 /begin REF_CHARACTERISTIC P_Bit_Sint16_Bit_00.P_Bit.Bit_Test P_Bit_Sint16_Bit_01.P_Bit.Bit_Test P_Bit_Sint16_Bit_02.P_Bit.Bit_Test P_Bit_Sint16_Bit_03.P_Bit.Bit_Test P_Bit_Sint16_Bit_04.P_Bit.Bit_Test P_Bit_Sint16_Bit_05.P_Bit.Bit_Test P_Bit_Sint16_Bit_06.P_Bit.Bit_Test P_Bit_Sint16_Bit_07.P_Bit.Bit_Test P_Bit_Sint16_Bit_08.P_Bit.Bit_Test P_Bit_Sint16_Bit_09.P_Bit.Bit_Test P_Bit_Sint16_Bit_10.P_Bit.Bit_Test P_Bit_Sint16_Bit_11.P_Bit.Bit_Test P_Bit_Sint16_Bit_12.P_Bit.Bit_Test P_Bit_Sint16_Bit_13.P_Bit.Bit_Test P_Bit_Sint16_Bit_14.P_Bit.Bit_Test P_Bit_Sint16_Bit_15.P_Bit.Bit_Test P_Bit_Sint32_Bit_00.P_Bit.Bit_Test P_Bit_Sint32_Bit_01.P_Bit.Bit_Test P_Bit_Sint32_Bit_02.P_Bit.Bit_Test P_Bit_Sint32_Bit_03.P_Bit.Bit_Test P_Bit_Sint32_Bit_04.P_Bit.Bit_Test P_Bit_Sint32_Bit_05.P_Bit.Bit_Test P_Bit_Sint32_Bit_06.P_Bit.Bit_Test P_Bit_Sint32_Bit_07.P_Bit.Bit_Test P_Bit_Sint32_Bit_08.P_Bit.Bit_Test P_Bit_Sint32_Bit_09.P_Bit.Bit_Test P_Bit_Sint32_Bit_10.P_Bit.Bit_Test P_Bit_Sint32_Bit_11.P_Bit.Bit_Test P_Bit_Sint32_Bit_12.P_Bit.Bit_Test P_Bit_Sint32_Bit_13.P_Bit.Bit_Test P_Bit_Sint32_Bit_14.P_Bit.Bit_Test P_Bit_Sint32_Bit_15.P_Bit.Bit_Test P_Bit_Sint32_Bit_16.P_Bit.Bit_Test P_Bit_Sint32_Bit_17.P_Bit.Bit_Test P_Bit_Sint32_Bit_18.P_Bit.Bit_Test P_Bit_Sint32_Bit_19.P_Bit.Bit_Test P_Bit_Sint32_Bit_20.P_Bit.Bit_Test P_Bit_Sint32_Bit_21.P_Bit.Bit_Test P_Bit_Sint32_Bit_22.P_Bit.Bit_Test P_Bit_Sint32_Bit_23.P_Bit.Bit_Test P_Bit_Sint32_Bit_24.P_Bit.Bit_Test P_Bit_Sint32_Bit_25.P_Bit.Bit_Test P_Bit_Sint32_Bit_26.P_Bit.Bit_Test P_Bit_Sint32_Bit_27.P_Bit.Bit_Test P_Bit_Sint32_Bit_28.P_Bit.Bit_Test P_Bit_Sint32_Bit_29.P_Bit.Bit_Test P_Bit_Sint32_Bit_30.P_Bit.Bit_Test P_Bit_Sint32_Bit_31.P_Bit.Bit_Test P_Bit_Sint8_Bit_0.P_Bit.Bit_Test P_Bit_Sint8_Bit_1.P_Bit.Bit_Test P_Bit_Sint8_Bit_2.P_Bit.Bit_Test P_Bit_Sint8_Bit_3.P_Bit.Bit_Test P_Bit_Sint8_Bit_4.P_Bit.Bit_Test P_Bit_Sint8_Bit_5.P_Bit.Bit_Test P_Bit_Sint8_Bit_6.P_Bit.Bit_Test P_Bit_Sint8_Bit_7.P_Bit.Bit_Test P_Bit_Uint16_Bit_00.P_Bit.Bit_Test P_Bit_Uint16_Bit_01.P_Bit.Bit_Test P_Bit_Uint16_Bit_02.P_Bit.Bit_Test P_Bit_Uint16_Bit_03.P_Bit.Bit_Test P_Bit_Uint16_Bit_04.P_Bit.Bit_Test P_Bit_Uint16_Bit_05.P_Bit.Bit_Test P_Bit_Uint16_Bit_06.P_Bit.Bit_Test P_Bit_Uint16_Bit_07.P_Bit.Bit_Test P_Bit_Uint16_Bit_08.P_Bit.Bit_Test P_Bit_Uint16_Bit_09.P_Bit.Bit_Test P_Bit_Uint16_Bit_10.P_Bit.Bit_Test P_Bit_Uint16_Bit_11.P_Bit.Bit_Test P_Bit_Uint16_Bit_12.P_Bit.Bit_Test P_Bit_Uint16_Bit_13.P_Bit.Bit_Test P_Bit_Uint16_Bit_14.P_Bit.Bit_Test P_Bit_Uint16_Bit_15.P_Bit.Bit_Test P_Bit_Uint32_Bit_00.P_Bit.Bit_Test P_Bit_Uint32_Bit_01.P_Bit.Bit_Test P_Bit_Uint32_Bit_02.P_Bit.Bit_Test P_Bit_Uint32_Bit_03.P_Bit.Bit_Test P_Bit_Uint32_Bit_04.P_Bit.Bit_Test P_Bit_Uint32_Bit_05.P_Bit.Bit_Test P_Bit_Uint32_Bit_06.P_Bit.Bit_Test P_Bit_Uint32_Bit_07.P_Bit.Bit_Test P_Bit_Uint32_Bit_08.P_Bit.Bit_Test P_Bit_Uint32_Bit_09.P_Bit.Bit_Test P_Bit_Uint32_Bit_10.P_Bit.Bit_Test P_Bit_Uint32_Bit_11.P_Bit.Bit_Test P_Bit_Uint32_Bit_12.P_Bit.Bit_Test P_Bit_Uint32_Bit_13.P_Bit.Bit_Test P_Bit_Uint32_Bit_14.P_Bit.Bit_Test P_Bit_Uint32_Bit_15.P_Bit.Bit_Test P_Bit_Uint32_Bit_16.P_Bit.Bit_Test P_Bit_Uint32_Bit_17.P_Bit.Bit_Test P_Bit_Uint32_Bit_18.P_Bit.Bit_Test P_Bit_Uint32_Bit_19.P_Bit.Bit_Test P_Bit_Uint32_Bit_20.P_Bit.Bit_Test P_Bit_Uint32_Bit_21.P_Bit.Bit_Test P_Bit_Uint32_Bit_22.P_Bit.Bit_Test P_Bit_Uint32_Bit_23.P_Bit.Bit_Test P_Bit_Uint32_Bit_24.P_Bit.Bit_Test P_Bit_Uint32_Bit_25.P_Bit.Bit_Test P_Bit_Uint32_Bit_26.P_Bit.Bit_Test P_Bit_Uint32_Bit_27.P_Bit.Bit_Test P_Bit_Uint32_Bit_28.P_Bit.Bit_Test P_Bit_Uint32_Bit_29.P_Bit.Bit_Test P_Bit_Uint32_Bit_30.P_Bit.Bit_Test P_Bit_Uint32_Bit_31.P_Bit.Bit_Test P_Bit_Uint8_Bit_0.P_Bit.Bit_Test P_Bit_Uint8_Bit_1.P_Bit.Bit_Test P_Bit_Uint8_Bit_2.P_Bit.Bit_Test P_Bit_Uint8_Bit_3.P_Bit.Bit_Test P_Bit_Uint8_Bit_4.P_Bit.Bit_Test P_Bit_Uint8_Bit_5.P_Bit.Bit_Test P_Bit_Uint8_Bit_6.P_Bit.Bit_Test P_Bit_Uint8_Bit_7.P_Bit.Bit_Test /end REF_CHARACTERISTIC
/end GROUP
/begin GROUP Time.DAQ2_Tx.CCP_SHELL ""
 /begin REF_MEASUREMENT Max.Time.DAQ2_Tx.CCP_SHELL Min.Time.DAQ2_Tx.CCP_SHELL Time.Time.DAQ2_Tx.CCP_SHELL /end REF_MEASUREMENT
/end GROUP
/begin GROUP TimeSum.DAQ2_Tx.CCP_SHELL ""
 /begin REF_MEASUREMENT Max.TimeSum.DAQ2_Tx.CCP_SHELL Min.TimeSum.DAQ2_Tx.CCP_SHELL Time.TimeSum.DAQ2_Tx.CCP_SHELL /end REF_MEASUREMENT
/end GROUP
/begin GROUP UDS_ISO14229 "" ROOT
 /begin REF_MEASUREMENT i_ActBdRate_u32.C_ClassDiagInfo.UDS_ISO14229 i_ComMedium_u8.C_ClassDiagInfo.UDS_ISO14229 i_ComProtocol_u8.C_ClassDiagInfo.UDS_ISO14229 i_DiaMode_u8.C_ClassDiagInfo.UDS_ISO14229 i_P2max_u32.C_ClassDiagInfo.UDS_ISO14229 i_P2min_u32.C_ClassDiagInfo.UDS_ISO14229 i_P3max_u32.C_ClassDiagInfo.UDS_ISO14229 i_P3min_u32.C_ClassDiagInfo.UDS_ISO14229 i_P4min_u32.C_ClassDiagInfo.UDS_ISO14229 i_PhysEcuAddr_u8.C_ClassDiagInfo.UDS_ISO14229 i_ReqBdRate_u32.C_ClassDiagInfo.UDS_ISO14229 i_SecLevel_u8.C_ClassDiagInfo.UDS_ISO14229 i_StimuAddrMode_u8.C_ClassDiagInfo.UDS_ISO14229 i_StimuAddr_u8.C_ClassDiagInfo.UDS_ISO14229 /end REF_MEASUREMENT
 /begin REF_CHARACTERISTIC pi_ActBdRate_u32.C_ClassDiagInfo.UDS_ISO14229 pi_ComMedium_u8.C_ClassDiagInfo.UDS_ISO14229 pi_ComProtocol_u8.C_ClassDiagInfo.UDS_ISO14229 pi_DiaMode_u8.C_ClassDiagInfo.UDS_ISO14229 pi_P2max_u32.C_ClassDiagInfo.UDS_ISO14229 pi_P2min_u32.C_ClassDiagInfo.UDS_ISO14229 pi_P3max_u32.C_ClassDiagInfo.UDS_ISO14229 pi_P3min_u32.C_ClassDiagInfo.UDS_ISO14229 pi_P4min_u32.C_ClassDiagInfo.UDS_ISO14229 pi_PhysEcuAddr_u8.C_ClassDiagInfo.UDS_ISO14229 pi_ReqBdRate_u32.C_ClassDiagInfo.UDS_ISO14229 pi_SecLevel_u8.C_ClassDiagInfo.UDS_ISO14229 pi_StimuAddrMode_u8.C_ClassDiagInfo.UDS_ISO14229 pi_StimuAddr_u8.C_ClassDiagInfo.UDS_ISO14229 /end REF_CHARACTERISTIC
/end GROUP
/begin GROUP UdsLocIDs "" ROOT
 /begin REF_MEASUREMENT i_LocalIdData_au8.C_ClassUdsVIN.UdsLocIDs i_LocalIdData_au8.C_ClassUdsVIN2.UdsLocIDs i_LocalId_u16.C_ClassUdsVIN.UdsLocIDs i_LocalId_u16.C_ClassUdsVIN2.UdsLocIDs i_LocalIds_pu32.C_ClassUdsVIN.UdsLocIDs i_LocalIds_pu32.C_ClassUdsVIN2.UdsLocIDs /end REF_MEASUREMENT
 /begin REF_CHARACTERISTIC ip_NumEntries_u8.C_ClassUdsVIN.UdsLocIDs ip_NumEntries_u8.C_ClassUdsVIN2.UdsLocIDs /end REF_CHARACTERISTIC
/end GROUP
/begin GROUP UdsSendList "" ROOT
 /begin REF_MEASUREMENT i_CanID_u32.C_ClassUdsSendList01.UdsSendList i_CanID_u32.C_ClassUdsSendList02.UdsSendList i_CanID_u32.C_ClassUdsSendList03.UdsSendList i_CanID_u32.C_ClassUdsSendList04.UdsSendList i_CanID_u32.C_ClassUdsSendList05.UdsSendList i_CanID_u32.C_ClassUdsSendList06.UdsSendList i_CanID_u32.C_ClassUdsSendList07.UdsSendList i_CanID_u32.C_ClassUdsSendList08.UdsSendList i_CanID_u32.C_ClassUdsSendList09.UdsSendList i_CanID_u32.C_ClassUdsSendList10.UdsSendList i_CanID_u32.C_ClassUdsSendList11.UdsSendList i_CanID_u32.C_ClassUdsSendList12.UdsSendList i_CanID_u32.C_ClassUdsSendList13.UdsSendList i_CanID_u32.C_ClassUdsSendList14.UdsSendList i_CanID_u32.C_ClassUdsSendList15.UdsSendList i_CanID_u32.C_ClassUdsSendList16.UdsSendList i_CanID_u32.C_ClassUdsSendList17.UdsSendList i_CanID_u32.C_ClassUdsSendList18.UdsSendList i_CanID_u32.C_ClassUdsSendList19.UdsSendList i_CanID_u32.C_ClassUdsSendList20.UdsSendList i_CanID_u32.C_ClassUdsSendList21.UdsSendList i_CanID_u32.C_ClassUdsSendList22.UdsSendList i_CanID_u32.C_ClassUdsSendList23.UdsSendList i_CanID_u32.C_ClassUdsSendList24.UdsSendList i_NumEntries_u8.C_ClassUdsSendList01.UdsSendList i_NumEntries_u8.C_ClassUdsSendList02.UdsSendList i_NumEntries_u8.C_ClassUdsSendList03.UdsSendList i_NumEntries_u8.C_ClassUdsSendList04.UdsSendList i_NumEntries_u8.C_ClassUdsSendList05.UdsSendList i_NumEntries_u8.C_ClassUdsSendList06.UdsSendList i_NumEntries_u8.C_ClassUdsSendList07.UdsSendList i_NumEntries_u8.C_ClassUdsSendList08.UdsSendList i_NumEntries_u8.C_ClassUdsSendList09.UdsSendList i_NumEntries_u8.C_ClassUdsSendList10.UdsSendList i_NumEntries_u8.C_ClassUdsSendList11.UdsSendList i_NumEntries_u8.C_ClassUdsSendList12.UdsSendList i_NumEntries_u8.C_ClassUdsSendList13.UdsSendList i_NumEntries_u8.C_ClassUdsSendList14.UdsSendList i_NumEntries_u8.C_ClassUdsSendList15.UdsSendList i_NumEntries_u8.C_ClassUdsSendList16.UdsSendList i_NumEntries_u8.C_ClassUdsSendList17.UdsSendList i_NumEntries_u8.C_ClassUdsSendList18.UdsSendList i_NumEntries_u8.C_ClassUdsSendList19.UdsSendList i_NumEntries_u8.C_ClassUdsSendList20.UdsSendList i_NumEntries_u8.C_ClassUdsSendList21.UdsSendList i_NumEntries_u8.C_ClassUdsSendList22.UdsSendList i_NumEntries_u8.C_ClassUdsSendList23.UdsSendList i_NumEntries_u8.C_ClassUdsSendList24.UdsSendList i_PeriodicID_u16.C_ClassUdsSendList01.UdsSendList i_PeriodicID_u16.C_ClassUdsSendList02.UdsSendList i_PeriodicID_u16.C_ClassUdsSendList03.UdsSendList i_PeriodicID_u16.C_ClassUdsSendList04.UdsSendList i_PeriodicID_u16.C_ClassUdsSendList05.UdsSendList i_PeriodicID_u16.C_ClassUdsSendList06.UdsSendList i_PeriodicID_u16.C_ClassUdsSendList07.UdsSendList i_PeriodicID_u16.C_ClassUdsSendList08.UdsSendList i_PeriodicID_u16.C_ClassUdsSendList09.UdsSendList i_PeriodicID_u16.C_ClassUdsSendList10.UdsSendList i_PeriodicID_u16.C_ClassUdsSendList11.UdsSendList i_PeriodicID_u16.C_ClassUdsSendList12.UdsSendList i_PeriodicID_u16.C_ClassUdsSendList13.UdsSendList i_PeriodicID_u16.C_ClassUdsSendList14.UdsSendList i_PeriodicID_u16.C_ClassUdsSendList15.UdsSendList i_PeriodicID_u16.C_ClassUdsSendList16.UdsSendList i_PeriodicID_u16.C_ClassUdsSendList17.UdsSendList i_PeriodicID_u16.C_ClassUdsSendList18.UdsSendList i_PeriodicID_u16.C_ClassUdsSendList19.UdsSendList i_PeriodicID_u16.C_ClassUdsSendList20.UdsSendList i_PeriodicID_u16.C_ClassUdsSendList21.UdsSendList i_PeriodicID_u16.C_ClassUdsSendList22.UdsSendList i_PeriodicID_u16.C_ClassUdsSendList23.UdsSendList i_PeriodicID_u16.C_ClassUdsSendList24.UdsSendList i_RasterMode_u8.C_ClassUdsSendList01.UdsSendList i_RasterMode_u8.C_ClassUdsSendList02.UdsSendList i_RasterMode_u8.C_ClassUdsSendList03.UdsSendList i_RasterMode_u8.C_ClassUdsSendList04.UdsSendList i_RasterMode_u8.C_ClassUdsSendList05.UdsSendList i_RasterMode_u8.C_ClassUdsSendList06.UdsSendList i_RasterMode_u8.C_ClassUdsSendList07.UdsSendList i_RasterMode_u8.C_ClassUdsSendList08.UdsSendList i_RasterMode_u8.C_ClassUdsSendList09.UdsSendList i_RasterMode_u8.C_ClassUdsSendList10.UdsSendList i_RasterMode_u8.C_ClassUdsSendList11.UdsSendList i_RasterMode_u8.C_ClassUdsSendList12.UdsSendList i_RasterMode_u8.C_ClassUdsSendList13.UdsSendList i_RasterMode_u8.C_ClassUdsSendList14.UdsSendList i_RasterMode_u8.C_ClassUdsSendList15.UdsSendList i_RasterMode_u8.C_ClassUdsSendList16.UdsSendList i_RasterMode_u8.C_ClassUdsSendList17.UdsSendList i_RasterMode_u8.C_ClassUdsSendList18.UdsSendList i_RasterMode_u8.C_ClassUdsSendList19.UdsSendList i_RasterMode_u8.C_ClassUdsSendList20.UdsSendList i_RasterMode_u8.C_ClassUdsSendList21.UdsSendList i_RasterMode_u8.C_ClassUdsSendList22.UdsSendList i_RasterMode_u8.C_ClassUdsSendList23.UdsSendList i_RasterMode_u8.C_ClassUdsSendList24.UdsSendList i_ResponceType_u8.C_ClassUdsSendList01.UdsSendList i_ResponceType_u8.C_ClassUdsSendList02.UdsSendList i_ResponceType_u8.C_ClassUdsSendList03.UdsSendList i_ResponceType_u8.C_ClassUdsSendList04.UdsSendList i_ResponceType_u8.C_ClassUdsSendList05.UdsSendList i_ResponceType_u8.C_ClassUdsSendList06.UdsSendList i_ResponceType_u8.C_ClassUdsSendList07.UdsSendList i_ResponceType_u8.C_ClassUdsSendList08.UdsSendList i_ResponceType_u8.C_ClassUdsSendList09.UdsSendList i_ResponceType_u8.C_ClassUdsSendList10.UdsSendList i_ResponceType_u8.C_ClassUdsSendList11.UdsSendList i_ResponceType_u8.C_ClassUdsSendList12.UdsSendList i_ResponceType_u8.C_ClassUdsSendList13.UdsSendList i_ResponceType_u8.C_ClassUdsSendList14.UdsSendList i_ResponceType_u8.C_ClassUdsSendList15.UdsSendList i_ResponceType_u8.C_ClassUdsSendList16.UdsSendList i_ResponceType_u8.C_ClassUdsSendList17.UdsSendList i_ResponceType_u8.C_ClassUdsSendList18.UdsSendList i_ResponceType_u8.C_ClassUdsSendList19.UdsSendList i_ResponceType_u8.C_ClassUdsSendList20.UdsSendList i_ResponceType_u8.C_ClassUdsSendList21.UdsSendList i_ResponceType_u8.C_ClassUdsSendList22.UdsSendList i_ResponceType_u8.C_ClassUdsSendList23.UdsSendList i_ResponceType_u8.C_ClassUdsSendList24.UdsSendList i_SampleBuf_au8.C_ClassUdsSendList01.UdsSendList i_SampleBuf_au8.C_ClassUdsSendList02.UdsSendList i_SampleBuf_au8.C_ClassUdsSendList03.UdsSendList i_SampleBuf_au8.C_ClassUdsSendList04.UdsSendList i_SampleBuf_au8.C_ClassUdsSendList05.UdsSendList i_SampleBuf_au8.C_ClassUdsSendList06.UdsSendList i_SampleBuf_au8.C_ClassUdsSendList07.UdsSendList i_SampleBuf_au8.C_ClassUdsSendList08.UdsSendList i_SampleBuf_au8.C_ClassUdsSendList09.UdsSendList i_SampleBuf_au8.C_ClassUdsSendList10.UdsSendList i_SampleBuf_au8.C_ClassUdsSendList11.UdsSendList i_SampleBuf_au8.C_ClassUdsSendList12.UdsSendList i_SampleBuf_au8.C_ClassUdsSendList13.UdsSendList i_SampleBuf_au8.C_ClassUdsSendList14.UdsSendList i_SampleBuf_au8.C_ClassUdsSendList15.UdsSendList i_SampleBuf_au8.C_ClassUdsSendList16.UdsSendList i_SampleBuf_au8.C_ClassUdsSendList17.UdsSendList i_SampleBuf_au8.C_ClassUdsSendList18.UdsSendList i_SampleBuf_au8.C_ClassUdsSendList19.UdsSendList i_SampleBuf_au8.C_ClassUdsSendList20.UdsSendList i_SampleBuf_au8.C_ClassUdsSendList21.UdsSendList i_SampleBuf_au8.C_ClassUdsSendList22.UdsSendList i_SampleBuf_au8.C_ClassUdsSendList23.UdsSendList i_SampleBuf_au8.C_ClassUdsSendList24.UdsSendList i_UdsDaqList_pu32.C_ClassUdsSendList01.UdsSendList i_UdsDaqList_pu32.C_ClassUdsSendList02.UdsSendList i_UdsDaqList_pu32.C_ClassUdsSendList03.UdsSendList i_UdsDaqList_pu32.C_ClassUdsSendList04.UdsSendList i_UdsDaqList_pu32.C_ClassUdsSendList05.UdsSendList i_UdsDaqList_pu32.C_ClassUdsSendList06.UdsSendList i_UdsDaqList_pu32.C_ClassUdsSendList07.UdsSendList i_UdsDaqList_pu32.C_ClassUdsSendList08.UdsSendList i_UdsDaqList_pu32.C_ClassUdsSendList09.UdsSendList i_UdsDaqList_pu32.C_ClassUdsSendList10.UdsSendList i_UdsDaqList_pu32.C_ClassUdsSendList11.UdsSendList i_UdsDaqList_pu32.C_ClassUdsSendList12.UdsSendList i_UdsDaqList_pu32.C_ClassUdsSendList13.UdsSendList i_UdsDaqList_pu32.C_ClassUdsSendList14.UdsSendList i_UdsDaqList_pu32.C_ClassUdsSendList15.UdsSendList i_UdsDaqList_pu32.C_ClassUdsSendList16.UdsSendList i_UdsDaqList_pu32.C_ClassUdsSendList17.UdsSendList i_UdsDaqList_pu32.C_ClassUdsSendList18.UdsSendList i_UdsDaqList_pu32.C_ClassUdsSendList19.UdsSendList i_UdsDaqList_pu32.C_ClassUdsSendList20.UdsSendList i_UdsDaqList_pu32.C_ClassUdsSendList21.UdsSendList i_UdsDaqList_pu32.C_ClassUdsSendList22.UdsSendList i_UdsDaqList_pu32.C_ClassUdsSendList23.UdsSendList i_UdsDaqList_pu32.C_ClassUdsSendList24.UdsSendList i_UdsSendListState_u8.C_ClassUdsSendList01.UdsSendList i_UdsSendListState_u8.C_ClassUdsSendList02.UdsSendList i_UdsSendListState_u8.C_ClassUdsSendList03.UdsSendList i_UdsSendListState_u8.C_ClassUdsSendList04.UdsSendList i_UdsSendListState_u8.C_ClassUdsSendList05.UdsSendList i_UdsSendListState_u8.C_ClassUdsSendList06.UdsSendList i_UdsSendListState_u8.C_ClassUdsSendList07.UdsSendList i_UdsSendListState_u8.C_ClassUdsSendList08.UdsSendList i_UdsSendListState_u8.C_ClassUdsSendList09.UdsSendList i_UdsSendListState_u8.C_ClassUdsSendList10.UdsSendList i_UdsSendListState_u8.C_ClassUdsSendList11.UdsSendList i_UdsSendListState_u8.C_ClassUdsSendList12.UdsSendList i_UdsSendListState_u8.C_ClassUdsSendList13.UdsSendList i_UdsSendListState_u8.C_ClassUdsSendList14.UdsSendList i_UdsSendListState_u8.C_ClassUdsSendList15.UdsSendList i_UdsSendListState_u8.C_ClassUdsSendList16.UdsSendList i_UdsSendListState_u8.C_ClassUdsSendList17.UdsSendList i_UdsSendListState_u8.C_ClassUdsSendList18.UdsSendList i_UdsSendListState_u8.C_ClassUdsSendList19.UdsSendList i_UdsSendListState_u8.C_ClassUdsSendList20.UdsSendList i_UdsSendListState_u8.C_ClassUdsSendList21.UdsSendList i_UdsSendListState_u8.C_ClassUdsSendList22.UdsSendList i_UdsSendListState_u8.C_ClassUdsSendList23.UdsSendList i_UdsSendListState_u8.C_ClassUdsSendList24.UdsSendList /end REF_MEASUREMENT
/end GROUP
/begin RECORD_LAYOUT STANDARD_CURVE_U16U16 FNC_VALUES 3 UWORD COLUMN_DIR DIRECT AXIS_PTS_X 2 UWORD INDEX_INCR DIRECT NO_AXIS_PTS_X 1 UWORD /end RECORD_LAYOUT
/begin RECORD_LAYOUT STANDARD_VALUE_BIT FNC_VALUES 1 UBYTE COLUMN_DIR DIRECT /end RECORD_LAYOUT
/begin RECORD_LAYOUT STANDARD_VALUE_R32 FNC_VALUES 1 FLOAT32_IEEE COLUMN_DIR DIRECT /end RECORD_LAYOUT
/begin RECORD_LAYOUT STANDARD_VALUE_R64 FNC_VALUES 1 FLOAT64_IEEE COLUMN_DIR DIRECT /end RECORD_LAYOUT
/begin RECORD_LAYOUT STANDARD_VALUE_S16 FNC_VALUES 1 SWORD COLUMN_DIR DIRECT /end RECORD_LAYOUT
/begin RECORD_LAYOUT STANDARD_VALUE_S32 FNC_VALUES 1 SLONG COLUMN_DIR DIRECT /end RECORD_LAYOUT
/begin RECORD_LAYOUT STANDARD_VALUE_S8 FNC_VALUES 1 SBYTE COLUMN_DIR DIRECT /end RECORD_LAYOUT
/begin RECORD_LAYOUT STANDARD_VALUE_U16 FNC_VALUES 1 UWORD COLUMN_DIR DIRECT /end RECORD_LAYOUT
/begin RECORD_LAYOUT STANDARD_VALUE_U32 FNC_VALUES 1 ULONG COLUMN_DIR DIRECT /end RECORD_LAYOUT
/begin RECORD_LAYOUT STANDARD_VALUE_U8 FNC_VALUES 1 UBYTE COLUMN_DIR DIRECT /end RECORD_LAYOUT
/end MODULE
/end PROJECT

ASAP2_VERSION 1 40
/begin PROJECT ECU_Base_Prj_CAN3Mon_UdsFlashing "Generated by ETAS from Project ECU_Base_Prj_CAN3Mon_UdsFlashing"
/begin HEADER "" VERSION "000" PROJECT_NO ASD /end HEADER
/begin MODULE ECU_Base_Prj_CAN3Mon_UdsFlashing "Generated by ETAS from Project ECU_Base_Prj_CAN3Mon_UdsFlashing"
/begin MOD_COMMON "2009-04-06 10:39:06	create by ETASHexVirtualAddressTableHeaderV2" BYTE_ORDER MSB_FIRST ALIGNMENT_BYTE 1 ALIGNMENT_WORD 2 ALIGNMENT_LONG 4 ALIGNMENT_FLOAT32_IEEE 4 ALIGNMENT_FLOAT64_IEEE 8 /end MOD_COMMON
/begin CHARACTERISTIC bypass_B01_enable.Model_Byp_B01 "" VALUE 0x1D6F0C STANDARD_VALUE_U8 0.0 ident 0 1 BIT_MASK 0x1 DISPLAY_IDENTIFIER Bypass_R01_Enable /end CHARACTERISTIC
/begin CHARACTERISTIC cont_sint16_1_100_bypEnable_B01.Model_Byp_B01 "" VALUE 0x1D6EF6 STANDARD_VALUE_U8 0.0 ident 0 1 BIT_MASK 0x1 DISPLAY_IDENTIFIER cont_sint16_1_100_bypEnable_B01.Model_Byp_B01_DISP_ID /end CHARACTERISTIC
/begin CHARACTERISTIC cont_sint16_1_100_offset_B01.Model_Byp_B01 "" VALUE 0x1c2A48 STANDARD_VALUE_U8 0.0 ident 0 255 DISPLAY_IDENTIFIER cont_sint16_1_100_offset_B01.Model_Byp_B01_DISP_ID /end CHARACTERISTIC
/begin CHARACTERISTIC cont_sint16_bypEnable_B01.Model_Byp_B01 "" VALUE 0x1D6EF7 STANDARD_VALUE_U8 0.0 ident 0 1 BIT_MASK 0x1 DISPLAY_IDENTIFIER cont_sint16_bypEnable_B01.Model_Byp_B01_DISP_ID /end CHARACTERISTIC
/begin CHARACTERISTIC cont_sint16_offset_B01.Model_Byp_B01 "" VALUE 0x1c2A49 STANDARD_VALUE_U8 0.0 ident 0 255 DISPLAY_IDENTIFIER cont_sint16_offset_B01.Model_Byp_B01_DISP_ID /end CHARACTERISTIC
/begin CHARACTERISTIC cont_sint8_1_10_bypEnable_B01.Model_Byp_B01 "" VALUE 0x1D6EF8 STANDARD_VALUE_U8 0.0 ident 0 1 BIT_MASK 0x1 DISPLAY_IDENTIFIER cont_sint8_1_10_bypEnable_B01.Model_Byp_B01_DISP_ID /end CHARACTERISTIC
/begin CHARACTERISTIC cont_sint8_1_10_offset_B01.Model_Byp_B01 "" VALUE 0x1c2A4A STANDARD_VALUE_U8 0.0 ident 0 255 DISPLAY_IDENTIFIER cont_sint8_1_10_offset_B01.Model_Byp_B01_DISP_ID /end CHARACTERISTIC
/begin CHARACTERISTIC cont_sint8_bypEnable_B01.Model_Byp_B01 "" VALUE 0x1D6EF9 STANDARD_VALUE_U8 0.0 ident 0 1 BIT_MASK 0x1 DISPLAY_IDENTIFIER cont_sint8_bypEnable_B01.Model_Byp_B01_DISP_ID /end CHARACTERISTIC
/begin CHARACTERISTIC cont_sint8_offset_B01.Model_Byp_B01 "" VALUE 0x1c2A4B STANDARD_VALUE_U8 0.0 ident 0 255 DISPLAY_IDENTIFIER cont_sint8_offset_B01.Model_Byp_B01_DISP_ID /end CHARACTERISTIC
/begin CHARACTERISTIC cont_uint16_1_2_bypEnable_B01.Model_Byp_B01 "" VALUE 0x1D6EFA STANDARD_VALUE_U8 0.0 ident 0 1 BIT_MASK 0x1 DISPLAY_IDENTIFIER cont_uint16_1_2_bypEnable_B01.Model_Byp_B01_DISP_ID /end CHARACTERISTIC
/begin CHARACTERISTIC cont_uint16_1_2_offset_B01.Model_Byp_B01 "" VALUE 0x1c2A4C STANDARD_VALUE_U8 0.0 ident 0 255 DISPLAY_IDENTIFIER cont_uint16_1_2_offset_B01.Model_Byp_B01_DISP_ID /end CHARACTERISTIC
/begin CHARACTERISTIC cont_uint8_10_1_bypEnable_B01.Model_Byp_B01 "" VALUE 0x1D6EFB STANDARD_VALUE_U8 0.0 ident 0 1 BIT_MASK 0x1 DISPLAY_IDENTIFIER cont_uint8_10_1_bypEnable_B01.Model_Byp_B01_DISP_ID /end CHARACTERISTIC
/begin CHARACTERISTIC cont_uint8_10_1_offset_B01.Model_Byp_B01 "" VALUE 0x1c2A4D STANDARD_VALUE_U8 0.0 ident 0 255 DISPLAY_IDENTIFIER cont_uint8_10_1_offset_B01.Model_Byp_B01_DISP_ID /end CHARACTERISTIC
/begin CHARACTERISTIC COUNT.FEA_performance_array "" VALUE 0x1D1AFC STANDARD_VALUE_U8 0.0 ident 0 255 /end CHARACTERISTIC
/begin CHARACTERISTIC Group_Two_D_1.Map_Mod "" MAP 0x1D1C30 STANDARD_GROUP_R32 0.0 ident -1.e+037 1.e+037
 /begin AXIS_DESCR COM_AXIS M_In_X_Dist.Map_Mod ident 7 -1.e+037 1.e+037 AXIS_PTS_REF X_distrib.Map_Mod /end AXIS_DESCR
 /begin AXIS_DESCR COM_AXIS M_In_Y_Dist.Map_Mod ident 8 -1.e+037 1.e+037 AXIS_PTS_REF Y_distrib.Map_Mod /end AXIS_DESCR
/end CHARACTERISTIC
/begin CHARACTERISTIC Group_Two_D_2.Map_Mod "" MAP 0x1D1D10 STANDARD_GROUP_R32 0.0 ident -1.e+037 1.e+037
 /begin AXIS_DESCR COM_AXIS M_In_X_Dist.Map_Mod ident 7 -1.e+037 1.e+037 AXIS_PTS_REF X_distrib.Map_Mod /end AXIS_DESCR
 /begin AXIS_DESCR COM_AXIS M_In_Y_Dist.Map_Mod ident 8 -1.e+037 1.e+037 AXIS_PTS_REF Y_distrib.Map_Mod /end AXIS_DESCR
/end CHARACTERISTIC
/begin CHARACTERISTIC Group_Two_D_3.Map_Mod "" MAP 0x1D1DF0 STANDARD_GROUP_R32 0.0 ident -1.e+037 1.e+037
 /begin AXIS_DESCR COM_AXIS M_In_X_Dist.Map_Mod ident 7 -1.e+037 1.e+037 AXIS_PTS_REF X_distrib_2.Map_Mod /end AXIS_DESCR
 /begin AXIS_DESCR COM_AXIS M_In_Y_Dist.Map_Mod ident 8 -1.e+037 1.e+037 AXIS_PTS_REF Y_distrib_2.Map_Mod /end AXIS_DESCR
/end CHARACTERISTIC
/begin CHARACTERISTIC log_uint8_0_bitOffset_B01.Model_Byp_B01 "" VALUE 0x1c2A4E STANDARD_VALUE_U8 0.0 ident 0 7 DISPLAY_IDENTIFIER log_uint8_0_bitOffset_B01.Model_Byp_B01_DISP_ID /end CHARACTERISTIC
/begin CHARACTERISTIC log_uint8_0_bypEnable_B01.Model_Byp_B01 "" VALUE 0x1D6EFC STANDARD_VALUE_U8 0.0 ident 0 1 BIT_MASK 0x1 DISPLAY_IDENTIFIER log_uint8_0_bypEnable_B01.Model_Byp_B01_DISP_ID /end CHARACTERISTIC
/begin CHARACTERISTIC log_uint8_0_offset_B01.Model_Byp_B01 "" VALUE 0x1c2A4F STANDARD_VALUE_U8 0.0 ident 0 255 DISPLAY_IDENTIFIER log_uint8_0_offset_B01.Model_Byp_B01_DISP_ID /end CHARACTERISTIC
/begin CHARACTERISTIC log_uint8_1_bitOffset_B01.Model_Byp_B01 "" VALUE 0x1c2A50 STANDARD_VALUE_U8 0.0 ident 0 7 DISPLAY_IDENTIFIER log_uint8_1_bitOffset_B01.Model_Byp_B01_DISP_ID /end CHARACTERISTIC
/begin CHARACTERISTIC log_uint8_1_bypEnable_B01.Model_Byp_B01 "" VALUE 0x1D6EFD STANDARD_VALUE_U8 0.0 ident 0 1 BIT_MASK 0x1 DISPLAY_IDENTIFIER log_uint8_1_bypEnable_B01.Model_Byp_B01_DISP_ID /end CHARACTERISTIC
/begin CHARACTERISTIC log_uint8_1_offset_B01.Model_Byp_B01 "" VALUE 0x1c2A51 STANDARD_VALUE_U8 0.0 ident 0 255 DISPLAY_IDENTIFIER log_uint8_1_offset_B01.Model_Byp_B01_DISP_ID /end CHARACTERISTIC
/begin CHARACTERISTIC p_cont_sint16_1_100_B01.Model_Byp_B01 "" VALUE 0x1D6EEC STANDARD_VALUE_S16 0.0 formula_1_100 -327.68 327.67 DISPLAY_IDENTIFIER p_cont_sint16_1_100_B01.Model_Byp_B01_DISP_ID /end CHARACTERISTIC
/begin CHARACTERISTIC p_cont_sint16_B01.Model_Byp_B01 "" VALUE 0x1D6EEE STANDARD_VALUE_S16 0.0 ident -32768.0 32767.0 DISPLAY_IDENTIFIER p_cont_sint16_B01.Model_Byp_B01_DISP_ID /end CHARACTERISTIC
/begin CHARACTERISTIC p_cont_sint8_1_10_B01.Model_Byp_B01 "" VALUE 0x1D6EFE STANDARD_VALUE_S8 0.0 formula_1_10 -12.8 12.7 DISPLAY_IDENTIFIER p_cont_sint8_1_10_B01.Model_Byp_B01_DISP_ID /end CHARACTERISTIC
/begin CHARACTERISTIC p_cont_sint8_B01.Model_Byp_B01 "" VALUE 0x1D6EFF STANDARD_VALUE_S8 0.0 ident -128.0 127.0 DISPLAY_IDENTIFIER p_cont_sint8_B01.Model_Byp_B01_DISP_ID /end CHARACTERISTIC
/begin CHARACTERISTIC p_cont_uint16_1_2_B01.Model_Byp_B01 "" VALUE 0x1D6EF0 STANDARD_VALUE_U16 0.0 formula_1_2 0.0 32767.5 DISPLAY_IDENTIFIER p_cont_uint16_1_2_B01.Model_Byp_B01_DISP_ID /end CHARACTERISTIC
/begin CHARACTERISTIC p_cont_uint8_10_1_B01.Model_Byp_B01 "" VALUE 0x1D6F00 STANDARD_VALUE_U8 0.0 formula_10_1 0.0 2550.0 DISPLAY_IDENTIFIER p_cont_uint8_10_1_B01.Model_Byp_B01_DISP_ID /end CHARACTERISTIC
/begin CHARACTERISTIC P_Do_Maps.Maps_Raster_1 "" VALUE 0x1D2198 STANDARD_VALUE_U8 0.0 ident 0 1 BIT_MASK 0x1 /end CHARACTERISTIC
/begin CHARACTERISTIC P_Do_Maps.Maps_Raster_2 "" VALUE 0x1D3B5C STANDARD_VALUE_U8 0.0 ident 0 1 BIT_MASK 0x1 /end CHARACTERISTIC
/begin CHARACTERISTIC P_Do_Maps.Maps_Raster_3 "" VALUE 0x1D5520 STANDARD_VALUE_U8 0.0 ident 0 1 BIT_MASK 0x1 /end CHARACTERISTIC
/begin CHARACTERISTIC P_F32_1.M_Ultimate "" VALUE 0x1D1BF8 STANDARD_VALUE_R32 0.0 ident -1.e+037 1.e+037 /end CHARACTERISTIC
/begin CHARACTERISTIC P_F64_1.M_Ultimate "" VALUE 0x1D1BF0 STANDARD_VALUE_R64 0.0 ident -1.e+037 1.e+037 /end CHARACTERISTIC
/begin CHARACTERISTIC P_In_X_Two_D.Map_Mod "" VALUE 0x1D1C28 STANDARD_VALUE_R32 0.0 ident -1.e+037 1.e+037 /end CHARACTERISTIC
/begin CHARACTERISTIC P_In_Y_Two_D.Map_Mod "" VALUE 0x1D1C2C STANDARD_VALUE_R32 0.0 ident -1.e+037 1.e+037 /end CHARACTERISTIC
/begin CHARACTERISTIC p_log_uint8_0_B01.Model_Byp_B01 "" VALUE 0x1D6F01 STANDARD_VALUE_U8 0.0 ident 0 1 BIT_MASK 0x1 DISPLAY_IDENTIFIER p_log_uint8_0_B01.Model_Byp_B01_DISP_ID /end CHARACTERISTIC
/begin CHARACTERISTIC p_log_uint8_1_B01.Model_Byp_B01 "" VALUE 0x1D6F02 STANDARD_VALUE_U8 0.0 ident 0 1 BIT_MASK 0x1 DISPLAY_IDENTIFIER p_log_uint8_1_B01.Model_Byp_B01_DISP_ID /end CHARACTERISTIC
/begin CHARACTERISTIC P_Op_Val_u8.M_Ultimate "" VALUE 0x1D1C1A STANDARD_VALUE_U8 0.0 ident 0 255 /end CHARACTERISTIC
/begin CHARACTERISTIC P_Operation_case.M_Ultimate "" VALUE 0x1D1C1B STANDARD_VALUE_U8 0.0 ident 0 255 /end CHARACTERISTIC
/begin CHARACTERISTIC P_Result_case.M_Ultimate "" VALUE 0x1D1BFC STANDARD_VALUE_U32 0.0 ident 0 4294967295 /end CHARACTERISTIC
/begin CHARACTERISTIC P_S16_1.M_Ultimate "" VALUE 0x1D1C0C STANDARD_VALUE_S16 0.0 ident -32768.0 32767.0 /end CHARACTERISTIC
/begin CHARACTERISTIC P_S32_1.M_Ultimate "" VALUE 0x1D1C00 STANDARD_VALUE_S32 0.0 ident -2147483648.0 2147483647.0 /end CHARACTERISTIC
/begin CHARACTERISTIC P_S8_1.M_Ultimate "" VALUE 0x1D1C10 STANDARD_VALUE_S8 0.0 ident -128.0 127.0 /end CHARACTERISTIC
/begin CHARACTERISTIC p_sdisc_sint16_B01.Model_Byp_B01 "" VALUE 0x1D6EF2 STANDARD_VALUE_S16 0.0 ident -32768 32767 DISPLAY_IDENTIFIER p_sdisc_sint16_B01.Model_Byp_B01_DISP_ID /end CHARACTERISTIC
/begin CHARACTERISTIC p_sdisc_sint8_B01.Model_Byp_B01 "" VALUE 0x1D6F03 STANDARD_VALUE_S8 0.0 ident -128 127 DISPLAY_IDENTIFIER p_sdisc_sint8_B01.Model_Byp_B01_DISP_ID /end CHARACTERISTIC
/begin CHARACTERISTIC P_Stimu_case.M_Ultimate "" VALUE 0x1D1C04 STANDARD_VALUE_U32 0.0 ident 0 4294967295 /end CHARACTERISTIC
/begin CHARACTERISTIC P_Stimu01_u8.M_Ultimate "" VALUE 0x1D1C19 STANDARD_VALUE_U8 0.0 ident 0 255 /end CHARACTERISTIC
/begin CHARACTERISTIC P_Stimu02_u8.M_Ultimate "" VALUE 0x1D1C18 STANDARD_VALUE_U8 0.0 ident 0 255 /end CHARACTERISTIC
/begin CHARACTERISTIC P_U16_1.M_Ultimate "" VALUE 0x1D1C0E STANDARD_VALUE_U16 0.0 ident 0.0 65535.0 /end CHARACTERISTIC
/begin CHARACTERISTIC P_U32_1.M_Ultimate "" VALUE 0x1D1C08 STANDARD_VALUE_U32 0.0 ident 0.0 4294967295.0 /end CHARACTERISTIC
/begin CHARACTERISTIC P_U8_1.M_Ultimate "" VALUE 0x1D1C11 STANDARD_VALUE_U8 0.0 ident 0.0 255.0 /end CHARACTERISTIC
/begin CHARACTERISTIC p_udisc_uint16_B01.Model_Byp_B01 "" VALUE 0x1D6EF4 STANDARD_VALUE_U16 0.0 ident 0 65535 DISPLAY_IDENTIFIER p_udisc_uint16_B01.Model_Byp_B01_DISP_ID /end CHARACTERISTIC
/begin CHARACTERISTIC p_udisc_uint8_B01.Model_Byp_B01 "" VALUE 0x1D6F04 STANDARD_VALUE_U8 0.0 ident 0 255 DISPLAY_IDENTIFIER p_udisc_uint8_B01.Model_Byp_B01_DISP_ID /end CHARACTERISTIC
/begin CHARACTERISTIC param.FEA_performance_array "" VAL_BLK 0x1D1A34 STANDARD_VALUE_R32 0.0 ident -1.e+037 1.e+037 MATRIX_DIM 50 1 1 /end CHARACTERISTIC
/begin CHARACTERISTIC Param_00.FEA_performance_scalar "" VALUE 0x1D1B04 STANDARD_VALUE_R32 0.0 ident -1.e+037 1.e+037 /end CHARACTERISTIC
/begin CHARACTERISTIC Param_01.FEA_performance_scalar "" VALUE 0x1D1B08 STANDARD_VALUE_R32 0.0 ident -1.e+037 1.e+037 /end CHARACTERISTIC
/begin CHARACTERISTIC Param_02.FEA_performance_scalar "" VALUE 0x1D1B0C STANDARD_VALUE_R32 0.0 ident -1.e+037 1.e+037 /end CHARACTERISTIC
/begin CHARACTERISTIC Param_03.FEA_performance_scalar "" VALUE 0x1D1B10 STANDARD_VALUE_R32 0.0 ident -1.e+037 1.e+037 /end CHARACTERISTIC
/begin CHARACTERISTIC Param_04.FEA_performance_scalar "" VALUE 0x1D1B14 STANDARD_VALUE_R32 0.0 ident -1.e+037 1.e+037 /end CHARACTERISTIC
/begin CHARACTERISTIC Param_05.FEA_performance_scalar "" VALUE 0x1D1B18 STANDARD_VALUE_R32 0.0 ident -1.e+037 1.e+037 /end CHARACTERISTIC
/begin CHARACTERISTIC Param_06.FEA_performance_scalar "" VALUE 0x1D1B1C STANDARD_VALUE_R32 0.0 ident -1.e+037 1.e+037 /end CHARACTERISTIC
/begin CHARACTERISTIC Param_07.FEA_performance_scalar "" VALUE 0x1D1B20 STANDARD_VALUE_R32 0.0 ident -1.e+037 1.e+037 /end CHARACTERISTIC
/begin CHARACTERISTIC Param_08.FEA_performance_scalar "" VALUE 0x1D1B24 STANDARD_VALUE_R32 0.0 ident -1.e+037 1.e+037 /end CHARACTERISTIC
/begin CHARACTERISTIC Param_09.FEA_performance_scalar "" VALUE 0x1D1B28 STANDARD_VALUE_R32 0.0 ident -1.e+037 1.e+037 /end CHARACTERISTIC
/begin CHARACTERISTIC Param_10.FEA_performance_scalar "" VALUE 0x1D1B2C STANDARD_VALUE_R32 0.0 ident -1.e+037 1.e+037 /end CHARACTERISTIC
/begin CHARACTERISTIC Param_11.FEA_performance_scalar "" VALUE 0x1D1B30 STANDARD_VALUE_R32 0.0 ident -1.e+037 1.e+037 /end CHARACTERISTIC
/begin CHARACTERISTIC Param_12.FEA_performance_scalar "" VALUE 0x1D1B34 STANDARD_VALUE_R32 0.0 ident -1.e+037 1.e+037 /end CHARACTERISTIC
/begin CHARACTERISTIC Param_13.FEA_performance_scalar "" VALUE 0x1D1B38 STANDARD_VALUE_R32 0.0 ident -1.e+037 1.e+037 /end CHARACTERISTIC
/begin CHARACTERISTIC Param_14.FEA_performance_scalar "" VALUE 0x1D1B3C STANDARD_VALUE_R32 0.0 ident -1.e+037 1.e+037 /end CHARACTERISTIC
/begin CHARACTERISTIC Param_15.FEA_performance_scalar "" VALUE 0x1D1B40 STANDARD_VALUE_R32 0.0 ident -1.e+037 1.e+037 /end CHARACTERISTIC
/begin CHARACTERISTIC Param_16.FEA_performance_scalar "" VALUE 0x1D1B44 STANDARD_VALUE_R32 0.0 ident -1.e+037 1.e+037 /end CHARACTERISTIC
/begin CHARACTERISTIC Param_17.FEA_performance_scalar "" VALUE 0x1D1B48 STANDARD_VALUE_R32 0.0 ident -1.e+037 1.e+037 /end CHARACTERISTIC
/begin CHARACTERISTIC Param_18.FEA_performance_scalar "" VALUE 0x1D1B4C STANDARD_VALUE_R32 0.0 ident -1.e+037 1.e+037 /end CHARACTERISTIC
/begin CHARACTERISTIC Param_19.FEA_performance_scalar "" VALUE 0x1D1B50 STANDARD_VALUE_R32 0.0 ident -1.e+037 1.e+037 /end CHARACTERISTIC
/begin CHARACTERISTIC Param_20.FEA_performance_scalar "" VALUE 0x1D1B54 STANDARD_VALUE_R32 0.0 ident -1.e+037 1.e+037 /end CHARACTERISTIC
/begin CHARACTERISTIC Param_21.FEA_performance_scalar "" VALUE 0x1D1B58 STANDARD_VALUE_R32 0.0 ident -1.e+037 1.e+037 /end CHARACTERISTIC
/begin CHARACTERISTIC Param_22.FEA_performance_scalar "" VALUE 0x1D1B5C STANDARD_VALUE_R32 0.0 ident -1.e+037 1.e+037 /end CHARACTERISTIC
/begin CHARACTERISTIC Param_23.FEA_performance_scalar "" VALUE 0x1D1B60 STANDARD_VALUE_R32 0.0 ident -1.e+037 1.e+037 /end CHARACTERISTIC
/begin CHARACTERISTIC Param_24.FEA_performance_scalar "" VALUE 0x1D1B64 STANDARD_VALUE_R32 0.0 ident -1.e+037 1.e+037 /end CHARACTERISTIC
/begin CHARACTERISTIC Param_25.FEA_performance_scalar "" VALUE 0x1D1B68 STANDARD_VALUE_R32 0.0 ident -1.e+037 1.e+037 /end CHARACTERISTIC
/begin CHARACTERISTIC Param_26.FEA_performance_scalar "" VALUE 0x1D1B6C STANDARD_VALUE_R32 0.0 ident -1.e+037 1.e+037 /end CHARACTERISTIC
/begin CHARACTERISTIC Param_27.FEA_performance_scalar "" VALUE 0x1D1B70 STANDARD_VALUE_R32 0.0 ident -1.e+037 1.e+037 /end CHARACTERISTIC
/begin CHARACTERISTIC Param_28.FEA_performance_scalar "" VALUE 0x1D1B74 STANDARD_VALUE_R32 0.0 ident -1.e+037 1.e+037 /end CHARACTERISTIC
/begin CHARACTERISTIC Param_29.FEA_performance_scalar "" VALUE 0x1D1B78 STANDARD_VALUE_R32 0.0 ident -1.e+037 1.e+037 /end CHARACTERISTIC
/begin CHARACTERISTIC Param_30.FEA_performance_scalar "" VALUE 0x1D1B7C STANDARD_VALUE_R32 0.0 ident -1.e+037 1.e+037 /end CHARACTERISTIC
/begin CHARACTERISTIC Param_31.FEA_performance_scalar "" VALUE 0x1D1B80 STANDARD_VALUE_R32 0.0 ident -1.e+037 1.e+037 /end CHARACTERISTIC
/begin CHARACTERISTIC Param_32.FEA_performance_scalar "" VALUE 0x1D1B84 STANDARD_VALUE_R32 0.0 ident -1.e+037 1.e+037 /end CHARACTERISTIC
/begin CHARACTERISTIC Param_33.FEA_performance_scalar "" VALUE 0x1D1B88 STANDARD_VALUE_R32 0.0 ident -1.e+037 1.e+037 /end CHARACTERISTIC
/begin CHARACTERISTIC Param_34.FEA_performance_scalar "" VALUE 0x1D1B8C STANDARD_VALUE_R32 0.0 ident -1.e+037 1.e+037 /end CHARACTERISTIC
/begin CHARACTERISTIC Param_35.FEA_performance_scalar "" VALUE 0x1D1B90 STANDARD_VALUE_R32 0.0 ident -1.e+037 1.e+037 /end CHARACTERISTIC
/begin CHARACTERISTIC Param_36.FEA_performance_scalar "" VALUE 0x1D1B94 STANDARD_VALUE_R32 0.0 ident -1.e+037 1.e+037 /end CHARACTERISTIC
/begin CHARACTERISTIC Param_37.FEA_performance_scalar "" VALUE 0x1D1B98 STANDARD_VALUE_R32 0.0 ident -1.e+037 1.e+037 /end CHARACTERISTIC
/begin CHARACTERISTIC Param_38.FEA_performance_scalar "" VALUE 0x1D1B9C STANDARD_VALUE_R32 0.0 ident -1.e+037 1.e+037 /end CHARACTERISTIC
/begin CHARACTERISTIC Param_39.FEA_performance_scalar "" VALUE 0x1D1BA0 STANDARD_VALUE_R32 0.0 ident -1.e+037 1.e+037 /end CHARACTERISTIC
/begin CHARACTERISTIC Param_40.FEA_performance_scalar "" VALUE 0x1D1BA4 STANDARD_VALUE_R32 0.0 ident -1.e+037 1.e+037 /end CHARACTERISTIC
/begin CHARACTERISTIC Param_41.FEA_performance_scalar "" VALUE 0x1D1BA8 STANDARD_VALUE_R32 0.0 ident -1.e+037 1.e+037 /end CHARACTERISTIC
/begin CHARACTERISTIC Param_42.FEA_performance_scalar "" VALUE 0x1D1BAC STANDARD_VALUE_R32 0.0 ident -1.e+037 1.e+037 /end CHARACTERISTIC
/begin CHARACTERISTIC Param_43.FEA_performance_scalar "" VALUE 0x1D1BB0 STANDARD_VALUE_R32 0.0 ident -1.e+037 1.e+037 /end CHARACTERISTIC
/begin CHARACTERISTIC Param_44.FEA_performance_scalar "" VALUE 0x1D1BB4 STANDARD_VALUE_R32 0.0 ident -1.e+037 1.e+037 /end CHARACTERISTIC
/begin CHARACTERISTIC Param_45.FEA_performance_scalar "" VALUE 0x1D1BB8 STANDARD_VALUE_R32 0.0 ident -1.e+037 1.e+037 /end CHARACTERISTIC
/begin CHARACTERISTIC Param_46.FEA_performance_scalar "" VALUE 0x1D1BBC STANDARD_VALUE_R32 0.0 ident -1.e+037 1.e+037 /end CHARACTERISTIC
/begin CHARACTERISTIC Param_47.FEA_performance_scalar "" VALUE 0x1D1BC0 STANDARD_VALUE_R32 0.0 ident -1.e+037 1.e+037 /end CHARACTERISTIC
/begin CHARACTERISTIC Param_48.FEA_performance_scalar "" VALUE 0x1D1BC4 STANDARD_VALUE_R32 0.0 ident -1.e+037 1.e+037 /end CHARACTERISTIC
/begin CHARACTERISTIC Param_49.FEA_performance_scalar "" VALUE 0x1D1BC8 STANDARD_VALUE_R32 0.0 ident -1.e+037 1.e+037 /end CHARACTERISTIC
/begin CHARACTERISTIC sdisc_sint16_bypEnable_B01.Model_Byp_B01 "" VALUE 0x1D6F05 STANDARD_VALUE_U8 0.0 ident 0 1 BIT_MASK 0x1 DISPLAY_IDENTIFIER sdisc_sint16_bypEnable_B01.Model_Byp_B01_DISP_ID /end CHARACTERISTIC
/begin CHARACTERISTIC sdisc_sint16_offset_B01.Model_Byp_B01 "" VALUE 0x1c2A52 STANDARD_VALUE_U8 0.0 ident 0 255 DISPLAY_IDENTIFIER sdisc_sint16_offset_B01.Model_Byp_B01_DISP_ID /end CHARACTERISTIC
/begin CHARACTERISTIC sdisc_sint8_bypEnable_B01.Model_Byp_B01 "" VALUE 0x1D6F06 STANDARD_VALUE_U8 0.0 ident 0 1 BIT_MASK 0x1 DISPLAY_IDENTIFIER sdisc_sint8_bypEnable_B01.Model_Byp_B01_DISP_ID /end CHARACTERISTIC
/begin CHARACTERISTIC sdisc_sint8_offset_B01.Model_Byp_B01 "" VALUE 0x1c2A53 STANDARD_VALUE_U8 0.0 ident 0 255 DISPLAY_IDENTIFIER sdisc_sint8_offset_B01.Model_Byp_B01_DISP_ID /end CHARACTERISTIC
/begin CHARACTERISTIC Threshold.FEA_performance_array "" VALUE 0x1D1A30 STANDARD_VALUE_R32 0.0 ident -1.e+037 1.e+037 /end CHARACTERISTIC
/begin CHARACTERISTIC Threshold.FEA_performance_scalar "" VALUE 0x1D1BCC STANDARD_VALUE_R32 0.0 ident -1.e+037 1.e+037 /end CHARACTERISTIC
/begin CHARACTERISTIC Two_D.Map_Mod "" MAP 0x1D1ED0 STANDARD_MAP_R64R64R64 0.0 ident -1.e+037 1.e+037 /begin AXIS_DESCR STD_AXIS M_In_X_Two_D.Map_Mod ident 7 -1.e+037 1.e+037 /end AXIS_DESCR /begin AXIS_DESCR STD_AXIS M_In_Y_Two_D.Map_Mod ident 8 -1.e+037 1.e+037 /end AXIS_DESCR /end CHARACTERISTIC
/begin CHARACTERISTIC udisc_uint16_bypEnable_B01.Model_Byp_B01 "" VALUE 0x1D6F07 STANDARD_VALUE_U8 0.0 ident 0 1 BIT_MASK 0x1 DISPLAY_IDENTIFIER udisc_uint16_bypEnable_B01.Model_Byp_B01_DISP_ID /end CHARACTERISTIC
/begin CHARACTERISTIC udisc_uint16_offset_B01.Model_Byp_B01 "" VALUE 0x1c2A54 STANDARD_VALUE_U8 0.0 ident 0 255 DISPLAY_IDENTIFIER udisc_uint16_offset_B01.Model_Byp_B01_DISP_ID /end CHARACTERISTIC
/begin CHARACTERISTIC udisc_uint8_bypEnable_B01.Model_Byp_B01 "" VALUE 0x1D6F08 STANDARD_VALUE_U8 0.0 ident 0 1 BIT_MASK 0x1 DISPLAY_IDENTIFIER udisc_uint8_bypEnable_B01.Model_Byp_B01_DISP_ID /end CHARACTERISTIC
/begin CHARACTERISTIC udisc_uint8_offset_B01.Model_Byp_B01 "" VALUE 0x1c2A55 STANDARD_VALUE_U8 0.0 ident 0 255 DISPLAY_IDENTIFIER udisc_uint8_offset_B01.Model_Byp_B01_DISP_ID /end CHARACTERISTIC
/begin AXIS_PTS X_distrib.Map_Mod "" 0x1D2110 M_In_X_Dist.Map_Mod STANDARD_DIST_R32 0.0 ident 7 -1.e+037 1.e+037 /end AXIS_PTS
/begin AXIS_PTS X_distrib_2.Map_Mod "" 0x1D2130 M_In_X_Dist.Map_Mod STANDARD_DIST_R32 0.0 ident 7 -1.e+037 1.e+037 /end AXIS_PTS
/begin AXIS_PTS Y_distrib.Map_Mod "" 0x1D2150 M_In_Y_Dist.Map_Mod STANDARD_DIST_R32 0.0 ident 8 -1.e+037 1.e+037 /end AXIS_PTS
/begin AXIS_PTS Y_distrib_2.Map_Mod "" 0x1D2174 M_In_Y_Dist.Map_Mod STANDARD_DIST_R32 0.0 ident 8 -1.e+037 1.e+037 /end AXIS_PTS
/begin MEASUREMENT B_cntr_B01_ok.clsCounter_B01.Model_Byp_B01 "" UBYTE ident 1 100 0 1 BIT_MASK 0x1 ECU_ADDRESS 0x7F856D DISPLAY_IDENTIFIER B_cntr_B01_ok.clsCounter_B01.Model_Byp_B01_DISP_ID /end MEASUREMENT
/begin MEASUREMENT buffer.EdgeRising.Reset_Schalter "" UBYTE ident 1 100 0 1 ECU_ADDRESS 0x7FB0E1 DISPLAY_IDENTIFIER buffer.EdgeRising.Reset_Schalter_DISP_ID /end MEASUREMENT
/begin MEASUREMENT bypass_B01_state.Model_Byp_B01 "" UBYTE ident 1 100 0 1 BIT_MASK 0x1 ECU_ADDRESS 0x7FB1BC DISPLAY_IDENTIFIER bypass_B01_state.Model_Byp_B01_DISP_ID /end MEASUREMENT
/begin MEASUREMENT cntrold_B01.clsCounter_B01.Model_Byp_B01 "" UBYTE ident 1 100 0 255 ECU_ADDRESS 0x7F856E DISPLAY_IDENTIFIER cntrold_B01.clsCounter_B01.Model_Byp_B01_DISP_ID /end MEASUREMENT
/begin MEASUREMENT cont_sint16_1_100_B01.Model_Byp_B01 "" SWORD formula_1_100 1 100 -327.68 327.67 ECU_ADDRESS 0x7FB1B2 DISPLAY_IDENTIFIER cont_sint16_1_100_B01.Model_Byp_B01_DISP_ID /end MEASUREMENT
/begin MEASUREMENT cont_sint16_1_100_offset_cpy_B01.Model_Byp_B01 "" UBYTE ident 1 100 0 255 ECU_ADDRESS 0x7FB1A4 DISPLAY_IDENTIFIER cont_sint16_1_100_offset_cpy_B01.Model_Byp_B01_DISP_ID /end MEASUREMENT
/begin MEASUREMENT cont_sint16_B01.Model_Byp_B01 "" SWORD ident 1 100 -32768 32767.0 ECU_ADDRESS 0x7FB1B4 DISPLAY_IDENTIFIER cont_sint16_B01.Model_Byp_B01_DISP_ID /end MEASUREMENT
/begin MEASUREMENT cont_sint16_offset_cpy_B01.Model_Byp_B01 "" UBYTE ident 1 100 0 255 ECU_ADDRESS 0x7FB1A5 DISPLAY_IDENTIFIER cont_sint16_offset_cpy_B01.Model_Byp_B01_DISP_ID /end MEASUREMENT
/begin MEASUREMENT cont_sint8_1_10_B01.Model_Byp_B01 "" SBYTE formula_1_10 1 100 -12.8 12.7 ECU_ADDRESS 0x7FB1BD DISPLAY_IDENTIFIER cont_sint8_1_10_B01.Model_Byp_B01_DISP_ID /end MEASUREMENT
/begin MEASUREMENT cont_sint8_1_10_offset_cpy_B01.Model_Byp_B01 "" UBYTE ident 1 100 0 255 ECU_ADDRESS 0x7FB1A6 DISPLAY_IDENTIFIER cont_sint8_1_10_offset_cpy_B01.Model_Byp_B01_DISP_ID /end MEASUREMENT
/begin MEASUREMENT cont_sint8_B01.Model_Byp_B01 "" SBYTE ident 1 100 -128.0 127.0 ECU_ADDRESS 0x7FB1BE DISPLAY_IDENTIFIER cont_sint8_B01.Model_Byp_B01_DISP_ID /end MEASUREMENT
/begin MEASUREMENT cont_sint8_offset_cpy_B01.Model_Byp_B01 "" UBYTE ident 1 100 0 255 ECU_ADDRESS 0x7FB1A7 DISPLAY_IDENTIFIER cont_sint8_offset_cpy_B01.Model_Byp_B01_DISP_ID /end MEASUREMENT
/begin MEASUREMENT cont_uint16_1_2_B01.Model_Byp_B01 "" UWORD formula_1_2 1 100 0.0 32767.5 ECU_ADDRESS 0x7FB1B6 DISPLAY_IDENTIFIER cont_uint16_1_2_B01.Model_Byp_B01_DISP_ID /end MEASUREMENT
/begin MEASUREMENT cont_uint16_1_2_offset_cpy_B01.Model_Byp_B01 "" UBYTE ident 1 100 0 255 ECU_ADDRESS 0x7FB1A8 DISPLAY_IDENTIFIER cont_uint16_1_2_offset_cpy_B01.Model_Byp_B01_DISP_ID /end MEASUREMENT
/begin MEASUREMENT cont_uint8_10_1_B01.Model_Byp_B01 "" UBYTE formula_10_1 1 100 0.0 2550.0 ECU_ADDRESS 0x7FB1BF DISPLAY_IDENTIFIER cont_uint8_10_1_B01.Model_Byp_B01_DISP_ID /end MEASUREMENT
/begin MEASUREMENT cont_uint8_10_1_offset_cpy_B01.Model_Byp_B01 "" UBYTE ident 1 100 0 255 ECU_ADDRESS 0x7FB1A9 DISPLAY_IDENTIFIER cont_uint8_10_1_offset_cpy_B01.Model_Byp_B01_DISP_ID /end MEASUREMENT
/begin MEASUREMENT errcntr_B01.clsCounter_B01.Model_Byp_B01 "" UBYTE ident 1 100 0 255 ECU_ADDRESS 0x7F856F DISPLAY_IDENTIFIER errcntr_B01.clsCounter_B01.Model_Byp_B01_DISP_ID /end MEASUREMENT
/begin MEASUREMENT fl32_01.I_fl32.R01_B "" FLOAT32_IEEE ident 1 100 -9.999999999999998e+036 9.999999999999998e+036 ECU_ADDRESS 0x7F8BD0 /end MEASUREMENT
/begin MEASUREMENT fl32_01.I_fl32.R02_B "" FLOAT32_IEEE ident 1 100 -9.999999999999998e+036 9.999999999999998e+036 ECU_ADDRESS 0x7F8C70 /end MEASUREMENT
/begin MEASUREMENT fl32_01.I_fl32.R03_B "" FLOAT32_IEEE ident 1 100 -9.999999999999998e+036 9.999999999999998e+036 ECU_ADDRESS 0x7F8D10 /end MEASUREMENT
/begin MEASUREMENT fl32_01.I_fl32.R04_B "" FLOAT32_IEEE ident 1 100 -9.999999999999998e+036 9.999999999999998e+036 ECU_ADDRESS 0x7F8DB0 /end MEASUREMENT
/begin MEASUREMENT fl32_01.M_Ultimate "" FLOAT32_IEEE ident 1 100 -1.e+037 1.e+037 ECU_ADDRESS 0x7FB118 /end MEASUREMENT
/begin MEASUREMENT fl32_02.I_fl32.R01_B "" FLOAT32_IEEE ident 1 100 -9.999999999999998e+036 9.999999999999998e+036 ECU_ADDRESS 0x7F8BD4 /end MEASUREMENT
/begin MEASUREMENT fl32_02.I_fl32.R02_B "" FLOAT32_IEEE ident 1 100 -9.999999999999998e+036 9.999999999999998e+036 ECU_ADDRESS 0x7F8C74 /end MEASUREMENT
/begin MEASUREMENT fl32_02.I_fl32.R03_B "" FLOAT32_IEEE ident 1 100 -9.999999999999998e+036 9.999999999999998e+036 ECU_ADDRESS 0x7F8D14 /end MEASUREMENT
/begin MEASUREMENT fl32_02.I_fl32.R04_B "" FLOAT32_IEEE ident 1 100 -9.999999999999998e+036 9.999999999999998e+036 ECU_ADDRESS 0x7F8DB4 /end MEASUREMENT
/begin MEASUREMENT fl32_03.I_fl32.R01_B "" FLOAT32_IEEE ident 1 100 -9.999999999999998e+036 9.999999999999998e+036 ECU_ADDRESS 0x7F8BD8 /end MEASUREMENT
/begin MEASUREMENT fl32_03.I_fl32.R02_B "" FLOAT32_IEEE ident 1 100 -9.999999999999998e+036 9.999999999999998e+036 ECU_ADDRESS 0x7F8C78 /end MEASUREMENT
/begin MEASUREMENT fl32_03.I_fl32.R03_B "" FLOAT32_IEEE ident 1 100 -9.999999999999998e+036 9.999999999999998e+036 ECU_ADDRESS 0x7F8D18 /end MEASUREMENT
/begin MEASUREMENT fl32_03.I_fl32.R04_B "" FLOAT32_IEEE ident 1 100 -9.999999999999998e+036 9.999999999999998e+036 ECU_ADDRESS 0x7F8DB8 /end MEASUREMENT
/begin MEASUREMENT fl32_04.I_fl32.R01_B "" FLOAT32_IEEE ident 1 100 -9.999999999999998e+036 9.999999999999998e+036 ECU_ADDRESS 0x7F8BDC /end MEASUREMENT
/begin MEASUREMENT fl32_04.I_fl32.R02_B "" FLOAT32_IEEE ident 1 100 -9.999999999999998e+036 9.999999999999998e+036 ECU_ADDRESS 0x7F8C7C /end MEASUREMENT
/begin MEASUREMENT fl32_04.I_fl32.R03_B "" FLOAT32_IEEE ident 1 100 -9.999999999999998e+036 9.999999999999998e+036 ECU_ADDRESS 0x7F8D1C /end MEASUREMENT
/begin MEASUREMENT fl32_04.I_fl32.R04_B "" FLOAT32_IEEE ident 1 100 -9.999999999999998e+036 9.999999999999998e+036 ECU_ADDRESS 0x7F8DBC /end MEASUREMENT
/begin MEASUREMENT fl32_05.I_fl32.R01_B "" FLOAT32_IEEE ident 1 100 -9.999999999999998e+036 9.999999999999998e+036 ECU_ADDRESS 0x7F8BE0 /end MEASUREMENT
/begin MEASUREMENT fl32_05.I_fl32.R02_B "" FLOAT32_IEEE ident 1 100 -9.999999999999998e+036 9.999999999999998e+036 ECU_ADDRESS 0x7F8C80 /end MEASUREMENT
/begin MEASUREMENT fl32_05.I_fl32.R03_B "" FLOAT32_IEEE ident 1 100 -9.999999999999998e+036 9.999999999999998e+036 ECU_ADDRESS 0x7F8D20 /end MEASUREMENT
/begin MEASUREMENT fl32_05.I_fl32.R04_B "" FLOAT32_IEEE ident 1 100 -9.999999999999998e+036 9.999999999999998e+036 ECU_ADDRESS 0x7F8DC0 /end MEASUREMENT
/begin MEASUREMENT fl32_06.I_fl32.R01_B "" FLOAT32_IEEE ident 1 100 -9.999999999999998e+036 9.999999999999998e+036 ECU_ADDRESS 0x7F8BE4 /end MEASUREMENT
/begin MEASUREMENT fl32_06.I_fl32.R02_B "" FLOAT32_IEEE ident 1 100 -9.999999999999998e+036 9.999999999999998e+036 ECU_ADDRESS 0x7F8C84 /end MEASUREMENT
/begin MEASUREMENT fl32_06.I_fl32.R03_B "" FLOAT32_IEEE ident 1 100 -9.999999999999998e+036 9.999999999999998e+036 ECU_ADDRESS 0x7F8D24 /end MEASUREMENT
/begin MEASUREMENT fl32_06.I_fl32.R04_B "" FLOAT32_IEEE ident 1 100 -9.999999999999998e+036 9.999999999999998e+036 ECU_ADDRESS 0x7F8DC4 /end MEASUREMENT
/begin MEASUREMENT fl32_07.I_fl32.R01_B "" FLOAT32_IEEE ident 1 100 -9.999999999999998e+036 9.999999999999998e+036 ECU_ADDRESS 0x7F8BE8 /end MEASUREMENT
/begin MEASUREMENT fl32_07.I_fl32.R02_B "" FLOAT32_IEEE ident 1 100 -9.999999999999998e+036 9.999999999999998e+036 ECU_ADDRESS 0x7F8C88 /end MEASUREMENT
/begin MEASUREMENT fl32_07.I_fl32.R03_B "" FLOAT32_IEEE ident 1 100 -9.999999999999998e+036 9.999999999999998e+036 ECU_ADDRESS 0x7F8D28 /end MEASUREMENT
/begin MEASUREMENT fl32_07.I_fl32.R04_B "" FLOAT32_IEEE ident 1 100 -9.999999999999998e+036 9.999999999999998e+036 ECU_ADDRESS 0x7F8DC8 /end MEASUREMENT
/begin MEASUREMENT fl32_08.I_fl32.R01_B "" FLOAT32_IEEE ident 1 100 -9.999999999999998e+036 9.999999999999998e+036 ECU_ADDRESS 0x7F8BEC /end MEASUREMENT
/begin MEASUREMENT fl32_08.I_fl32.R02_B "" FLOAT32_IEEE ident 1 100 -9.999999999999998e+036 9.999999999999998e+036 ECU_ADDRESS 0x7F8C8C /end MEASUREMENT
/begin MEASUREMENT fl32_08.I_fl32.R03_B "" FLOAT32_IEEE ident 1 100 -9.999999999999998e+036 9.999999999999998e+036 ECU_ADDRESS 0x7F8D2C /end MEASUREMENT
/begin MEASUREMENT fl32_08.I_fl32.R04_B "" FLOAT32_IEEE ident 1 100 -9.999999999999998e+036 9.999999999999998e+036 ECU_ADDRESS 0x7F8DCC /end MEASUREMENT
/begin MEASUREMENT fl64_01.I_fl64.R01_B "" FLOAT64_IEEE ident 1 100 -1.e+037 1.e+037 ECU_ADDRESS 0x7F8BF0 /end MEASUREMENT
/begin MEASUREMENT fl64_01.I_fl64.R02_B "" FLOAT64_IEEE ident 1 100 -1.e+037 1.e+037 ECU_ADDRESS 0x7F8C90 /end MEASUREMENT
/begin MEASUREMENT fl64_01.I_fl64.R03_B "" FLOAT64_IEEE ident 1 100 -1.e+037 1.e+037 ECU_ADDRESS 0x7F8D30 /end MEASUREMENT
/begin MEASUREMENT fl64_01.I_fl64.R04_B "" FLOAT64_IEEE ident 1 100 -1.e+037 1.e+037 ECU_ADDRESS 0x7F8DD0 /end MEASUREMENT
/begin MEASUREMENT fl64_01.M_Ultimate "" FLOAT64_IEEE ident 1 100 -1.e+037 1.e+037 ECU_ADDRESS 0x7FB110 /end MEASUREMENT
/begin MEASUREMENT fl64_02.I_fl64.R01_B "" FLOAT64_IEEE ident 1 100 -1.e+037 1.e+037 ECU_ADDRESS 0x7F8BF8 /end MEASUREMENT
/begin MEASUREMENT fl64_02.I_fl64.R02_B "" FLOAT64_IEEE ident 1 100 -1.e+037 1.e+037 ECU_ADDRESS 0x7F8C98 /end MEASUREMENT
/begin MEASUREMENT fl64_02.I_fl64.R03_B "" FLOAT64_IEEE ident 1 100 -1.e+037 1.e+037 ECU_ADDRESS 0x7F8D38 /end MEASUREMENT
/begin MEASUREMENT fl64_02.I_fl64.R04_B "" FLOAT64_IEEE ident 1 100 -1.e+037 1.e+037 ECU_ADDRESS 0x7F8DD8 /end MEASUREMENT
/begin MEASUREMENT fl64_03.I_fl64.R01_B "" FLOAT64_IEEE ident 1 100 -1.e+037 1.e+037 ECU_ADDRESS 0x7F8C00 /end MEASUREMENT
/begin MEASUREMENT fl64_03.I_fl64.R02_B "" FLOAT64_IEEE ident 1 100 -1.e+037 1.e+037 ECU_ADDRESS 0x7F8CA0 /end MEASUREMENT
/begin MEASUREMENT fl64_03.I_fl64.R03_B "" FLOAT64_IEEE ident 1 100 -1.e+037 1.e+037 ECU_ADDRESS 0x7F8D40 /end MEASUREMENT
/begin MEASUREMENT fl64_03.I_fl64.R04_B "" FLOAT64_IEEE ident 1 100 -1.e+037 1.e+037 ECU_ADDRESS 0x7F8DE0 /end MEASUREMENT
/begin MEASUREMENT fl64_04.I_fl64.R01_B "" FLOAT64_IEEE ident 1 100 -1.e+037 1.e+037 ECU_ADDRESS 0x7F8C08 /end MEASUREMENT
/begin MEASUREMENT fl64_04.I_fl64.R02_B "" FLOAT64_IEEE ident 1 100 -1.e+037 1.e+037 ECU_ADDRESS 0x7F8CA8 /end MEASUREMENT
/begin MEASUREMENT fl64_04.I_fl64.R03_B "" FLOAT64_IEEE ident 1 100 -1.e+037 1.e+037 ECU_ADDRESS 0x7F8D48 /end MEASUREMENT
/begin MEASUREMENT fl64_04.I_fl64.R04_B "" FLOAT64_IEEE ident 1 100 -1.e+037 1.e+037 ECU_ADDRESS 0x7F8DE8 /end MEASUREMENT
/begin MEASUREMENT fl64_05.I_fl64.R01_B "" FLOAT64_IEEE ident 1 100 -1.e+037 1.e+037 ECU_ADDRESS 0x7F8C10 /end MEASUREMENT
/begin MEASUREMENT fl64_05.I_fl64.R02_B "" FLOAT64_IEEE ident 1 100 -1.e+037 1.e+037 ECU_ADDRESS 0x7F8CB0 /end MEASUREMENT
/begin MEASUREMENT fl64_05.I_fl64.R03_B "" FLOAT64_IEEE ident 1 100 -1.e+037 1.e+037 ECU_ADDRESS 0x7F8D50 /end MEASUREMENT
/begin MEASUREMENT fl64_05.I_fl64.R04_B "" FLOAT64_IEEE ident 1 100 -1.e+037 1.e+037 ECU_ADDRESS 0x7F8DF0 /end MEASUREMENT
/begin MEASUREMENT fl64_06.I_fl64.R01_B "" FLOAT64_IEEE ident 1 100 -1.e+037 1.e+037 ECU_ADDRESS 0x7F8C18 /end MEASUREMENT
/begin MEASUREMENT fl64_06.I_fl64.R02_B "" FLOAT64_IEEE ident 1 100 -1.e+037 1.e+037 ECU_ADDRESS 0x7F8CB8 /end MEASUREMENT
/begin MEASUREMENT fl64_06.I_fl64.R03_B "" FLOAT64_IEEE ident 1 100 -1.e+037 1.e+037 ECU_ADDRESS 0x7F8D58 /end MEASUREMENT
/begin MEASUREMENT fl64_06.I_fl64.R04_B "" FLOAT64_IEEE ident 1 100 -1.e+037 1.e+037 ECU_ADDRESS 0x7F8DF8 /end MEASUREMENT
/begin MEASUREMENT fl64_07.I_fl64.R01_B "" FLOAT64_IEEE ident 1 100 -1.e+037 1.e+037 ECU_ADDRESS 0x7F8C20 /end MEASUREMENT
/begin MEASUREMENT fl64_07.I_fl64.R02_B "" FLOAT64_IEEE ident 1 100 -1.e+037 1.e+037 ECU_ADDRESS 0x7F8CC0 /end MEASUREMENT
/begin MEASUREMENT fl64_07.I_fl64.R03_B "" FLOAT64_IEEE ident 1 100 -1.e+037 1.e+037 ECU_ADDRESS 0x7F8D60 /end MEASUREMENT
/begin MEASUREMENT fl64_07.I_fl64.R04_B "" FLOAT64_IEEE ident 1 100 -1.e+037 1.e+037 ECU_ADDRESS 0x7F8E00 /end MEASUREMENT
/begin MEASUREMENT fl64_08.I_fl64.R01_B "" FLOAT64_IEEE ident 1 100 -1.e+037 1.e+037 ECU_ADDRESS 0x7F8C28 /end MEASUREMENT
/begin MEASUREMENT fl64_08.I_fl64.R02_B "" FLOAT64_IEEE ident 1 100 -1.e+037 1.e+037 ECU_ADDRESS 0x7F8CC8 /end MEASUREMENT
/begin MEASUREMENT fl64_08.I_fl64.R03_B "" FLOAT64_IEEE ident 1 100 -1.e+037 1.e+037 ECU_ADDRESS 0x7F8D68 /end MEASUREMENT
/begin MEASUREMENT fl64_08.I_fl64.R04_B "" FLOAT64_IEEE ident 1 100 -1.e+037 1.e+037 ECU_ADDRESS 0x7F8E08 /end MEASUREMENT
/begin MEASUREMENT i.FEA_performance_array "" UBYTE ident 1 100 0 255 ECU_ADDRESS 0x7F88D0 /end MEASUREMENT
/begin MEASUREMENT log_uint8_0_B01.Model_Byp_B01 "" UBYTE ident 1 100 0 1 BIT_MASK 0x1 ECU_ADDRESS 0x7FB1C0 DISPLAY_IDENTIFIER log_uint8_0_B01.Model_Byp_B01_DISP_ID /end MEASUREMENT
/begin MEASUREMENT log_uint8_0_bitOffset_cpy_B01.Model_Byp_B01 "" UBYTE ident 1 100 0 7 ECU_ADDRESS 0x7FB1AA DISPLAY_IDENTIFIER log_uint8_0_bitOffset_cpy_B01.Model_Byp_B01_DISP_ID /end MEASUREMENT
/begin MEASUREMENT log_uint8_0_offset_cpy_B01.Model_Byp_B01 "" UBYTE ident 1 100 0 255 ECU_ADDRESS 0x7FB1AB DISPLAY_IDENTIFIER log_uint8_0_offset_cpy_B01.Model_Byp_B01_DISP_ID /end MEASUREMENT
/begin MEASUREMENT log_uint8_1_B01.Model_Byp_B01 "" UBYTE ident 1 100 0 1 BIT_MASK 0x1 ECU_ADDRESS 0x7FB1C1 DISPLAY_IDENTIFIER log_uint8_1_B01.Model_Byp_B01_DISP_ID /end MEASUREMENT
/begin MEASUREMENT log_uint8_1_bitOffset_cpy_B01.Model_Byp_B01 "" UBYTE ident 1 100 0 7 ECU_ADDRESS 0x7FB1AC DISPLAY_IDENTIFIER log_uint8_1_bitOffset_cpy_B01.Model_Byp_B01_DISP_ID /end MEASUREMENT
/begin MEASUREMENT log_uint8_1_offset_cpy_B01.Model_Byp_B01 "" UBYTE ident 1 100 0 255 ECU_ADDRESS 0x7FB1AD DISPLAY_IDENTIFIER log_uint8_1_offset_cpy_B01.Model_Byp_B01_DISP_ID /end MEASUREMENT
/begin MEASUREMENT M_In_X_Dist.Map_Mod "" FLOAT32_IEEE ident 1 100 -1.e+037 1.e+037 ECU_ADDRESS 0x7FB184 /end MEASUREMENT
/begin MEASUREMENT M_In_X_Two_D.Map_Mod "" FLOAT32_IEEE ident 1 100 -1.e+037 1.e+037 ECU_ADDRESS 0x7FB188 /end MEASUREMENT
/begin MEASUREMENT M_In_Y_Dist.Map_Mod "" FLOAT32_IEEE ident 1 100 -1.e+037 1.e+037 ECU_ADDRESS 0x7FB18C /end MEASUREMENT
/begin MEASUREMENT M_In_Y_Two_D.Map_Mod "" FLOAT32_IEEE ident 1 100 -1.e+037 1.e+037 ECU_ADDRESS 0x7FB190 /end MEASUREMENT
/begin MEASUREMENT M_Out_Group_1.Map_Mod "" FLOAT32_IEEE ident 1 100 -1.e+037 1.e+037 ECU_ADDRESS 0x7FB194 /end MEASUREMENT
/begin MEASUREMENT M_Out_Group_2.Map_Mod "" FLOAT32_IEEE ident 1 100 -1.e+037 1.e+037 ECU_ADDRESS 0x7FB198 /end MEASUREMENT
/begin MEASUREMENT M_Out_Group_3.Map_Mod "" FLOAT32_IEEE ident 1 100 -1.e+037 1.e+037 ECU_ADDRESS 0x7FB19C /end MEASUREMENT
/begin MEASUREMENT M_Out_X_Two_D.Map_Mod "" FLOAT32_IEEE ident 1 100 -1.e+037 1.e+037 ECU_ADDRESS 0x7FB1A0 /end MEASUREMENT
/begin MEASUREMENT oldSignal.EdgeRising.Reset_Schalter "" UBYTE ident 1 100 0 1 ECU_ADDRESS 0x7FB0E2 DISPLAY_IDENTIFIER oldSignal.EdgeRising.Reset_Schalter_DISP_ID /end MEASUREMENT
/begin MEASUREMENT Result.FEA_performance_array "" ULONG ident 1 100 0 255 ECU_ADDRESS 0x7F88C4 /end MEASUREMENT
/begin MEASUREMENT Result.FEA_performance_scalar "" ULONG ident 1 100 0 255 ECU_ADDRESS 0x7F88D4 /end MEASUREMENT
/begin MEASUREMENT ResultShort.FEA_performance_scalar "" ULONG ident 1 100 0 255 ECU_ADDRESS 0x7F88D8 /end MEASUREMENT
/begin MEASUREMENT RM01_Op_u8.M_Ultimate "" UBYTE ident 1 100 0 255 ECU_ADDRESS 0x7FB178 /end MEASUREMENT
/begin MEASUREMENT RM01_Par01_u8.M_Ultimate "" FLOAT64_IEEE ident 1 100 -1.e+037 1.e+037 ECU_ADDRESS 0x7FB130 /end MEASUREMENT
/begin MEASUREMENT RM01_Par02_u8.M_Ultimate "" FLOAT64_IEEE ident 1 100 -1.e+037 1.e+037 ECU_ADDRESS 0x7FB138 /end MEASUREMENT
/begin MEASUREMENT RM01_Res_u8.M_Ultimate "" FLOAT64_IEEE ident 1 100 -1.e+037 1.e+037 ECU_ADDRESS 0x7FB140 /end MEASUREMENT
/begin MEASUREMENT s_uint8_01.M_Ultimate "" FLOAT64_IEEE ident 1 100 -1.e+037 1.e+037 ECU_ADDRESS 0x7FB168 /end MEASUREMENT
/begin MEASUREMENT sdisc_sint16_B01.Model_Byp_B01 "" SWORD ident 1 100 -32768 32767 ECU_ADDRESS 0x7FB1B8 DISPLAY_IDENTIFIER sdisc_sint16_B01.Model_Byp_B01_DISP_ID /end MEASUREMENT
/begin MEASUREMENT sdisc_sint16_offset_cpy_B01.Model_Byp_B01 "" UBYTE ident 1 100 0 255 ECU_ADDRESS 0x7FB1AE DISPLAY_IDENTIFIER sdisc_sint16_offset_cpy_B01.Model_Byp_B01_DISP_ID /end MEASUREMENT
/begin MEASUREMENT sdisc_sint8_B01.Model_Byp_B01 "" SBYTE ident 1 100 -128 127 ECU_ADDRESS 0x7FB1C2 DISPLAY_IDENTIFIER sdisc_sint8_B01.Model_Byp_B01_DISP_ID /end MEASUREMENT
/begin MEASUREMENT sdisc_sint8_offset_cpy_B01.Model_Byp_B01 "" UBYTE ident 1 100 0 255 ECU_ADDRESS 0x7FB1AF DISPLAY_IDENTIFIER sdisc_sint8_offset_cpy_B01.Model_Byp_B01_DISP_ID /end MEASUREMENT
/begin MEASUREMENT sint16_01.I_sint16.R01 "" SWORD ident 1 100 -32768 32767 ECU_ADDRESS 0x7FB2CA DISPLAY_IDENTIFIER sint16_01.I_sint16.R01_DISP_ID_R01 /end MEASUREMENT
/begin MEASUREMENT sint16_01.I_sint16.R02 "" SWORD ident 1 100 -32768 32767 ECU_ADDRESS 0x7FB400 DISPLAY_IDENTIFIER sint16_01.I_sint16.R02_DISP_ID_R02 /end MEASUREMENT
/begin MEASUREMENT sint16_01.I_sint16.R03 "" SWORD ident 1 100 -32768 32767 ECU_ADDRESS 0x7FB436 DISPLAY_IDENTIFIER sint16_01.I_sint16.R03_DISP_ID_R03 /end MEASUREMENT
/begin MEASUREMENT sint16_01.I_sint16.R04 "" SWORD ident 1 100 -32768 32767 ECU_ADDRESS 0x7FB46A /end MEASUREMENT
/begin MEASUREMENT sint16_01.I_sint16_1.R01_16bit "" SWORD ident 1 100 -32768 32767 ECU_ADDRESS 0x7FB300 /end MEASUREMENT
/begin MEASUREMENT sint16_01.I_sint16_2.R01_16bit "" SWORD ident 1 100 -32768 32767 ECU_ADDRESS 0x7FB310 /end MEASUREMENT
/begin MEASUREMENT sint16_01.I_sint16_3.R01_16bit "" SWORD ident 1 100 -32768 32767 ECU_ADDRESS 0x7FB320 /end MEASUREMENT
/begin MEASUREMENT sint16_01.I_sint16_4.R01_16bit "" SWORD ident 1 100 -32768 32767 ECU_ADDRESS 0x7FB330 /end MEASUREMENT
/begin MEASUREMENT sint16_01.M_Ultimate "" SWORD ident 1 100 -32768 32767 ECU_ADDRESS 0x7FB124 /end MEASUREMENT
/begin MEASUREMENT sint16_02.I_sint16.R01 "" SWORD ident 1 100 -32768 32767 ECU_ADDRESS 0x7FB2CC DISPLAY_IDENTIFIER sint16_02.I_sint16.R01_DISP_ID_R01 /end MEASUREMENT
/begin MEASUREMENT sint16_02.I_sint16.R02 "" SWORD ident 1 100 -32768 32767 ECU_ADDRESS 0x7FB402 DISPLAY_IDENTIFIER sint16_02.I_sint16.R02_DISP_ID_R02 /end MEASUREMENT
/begin MEASUREMENT sint16_02.I_sint16.R03 "" SWORD ident 1 100 -32768 32767 ECU_ADDRESS 0x7FB438 DISPLAY_IDENTIFIER sint16_02.I_sint16.R03_DISP_ID_R03 /end MEASUREMENT
/begin MEASUREMENT sint16_02.I_sint16.R04 "" SWORD ident 1 100 -32768 32767 ECU_ADDRESS 0x7FB46C /end MEASUREMENT
/begin MEASUREMENT sint16_02.I_sint16_1.R01_16bit "" SWORD ident 1 100 -32768 32767 ECU_ADDRESS 0x7FB302 /end MEASUREMENT
/begin MEASUREMENT sint16_02.I_sint16_2.R01_16bit "" SWORD ident 1 100 -32768 32767 ECU_ADDRESS 0x7FB312 /end MEASUREMENT
/begin MEASUREMENT sint16_02.I_sint16_3.R01_16bit "" SWORD ident 1 100 -32768 32767 ECU_ADDRESS 0x7FB322 /end MEASUREMENT
/begin MEASUREMENT sint16_02.I_sint16_4.R01_16bit "" SWORD ident 1 100 -32768 32767 ECU_ADDRESS 0x7FB332 /end MEASUREMENT
/begin MEASUREMENT sint16_03.I_sint16.R01 "" SWORD ident 1 100 -32768 32767 ECU_ADDRESS 0x7FB2CE DISPLAY_IDENTIFIER sint16_03.I_sint16.R01_DISP_ID_R01 /end MEASUREMENT
/begin MEASUREMENT sint16_03.I_sint16.R02 "" SWORD ident 1 100 -32768 32767 ECU_ADDRESS 0x7FB404 DISPLAY_IDENTIFIER sint16_03.I_sint16.R02_DISP_ID_R02 /end MEASUREMENT
/begin MEASUREMENT sint16_03.I_sint16.R03 "" SWORD ident 1 100 -32768 32767 ECU_ADDRESS 0x7FB43A DISPLAY_IDENTIFIER sint16_03.I_sint16.R03_DISP_ID_R03 /end MEASUREMENT
/begin MEASUREMENT sint16_03.I_sint16.R04 "" SWORD ident 1 100 -32768 32767 ECU_ADDRESS 0x7FB46E /end MEASUREMENT
/begin MEASUREMENT sint16_03.I_sint16_1.R01_16bit "" SWORD ident 1 100 -32768 32767 ECU_ADDRESS 0x7FB304 /end MEASUREMENT
/begin MEASUREMENT sint16_03.I_sint16_2.R01_16bit "" SWORD ident 1 100 -32768 32767 ECU_ADDRESS 0x7FB314 /end MEASUREMENT
/begin MEASUREMENT sint16_03.I_sint16_3.R01_16bit "" SWORD ident 1 100 -32768 32767 ECU_ADDRESS 0x7FB324 /end MEASUREMENT
/begin MEASUREMENT sint16_03.I_sint16_4.R01_16bit "" SWORD ident 1 100 -32768 32767 ECU_ADDRESS 0x7FB334 /end MEASUREMENT
/begin MEASUREMENT sint16_04.I_sint16.R01 "" SWORD ident 1 100 -32768 32767 ECU_ADDRESS 0x7FB2D0 DISPLAY_IDENTIFIER sint16_04.I_sint16.R01_DISP_ID_R01 /end MEASUREMENT
/begin MEASUREMENT sint16_04.I_sint16.R02 "" SWORD ident 1 100 -32768 32767 ECU_ADDRESS 0x7FB406 DISPLAY_IDENTIFIER sint16_04.I_sint16.R02_DISP_ID_R02 /end MEASUREMENT
/begin MEASUREMENT sint16_04.I_sint16.R03 "" SWORD ident 1 100 -32768 32767 ECU_ADDRESS 0x7FB43C DISPLAY_IDENTIFIER sint16_04.I_sint16.R03_DISP_ID_R03 /end MEASUREMENT
/begin MEASUREMENT sint16_04.I_sint16.R04 "" SWORD ident 1 100 -32768 32767 ECU_ADDRESS 0x7FB470 /end MEASUREMENT
/begin MEASUREMENT sint16_04.I_sint16_1.R01_16bit "" SWORD ident 1 100 -32768 32767 ECU_ADDRESS 0x7FB306 /end MEASUREMENT
/begin MEASUREMENT sint16_04.I_sint16_2.R01_16bit "" SWORD ident 1 100 -32768 32767 ECU_ADDRESS 0x7FB316 /end MEASUREMENT
/begin MEASUREMENT sint16_04.I_sint16_3.R01_16bit "" SWORD ident 1 100 -32768 32767 ECU_ADDRESS 0x7FB326 /end MEASUREMENT
/begin MEASUREMENT sint16_04.I_sint16_4.R01_16bit "" SWORD ident 1 100 -32768 32767 ECU_ADDRESS 0x7FB336 /end MEASUREMENT
/begin MEASUREMENT sint16_05.I_sint16.R01 "" SWORD ident 1 100 -32768 32767 ECU_ADDRESS 0x7FB2D2 DISPLAY_IDENTIFIER sint16_05.I_sint16.R01_DISP_ID_R01 /end MEASUREMENT
/begin MEASUREMENT sint16_05.I_sint16.R02 "" SWORD ident 1 100 -32768 32767 ECU_ADDRESS 0x7FB408 DISPLAY_IDENTIFIER sint16_05.I_sint16.R02_DISP_ID_R02 /end MEASUREMENT
/begin MEASUREMENT sint16_05.I_sint16.R03 "" SWORD ident 1 100 -32768 32767 ECU_ADDRESS 0x7FB43E DISPLAY_IDENTIFIER sint16_05.I_sint16.R03_DISP_ID_R03 /end MEASUREMENT
/begin MEASUREMENT sint16_05.I_sint16.R04 "" SWORD ident 1 100 -32768 32767 ECU_ADDRESS 0x7FB472 /end MEASUREMENT
/begin MEASUREMENT sint16_05.I_sint16_1.R01_16bit "" SWORD ident 1 100 -32768 32767 ECU_ADDRESS 0x7FB308 /end MEASUREMENT
/begin MEASUREMENT sint16_05.I_sint16_2.R01_16bit "" SWORD ident 1 100 -32768 32767 ECU_ADDRESS 0x7FB318 /end MEASUREMENT
/begin MEASUREMENT sint16_05.I_sint16_3.R01_16bit "" SWORD ident 1 100 -32768 32767 ECU_ADDRESS 0x7FB328 /end MEASUREMENT
/begin MEASUREMENT sint16_05.I_sint16_4.R01_16bit "" SWORD ident 1 100 -32768 32767 ECU_ADDRESS 0x7FB338 /end MEASUREMENT
/begin MEASUREMENT sint16_06.I_sint16.R01 "" SWORD ident 1 100 -32768 32767 ECU_ADDRESS 0x7FB2D4 DISPLAY_IDENTIFIER sint16_06.I_sint16.R01_DISP_ID_R01 /end MEASUREMENT
/begin MEASUREMENT sint16_06.I_sint16.R02 "" SWORD ident 1 100 -32768 32767 ECU_ADDRESS 0x7FB40A DISPLAY_IDENTIFIER sint16_06.I_sint16.R02_DISP_ID_R02 /end MEASUREMENT
/begin MEASUREMENT sint16_06.I_sint16.R03 "" SWORD ident 1 100 -32768 32767 ECU_ADDRESS 0x7FB440 DISPLAY_IDENTIFIER sint16_06.I_sint16.R03_DISP_ID_R03 /end MEASUREMENT
/begin MEASUREMENT sint16_06.I_sint16.R04 "" SWORD ident 1 100 -32768 32767 ECU_ADDRESS 0x7FB474 /end MEASUREMENT
/begin MEASUREMENT sint16_06.I_sint16_1.R01_16bit "" SWORD ident 1 100 -32768 32767 ECU_ADDRESS 0x7FB30A /end MEASUREMENT
/begin MEASUREMENT sint16_06.I_sint16_2.R01_16bit "" SWORD ident 1 100 -32768 32767 ECU_ADDRESS 0x7FB31A /end MEASUREMENT
/begin MEASUREMENT sint16_06.I_sint16_3.R01_16bit "" SWORD ident 1 100 -32768 32767 ECU_ADDRESS 0x7FB32A /end MEASUREMENT
/begin MEASUREMENT sint16_06.I_sint16_4.R01_16bit "" SWORD ident 1 100 -32768 32767 ECU_ADDRESS 0x7FB33A /end MEASUREMENT
/begin MEASUREMENT sint16_07.I_sint16.R01 "" SWORD ident 1 100 -32768 32767 ECU_ADDRESS 0x7FB2D6 DISPLAY_IDENTIFIER sint16_07.I_sint16.R01_DISP_ID_R01 /end MEASUREMENT
/begin MEASUREMENT sint16_07.I_sint16.R02 "" SWORD ident 1 100 -32768 32767 ECU_ADDRESS 0x7FB40C DISPLAY_IDENTIFIER sint16_07.I_sint16.R02_DISP_ID_R02 /end MEASUREMENT
/begin MEASUREMENT sint16_07.I_sint16.R03 "" SWORD ident 1 100 -32768 32767 ECU_ADDRESS 0x7FB442 DISPLAY_IDENTIFIER sint16_07.I_sint16.R03_DISP_ID_R03 /end MEASUREMENT
/begin MEASUREMENT sint16_07.I_sint16.R04 "" SWORD ident 1 100 -32768 32767 ECU_ADDRESS 0x7FB476 /end MEASUREMENT
/begin MEASUREMENT sint16_07.I_sint16_1.R01_16bit "" SWORD ident 1 100 -32768 32767 ECU_ADDRESS 0x7FB30C /end MEASUREMENT
/begin MEASUREMENT sint16_07.I_sint16_2.R01_16bit "" SWORD ident 1 100 -32768 32767 ECU_ADDRESS 0x7FB31C /end MEASUREMENT
/begin MEASUREMENT sint16_07.I_sint16_3.R01_16bit "" SWORD ident 1 100 -32768 32767 ECU_ADDRESS 0x7FB32C /end MEASUREMENT
/begin MEASUREMENT sint16_07.I_sint16_4.R01_16bit "" SWORD ident 1 100 -32768 32767 ECU_ADDRESS 0x7FB33C /end MEASUREMENT
/begin MEASUREMENT sint16_08.I_sint16.R01 "" SWORD ident 1 100 -32768 32767 ECU_ADDRESS 0x7FB2D8 DISPLAY_IDENTIFIER sint16_08.I_sint16.R01_DISP_ID_R01 /end MEASUREMENT
/begin MEASUREMENT sint16_08.I_sint16.R02 "" SWORD ident 1 100 -32768 32767 ECU_ADDRESS 0x7FB40E DISPLAY_IDENTIFIER sint16_08.I_sint16.R02_DISP_ID_R02 /end MEASUREMENT
/begin MEASUREMENT sint16_08.I_sint16.R03 "" SWORD ident 1 100 -32768 32767 ECU_ADDRESS 0x7FB444 DISPLAY_IDENTIFIER sint16_08.I_sint16.R03_DISP_ID_R03 /end MEASUREMENT
/begin MEASUREMENT sint16_08.I_sint16.R04 "" SWORD ident 1 100 -32768 32767 ECU_ADDRESS 0x7FB478 /end MEASUREMENT
/begin MEASUREMENT sint16_08.I_sint16_1.R01_16bit "" SWORD ident 1 100 -32768 32767 ECU_ADDRESS 0x7FB30E /end MEASUREMENT
/begin MEASUREMENT sint16_08.I_sint16_2.R01_16bit "" SWORD ident 1 100 -32768 32767 ECU_ADDRESS 0x7FB31E /end MEASUREMENT
/begin MEASUREMENT sint16_08.I_sint16_3.R01_16bit "" SWORD ident 1 100 -32768 32767 ECU_ADDRESS 0x7FB32E /end MEASUREMENT
/begin MEASUREMENT sint16_08.I_sint16_4.R01_16bit "" SWORD ident 1 100 -32768 32767 ECU_ADDRESS 0x7FB33E /end MEASUREMENT
/begin MEASUREMENT sint32_01.I_sint32.R01_B "" SLONG ident 1 100 -2147483648 2147483647 ECU_ADDRESS 0x7F8C30 /end MEASUREMENT
/begin MEASUREMENT sint32_01.I_sint32.R02_B "" SLONG ident 1 100 -2147483648 2147483647 ECU_ADDRESS 0x7F8CD0 /end MEASUREMENT
/begin MEASUREMENT sint32_01.I_sint32.R03_B "" SLONG ident 1 100 -2147483648 2147483647 ECU_ADDRESS 0x7F8D70 /end MEASUREMENT
/begin MEASUREMENT sint32_01.I_sint32.R04_B "" SLONG ident 1 100 -2147483648 2147483647 ECU_ADDRESS 0x7F8E10 /end MEASUREMENT
/begin MEASUREMENT sint32_01.M_Ultimate "" SLONG ident 1 100 -2147483648 2147483647 ECU_ADDRESS 0x7FB11C /end MEASUREMENT
/begin MEASUREMENT sint32_02.I_sint32.R01_B "" SLONG ident 1 100 -2147483648 2147483647 ECU_ADDRESS 0x7F8C34 /end MEASUREMENT
/begin MEASUREMENT sint32_02.I_sint32.R02_B "" SLONG ident 1 100 -2147483648 2147483647 ECU_ADDRESS 0x7F8CD4 /end MEASUREMENT
/begin MEASUREMENT sint32_02.I_sint32.R03_B "" SLONG ident 1 100 -2147483648 2147483647 ECU_ADDRESS 0x7F8D74 /end MEASUREMENT
/begin MEASUREMENT sint32_02.I_sint32.R04_B "" SLONG ident 1 100 -2147483648 2147483647 ECU_ADDRESS 0x7F8E14 /end MEASUREMENT
/begin MEASUREMENT sint32_03.I_sint32.R01_B "" SLONG ident 1 100 -2147483648 2147483647 ECU_ADDRESS 0x7F8C38 /end MEASUREMENT
/begin MEASUREMENT sint32_03.I_sint32.R02_B "" SLONG ident 1 100 -2147483648 2147483647 ECU_ADDRESS 0x7F8CD8 /end MEASUREMENT
/begin MEASUREMENT sint32_03.I_sint32.R03_B "" SLONG ident 1 100 -2147483648 2147483647 ECU_ADDRESS 0x7F8D78 /end MEASUREMENT
/begin MEASUREMENT sint32_03.I_sint32.R04_B "" SLONG ident 1 100 -2147483648 2147483647 ECU_ADDRESS 0x7F8E18 /end MEASUREMENT
/begin MEASUREMENT sint32_04.I_sint32.R01_B "" SLONG ident 1 100 -2147483648 2147483647 ECU_ADDRESS 0x7F8C3C /end MEASUREMENT
/begin MEASUREMENT sint32_04.I_sint32.R02_B "" SLONG ident 1 100 -2147483648 2147483647 ECU_ADDRESS 0x7F8CDC /end MEASUREMENT
/begin MEASUREMENT sint32_04.I_sint32.R03_B "" SLONG ident 1 100 -2147483648 2147483647 ECU_ADDRESS 0x7F8D7C /end MEASUREMENT
/begin MEASUREMENT sint32_04.I_sint32.R04_B "" SLONG ident 1 100 -2147483648 2147483647 ECU_ADDRESS 0x7F8E1C /end MEASUREMENT
/begin MEASUREMENT sint32_05.I_sint32.R01_B "" SLONG ident 1 100 -2147483648 2147483647 ECU_ADDRESS 0x7F8C40 /end MEASUREMENT
/begin MEASUREMENT sint32_05.I_sint32.R02_B "" SLONG ident 1 100 -2147483648 2147483647 ECU_ADDRESS 0x7F8CE0 /end MEASUREMENT
/begin MEASUREMENT sint32_05.I_sint32.R03_B "" SLONG ident 1 100 -2147483648 2147483647 ECU_ADDRESS 0x7F8D80 /end MEASUREMENT
/begin MEASUREMENT sint32_05.I_sint32.R04_B "" SLONG ident 1 100 -2147483648 2147483647 ECU_ADDRESS 0x7F8E20 /end MEASUREMENT
/begin MEASUREMENT sint32_06.I_sint32.R01_B "" SLONG ident 1 100 -2147483648 2147483647 ECU_ADDRESS 0x7F8C44 /end MEASUREMENT
/begin MEASUREMENT sint32_06.I_sint32.R02_B "" SLONG ident 1 100 -2147483648 2147483647 ECU_ADDRESS 0x7F8CE4 /end MEASUREMENT
/begin MEASUREMENT sint32_06.I_sint32.R03_B "" SLONG ident 1 100 -2147483648 2147483647 ECU_ADDRESS 0x7F8D84 /end MEASUREMENT
/begin MEASUREMENT sint32_06.I_sint32.R04_B "" SLONG ident 1 100 -2147483648 2147483647 ECU_ADDRESS 0x7F8E24 /end MEASUREMENT
/begin MEASUREMENT sint32_07.I_sint32.R01_B "" SLONG ident 1 100 -2147483648 2147483647 ECU_ADDRESS 0x7F8C48 /end MEASUREMENT
/begin MEASUREMENT sint32_07.I_sint32.R02_B "" SLONG ident 1 100 -2147483648 2147483647 ECU_ADDRESS 0x7F8CE8 /end MEASUREMENT
/begin MEASUREMENT sint32_07.I_sint32.R03_B "" SLONG ident 1 100 -2147483648 2147483647 ECU_ADDRESS 0x7F8D88 /end MEASUREMENT
/begin MEASUREMENT sint32_07.I_sint32.R04_B "" SLONG ident 1 100 -2147483648 2147483647 ECU_ADDRESS 0x7F8E28 /end MEASUREMENT
/begin MEASUREMENT sint32_08.I_sint32.R01_B "" SLONG ident 1 100 -2147483648 2147483647 ECU_ADDRESS 0x7F8C4C /end MEASUREMENT
/begin MEASUREMENT sint32_08.I_sint32.R02_B "" SLONG ident 1 100 -2147483648 2147483647 ECU_ADDRESS 0x7F8CEC /end MEASUREMENT
/begin MEASUREMENT sint32_08.I_sint32.R03_B "" SLONG ident 1 100 -2147483648 2147483647 ECU_ADDRESS 0x7F8D8C /end MEASUREMENT
/begin MEASUREMENT sint32_08.I_sint32.R04_B "" SLONG ident 1 100 -2147483648 2147483647 ECU_ADDRESS 0x7F8E2C /end MEASUREMENT
/begin MEASUREMENT sint8_01.I_sint8.R01 "" SBYTE ident 1 100 -128 127 ECU_ADDRESS 0x7FB2DA DISPLAY_IDENTIFIER sint8_01.I_sint8.R01_DISP_ID_R01 /end MEASUREMENT
/begin MEASUREMENT sint8_01.I_sint8.R02 "" SBYTE ident 1 100 -128 127 ECU_ADDRESS 0x7FB410 DISPLAY_IDENTIFIER sint8_01.I_sint8.R02_DISP_ID_R02 /end MEASUREMENT
/begin MEASUREMENT sint8_01.I_sint8.R03 "" SBYTE ident 1 100 -128 127 ECU_ADDRESS 0x7FB446 DISPLAY_IDENTIFIER sint8_01.I_sint8.R03_DISP_ID_R03 /end MEASUREMENT
/begin MEASUREMENT sint8_01.I_sint8.R04 "" SBYTE ident 1 100 -128 127 ECU_ADDRESS 0x7FB47A /end MEASUREMENT
/begin MEASUREMENT sint8_01.I_sint8_1.R01_8bit "" SBYTE ident 1 100 -128 127 ECU_ADDRESS 0x7FB380 /end MEASUREMENT
/begin MEASUREMENT sint8_01.I_sint8_2.R01_8bit "" SBYTE ident 1 100 -128 127 ECU_ADDRESS 0x7FB388 /end MEASUREMENT
/begin MEASUREMENT sint8_01.I_sint8_3.R01_8bit "" SBYTE ident 1 100 -128 127 ECU_ADDRESS 0x7FB390 /end MEASUREMENT
/begin MEASUREMENT sint8_01.I_sint8_4.R01_8bit "" SBYTE ident 1 100 -128 127 ECU_ADDRESS 0x7FB398 /end MEASUREMENT
/begin MEASUREMENT sint8_01.I_sint8_5.R01_8bit "" SBYTE ident 1 100 -128 127 ECU_ADDRESS 0x7FB3A0 /end MEASUREMENT
/begin MEASUREMENT sint8_01.I_sint8_6.R01_8bit "" SBYTE ident 1 100 -128 127 ECU_ADDRESS 0x7FB3A8 /end MEASUREMENT
/begin MEASUREMENT sint8_01.I_sint8_7.R01_8bit "" SBYTE ident 1 100 -128 127 ECU_ADDRESS 0x7FB3B0 /end MEASUREMENT
/begin MEASUREMENT sint8_01.I_sint8_8.R01_8bit "" SBYTE ident 1 100 -128 127 ECU_ADDRESS 0x7FB3B8 /end MEASUREMENT
/begin MEASUREMENT sint8_01.M_Ultimate "" SBYTE ident 1 100 -128 127 ECU_ADDRESS 0x7FB128 /end MEASUREMENT
/begin MEASUREMENT sint8_02.I_sint8.R01 "" SBYTE ident 1 100 -128 127 ECU_ADDRESS 0x7FB2DB DISPLAY_IDENTIFIER sint8_02.I_sint8.R01_DISP_ID_R01 /end MEASUREMENT
/begin MEASUREMENT sint8_02.I_sint8.R02 "" SBYTE ident 1 100 -128 127 ECU_ADDRESS 0x7FB411 DISPLAY_IDENTIFIER sint8_02.I_sint8.R02_DISP_ID_R02 /end MEASUREMENT
/begin MEASUREMENT sint8_02.I_sint8.R03 "" SBYTE ident 1 100 -128 127 ECU_ADDRESS 0x7FB447 DISPLAY_IDENTIFIER sint8_02.I_sint8.R03_DISP_ID_R03 /end MEASUREMENT
/begin MEASUREMENT sint8_02.I_sint8.R04 "" SBYTE ident 1 100 -128 127 ECU_ADDRESS 0x7FB47B /end MEASUREMENT
/begin MEASUREMENT sint8_02.I_sint8_1.R01_8bit "" SBYTE ident 1 100 -128 127 ECU_ADDRESS 0x7FB381 /end MEASUREMENT
/begin MEASUREMENT sint8_02.I_sint8_2.R01_8bit "" SBYTE ident 1 100 -128 127 ECU_ADDRESS 0x7FB389 /end MEASUREMENT
/begin MEASUREMENT sint8_02.I_sint8_3.R01_8bit "" SBYTE ident 1 100 -128 127 ECU_ADDRESS 0x7FB391 /end MEASUREMENT
/begin MEASUREMENT sint8_02.I_sint8_4.R01_8bit "" SBYTE ident 1 100 -128 127 ECU_ADDRESS 0x7FB399 /end MEASUREMENT
/begin MEASUREMENT sint8_02.I_sint8_5.R01_8bit "" SBYTE ident 1 100 -128 127 ECU_ADDRESS 0x7FB3A1 /end MEASUREMENT
/begin MEASUREMENT sint8_02.I_sint8_6.R01_8bit "" SBYTE ident 1 100 -128 127 ECU_ADDRESS 0x7FB3A9 /end MEASUREMENT
/begin MEASUREMENT sint8_02.I_sint8_7.R01_8bit "" SBYTE ident 1 100 -128 127 ECU_ADDRESS 0x7FB3B1 /end MEASUREMENT
/begin MEASUREMENT sint8_02.I_sint8_8.R01_8bit "" SBYTE ident 1 100 -128 127 ECU_ADDRESS 0x7FB3B9 /end MEASUREMENT
/begin MEASUREMENT sint8_03.I_sint8.R01 "" SBYTE ident 1 100 -128 127 ECU_ADDRESS 0x7FB2DC DISPLAY_IDENTIFIER sint8_03.I_sint8.R01_DISP_ID_R01 /end MEASUREMENT
/begin MEASUREMENT sint8_03.I_sint8.R02 "" SBYTE ident 1 100 -128 127 ECU_ADDRESS 0x7FB412 DISPLAY_IDENTIFIER sint8_03.I_sint8.R02_DISP_ID_R02 /end MEASUREMENT
/begin MEASUREMENT sint8_03.I_sint8.R03 "" SBYTE ident 1 100 -128 127 ECU_ADDRESS 0x7FB448 DISPLAY_IDENTIFIER sint8_03.I_sint8.R03_DISP_ID_R03 /end MEASUREMENT
/begin MEASUREMENT sint8_03.I_sint8.R04 "" SBYTE ident 1 100 -128 127 ECU_ADDRESS 0x7FB47C /end MEASUREMENT
/begin MEASUREMENT sint8_03.I_sint8_1.R01_8bit "" SBYTE ident 1 100 -128 127 ECU_ADDRESS 0x7FB382 /end MEASUREMENT
/begin MEASUREMENT sint8_03.I_sint8_2.R01_8bit "" SBYTE ident 1 100 -128 127 ECU_ADDRESS 0x7FB38A /end MEASUREMENT
/begin MEASUREMENT sint8_03.I_sint8_3.R01_8bit "" SBYTE ident 1 100 -128 127 ECU_ADDRESS 0x7FB392 /end MEASUREMENT
/begin MEASUREMENT sint8_03.I_sint8_4.R01_8bit "" SBYTE ident 1 100 -128 127 ECU_ADDRESS 0x7FB39A /end MEASUREMENT
/begin MEASUREMENT sint8_03.I_sint8_5.R01_8bit "" SBYTE ident 1 100 -128 127 ECU_ADDRESS 0x7FB3A2 /end MEASUREMENT
/begin MEASUREMENT sint8_03.I_sint8_6.R01_8bit "" SBYTE ident 1 100 -128 127 ECU_ADDRESS 0x7FB3AA /end MEASUREMENT
/begin MEASUREMENT sint8_03.I_sint8_7.R01_8bit "" SBYTE ident 1 100 -128 127 ECU_ADDRESS 0x7FB3B2 /end MEASUREMENT
/begin MEASUREMENT sint8_03.I_sint8_8.R01_8bit "" SBYTE ident 1 100 -128 127 ECU_ADDRESS 0x7FB3BA /end MEASUREMENT
/begin MEASUREMENT sint8_04.I_sint8.R01 "" SBYTE ident 1 100 -128 127 ECU_ADDRESS 0x7FB2DD DISPLAY_IDENTIFIER sint8_04.I_sint8.R01_DISP_ID_R01 /end MEASUREMENT
/begin MEASUREMENT sint8_04.I_sint8.R02 "" SBYTE ident 1 100 -128 127 ECU_ADDRESS 0x7FB413 DISPLAY_IDENTIFIER sint8_04.I_sint8.R02_DISP_ID_R02 /end MEASUREMENT
/begin MEASUREMENT sint8_04.I_sint8.R03 "" SBYTE ident 1 100 -128 127 ECU_ADDRESS 0x7FB449 DISPLAY_IDENTIFIER sint8_04.I_sint8.R03_DISP_ID_R03 /end MEASUREMENT
/begin MEASUREMENT sint8_04.I_sint8.R04 "" SBYTE ident 1 100 -128 127 ECU_ADDRESS 0x7FB47D /end MEASUREMENT
/begin MEASUREMENT sint8_04.I_sint8_1.R01_8bit "" SBYTE ident 1 100 -128 127 ECU_ADDRESS 0x7FB383 /end MEASUREMENT
/begin MEASUREMENT sint8_04.I_sint8_2.R01_8bit "" SBYTE ident 1 100 -128 127 ECU_ADDRESS 0x7FB38B /end MEASUREMENT
/begin MEASUREMENT sint8_04.I_sint8_3.R01_8bit "" SBYTE ident 1 100 -128 127 ECU_ADDRESS 0x7FB393 /end MEASUREMENT
/begin MEASUREMENT sint8_04.I_sint8_4.R01_8bit "" SBYTE ident 1 100 -128 127 ECU_ADDRESS 0x7FB39B /end MEASUREMENT
/begin MEASUREMENT sint8_04.I_sint8_5.R01_8bit "" SBYTE ident 1 100 -128 127 ECU_ADDRESS 0x7FB3A3 /end MEASUREMENT
/begin MEASUREMENT sint8_04.I_sint8_6.R01_8bit "" SBYTE ident 1 100 -128 127 ECU_ADDRESS 0x7FB3AB /end MEASUREMENT
/begin MEASUREMENT sint8_04.I_sint8_7.R01_8bit "" SBYTE ident 1 100 -128 127 ECU_ADDRESS 0x7FB3B3 /end MEASUREMENT
/begin MEASUREMENT sint8_04.I_sint8_8.R01_8bit "" SBYTE ident 1 100 -128 127 ECU_ADDRESS 0x7FB3BB /end MEASUREMENT
/begin MEASUREMENT sint8_05.I_sint8.R01 "" SBYTE ident 1 100 -128 127 ECU_ADDRESS 0x7FB2DE DISPLAY_IDENTIFIER sint8_05.I_sint8.R01_DISP_ID_R01 /end MEASUREMENT
/begin MEASUREMENT sint8_05.I_sint8.R02 "" SBYTE ident 1 100 -128 127 ECU_ADDRESS 0x7FB414 DISPLAY_IDENTIFIER sint8_05.I_sint8.R02_DISP_ID_R02 /end MEASUREMENT
/begin MEASUREMENT sint8_05.I_sint8.R03 "" SBYTE ident 1 100 -128 127 ECU_ADDRESS 0x7FB44A DISPLAY_IDENTIFIER sint8_05.I_sint8.R03_DISP_ID_R03 /end MEASUREMENT
/begin MEASUREMENT sint8_05.I_sint8.R04 "" SBYTE ident 1 100 -128 127 ECU_ADDRESS 0x7FB47E /end MEASUREMENT
/begin MEASUREMENT sint8_05.I_sint8_1.R01_8bit "" SBYTE ident 1 100 -128 127 ECU_ADDRESS 0x7FB384 /end MEASUREMENT
/begin MEASUREMENT sint8_05.I_sint8_2.R01_8bit "" SBYTE ident 1 100 -128 127 ECU_ADDRESS 0x7FB38C /end MEASUREMENT
/begin MEASUREMENT sint8_05.I_sint8_3.R01_8bit "" SBYTE ident 1 100 -128 127 ECU_ADDRESS 0x7FB394 /end MEASUREMENT
/begin MEASUREMENT sint8_05.I_sint8_4.R01_8bit "" SBYTE ident 1 100 -128 127 ECU_ADDRESS 0x7FB39C /end MEASUREMENT
/begin MEASUREMENT sint8_05.I_sint8_5.R01_8bit "" SBYTE ident 1 100 -128 127 ECU_ADDRESS 0x7FB3A4 /end MEASUREMENT
/begin MEASUREMENT sint8_05.I_sint8_6.R01_8bit "" SBYTE ident 1 100 -128 127 ECU_ADDRESS 0x7FB3AC /end MEASUREMENT
/begin MEASUREMENT sint8_05.I_sint8_7.R01_8bit "" SBYTE ident 1 100 -128 127 ECU_ADDRESS 0x7FB3B4 /end MEASUREMENT
/begin MEASUREMENT sint8_05.I_sint8_8.R01_8bit "" SBYTE ident 1 100 -128 127 ECU_ADDRESS 0x7FB3BC /end MEASUREMENT
/begin MEASUREMENT sint8_06.I_sint8.R01 "" SBYTE ident 1 100 -128 127 ECU_ADDRESS 0x7FB2DF DISPLAY_IDENTIFIER sint8_06.I_sint8.R01_DISP_ID_R01 /end MEASUREMENT
/begin MEASUREMENT sint8_06.I_sint8.R02 "" SBYTE ident 1 100 -128 127 ECU_ADDRESS 0x7FB415 DISPLAY_IDENTIFIER sint8_06.I_sint8.R02_DISP_ID_R02 /end MEASUREMENT
/begin MEASUREMENT sint8_06.I_sint8.R03 "" SBYTE ident 1 100 -128 127 ECU_ADDRESS 0x7FB44B DISPLAY_IDENTIFIER sint8_06.I_sint8.R03_DISP_ID_R03 /end MEASUREMENT
/begin MEASUREMENT sint8_06.I_sint8.R04 "" SBYTE ident 1 100 -128 127 ECU_ADDRESS 0x7FB47F /end MEASUREMENT
/begin MEASUREMENT sint8_06.I_sint8_1.R01_8bit "" SBYTE ident 1 100 -128 127 ECU_ADDRESS 0x7FB385 /end MEASUREMENT
/begin MEASUREMENT sint8_06.I_sint8_2.R01_8bit "" SBYTE ident 1 100 -128 127 ECU_ADDRESS 0x7FB38D /end MEASUREMENT
/begin MEASUREMENT sint8_06.I_sint8_3.R01_8bit "" SBYTE ident 1 100 -128 127 ECU_ADDRESS 0x7FB395 /end MEASUREMENT
/begin MEASUREMENT sint8_06.I_sint8_4.R01_8bit "" SBYTE ident 1 100 -128 127 ECU_ADDRESS 0x7FB39D /end MEASUREMENT
/begin MEASUREMENT sint8_06.I_sint8_5.R01_8bit "" SBYTE ident 1 100 -128 127 ECU_ADDRESS 0x7FB3A5 /end MEASUREMENT
/begin MEASUREMENT sint8_06.I_sint8_6.R01_8bit "" SBYTE ident 1 100 -128 127 ECU_ADDRESS 0x7FB3AD /end MEASUREMENT
/begin MEASUREMENT sint8_06.I_sint8_7.R01_8bit "" SBYTE ident 1 100 -128 127 ECU_ADDRESS 0x7FB3B5 /end MEASUREMENT
/begin MEASUREMENT sint8_06.I_sint8_8.R01_8bit "" SBYTE ident 1 100 -128 127 ECU_ADDRESS 0x7FB3BD /end MEASUREMENT
/begin MEASUREMENT sint8_07.I_sint8.R01 "" SBYTE ident 1 100 -128 127 ECU_ADDRESS 0x7FB2E0 DISPLAY_IDENTIFIER sint8_07.I_sint8.R01_DISP_ID_R01 /end MEASUREMENT
/begin MEASUREMENT sint8_07.I_sint8.R02 "" SBYTE ident 1 100 -128 127 ECU_ADDRESS 0x7FB416 DISPLAY_IDENTIFIER sint8_07.I_sint8.R02_DISP_ID_R02 /end MEASUREMENT
/begin MEASUREMENT sint8_07.I_sint8.R03 "" SBYTE ident 1 100 -128 127 ECU_ADDRESS 0x7FB44C DISPLAY_IDENTIFIER sint8_07.I_sint8.R03_DISP_ID_R03 /end MEASUREMENT
/begin MEASUREMENT sint8_07.I_sint8.R04 "" SBYTE ident 1 100 -128 127 ECU_ADDRESS 0x7FB480 /end MEASUREMENT
/begin MEASUREMENT sint8_07.I_sint8_1.R01_8bit "" SBYTE ident 1 100 -128 127 ECU_ADDRESS 0x7FB386 /end MEASUREMENT
/begin MEASUREMENT sint8_07.I_sint8_2.R01_8bit "" SBYTE ident 1 100 -128 127 ECU_ADDRESS 0x7FB38E /end MEASUREMENT
/begin MEASUREMENT sint8_07.I_sint8_3.R01_8bit "" SBYTE ident 1 100 -128 127 ECU_ADDRESS 0x7FB396 /end MEASUREMENT
/begin MEASUREMENT sint8_07.I_sint8_4.R01_8bit "" SBYTE ident 1 100 -128 127 ECU_ADDRESS 0x7FB39E /end MEASUREMENT
/begin MEASUREMENT sint8_07.I_sint8_5.R01_8bit "" SBYTE ident 1 100 -128 127 ECU_ADDRESS 0x7FB3A6 /end MEASUREMENT
/begin MEASUREMENT sint8_07.I_sint8_6.R01_8bit "" SBYTE ident 1 100 -128 127 ECU_ADDRESS 0x7FB3AE /end MEASUREMENT
/begin MEASUREMENT sint8_07.I_sint8_7.R01_8bit "" SBYTE ident 1 100 -128 127 ECU_ADDRESS 0x7FB3B6 /end MEASUREMENT
/begin MEASUREMENT sint8_07.I_sint8_8.R01_8bit "" SBYTE ident 1 100 -128 127 ECU_ADDRESS 0x7FB3BE /end MEASUREMENT
/begin MEASUREMENT sint8_08.I_sint8.R01 "" SBYTE ident 1 100 -128 127 ECU_ADDRESS 0x7FB2E1 DISPLAY_IDENTIFIER sint8_08.I_sint8.R01_DISP_ID_R01 /end MEASUREMENT
/begin MEASUREMENT sint8_08.I_sint8.R02 "" SBYTE ident 1 100 -128 127 ECU_ADDRESS 0x7FB417 DISPLAY_IDENTIFIER sint8_08.I_sint8.R02_DISP_ID_R02 /end MEASUREMENT
/begin MEASUREMENT sint8_08.I_sint8.R03 "" SBYTE ident 1 100 -128 127 ECU_ADDRESS 0x7FB44D DISPLAY_IDENTIFIER sint8_08.I_sint8.R03_DISP_ID_R03 /end MEASUREMENT
/begin MEASUREMENT sint8_08.I_sint8.R04 "" SBYTE ident 1 100 -128 127 ECU_ADDRESS 0x7FB481 /end MEASUREMENT
/begin MEASUREMENT sint8_08.I_sint8_1.R01_8bit "" SBYTE ident 1 100 -128 127 ECU_ADDRESS 0x7FB387 /end MEASUREMENT
/begin MEASUREMENT sint8_08.I_sint8_2.R01_8bit "" SBYTE ident 1 100 -128 127 ECU_ADDRESS 0x7FB38F /end MEASUREMENT
/begin MEASUREMENT sint8_08.I_sint8_3.R01_8bit "" SBYTE ident 1 100 -128 127 ECU_ADDRESS 0x7FB397 /end MEASUREMENT
/begin MEASUREMENT sint8_08.I_sint8_4.R01_8bit "" SBYTE ident 1 100 -128 127 ECU_ADDRESS 0x7FB39F /end MEASUREMENT
/begin MEASUREMENT sint8_08.I_sint8_5.R01_8bit "" SBYTE ident 1 100 -128 127 ECU_ADDRESS 0x7FB3A7 /end MEASUREMENT
/begin MEASUREMENT sint8_08.I_sint8_6.R01_8bit "" SBYTE ident 1 100 -128 127 ECU_ADDRESS 0x7FB3AF /end MEASUREMENT
/begin MEASUREMENT sint8_08.I_sint8_7.R01_8bit "" SBYTE ident 1 100 -128 127 ECU_ADDRESS 0x7FB3B7 /end MEASUREMENT
/begin MEASUREMENT sint8_08.I_sint8_8.R01_8bit "" SBYTE ident 1 100 -128 127 ECU_ADDRESS 0x7FB3BF /end MEASUREMENT
/begin MEASUREMENT SM_Err01_log.M_Ultimate "" UBYTE ident 1 100 0 1 BIT_MASK 0x1 ECU_ADDRESS 0x7FB179 /end MEASUREMENT
/begin MEASUREMENT SM01_Par01_u8.M_Ultimate "" ULONG ident 1 100 0 4294967295 ECU_ADDRESS 0x7FB170 /end MEASUREMENT
/begin MEASUREMENT SM01_Par02_u8.M_Ultimate "" ULONG ident 1 100 0 4294967295 ECU_ADDRESS 0x7FB174 /end MEASUREMENT
/begin MEASUREMENT SM01_Res_u8.M_Ultimate "" FLOAT64_IEEE ident 1 100 -1.e+037 1.e+037 ECU_ADDRESS 0x7FB148 /end MEASUREMENT
/begin MEASUREMENT SRM_Err01_log.M_Ultimate "" UBYTE ident 1 100 0 1 BIT_MASK 0x1 ECU_ADDRESS 0x7FB17A /end MEASUREMENT
/begin MEASUREMENT SRM_Stimu_Count01_u8.M_Ultimate "" FLOAT64_IEEE ident 1 100 -1.e+037 1.e+037 ECU_ADDRESS 0x7FB160 /end MEASUREMENT
/begin MEASUREMENT SRM01_Res_u8.M_Ultimate "" FLOAT64_IEEE ident 1 100 -1.e+037 1.e+037 ECU_ADDRESS 0x7FB150 /end MEASUREMENT
/begin MEASUREMENT SRM02_Res_u8.M_Ultimate "" FLOAT64_IEEE ident 1 100 -1.e+037 1.e+037 ECU_ADDRESS 0x7FB158 /end MEASUREMENT
/begin MEASUREMENT TheLastMax.FEA_performance_scalar "" FLOAT32_IEEE ident 1 100 -1.e+037 1.e+037 ECU_ADDRESS 0x7F88DC /end MEASUREMENT
/begin MEASUREMENT TheLastMaxShort.FEA_performance_scalar "" FLOAT32_IEEE ident 1 100 -1.e+037 1.e+037 ECU_ADDRESS 0x7F88E0 /end MEASUREMENT
/begin MEASUREMENT TheLastMin.FEA_performance_scalar "" FLOAT32_IEEE ident 1 100 -1.e+037 1.e+037 ECU_ADDRESS 0x7F88E4 /end MEASUREMENT
/begin MEASUREMENT TheLastMinShort.FEA_performance_scalar "" FLOAT32_IEEE ident 1 100 -1.e+037 1.e+037 ECU_ADDRESS 0x7F88E8 /end MEASUREMENT
/begin MEASUREMENT TheMax.FEA_performance_array "" FLOAT32_IEEE ident 1 100 -1.e+037 1.e+037 ECU_ADDRESS 0x7F88C8 /end MEASUREMENT
/begin MEASUREMENT TheMax.FEA_performance_scalar "" FLOAT32_IEEE ident 1 100 -1.e+037 1.e+037 ECU_ADDRESS 0x7F88EC /end MEASUREMENT
/begin MEASUREMENT TheMaxShort.FEA_performance_scalar "" FLOAT32_IEEE ident 1 100 -1.e+037 1.e+037 ECU_ADDRESS 0x7F88F0 /end MEASUREMENT
/begin MEASUREMENT TheMin.FEA_performance_array "" FLOAT32_IEEE ident 1 100 -1.e+037 1.e+037 ECU_ADDRESS 0x7F88CC /end MEASUREMENT
/begin MEASUREMENT TheMin.FEA_performance_scalar "" FLOAT32_IEEE ident 1 100 -1.e+037 1.e+037 ECU_ADDRESS 0x7F88F4 /end MEASUREMENT
/begin MEASUREMENT TheMinShort.FEA_performance_scalar "" FLOAT32_IEEE ident 1 100 -1.e+037 1.e+037 ECU_ADDRESS 0x7F88F8 /end MEASUREMENT
/begin MEASUREMENT udisc_uint16_B01.Model_Byp_B01 "" UWORD ident 1 100 0 65535 ECU_ADDRESS 0x7FB1BA DISPLAY_IDENTIFIER udisc_uint16_B01.Model_Byp_B01_DISP_ID /end MEASUREMENT
/begin MEASUREMENT udisc_uint16_offset_cpy_B01.Model_Byp_B01 "" UBYTE ident 1 100 0 255 ECU_ADDRESS 0x7FB1B0 DISPLAY_IDENTIFIER udisc_uint16_offset_cpy_B01.Model_Byp_B01_DISP_ID /end MEASUREMENT
/begin MEASUREMENT udisc_uint8_B01.Model_Byp_B01 "" UBYTE ident 1 100 0 255 ECU_ADDRESS 0x7FB1C3 DISPLAY_IDENTIFIER udisc_uint8_B01.Model_Byp_B01_DISP_ID /end MEASUREMENT
/begin MEASUREMENT udisc_uint8_offset_cpy_B01.Model_Byp_B01 "" UBYTE ident 1 100 0 255 ECU_ADDRESS 0x7FB1B1 DISPLAY_IDENTIFIER udisc_uint8_offset_cpy_B01.Model_Byp_B01_DISP_ID /end MEASUREMENT
/begin MEASUREMENT uint16_01.E_uint16.R09 "" UWORD ident 1 100 0 65535 ECU_ADDRESS 0x821B78 /end MEASUREMENT
/begin MEASUREMENT uint16_01.E_uint16.R10 "" UWORD ident 1 100 0 65535 ECU_ADDRESS 0x821BA8 /end MEASUREMENT
/begin MEASUREMENT uint16_01.E_uint16.R11 "" UWORD ident 1 100 0 65535 ECU_ADDRESS 0x821BD8 /end MEASUREMENT
/begin MEASUREMENT uint16_01.E_uint16.R12 "" UWORD ident 1 100 0 65535 ECU_ADDRESS 0x821C08 /end MEASUREMENT
/begin MEASUREMENT uint16_01.E_uint16.R13 "" UWORD ident 1 100 0 65535 ECU_ADDRESS 0x821C38 /end MEASUREMENT
/begin MEASUREMENT uint16_01.E_uint16.R14 "" UWORD ident 1 100 0 65535 ECU_ADDRESS 0x821C68 /end MEASUREMENT
/begin MEASUREMENT uint16_01.E_uint16.R15 "" UWORD ident 1 100 0 65535 ECU_ADDRESS 0x821C98 /end MEASUREMENT
/begin MEASUREMENT uint16_01.E_uint16_1.R01_16bit "" UWORD ident 1 100 0 65535 ECU_ADDRESS 0x8216D0 /end MEASUREMENT
/begin MEASUREMENT uint16_01.E_uint16_2.R01_16bit "" UWORD ident 1 100 0 65535 ECU_ADDRESS 0x8216E0 /end MEASUREMENT
/begin MEASUREMENT uint16_01.E_uint16_3.R01_16bit "" UWORD ident 1 100 0 65535 ECU_ADDRESS 0x8216F0 /end MEASUREMENT
/begin MEASUREMENT uint16_01.E_uint16_4.R01_16bit "" UWORD ident 1 100 0 65535 ECU_ADDRESS 0x821700 /end MEASUREMENT
/begin MEASUREMENT uint16_01.I_uint16.R01 "" UWORD ident 1 100 0 65535 ECU_ADDRESS 0x7FB2E2 DISPLAY_IDENTIFIER uint16_01.I_uint16.R01_DISP_ID_R01 /end MEASUREMENT
/begin MEASUREMENT uint16_01.I_uint16.R02 "" UWORD ident 1 100 0 65535 ECU_ADDRESS 0x7FB418 DISPLAY_IDENTIFIER uint16_01.I_uint16.R02_DISP_ID_R02 /end MEASUREMENT
/begin MEASUREMENT uint16_01.I_uint16.R03 "" UWORD ident 1 100 0 65535 ECU_ADDRESS 0x7FB44E DISPLAY_IDENTIFIER uint16_01.I_uint16.R03_DISP_ID_R03 /end MEASUREMENT
/begin MEASUREMENT uint16_01.I_uint16.R04 "" UWORD ident 1 100 0 65535 ECU_ADDRESS 0x7FB482 /end MEASUREMENT
/begin MEASUREMENT uint16_01.I_uint16_1.R01_16bit "" UWORD ident 1 100 0 65535 ECU_ADDRESS 0x7FB340 /end MEASUREMENT
/begin MEASUREMENT uint16_01.I_uint16_2.R01_16bit "" UWORD ident 1 100 0 65535 ECU_ADDRESS 0x7FB350 /end MEASUREMENT
/begin MEASUREMENT uint16_01.I_uint16_3.R01_16bit "" UWORD ident 1 100 0 65535 ECU_ADDRESS 0x7FB360 /end MEASUREMENT
/begin MEASUREMENT uint16_01.I_uint16_4.R01_16bit "" UWORD ident 1 100 0 65535 ECU_ADDRESS 0x7FB370 /end MEASUREMENT
/begin MEASUREMENT uint16_01.M_Ultimate "" UWORD ident 1 100 0 65535 ECU_ADDRESS 0x7FB126 /end MEASUREMENT
/begin MEASUREMENT uint16_02.E_uint16.R09 "" UWORD ident 1 100 0 65535 ECU_ADDRESS 0x821B7A /end MEASUREMENT
/begin MEASUREMENT uint16_02.E_uint16.R10 "" UWORD ident 1 100 0 65535 ECU_ADDRESS 0x821BAA /end MEASUREMENT
/begin MEASUREMENT uint16_02.E_uint16.R11 "" UWORD ident 1 100 0 65535 ECU_ADDRESS 0x821BDA /end MEASUREMENT
/begin MEASUREMENT uint16_02.E_uint16.R12 "" UWORD ident 1 100 0 65535 ECU_ADDRESS 0x821C0A /end MEASUREMENT
/begin MEASUREMENT uint16_02.E_uint16.R13 "" UWORD ident 1 100 0 65535 ECU_ADDRESS 0x821C3A /end MEASUREMENT
/begin MEASUREMENT uint16_02.E_uint16.R14 "" UWORD ident 1 100 0 65535 ECU_ADDRESS 0x821C6A /end MEASUREMENT
/begin MEASUREMENT uint16_02.E_uint16.R15 "" UWORD ident 1 100 0 65535 ECU_ADDRESS 0x821C9A /end MEASUREMENT
/begin MEASUREMENT uint16_02.E_uint16_1.R01_16bit "" UWORD ident 1 100 0 65535 ECU_ADDRESS 0x8216D2 /end MEASUREMENT
/begin MEASUREMENT uint16_02.E_uint16_2.R01_16bit "" UWORD ident 1 100 0 65535 ECU_ADDRESS 0x8216E2 /end MEASUREMENT
/begin MEASUREMENT uint16_02.E_uint16_3.R01_16bit "" UWORD ident 1 100 0 65535 ECU_ADDRESS 0x8216F2 /end MEASUREMENT
/begin MEASUREMENT uint16_02.E_uint16_4.R01_16bit "" UWORD ident 1 100 0 65535 ECU_ADDRESS 0x821702 /end MEASUREMENT
/begin MEASUREMENT uint16_02.I_uint16.R01 "" UWORD ident 1 100 0 65535 ECU_ADDRESS 0x7FB2E4 DISPLAY_IDENTIFIER uint16_02.I_uint16.R01_DISP_ID_R01 /end MEASUREMENT
/begin MEASUREMENT uint16_02.I_uint16.R02 "" UWORD ident 1 100 0 65535 ECU_ADDRESS 0x7FB41A DISPLAY_IDENTIFIER uint16_02.I_uint16.R02_DISP_ID_R02 /end MEASUREMENT
/begin MEASUREMENT uint16_02.I_uint16.R03 "" UWORD ident 1 100 0 65535 ECU_ADDRESS 0x7FB450 DISPLAY_IDENTIFIER uint16_02.I_uint16.R03_DISP_ID_R03 /end MEASUREMENT
/begin MEASUREMENT uint16_02.I_uint16.R04 "" UWORD ident 1 100 0 65535 ECU_ADDRESS 0x7FB484 /end MEASUREMENT
/begin MEASUREMENT uint16_02.I_uint16_1.R01_16bit "" UWORD ident 1 100 0 65535 ECU_ADDRESS 0x7FB342 /end MEASUREMENT
/begin MEASUREMENT uint16_02.I_uint16_2.R01_16bit "" UWORD ident 1 100 0 65535 ECU_ADDRESS 0x7FB352 /end MEASUREMENT
/begin MEASUREMENT uint16_02.I_uint16_3.R01_16bit "" UWORD ident 1 100 0 65535 ECU_ADDRESS 0x7FB362 /end MEASUREMENT
/begin MEASUREMENT uint16_02.I_uint16_4.R01_16bit "" UWORD ident 1 100 0 65535 ECU_ADDRESS 0x7FB372 /end MEASUREMENT
/begin MEASUREMENT uint16_03.E_uint16.R09 "" UWORD ident 1 100 0 65535 ECU_ADDRESS 0x821B7C /end MEASUREMENT
/begin MEASUREMENT uint16_03.E_uint16.R10 "" UWORD ident 1 100 0 65535 ECU_ADDRESS 0x821BAC /end MEASUREMENT
/begin MEASUREMENT uint16_03.E_uint16.R11 "" UWORD ident 1 100 0 65535 ECU_ADDRESS 0x821BDC /end MEASUREMENT
/begin MEASUREMENT uint16_03.E_uint16.R12 "" UWORD ident 1 100 0 65535 ECU_ADDRESS 0x821C0C /end MEASUREMENT
/begin MEASUREMENT uint16_03.E_uint16.R13 "" UWORD ident 1 100 0 65535 ECU_ADDRESS 0x821C3C /end MEASUREMENT
/begin MEASUREMENT uint16_03.E_uint16.R14 "" UWORD ident 1 100 0 65535 ECU_ADDRESS 0x821C6C /end MEASUREMENT
/begin MEASUREMENT uint16_03.E_uint16.R15 "" UWORD ident 1 100 0 65535 ECU_ADDRESS 0x821C9C /end MEASUREMENT
/begin MEASUREMENT uint16_03.E_uint16_1.R01_16bit "" UWORD ident 1 100 0 65535 ECU_ADDRESS 0x8216D4 /end MEASUREMENT
/begin MEASUREMENT uint16_03.E_uint16_2.R01_16bit "" UWORD ident 1 100 0 65535 ECU_ADDRESS 0x8216E4 /end MEASUREMENT
/begin MEASUREMENT uint16_03.E_uint16_3.R01_16bit "" UWORD ident 1 100 0 65535 ECU_ADDRESS 0x8216F4 /end MEASUREMENT
/begin MEASUREMENT uint16_03.E_uint16_4.R01_16bit "" UWORD ident 1 100 0 65535 ECU_ADDRESS 0x821704 /end MEASUREMENT
/begin MEASUREMENT uint16_03.I_uint16.R01 "" UWORD ident 1 100 0 65535 ECU_ADDRESS 0x7FB2E6 DISPLAY_IDENTIFIER uint16_03.I_uint16.R01_DISP_ID_R01 /end MEASUREMENT
/begin MEASUREMENT uint16_03.I_uint16.R02 "" UWORD ident 1 100 0 65535 ECU_ADDRESS 0x7FB41C DISPLAY_IDENTIFIER uint16_03.I_uint16.R02_DISP_ID_R02 /end MEASUREMENT
/begin MEASUREMENT uint16_03.I_uint16.R03 "" UWORD ident 1 100 0 65535 ECU_ADDRESS 0x7FB452 DISPLAY_IDENTIFIER uint16_03.I_uint16.R03_DISP_ID_R03 /end MEASUREMENT
/begin MEASUREMENT uint16_03.I_uint16.R04 "" UWORD ident 1 100 0 65535 ECU_ADDRESS 0x7FB486 /end MEASUREMENT
/begin MEASUREMENT uint16_03.I_uint16_1.R01_16bit "" UWORD ident 1 100 0 65535 ECU_ADDRESS 0x7FB344 /end MEASUREMENT
/begin MEASUREMENT uint16_03.I_uint16_2.R01_16bit "" UWORD ident 1 100 0 65535 ECU_ADDRESS 0x7FB354 /end MEASUREMENT
/begin MEASUREMENT uint16_03.I_uint16_3.R01_16bit "" UWORD ident 1 100 0 65535 ECU_ADDRESS 0x7FB364 /end MEASUREMENT
/begin MEASUREMENT uint16_03.I_uint16_4.R01_16bit "" UWORD ident 1 100 0 65535 ECU_ADDRESS 0x7FB374 /end MEASUREMENT
/begin MEASUREMENT uint16_04.E_uint16.R09 "" UWORD ident 1 100 0 65535 ECU_ADDRESS 0x821B7E /end MEASUREMENT
/begin MEASUREMENT uint16_04.E_uint16.R10 "" UWORD ident 1 100 0 65535 ECU_ADDRESS 0x821BAE /end MEASUREMENT
/begin MEASUREMENT uint16_04.E_uint16.R11 "" UWORD ident 1 100 0 65535 ECU_ADDRESS 0x821BDE /end MEASUREMENT
/begin MEASUREMENT uint16_04.E_uint16.R12 "" UWORD ident 1 100 0 65535 ECU_ADDRESS 0x821C0E /end MEASUREMENT
/begin MEASUREMENT uint16_04.E_uint16.R13 "" UWORD ident 1 100 0 65535 ECU_ADDRESS 0x821C3E /end MEASUREMENT
/begin MEASUREMENT uint16_04.E_uint16.R14 "" UWORD ident 1 100 0 65535 ECU_ADDRESS 0x821C6E /end MEASUREMENT
/begin MEASUREMENT uint16_04.E_uint16.R15 "" UWORD ident 1 100 0 65535 ECU_ADDRESS 0x821C9E /end MEASUREMENT
/begin MEASUREMENT uint16_04.E_uint16_1.R01_16bit "" UWORD ident 1 100 0 65535 ECU_ADDRESS 0x8216D6 /end MEASUREMENT
/begin MEASUREMENT uint16_04.E_uint16_2.R01_16bit "" UWORD ident 1 100 0 65535 ECU_ADDRESS 0x8216E6 /end MEASUREMENT
/begin MEASUREMENT uint16_04.E_uint16_3.R01_16bit "" UWORD ident 1 100 0 65535 ECU_ADDRESS 0x8216F6 /end MEASUREMENT
/begin MEASUREMENT uint16_04.E_uint16_4.R01_16bit "" UWORD ident 1 100 0 65535 ECU_ADDRESS 0x821706 /end MEASUREMENT
/begin MEASUREMENT uint16_04.I_uint16.R01 "" UWORD ident 1 100 0 65535 ECU_ADDRESS 0x7FB2E8 DISPLAY_IDENTIFIER uint16_04.I_uint16.R01_DISP_ID_R01 /end MEASUREMENT
/begin MEASUREMENT uint16_04.I_uint16.R02 "" UWORD ident 1 100 0 65535 ECU_ADDRESS 0x7FB41E DISPLAY_IDENTIFIER uint16_04.I_uint16.R02_DISP_ID_R02 /end MEASUREMENT
/begin MEASUREMENT uint16_04.I_uint16.R03 "" UWORD ident 1 100 0 65535 ECU_ADDRESS 0x7FB454 DISPLAY_IDENTIFIER uint16_04.I_uint16.R03_DISP_ID_R03 /end MEASUREMENT
/begin MEASUREMENT uint16_04.I_uint16.R04 "" UWORD ident 1 100 0 65535 ECU_ADDRESS 0x7FB488 /end MEASUREMENT
/begin MEASUREMENT uint16_04.I_uint16_1.R01_16bit "" UWORD ident 1 100 0 65535 ECU_ADDRESS 0x7FB346 /end MEASUREMENT
/begin MEASUREMENT uint16_04.I_uint16_2.R01_16bit "" UWORD ident 1 100 0 65535 ECU_ADDRESS 0x7FB356 /end MEASUREMENT
/begin MEASUREMENT uint16_04.I_uint16_3.R01_16bit "" UWORD ident 1 100 0 65535 ECU_ADDRESS 0x7FB366 /end MEASUREMENT
/begin MEASUREMENT uint16_04.I_uint16_4.R01_16bit "" UWORD ident 1 100 0 65535 ECU_ADDRESS 0x7FB376 /end MEASUREMENT
/begin MEASUREMENT uint16_05.E_uint16.R09 "" UWORD ident 1 100 0 65535 ECU_ADDRESS 0x821B80 /end MEASUREMENT
/begin MEASUREMENT uint16_05.E_uint16.R10 "" UWORD ident 1 100 0 65535 ECU_ADDRESS 0x821BB0 /end MEASUREMENT
/begin MEASUREMENT uint16_05.E_uint16.R11 "" UWORD ident 1 100 0 65535 ECU_ADDRESS 0x821BE0 /end MEASUREMENT
/begin MEASUREMENT uint16_05.E_uint16.R12 "" UWORD ident 1 100 0 65535 ECU_ADDRESS 0x821C10 /end MEASUREMENT
/begin MEASUREMENT uint16_05.E_uint16.R13 "" UWORD ident 1 100 0 65535 ECU_ADDRESS 0x821C40 /end MEASUREMENT
/begin MEASUREMENT uint16_05.E_uint16.R14 "" UWORD ident 1 100 0 65535 ECU_ADDRESS 0x821C70 /end MEASUREMENT
/begin MEASUREMENT uint16_05.E_uint16.R15 "" UWORD ident 1 100 0 65535 ECU_ADDRESS 0x821CA0 /end MEASUREMENT
/begin MEASUREMENT uint16_05.E_uint16_1.R01_16bit "" UWORD ident 1 100 0 65535 ECU_ADDRESS 0x8216D8 /end MEASUREMENT
/begin MEASUREMENT uint16_05.E_uint16_2.R01_16bit "" UWORD ident 1 100 0 65535 ECU_ADDRESS 0x8216E8 /end MEASUREMENT
/begin MEASUREMENT uint16_05.E_uint16_3.R01_16bit "" UWORD ident 1 100 0 65535 ECU_ADDRESS 0x8216F8 /end MEASUREMENT
/begin MEASUREMENT uint16_05.E_uint16_4.R01_16bit "" UWORD ident 1 100 0 65535 ECU_ADDRESS 0x821708 /end MEASUREMENT
/begin MEASUREMENT uint16_05.I_uint16.R01 "" UWORD ident 1 100 0 65535 ECU_ADDRESS 0x7FB2EA DISPLAY_IDENTIFIER uint16_05.I_uint16.R01_DISP_ID_R01 /end MEASUREMENT
/begin MEASUREMENT uint16_05.I_uint16.R02 "" UWORD ident 1 100 0 65535 ECU_ADDRESS 0x7FB420 DISPLAY_IDENTIFIER uint16_05.I_uint16.R02_DISP_ID_R02 /end MEASUREMENT
/begin MEASUREMENT uint16_05.I_uint16.R03 "" UWORD ident 1 100 0 65535 ECU_ADDRESS 0x7FB456 DISPLAY_IDENTIFIER uint16_05.I_uint16.R03_DISP_ID_R03 /end MEASUREMENT
/begin MEASUREMENT uint16_05.I_uint16.R04 "" UWORD ident 1 100 0 65535 ECU_ADDRESS 0x7FB48A /end MEASUREMENT
/begin MEASUREMENT uint16_05.I_uint16_1.R01_16bit "" UWORD ident 1 100 0 65535 ECU_ADDRESS 0x7FB348 /end MEASUREMENT
/begin MEASUREMENT uint16_05.I_uint16_2.R01_16bit "" UWORD ident 1 100 0 65535 ECU_ADDRESS 0x7FB358 /end MEASUREMENT
/begin MEASUREMENT uint16_05.I_uint16_3.R01_16bit "" UWORD ident 1 100 0 65535 ECU_ADDRESS 0x7FB368 /end MEASUREMENT
/begin MEASUREMENT uint16_05.I_uint16_4.R01_16bit "" UWORD ident 1 100 0 65535 ECU_ADDRESS 0x7FB378 /end MEASUREMENT
/begin MEASUREMENT uint16_06.E_uint16.R09 "" UWORD ident 1 100 0 65535 ECU_ADDRESS 0x821B82 /end MEASUREMENT
/begin MEASUREMENT uint16_06.E_uint16.R10 "" UWORD ident 1 100 0 65535 ECU_ADDRESS 0x821BB2 /end MEASUREMENT
/begin MEASUREMENT uint16_06.E_uint16.R11 "" UWORD ident 1 100 0 65535 ECU_ADDRESS 0x821BE2 /end MEASUREMENT
/begin MEASUREMENT uint16_06.E_uint16.R12 "" UWORD ident 1 100 0 65535 ECU_ADDRESS 0x821C12 /end MEASUREMENT
/begin MEASUREMENT uint16_06.E_uint16.R13 "" UWORD ident 1 100 0 65535 ECU_ADDRESS 0x821C42 /end MEASUREMENT
/begin MEASUREMENT uint16_06.E_uint16.R14 "" UWORD ident 1 100 0 65535 ECU_ADDRESS 0x821C72 /end MEASUREMENT
/begin MEASUREMENT uint16_06.E_uint16.R15 "" UWORD ident 1 100 0 65535 ECU_ADDRESS 0x821CA2 /end MEASUREMENT
/begin MEASUREMENT uint16_06.E_uint16_1.R01_16bit "" UWORD ident 1 100 0 65535 ECU_ADDRESS 0x8216DA /end MEASUREMENT
/begin MEASUREMENT uint16_06.E_uint16_2.R01_16bit "" UWORD ident 1 100 0 65535 ECU_ADDRESS 0x8216EA /end MEASUREMENT
/begin MEASUREMENT uint16_06.E_uint16_3.R01_16bit "" UWORD ident 1 100 0 65535 ECU_ADDRESS 0x8216FA /end MEASUREMENT
/begin MEASUREMENT uint16_06.E_uint16_4.R01_16bit "" UWORD ident 1 100 0 65535 ECU_ADDRESS 0x82170A /end MEASUREMENT
/begin MEASUREMENT uint16_06.I_uint16.R01 "" UWORD ident 1 100 0 65535 ECU_ADDRESS 0x7FB2EC DISPLAY_IDENTIFIER uint16_06.I_uint16.R01_DISP_ID_R01 /end MEASUREMENT
/begin MEASUREMENT uint16_06.I_uint16.R02 "" UWORD ident 1 100 0 65535 ECU_ADDRESS 0x7FB422 DISPLAY_IDENTIFIER uint16_06.I_uint16.R02_DISP_ID_R02 /end MEASUREMENT
/begin MEASUREMENT uint16_06.I_uint16.R03 "" UWORD ident 1 100 0 65535 ECU_ADDRESS 0x7FB458 DISPLAY_IDENTIFIER uint16_06.I_uint16.R03_DISP_ID_R03 /end MEASUREMENT
/begin MEASUREMENT uint16_06.I_uint16.R04 "" UWORD ident 1 100 0 65535 ECU_ADDRESS 0x7FB48C /end MEASUREMENT
/begin MEASUREMENT uint16_06.I_uint16_1.R01_16bit "" UWORD ident 1 100 0 65535 ECU_ADDRESS 0x7FB34A /end MEASUREMENT
/begin MEASUREMENT uint16_06.I_uint16_2.R01_16bit "" UWORD ident 1 100 0 65535 ECU_ADDRESS 0x7FB35A /end MEASUREMENT
/begin MEASUREMENT uint16_06.I_uint16_3.R01_16bit "" UWORD ident 1 100 0 65535 ECU_ADDRESS 0x7FB36A /end MEASUREMENT
/begin MEASUREMENT uint16_06.I_uint16_4.R01_16bit "" UWORD ident 1 100 0 65535 ECU_ADDRESS 0x7FB37A /end MEASUREMENT
/begin MEASUREMENT uint16_07.E_uint16.R09 "" UWORD ident 1 100 0 65535 ECU_ADDRESS 0x821B84 /end MEASUREMENT
/begin MEASUREMENT uint16_07.E_uint16.R10 "" UWORD ident 1 100 0 65535 ECU_ADDRESS 0x821BB4 /end MEASUREMENT
/begin MEASUREMENT uint16_07.E_uint16.R11 "" UWORD ident 1 100 0 65535 ECU_ADDRESS 0x821BE4 /end MEASUREMENT
/begin MEASUREMENT uint16_07.E_uint16.R12 "" UWORD ident 1 100 0 65535 ECU_ADDRESS 0x821C14 /end MEASUREMENT
/begin MEASUREMENT uint16_07.E_uint16.R13 "" UWORD ident 1 100 0 65535 ECU_ADDRESS 0x821C44 /end MEASUREMENT
/begin MEASUREMENT uint16_07.E_uint16.R14 "" UWORD ident 1 100 0 65535 ECU_ADDRESS 0x821C74 /end MEASUREMENT
/begin MEASUREMENT uint16_07.E_uint16.R15 "" UWORD ident 1 100 0 65535 ECU_ADDRESS 0x821CA4 /end MEASUREMENT
/begin MEASUREMENT uint16_07.E_uint16_1.R01_16bit "" UWORD ident 1 100 0 65535 ECU_ADDRESS 0x8216DC /end MEASUREMENT
/begin MEASUREMENT uint16_07.E_uint16_2.R01_16bit "" UWORD ident 1 100 0 65535 ECU_ADDRESS 0x8216EC /end MEASUREMENT
/begin MEASUREMENT uint16_07.E_uint16_3.R01_16bit "" UWORD ident 1 100 0 65535 ECU_ADDRESS 0x8216FC /end MEASUREMENT
/begin MEASUREMENT uint16_07.E_uint16_4.R01_16bit "" UWORD ident 1 100 0 65535 ECU_ADDRESS 0x82170C /end MEASUREMENT
/begin MEASUREMENT uint16_07.I_uint16.R01 "" UWORD ident 1 100 0 65535 ECU_ADDRESS 0x7FB2EE DISPLAY_IDENTIFIER uint16_07.I_uint16.R01_DISP_ID_R01 /end MEASUREMENT
/begin MEASUREMENT uint16_07.I_uint16.R02 "" UWORD ident 1 100 0 65535 ECU_ADDRESS 0x7FB424 DISPLAY_IDENTIFIER uint16_07.I_uint16.R02_DISP_ID_R02 /end MEASUREMENT
/begin MEASUREMENT uint16_07.I_uint16.R03 "" UWORD ident 1 100 0 65535 ECU_ADDRESS 0x7FB45A DISPLAY_IDENTIFIER uint16_07.I_uint16.R03_DISP_ID_R03 /end MEASUREMENT
/begin MEASUREMENT uint16_07.I_uint16.R04 "" UWORD ident 1 100 0 65535 ECU_ADDRESS 0x7FB48E /end MEASUREMENT
/begin MEASUREMENT uint16_07.I_uint16_1.R01_16bit "" UWORD ident 1 100 0 65535 ECU_ADDRESS 0x7FB34C /end MEASUREMENT
/begin MEASUREMENT uint16_07.I_uint16_2.R01_16bit "" UWORD ident 1 100 0 65535 ECU_ADDRESS 0x7FB35C /end MEASUREMENT
/begin MEASUREMENT uint16_07.I_uint16_3.R01_16bit "" UWORD ident 1 100 0 65535 ECU_ADDRESS 0x7FB36C /end MEASUREMENT
/begin MEASUREMENT uint16_07.I_uint16_4.R01_16bit "" UWORD ident 1 100 0 65535 ECU_ADDRESS 0x7FB37C /end MEASUREMENT
/begin MEASUREMENT uint16_08.E_uint16.R09 "" UWORD ident 1 100 0 65535 ECU_ADDRESS 0x821B86 /end MEASUREMENT
/begin MEASUREMENT uint16_08.E_uint16.R10 "" UWORD ident 1 100 0 65535 ECU_ADDRESS 0x821BB6 /end MEASUREMENT
/begin MEASUREMENT uint16_08.E_uint16.R11 "" UWORD ident 1 100 0 65535 ECU_ADDRESS 0x821BE6 /end MEASUREMENT
/begin MEASUREMENT uint16_08.E_uint16.R12 "" UWORD ident 1 100 0 65535 ECU_ADDRESS 0x821C16 /end MEASUREMENT
/begin MEASUREMENT uint16_08.E_uint16.R13 "" UWORD ident 1 100 0 65535 ECU_ADDRESS 0x821C46 /end MEASUREMENT
/begin MEASUREMENT uint16_08.E_uint16.R14 "" UWORD ident 1 100 0 65535 ECU_ADDRESS 0x821C76 /end MEASUREMENT
/begin MEASUREMENT uint16_08.E_uint16.R15 "" UWORD ident 1 100 0 65535 ECU_ADDRESS 0x821CA6 /end MEASUREMENT
/begin MEASUREMENT uint16_08.E_uint16_1.R01_16bit "" UWORD ident 1 100 0 65535 ECU_ADDRESS 0x8216DE /end MEASUREMENT
/begin MEASUREMENT uint16_08.E_uint16_2.R01_16bit "" UWORD ident 1 100 0 65535 ECU_ADDRESS 0x8216EE /end MEASUREMENT
/begin MEASUREMENT uint16_08.E_uint16_3.R01_16bit "" UWORD ident 1 100 0 65535 ECU_ADDRESS 0x8216FE /end MEASUREMENT
/begin MEASUREMENT uint16_08.E_uint16_4.R01_16bit "" UWORD ident 1 100 0 65535 ECU_ADDRESS 0x82170E /end MEASUREMENT
/begin MEASUREMENT uint16_08.I_uint16.R01 "" UWORD ident 1 100 0 65535 ECU_ADDRESS 0x7FB2F0 DISPLAY_IDENTIFIER uint16_08.I_uint16.R01_DISP_ID_R01 /end MEASUREMENT
/begin MEASUREMENT uint16_08.I_uint16.R02 "" UWORD ident 1 100 0 65535 ECU_ADDRESS 0x7FB426 DISPLAY_IDENTIFIER uint16_08.I_uint16.R02_DISP_ID_R02 /end MEASUREMENT
/begin MEASUREMENT uint16_08.I_uint16.R03 "" UWORD ident 1 100 0 65535 ECU_ADDRESS 0x7FB45C DISPLAY_IDENTIFIER uint16_08.I_uint16.R03_DISP_ID_R03 /end MEASUREMENT
/begin MEASUREMENT uint16_08.I_uint16.R04 "" UWORD ident 1 100 0 65535 ECU_ADDRESS 0x7FB490 /end MEASUREMENT
/begin MEASUREMENT uint16_08.I_uint16_1.R01_16bit "" UWORD ident 1 100 0 65535 ECU_ADDRESS 0x7FB34E /end MEASUREMENT
/begin MEASUREMENT uint16_08.I_uint16_2.R01_16bit "" UWORD ident 1 100 0 65535 ECU_ADDRESS 0x7FB35E /end MEASUREMENT
/begin MEASUREMENT uint16_08.I_uint16_3.R01_16bit "" UWORD ident 1 100 0 65535 ECU_ADDRESS 0x7FB36E /end MEASUREMENT
/begin MEASUREMENT uint16_08.I_uint16_4.R01_16bit "" UWORD ident 1 100 0 65535 ECU_ADDRESS 0x7FB37E /end MEASUREMENT
/begin MEASUREMENT uint32_01.E_uint32.R01_B "" ULONG ident 1 100 0 4294967295 ECU_ADDRESS 0x821810 /end MEASUREMENT
/begin MEASUREMENT uint32_01.E_uint32.R02_B "" ULONG ident 1 100 0 4294967295 ECU_ADDRESS 0x8218E0 /end MEASUREMENT
/begin MEASUREMENT uint32_01.E_uint32.R03_B "" ULONG ident 1 100 0 4294967295 ECU_ADDRESS 0x8219B0 /end MEASUREMENT
/begin MEASUREMENT uint32_01.E_uint32.R04_B "" ULONG ident 1 100 0 4294967295 ECU_ADDRESS 0x821A80 /end MEASUREMENT
/begin MEASUREMENT uint32_01.I_uint32.R01_B "" ULONG ident 1 100 0 4294967295 ECU_ADDRESS 0x7F8C50 /end MEASUREMENT
/begin MEASUREMENT uint32_01.I_uint32.R02_B "" ULONG ident 1 100 0 4294967295 ECU_ADDRESS 0x7F8CF0 /end MEASUREMENT
/begin MEASUREMENT uint32_01.I_uint32.R03_B "" ULONG ident 1 100 0 4294967295 ECU_ADDRESS 0x7F8D90 /end MEASUREMENT
/begin MEASUREMENT uint32_01.I_uint32.R04_B "" ULONG ident 1 100 0 4294967295 ECU_ADDRESS 0x7F8E30 /end MEASUREMENT
/begin MEASUREMENT uint32_01.M_Ultimate "" ULONG ident 1 100 0 4294967295 ECU_ADDRESS 0x7FB120 /end MEASUREMENT
/begin MEASUREMENT uint32_02.E_uint32.R01_B "" ULONG ident 1 100 0 4294967295 ECU_ADDRESS 0x821814 /end MEASUREMENT
/begin MEASUREMENT uint32_02.E_uint32.R02_B "" ULONG ident 1 100 0 4294967295 ECU_ADDRESS 0x8218E4 /end MEASUREMENT
/begin MEASUREMENT uint32_02.E_uint32.R03_B "" ULONG ident 1 100 0 4294967295 ECU_ADDRESS 0x8219B4 /end MEASUREMENT
/begin MEASUREMENT uint32_02.E_uint32.R04_B "" ULONG ident 1 100 0 4294967295 ECU_ADDRESS 0x821A84 /end MEASUREMENT
/begin MEASUREMENT uint32_02.I_uint32.R01_B "" ULONG ident 1 100 0 4294967295 ECU_ADDRESS 0x7F8C54 /end MEASUREMENT
/begin MEASUREMENT uint32_02.I_uint32.R02_B "" ULONG ident 1 100 0 4294967295 ECU_ADDRESS 0x7F8CF4 /end MEASUREMENT
/begin MEASUREMENT uint32_02.I_uint32.R03_B "" ULONG ident 1 100 0 4294967295 ECU_ADDRESS 0x7F8D94 /end MEASUREMENT
/begin MEASUREMENT uint32_02.I_uint32.R04_B "" ULONG ident 1 100 0 4294967295 ECU_ADDRESS 0x7F8E34 /end MEASUREMENT
/begin MEASUREMENT uint32_03.E_uint32.R01_B "" ULONG ident 1 100 0 4294967295 ECU_ADDRESS 0x821818 /end MEASUREMENT
/begin MEASUREMENT uint32_03.E_uint32.R02_B "" ULONG ident 1 100 0 4294967295 ECU_ADDRESS 0x8218E8 /end MEASUREMENT
/begin MEASUREMENT uint32_03.E_uint32.R03_B "" ULONG ident 1 100 0 4294967295 ECU_ADDRESS 0x8219B8 /end MEASUREMENT
/begin MEASUREMENT uint32_03.E_uint32.R04_B "" ULONG ident 1 100 0 4294967295 ECU_ADDRESS 0x821A88 /end MEASUREMENT
/begin MEASUREMENT uint32_03.I_uint32.R01_B "" ULONG ident 1 100 0 4294967295 ECU_ADDRESS 0x7F8C58 /end MEASUREMENT
/begin MEASUREMENT uint32_03.I_uint32.R02_B "" ULONG ident 1 100 0 4294967295 ECU_ADDRESS 0x7F8CF8 /end MEASUREMENT
/begin MEASUREMENT uint32_03.I_uint32.R03_B "" ULONG ident 1 100 0 4294967295 ECU_ADDRESS 0x7F8D98 /end MEASUREMENT
/begin MEASUREMENT uint32_03.I_uint32.R04_B "" ULONG ident 1 100 0 4294967295 ECU_ADDRESS 0x7F8E38 /end MEASUREMENT
/begin MEASUREMENT uint32_04.E_uint32.R01_B "" ULONG ident 1 100 0 4294967295 ECU_ADDRESS 0x82181C /end MEASUREMENT
/begin MEASUREMENT uint32_04.E_uint32.R02_B "" ULONG ident 1 100 0 4294967295 ECU_ADDRESS 0x8218EC /end MEASUREMENT
/begin MEASUREMENT uint32_04.E_uint32.R03_B "" ULONG ident 1 100 0 4294967295 ECU_ADDRESS 0x8219BC /end MEASUREMENT
/begin MEASUREMENT uint32_04.E_uint32.R04_B "" ULONG ident 1 100 0 4294967295 ECU_ADDRESS 0x821A8C /end MEASUREMENT
/begin MEASUREMENT uint32_04.I_uint32.R01_B "" ULONG ident 1 100 0 4294967295 ECU_ADDRESS 0x7F8C5C /end MEASUREMENT
/begin MEASUREMENT uint32_04.I_uint32.R02_B "" ULONG ident 1 100 0 4294967295 ECU_ADDRESS 0x7F8CFC /end MEASUREMENT
/begin MEASUREMENT uint32_04.I_uint32.R03_B "" ULONG ident 1 100 0 4294967295 ECU_ADDRESS 0x7F8D9C /end MEASUREMENT
/begin MEASUREMENT uint32_04.I_uint32.R04_B "" ULONG ident 1 100 0 4294967295 ECU_ADDRESS 0x7F8E3C /end MEASUREMENT
/begin MEASUREMENT uint32_05.E_uint32.R01_B "" ULONG ident 1 100 0 4294967295 ECU_ADDRESS 0x821820 /end MEASUREMENT
/begin MEASUREMENT uint32_05.E_uint32.R02_B "" ULONG ident 1 100 0 4294967295 ECU_ADDRESS 0x8218F0 /end MEASUREMENT
/begin MEASUREMENT uint32_05.E_uint32.R03_B "" ULONG ident 1 100 0 4294967295 ECU_ADDRESS 0x8219C0 /end MEASUREMENT
/begin MEASUREMENT uint32_05.E_uint32.R04_B "" ULONG ident 1 100 0 4294967295 ECU_ADDRESS 0x821A90 /end MEASUREMENT
/begin MEASUREMENT uint32_05.I_uint32.R01_B "" ULONG ident 1 100 0 4294967295 ECU_ADDRESS 0x7F8C60 /end MEASUREMENT
/begin MEASUREMENT uint32_05.I_uint32.R02_B "" ULONG ident 1 100 0 4294967295 ECU_ADDRESS 0x7F8D00 /end MEASUREMENT
/begin MEASUREMENT uint32_05.I_uint32.R03_B "" ULONG ident 1 100 0 4294967295 ECU_ADDRESS 0x7F8DA0 /end MEASUREMENT
/begin MEASUREMENT uint32_05.I_uint32.R04_B "" ULONG ident 1 100 0 4294967295 ECU_ADDRESS 0x7F8E40 /end MEASUREMENT
/begin MEASUREMENT uint32_06.E_uint32.R01_B "" ULONG ident 1 100 0 4294967295 ECU_ADDRESS 0x821824 /end MEASUREMENT
/begin MEASUREMENT uint32_06.E_uint32.R02_B "" ULONG ident 1 100 0 4294967295 ECU_ADDRESS 0x8218F4 /end MEASUREMENT
/begin MEASUREMENT uint32_06.E_uint32.R03_B "" ULONG ident 1 100 0 4294967295 ECU_ADDRESS 0x8219C4 /end MEASUREMENT
/begin MEASUREMENT uint32_06.E_uint32.R04_B "" ULONG ident 1 100 0 4294967295 ECU_ADDRESS 0x821A94 /end MEASUREMENT
/begin MEASUREMENT uint32_06.I_uint32.R01_B "" ULONG ident 1 100 0 4294967295 ECU_ADDRESS 0x7F8C64 /end MEASUREMENT
/begin MEASUREMENT uint32_06.I_uint32.R02_B "" ULONG ident 1 100 0 4294967295 ECU_ADDRESS 0x7F8D04 /end MEASUREMENT
/begin MEASUREMENT uint32_06.I_uint32.R03_B "" ULONG ident 1 100 0 4294967295 ECU_ADDRESS 0x7F8DA4 /end MEASUREMENT
/begin MEASUREMENT uint32_06.I_uint32.R04_B "" ULONG ident 1 100 0 4294967295 ECU_ADDRESS 0x7F8E44 /end MEASUREMENT
/begin MEASUREMENT uint32_07.E_uint32.R01_B "" ULONG ident 1 100 0 4294967295 ECU_ADDRESS 0x821828 /end MEASUREMENT
/begin MEASUREMENT uint32_07.E_uint32.R02_B "" ULONG ident 1 100 0 4294967295 ECU_ADDRESS 0x8218F8 /end MEASUREMENT
/begin MEASUREMENT uint32_07.E_uint32.R03_B "" ULONG ident 1 100 0 4294967295 ECU_ADDRESS 0x8219C8 /end MEASUREMENT
/begin MEASUREMENT uint32_07.E_uint32.R04_B "" ULONG ident 1 100 0 4294967295 ECU_ADDRESS 0x821A98 /end MEASUREMENT
/begin MEASUREMENT uint32_07.I_uint32.R01_B "" ULONG ident 1 100 0 4294967295 ECU_ADDRESS 0x7F8C68 /end MEASUREMENT
/begin MEASUREMENT uint32_07.I_uint32.R02_B "" ULONG ident 1 100 0 4294967295 ECU_ADDRESS 0x7F8D08 /end MEASUREMENT
/begin MEASUREMENT uint32_07.I_uint32.R03_B "" ULONG ident 1 100 0 4294967295 ECU_ADDRESS 0x7F8DA8 /end MEASUREMENT
/begin MEASUREMENT uint32_07.I_uint32.R04_B "" ULONG ident 1 100 0 4294967295 ECU_ADDRESS 0x7F8E48 /end MEASUREMENT
/begin MEASUREMENT uint32_08.E_uint32.R01_B "" ULONG ident 1 100 0 4294967295 ECU_ADDRESS 0x82182C /end MEASUREMENT
/begin MEASUREMENT uint32_08.E_uint32.R02_B "" ULONG ident 1 100 0 4294967295 ECU_ADDRESS 0x8218FC /end MEASUREMENT
/begin MEASUREMENT uint32_08.E_uint32.R03_B "" ULONG ident 1 100 0 4294967295 ECU_ADDRESS 0x8219CC /end MEASUREMENT
/begin MEASUREMENT uint32_08.E_uint32.R04_B "" ULONG ident 1 100 0 4294967295 ECU_ADDRESS 0x821A9C /end MEASUREMENT
/begin MEASUREMENT uint32_08.I_uint32.R01_B "" ULONG ident 1 100 0 4294967295 ECU_ADDRESS 0x7F8C6C /end MEASUREMENT
/begin MEASUREMENT uint32_08.I_uint32.R02_B "" ULONG ident 1 100 0 4294967295 ECU_ADDRESS 0x7F8D0C /end MEASUREMENT
/begin MEASUREMENT uint32_08.I_uint32.R03_B "" ULONG ident 1 100 0 4294967295 ECU_ADDRESS 0x7F8DAC /end MEASUREMENT
/begin MEASUREMENT uint32_08.I_uint32.R04_B "" ULONG ident 1 100 0 4294967295 ECU_ADDRESS 0x7F8E4C /end MEASUREMENT
/begin MEASUREMENT uint8_01.E_uint8.counter_send_fast "" UBYTE ident 1 100 0 255 ECU_ADDRESS 0x82157F /end MEASUREMENT
/begin MEASUREMENT uint8_01.E_uint8.R01 "" UBYTE ident 1 100 0 255 ECU_ADDRESS 0x821688 DISPLAY_IDENTIFIER uint8_01.E_uint8.R01_DISP_ID_R01 /end MEASUREMENT
/begin MEASUREMENT uint8_01.E_uint8.R02 "" UBYTE ident 1 100 0 255 ECU_ADDRESS 0x821858 DISPLAY_IDENTIFIER uint8_01.E_uint8.R02_DISP_ID_R02 /end MEASUREMENT
/begin MEASUREMENT uint8_01.E_uint8.R03 "" UBYTE ident 1 100 0 255 ECU_ADDRESS 0x821928 DISPLAY_IDENTIFIER uint8_01.E_uint8.R03_DISP_ID_R03 /end MEASUREMENT
/begin MEASUREMENT uint8_01.E_uint8.R04 "" UBYTE ident 1 100 0 255 ECU_ADDRESS 0x8219F8 /end MEASUREMENT
/begin MEASUREMENT uint8_01.E_uint8.R05 "" UBYTE ident 1 100 0 255 ECU_ADDRESS 0x821AC8 /end MEASUREMENT
/begin MEASUREMENT uint8_01.E_uint8.R06 "" UBYTE ident 1 100 0 255 ECU_ADDRESS 0x821AF8 /end MEASUREMENT
/begin MEASUREMENT uint8_01.E_uint8.R07 "" UBYTE ident 1 100 0 255 ECU_ADDRESS 0x821B28 /end MEASUREMENT
/begin MEASUREMENT uint8_01.E_uint8.R08 "" UBYTE ident 1 100 0 255 ECU_ADDRESS 0x821B58 /end MEASUREMENT
/begin MEASUREMENT uint8_01.E_uint8.R09 "" UBYTE ident 1 100 0 255 ECU_ADDRESS 0x821B88 /end MEASUREMENT
/begin MEASUREMENT uint8_01.E_uint8.R10 "" UBYTE ident 1 100 0 255 ECU_ADDRESS 0x821BB8 /end MEASUREMENT
/begin MEASUREMENT uint8_01.E_uint8.R11 "" UBYTE ident 1 100 0 255 ECU_ADDRESS 0x821BE8 /end MEASUREMENT
/begin MEASUREMENT uint8_01.E_uint8.R12 "" UBYTE ident 1 100 0 255 ECU_ADDRESS 0x821C18 /end MEASUREMENT
/begin MEASUREMENT uint8_01.E_uint8.R13 "" UBYTE ident 1 100 0 255 ECU_ADDRESS 0x821C48 /end MEASUREMENT
/begin MEASUREMENT uint8_01.E_uint8.R14 "" UBYTE ident 1 100 0 255 ECU_ADDRESS 0x821C78 /end MEASUREMENT
/begin MEASUREMENT uint8_01.E_uint8.R15 "" UBYTE ident 1 100 0 255 ECU_ADDRESS 0x821CA8 /end MEASUREMENT
/begin MEASUREMENT uint8_01.E_uint8.R16 "" UBYTE ident 1 100 0 255 ECU_ADDRESS 0x821CB8 /end MEASUREMENT
/begin MEASUREMENT uint8_01.E_uint8_1.R01_8bit "" UBYTE ident 1 100 0 255 ECU_ADDRESS 0x821750 /end MEASUREMENT
/begin MEASUREMENT uint8_01.E_uint8_2.R01_8bit "" UBYTE ident 1 100 0 255 ECU_ADDRESS 0x821758 /end MEASUREMENT
/begin MEASUREMENT uint8_01.E_uint8_3.R01_8bit "" UBYTE ident 1 100 0 255 ECU_ADDRESS 0x821760 /end MEASUREMENT
/begin MEASUREMENT uint8_01.E_uint8_4.R01_8bit "" UBYTE ident 1 100 0 255 ECU_ADDRESS 0x821768 /end MEASUREMENT
/begin MEASUREMENT uint8_01.E_uint8_5.R01_8bit "" UBYTE ident 1 100 0 255 ECU_ADDRESS 0x821770 /end MEASUREMENT
/begin MEASUREMENT uint8_01.E_uint8_6.R01_8bit "" UBYTE ident 1 100 0 255 ECU_ADDRESS 0x821778 /end MEASUREMENT
/begin MEASUREMENT uint8_01.E_uint8_7.R01_8bit "" UBYTE ident 1 100 0 255 ECU_ADDRESS 0x821780 /end MEASUREMENT
/begin MEASUREMENT uint8_01.E_uint8_8.R01_8bit "" UBYTE ident 1 100 0 255 ECU_ADDRESS 0x821788 /end MEASUREMENT
/begin MEASUREMENT uint8_01.I_uint8.R01 "" UBYTE ident 1 100 0 255 ECU_ADDRESS 0x7FB2F2 DISPLAY_IDENTIFIER uint8_01.I_uint8.R01_DISP_ID_R01 /end MEASUREMENT
/begin MEASUREMENT uint8_01.I_uint8.R02 "" UBYTE ident 1 100 0 255 ECU_ADDRESS 0x7FB428 DISPLAY_IDENTIFIER uint8_01.I_uint8.R02_DISP_ID_R02 /end MEASUREMENT
/begin MEASUREMENT uint8_01.I_uint8.R03 "" UBYTE ident 1 100 0 255 ECU_ADDRESS 0x7FB45E DISPLAY_IDENTIFIER uint8_01.I_uint8.R03_DISP_ID_R03 /end MEASUREMENT
/begin MEASUREMENT uint8_01.I_uint8.R04 "" UBYTE ident 1 100 0 255 ECU_ADDRESS 0x7FB492 /end MEASUREMENT
/begin MEASUREMENT uint8_01.I_uint8_1.R01_8bit "" UBYTE ident 1 100 0 255 ECU_ADDRESS 0x7FB3C0 /end MEASUREMENT
/begin MEASUREMENT uint8_01.I_uint8_2.R01_8bit "" UBYTE ident 1 100 0 255 ECU_ADDRESS 0x7FB3C8 /end MEASUREMENT
/begin MEASUREMENT uint8_01.I_uint8_3.R01_8bit "" UBYTE ident 1 100 0 255 ECU_ADDRESS 0x7FB3D0 /end MEASUREMENT
/begin MEASUREMENT uint8_01.I_uint8_4.R01_8bit "" UBYTE ident 1 100 0 255 ECU_ADDRESS 0x7FB3D8 /end MEASUREMENT
/begin MEASUREMENT uint8_01.I_uint8_5.R01_8bit "" UBYTE ident 1 100 0 255 ECU_ADDRESS 0x7FB3E0 /end MEASUREMENT
/begin MEASUREMENT uint8_01.I_uint8_6.R01_8bit "" UBYTE ident 1 100 0 255 ECU_ADDRESS 0x7FB3E8 /end MEASUREMENT
/begin MEASUREMENT uint8_01.I_uint8_7.R01_8bit "" UBYTE ident 1 100 0 255 ECU_ADDRESS 0x7FB3F0 /end MEASUREMENT
/begin MEASUREMENT uint8_01.I_uint8_8.R01_8bit "" UBYTE ident 1 100 0 255 ECU_ADDRESS 0x7FB3F8 /end MEASUREMENT
/begin MEASUREMENT uint8_01.M_Ultimate "" UBYTE ident 1 100 0 255 ECU_ADDRESS 0x7FB129 /end MEASUREMENT
/begin MEASUREMENT uint8_02.E_uint8.counter_send_fast "" UBYTE ident 1 100 0 255 ECU_ADDRESS 0x821580 /end MEASUREMENT
/begin MEASUREMENT uint8_02.E_uint8.R01 "" UBYTE ident 1 100 0 255 ECU_ADDRESS 0x821689 DISPLAY_IDENTIFIER uint8_02.E_uint8.R01_DISP_ID_R01 /end MEASUREMENT
/begin MEASUREMENT uint8_02.E_uint8.R02 "" UBYTE ident 1 100 0 255 ECU_ADDRESS 0x821859 DISPLAY_IDENTIFIER uint8_02.E_uint8.R02_DISP_ID_R02 /end MEASUREMENT
/begin MEASUREMENT uint8_02.E_uint8.R03 "" UBYTE ident 1 100 0 255 ECU_ADDRESS 0x821929 DISPLAY_IDENTIFIER uint8_02.E_uint8.R03_DISP_ID_R03 /end MEASUREMENT
/begin MEASUREMENT uint8_02.E_uint8.R04 "" UBYTE ident 1 100 0 255 ECU_ADDRESS 0x8219F9 /end MEASUREMENT
/begin MEASUREMENT uint8_02.E_uint8.R05 "" UBYTE ident 1 100 0 255 ECU_ADDRESS 0x821AC9 /end MEASUREMENT
/begin MEASUREMENT uint8_02.E_uint8.R06 "" UBYTE ident 1 100 0 255 ECU_ADDRESS 0x821AF9 /end MEASUREMENT
/begin MEASUREMENT uint8_02.E_uint8.R07 "" UBYTE ident 1 100 0 255 ECU_ADDRESS 0x821B29 /end MEASUREMENT
/begin MEASUREMENT uint8_02.E_uint8.R08 "" UBYTE ident 1 100 0 255 ECU_ADDRESS 0x821B59 /end MEASUREMENT
/begin MEASUREMENT uint8_02.E_uint8.R09 "" UBYTE ident 1 100 0 255 ECU_ADDRESS 0x821B89 /end MEASUREMENT
/begin MEASUREMENT uint8_02.E_uint8.R10 "" UBYTE ident 1 100 0 255 ECU_ADDRESS 0x821BB9 /end MEASUREMENT
/begin MEASUREMENT uint8_02.E_uint8.R11 "" UBYTE ident 1 100 0 255 ECU_ADDRESS 0x821BE9 /end MEASUREMENT
/begin MEASUREMENT uint8_02.E_uint8.R12 "" UBYTE ident 1 100 0 255 ECU_ADDRESS 0x821C19 /end MEASUREMENT
/begin MEASUREMENT uint8_02.E_uint8.R13 "" UBYTE ident 1 100 0 255 ECU_ADDRESS 0x821C49 /end MEASUREMENT
/begin MEASUREMENT uint8_02.E_uint8.R14 "" UBYTE ident 1 100 0 255 ECU_ADDRESS 0x821C79 /end MEASUREMENT
/begin MEASUREMENT uint8_02.E_uint8.R15 "" UBYTE ident 1 100 0 255 ECU_ADDRESS 0x821CA9 /end MEASUREMENT
/begin MEASUREMENT uint8_02.E_uint8.R16 "" UBYTE ident 1 100 0 255 ECU_ADDRESS 0x821CB9 /end MEASUREMENT
/begin MEASUREMENT uint8_02.E_uint8_1.R01_8bit "" UBYTE ident 1 100 0 255 ECU_ADDRESS 0x821751 /end MEASUREMENT
/begin MEASUREMENT uint8_02.E_uint8_2.R01_8bit "" UBYTE ident 1 100 0 255 ECU_ADDRESS 0x821759 /end MEASUREMENT
/begin MEASUREMENT uint8_02.E_uint8_3.R01_8bit "" UBYTE ident 1 100 0 255 ECU_ADDRESS 0x821761 /end MEASUREMENT
/begin MEASUREMENT uint8_02.E_uint8_4.R01_8bit "" UBYTE ident 1 100 0 255 ECU_ADDRESS 0x821769 /end MEASUREMENT
/begin MEASUREMENT uint8_02.E_uint8_5.R01_8bit "" UBYTE ident 1 100 0 255 ECU_ADDRESS 0x821771 /end MEASUREMENT
/begin MEASUREMENT uint8_02.E_uint8_6.R01_8bit "" UBYTE ident 1 100 0 255 ECU_ADDRESS 0x821779 /end MEASUREMENT
/begin MEASUREMENT uint8_02.E_uint8_7.R01_8bit "" UBYTE ident 1 100 0 255 ECU_ADDRESS 0x821781 /end MEASUREMENT
/begin MEASUREMENT uint8_02.E_uint8_8.R01_8bit "" UBYTE ident 1 100 0 255 ECU_ADDRESS 0x821789 /end MEASUREMENT
/begin MEASUREMENT uint8_02.I_uint8.R01 "" UBYTE ident 1 100 0 255 ECU_ADDRESS 0x7FB2F3 DISPLAY_IDENTIFIER uint8_02.I_uint8.R01_DISP_ID_R01 /end MEASUREMENT
/begin MEASUREMENT uint8_02.I_uint8.R02 "" UBYTE ident 1 100 0 255 ECU_ADDRESS 0x7FB429 DISPLAY_IDENTIFIER uint8_02.I_uint8.R02_DISP_ID_R02 /end MEASUREMENT
/begin MEASUREMENT uint8_02.I_uint8.R03 "" UBYTE ident 1 100 0 255 ECU_ADDRESS 0x7FB45F DISPLAY_IDENTIFIER uint8_02.I_uint8.R03_DISP_ID_R03 /end MEASUREMENT
/begin MEASUREMENT uint8_02.I_uint8.R04 "" UBYTE ident 1 100 0 255 ECU_ADDRESS 0x7FB493 /end MEASUREMENT
/begin MEASUREMENT uint8_02.I_uint8_1.R01_8bit "" UBYTE ident 1 100 0 255 ECU_ADDRESS 0x7FB3C1 /end MEASUREMENT
/begin MEASUREMENT uint8_02.I_uint8_2.R01_8bit "" UBYTE ident 1 100 0 255 ECU_ADDRESS 0x7FB3C9 /end MEASUREMENT
/begin MEASUREMENT uint8_02.I_uint8_3.R01_8bit "" UBYTE ident 1 100 0 255 ECU_ADDRESS 0x7FB3D1 /end MEASUREMENT
/begin MEASUREMENT uint8_02.I_uint8_4.R01_8bit "" UBYTE ident 1 100 0 255 ECU_ADDRESS 0x7FB3D9 /end MEASUREMENT
/begin MEASUREMENT uint8_02.I_uint8_5.R01_8bit "" UBYTE ident 1 100 0 255 ECU_ADDRESS 0x7FB3E1 /end MEASUREMENT
/begin MEASUREMENT uint8_02.I_uint8_6.R01_8bit "" UBYTE ident 1 100 0 255 ECU_ADDRESS 0x7FB3E9 /end MEASUREMENT
/begin MEASUREMENT uint8_02.I_uint8_7.R01_8bit "" UBYTE ident 1 100 0 255 ECU_ADDRESS 0x7FB3F1 /end MEASUREMENT
/begin MEASUREMENT uint8_02.I_uint8_8.R01_8bit "" UBYTE ident 1 100 0 255 ECU_ADDRESS 0x7FB3F9 /end MEASUREMENT
/begin MEASUREMENT uint8_03.E_uint8.counter_send_fast "" UBYTE ident 1 100 0 255 ECU_ADDRESS 0x821581 /end MEASUREMENT
/begin MEASUREMENT uint8_03.E_uint8.R01 "" UBYTE ident 1 100 0 255 ECU_ADDRESS 0x82168A DISPLAY_IDENTIFIER uint8_03.E_uint8.R01_DISP_ID_R01 /end MEASUREMENT
/begin MEASUREMENT uint8_03.E_uint8.R02 "" UBYTE ident 1 100 0 255 ECU_ADDRESS 0x82185A DISPLAY_IDENTIFIER uint8_03.E_uint8.R02_DISP_ID_R02 /end MEASUREMENT
/begin MEASUREMENT uint8_03.E_uint8.R03 "" UBYTE ident 1 100 0 255 ECU_ADDRESS 0x82192A DISPLAY_IDENTIFIER uint8_03.E_uint8.R03_DISP_ID_R03 /end MEASUREMENT
/begin MEASUREMENT uint8_03.E_uint8.R04 "" UBYTE ident 1 100 0 255 ECU_ADDRESS 0x8219FA /end MEASUREMENT
/begin MEASUREMENT uint8_03.E_uint8.R05 "" UBYTE ident 1 100 0 255 ECU_ADDRESS 0x821ACA /end MEASUREMENT
/begin MEASUREMENT uint8_03.E_uint8.R06 "" UBYTE ident 1 100 0 255 ECU_ADDRESS 0x821AFA /end MEASUREMENT
/begin MEASUREMENT uint8_03.E_uint8.R07 "" UBYTE ident 1 100 0 255 ECU_ADDRESS 0x821B2A /end MEASUREMENT
/begin MEASUREMENT uint8_03.E_uint8.R08 "" UBYTE ident 1 100 0 255 ECU_ADDRESS 0x821B5A /end MEASUREMENT
/begin MEASUREMENT uint8_03.E_uint8.R09 "" UBYTE ident 1 100 0 255 ECU_ADDRESS 0x821B8A /end MEASUREMENT
/begin MEASUREMENT uint8_03.E_uint8.R10 "" UBYTE ident 1 100 0 255 ECU_ADDRESS 0x821BBA /end MEASUREMENT
/begin MEASUREMENT uint8_03.E_uint8.R11 "" UBYTE ident 1 100 0 255 ECU_ADDRESS 0x821BEA /end MEASUREMENT
/begin MEASUREMENT uint8_03.E_uint8.R12 "" UBYTE ident 1 100 0 255 ECU_ADDRESS 0x821C1A /end MEASUREMENT
/begin MEASUREMENT uint8_03.E_uint8.R13 "" UBYTE ident 1 100 0 255 ECU_ADDRESS 0x821C4A /end MEASUREMENT
/begin MEASUREMENT uint8_03.E_uint8.R14 "" UBYTE ident 1 100 0 255 ECU_ADDRESS 0x821C7A /end MEASUREMENT
/begin MEASUREMENT uint8_03.E_uint8.R15 "" UBYTE ident 1 100 0 255 ECU_ADDRESS 0x821CAA /end MEASUREMENT
/begin MEASUREMENT uint8_03.E_uint8.R16 "" UBYTE ident 1 100 0 255 ECU_ADDRESS 0x821CBA /end MEASUREMENT
/begin MEASUREMENT uint8_03.E_uint8_1.R01_8bit "" UBYTE ident 1 100 0 255 ECU_ADDRESS 0x821752 /end MEASUREMENT
/begin MEASUREMENT uint8_03.E_uint8_2.R01_8bit "" UBYTE ident 1 100 0 255 ECU_ADDRESS 0x82175A /end MEASUREMENT
/begin MEASUREMENT uint8_03.E_uint8_3.R01_8bit "" UBYTE ident 1 100 0 255 ECU_ADDRESS 0x821762 /end MEASUREMENT
/begin MEASUREMENT uint8_03.E_uint8_4.R01_8bit "" UBYTE ident 1 100 0 255 ECU_ADDRESS 0x82176A /end MEASUREMENT
/begin MEASUREMENT uint8_03.E_uint8_5.R01_8bit "" UBYTE ident 1 100 0 255 ECU_ADDRESS 0x821772 /end MEASUREMENT
/begin MEASUREMENT uint8_03.E_uint8_6.R01_8bit "" UBYTE ident 1 100 0 255 ECU_ADDRESS 0x82177A /end MEASUREMENT
/begin MEASUREMENT uint8_03.E_uint8_7.R01_8bit "" UBYTE ident 1 100 0 255 ECU_ADDRESS 0x821782 /end MEASUREMENT
/begin MEASUREMENT uint8_03.E_uint8_8.R01_8bit "" UBYTE ident 1 100 0 255 ECU_ADDRESS 0x82178A /end MEASUREMENT
/begin MEASUREMENT uint8_03.I_uint8.R01 "" UBYTE ident 1 100 0 255 ECU_ADDRESS 0x7FB2F4 DISPLAY_IDENTIFIER uint8_03.I_uint8.R01_DISP_ID_R01 /end MEASUREMENT
/begin MEASUREMENT uint8_03.I_uint8.R02 "" UBYTE ident 1 100 0 255 ECU_ADDRESS 0x7FB42A DISPLAY_IDENTIFIER uint8_03.I_uint8.R02_DISP_ID_R02 /end MEASUREMENT
/begin MEASUREMENT uint8_03.I_uint8.R03 "" UBYTE ident 1 100 0 255 ECU_ADDRESS 0x7FB460 DISPLAY_IDENTIFIER uint8_03.I_uint8.R03_DISP_ID_R03 /end MEASUREMENT
/begin MEASUREMENT uint8_03.I_uint8.R04 "" UBYTE ident 1 100 0 255 ECU_ADDRESS 0x7FB494 /end MEASUREMENT
/begin MEASUREMENT uint8_03.I_uint8_1.R01_8bit "" UBYTE ident 1 100 0 255 ECU_ADDRESS 0x7FB3C2 /end MEASUREMENT
/begin MEASUREMENT uint8_03.I_uint8_2.R01_8bit "" UBYTE ident 1 100 0 255 ECU_ADDRESS 0x7FB3CA /end MEASUREMENT
/begin MEASUREMENT uint8_03.I_uint8_3.R01_8bit "" UBYTE ident 1 100 0 255 ECU_ADDRESS 0x7FB3D2 /end MEASUREMENT
/begin MEASUREMENT uint8_03.I_uint8_4.R01_8bit "" UBYTE ident 1 100 0 255 ECU_ADDRESS 0x7FB3DA /end MEASUREMENT
/begin MEASUREMENT uint8_03.I_uint8_5.R01_8bit "" UBYTE ident 1 100 0 255 ECU_ADDRESS 0x7FB3E2 /end MEASUREMENT
/begin MEASUREMENT uint8_03.I_uint8_6.R01_8bit "" UBYTE ident 1 100 0 255 ECU_ADDRESS 0x7FB3EA /end MEASUREMENT
/begin MEASUREMENT uint8_03.I_uint8_7.R01_8bit "" UBYTE ident 1 100 0 255 ECU_ADDRESS 0x7FB3F2 /end MEASUREMENT
/begin MEASUREMENT uint8_03.I_uint8_8.R01_8bit "" UBYTE ident 1 100 0 255 ECU_ADDRESS 0x7FB3FA /end MEASUREMENT
/begin MEASUREMENT uint8_04.E_uint8.counter_send_fast "" UBYTE ident 1 100 0 255 ECU_ADDRESS 0x821582 /end MEASUREMENT
/begin MEASUREMENT uint8_04.E_uint8.R01 "" UBYTE ident 1 100 0 255 ECU_ADDRESS 0x82168B DISPLAY_IDENTIFIER uint8_04.E_uint8.R01_DISP_ID_R01 /end MEASUREMENT
/begin MEASUREMENT uint8_04.E_uint8.R02 "" UBYTE ident 1 100 0 255 ECU_ADDRESS 0x82185B DISPLAY_IDENTIFIER uint8_04.E_uint8.R02_DISP_ID_R02 /end MEASUREMENT
/begin MEASUREMENT uint8_04.E_uint8.R03 "" UBYTE ident 1 100 0 255 ECU_ADDRESS 0x82192B DISPLAY_IDENTIFIER uint8_04.E_uint8.R03_DISP_ID_R03 /end MEASUREMENT
/begin MEASUREMENT uint8_04.E_uint8.R04 "" UBYTE ident 1 100 0 255 ECU_ADDRESS 0x8219FB /end MEASUREMENT
/begin MEASUREMENT uint8_04.E_uint8.R05 "" UBYTE ident 1 100 0 255 ECU_ADDRESS 0x821ACB /end MEASUREMENT
/begin MEASUREMENT uint8_04.E_uint8.R06 "" UBYTE ident 1 100 0 255 ECU_ADDRESS 0x821AFB /end MEASUREMENT
/begin MEASUREMENT uint8_04.E_uint8.R07 "" UBYTE ident 1 100 0 255 ECU_ADDRESS 0x821B2B /end MEASUREMENT
/begin MEASUREMENT uint8_04.E_uint8.R08 "" UBYTE ident 1 100 0 255 ECU_ADDRESS 0x821B5B /end MEASUREMENT
/begin MEASUREMENT uint8_04.E_uint8.R09 "" UBYTE ident 1 100 0 255 ECU_ADDRESS 0x821B8B /end MEASUREMENT
/begin MEASUREMENT uint8_04.E_uint8.R10 "" UBYTE ident 1 100 0 255 ECU_ADDRESS 0x821BBB /end MEASUREMENT
/begin MEASUREMENT uint8_04.E_uint8.R11 "" UBYTE ident 1 100 0 255 ECU_ADDRESS 0x821BEB /end MEASUREMENT
/begin MEASUREMENT uint8_04.E_uint8.R12 "" UBYTE ident 1 100 0 255 ECU_ADDRESS 0x821C1B /end MEASUREMENT
/begin MEASUREMENT uint8_04.E_uint8.R13 "" UBYTE ident 1 100 0 255 ECU_ADDRESS 0x821C4B /end MEASUREMENT
/begin MEASUREMENT uint8_04.E_uint8.R14 "" UBYTE ident 1 100 0 255 ECU_ADDRESS 0x821C7B /end MEASUREMENT
/begin MEASUREMENT uint8_04.E_uint8.R15 "" UBYTE ident 1 100 0 255 ECU_ADDRESS 0x821CAB /end MEASUREMENT
/begin MEASUREMENT uint8_04.E_uint8.R16 "" UBYTE ident 1 100 0 255 ECU_ADDRESS 0x821CBB /end MEASUREMENT
/begin MEASUREMENT uint8_04.E_uint8_1.R01_8bit "" UBYTE ident 1 100 0 255 ECU_ADDRESS 0x821753 /end MEASUREMENT
/begin MEASUREMENT uint8_04.E_uint8_2.R01_8bit "" UBYTE ident 1 100 0 255 ECU_ADDRESS 0x82175B /end MEASUREMENT
/begin MEASUREMENT uint8_04.E_uint8_3.R01_8bit "" UBYTE ident 1 100 0 255 ECU_ADDRESS 0x821763 /end MEASUREMENT
/begin MEASUREMENT uint8_04.E_uint8_4.R01_8bit "" UBYTE ident 1 100 0 255 ECU_ADDRESS 0x82176B /end MEASUREMENT
/begin MEASUREMENT uint8_04.E_uint8_5.R01_8bit "" UBYTE ident 1 100 0 255 ECU_ADDRESS 0x821773 /end MEASUREMENT
/begin MEASUREMENT uint8_04.E_uint8_6.R01_8bit "" UBYTE ident 1 100 0 255 ECU_ADDRESS 0x82177B /end MEASUREMENT
/begin MEASUREMENT uint8_04.E_uint8_7.R01_8bit "" UBYTE ident 1 100 0 255 ECU_ADDRESS 0x821783 /end MEASUREMENT
/begin MEASUREMENT uint8_04.E_uint8_8.R01_8bit "" UBYTE ident 1 100 0 255 ECU_ADDRESS 0x82178B /end MEASUREMENT
/begin MEASUREMENT uint8_04.I_uint8.R01 "" UBYTE ident 1 100 0 255 ECU_ADDRESS 0x7FB2F5 DISPLAY_IDENTIFIER uint8_04.I_uint8.R01_DISP_ID_R01 /end MEASUREMENT
/begin MEASUREMENT uint8_04.I_uint8.R02 "" UBYTE ident 1 100 0 255 ECU_ADDRESS 0x7FB42B DISPLAY_IDENTIFIER uint8_04.I_uint8.R02_DISP_ID_R02 /end MEASUREMENT
/begin MEASUREMENT uint8_04.I_uint8.R03 "" UBYTE ident 1 100 0 255 ECU_ADDRESS 0x7FB461 DISPLAY_IDENTIFIER uint8_04.I_uint8.R03_DISP_ID_R03 /end MEASUREMENT
/begin MEASUREMENT uint8_04.I_uint8.R04 "" UBYTE ident 1 100 0 255 ECU_ADDRESS 0x7FB495 /end MEASUREMENT
/begin MEASUREMENT uint8_04.I_uint8_1.R01_8bit "" UBYTE ident 1 100 0 255 ECU_ADDRESS 0x7FB3C3 /end MEASUREMENT
/begin MEASUREMENT uint8_04.I_uint8_2.R01_8bit "" UBYTE ident 1 100 0 255 ECU_ADDRESS 0x7FB3CB /end MEASUREMENT
/begin MEASUREMENT uint8_04.I_uint8_3.R01_8bit "" UBYTE ident 1 100 0 255 ECU_ADDRESS 0x7FB3D3 /end MEASUREMENT
/begin MEASUREMENT uint8_04.I_uint8_4.R01_8bit "" UBYTE ident 1 100 0 255 ECU_ADDRESS 0x7FB3DB /end MEASUREMENT
/begin MEASUREMENT uint8_04.I_uint8_5.R01_8bit "" UBYTE ident 1 100 0 255 ECU_ADDRESS 0x7FB3E3 /end MEASUREMENT
/begin MEASUREMENT uint8_04.I_uint8_6.R01_8bit "" UBYTE ident 1 100 0 255 ECU_ADDRESS 0x7FB3EB /end MEASUREMENT
/begin MEASUREMENT uint8_04.I_uint8_7.R01_8bit "" UBYTE ident 1 100 0 255 ECU_ADDRESS 0x7FB3F3 /end MEASUREMENT
/begin MEASUREMENT uint8_04.I_uint8_8.R01_8bit "" UBYTE ident 1 100 0 255 ECU_ADDRESS 0x7FB3FB /end MEASUREMENT
/begin MEASUREMENT uint8_05.E_uint8.counter_send_fast "" UBYTE ident 1 100 0 255 ECU_ADDRESS 0x821583 /end MEASUREMENT
/begin MEASUREMENT uint8_05.E_uint8.R01 "" UBYTE ident 1 100 0 255 ECU_ADDRESS 0x82168C DISPLAY_IDENTIFIER uint8_05.E_uint8.R01_DISP_ID_R01 /end MEASUREMENT
/begin MEASUREMENT uint8_05.E_uint8.R02 "" UBYTE ident 1 100 0 255 ECU_ADDRESS 0x82185C DISPLAY_IDENTIFIER uint8_05.E_uint8.R02_DISP_ID_R02 /end MEASUREMENT
/begin MEASUREMENT uint8_05.E_uint8.R03 "" UBYTE ident 1 100 0 255 ECU_ADDRESS 0x82192C DISPLAY_IDENTIFIER uint8_05.E_uint8.R03_DISP_ID_R03 /end MEASUREMENT
/begin MEASUREMENT uint8_05.E_uint8.R04 "" UBYTE ident 1 100 0 255 ECU_ADDRESS 0x8219FC /end MEASUREMENT
/begin MEASUREMENT uint8_05.E_uint8.R05 "" UBYTE ident 1 100 0 255 ECU_ADDRESS 0x821ACC /end MEASUREMENT
/begin MEASUREMENT uint8_05.E_uint8.R06 "" UBYTE ident 1 100 0 255 ECU_ADDRESS 0x821AFC /end MEASUREMENT
/begin MEASUREMENT uint8_05.E_uint8.R07 "" UBYTE ident 1 100 0 255 ECU_ADDRESS 0x821B2C /end MEASUREMENT
/begin MEASUREMENT uint8_05.E_uint8.R08 "" UBYTE ident 1 100 0 255 ECU_ADDRESS 0x821B5C /end MEASUREMENT
/begin MEASUREMENT uint8_05.E_uint8.R09 "" UBYTE ident 1 100 0 255 ECU_ADDRESS 0x821B8C /end MEASUREMENT
/begin MEASUREMENT uint8_05.E_uint8.R10 "" UBYTE ident 1 100 0 255 ECU_ADDRESS 0x821BBC /end MEASUREMENT
/begin MEASUREMENT uint8_05.E_uint8.R11 "" UBYTE ident 1 100 0 255 ECU_ADDRESS 0x821BEC /end MEASUREMENT
/begin MEASUREMENT uint8_05.E_uint8.R12 "" UBYTE ident 1 100 0 255 ECU_ADDRESS 0x821C1C /end MEASUREMENT
/begin MEASUREMENT uint8_05.E_uint8.R13 "" UBYTE ident 1 100 0 255 ECU_ADDRESS 0x821C4C /end MEASUREMENT
/begin MEASUREMENT uint8_05.E_uint8.R14 "" UBYTE ident 1 100 0 255 ECU_ADDRESS 0x821C7C /end MEASUREMENT
/begin MEASUREMENT uint8_05.E_uint8.R15 "" UBYTE ident 1 100 0 255 ECU_ADDRESS 0x821CAC /end MEASUREMENT
/begin MEASUREMENT uint8_05.E_uint8.R16 "" UBYTE ident 1 100 0 255 ECU_ADDRESS 0x821CBC /end MEASUREMENT
/begin MEASUREMENT uint8_05.E_uint8_1.R01_8bit "" UBYTE ident 1 100 0 255 ECU_ADDRESS 0x821754 /end MEASUREMENT
/begin MEASUREMENT uint8_05.E_uint8_2.R01_8bit "" UBYTE ident 1 100 0 255 ECU_ADDRESS 0x82175C /end MEASUREMENT
/begin MEASUREMENT uint8_05.E_uint8_3.R01_8bit "" UBYTE ident 1 100 0 255 ECU_ADDRESS 0x821764 /end MEASUREMENT
/begin MEASUREMENT uint8_05.E_uint8_4.R01_8bit "" UBYTE ident 1 100 0 255 ECU_ADDRESS 0x82176C /end MEASUREMENT
/begin MEASUREMENT uint8_05.E_uint8_5.R01_8bit "" UBYTE ident 1 100 0 255 ECU_ADDRESS 0x821774 /end MEASUREMENT
/begin MEASUREMENT uint8_05.E_uint8_6.R01_8bit "" UBYTE ident 1 100 0 255 ECU_ADDRESS 0x82177C /end MEASUREMENT
/begin MEASUREMENT uint8_05.E_uint8_7.R01_8bit "" UBYTE ident 1 100 0 255 ECU_ADDRESS 0x821784 /end MEASUREMENT
/begin MEASUREMENT uint8_05.E_uint8_8.R01_8bit "" UBYTE ident 1 100 0 255 ECU_ADDRESS 0x82178C /end MEASUREMENT
/begin MEASUREMENT uint8_05.I_uint8.R01 "" UBYTE ident 1 100 0 255 ECU_ADDRESS 0x7FB2F6 DISPLAY_IDENTIFIER uint8_05.I_uint8.R01_DISP_ID_R01 /end MEASUREMENT
/begin MEASUREMENT uint8_05.I_uint8.R02 "" UBYTE ident 1 100 0 255 ECU_ADDRESS 0x7FB42C DISPLAY_IDENTIFIER uint8_05.I_uint8.R02_DISP_ID_R02 /end MEASUREMENT
/begin MEASUREMENT uint8_05.I_uint8.R03 "" UBYTE ident 1 100 0 255 ECU_ADDRESS 0x7FB462 DISPLAY_IDENTIFIER uint8_05.I_uint8.R03_DISP_ID_R03 /end MEASUREMENT
/begin MEASUREMENT uint8_05.I_uint8.R04 "" UBYTE ident 1 100 0 255 ECU_ADDRESS 0x7FB496 /end MEASUREMENT
/begin MEASUREMENT uint8_05.I_uint8_1.R01_8bit "" UBYTE ident 1 100 0 255 ECU_ADDRESS 0x7FB3C4 /end MEASUREMENT
/begin MEASUREMENT uint8_05.I_uint8_2.R01_8bit "" UBYTE ident 1 100 0 255 ECU_ADDRESS 0x7FB3CC /end MEASUREMENT
/begin MEASUREMENT uint8_05.I_uint8_3.R01_8bit "" UBYTE ident 1 100 0 255 ECU_ADDRESS 0x7FB3D4 /end MEASUREMENT
/begin MEASUREMENT uint8_05.I_uint8_4.R01_8bit "" UBYTE ident 1 100 0 255 ECU_ADDRESS 0x7FB3DC /end MEASUREMENT
/begin MEASUREMENT uint8_05.I_uint8_5.R01_8bit "" UBYTE ident 1 100 0 255 ECU_ADDRESS 0x7FB3E4 /end MEASUREMENT
/begin MEASUREMENT uint8_05.I_uint8_6.R01_8bit "" UBYTE ident 1 100 0 255 ECU_ADDRESS 0x7FB3EC /end MEASUREMENT
/begin MEASUREMENT uint8_05.I_uint8_7.R01_8bit "" UBYTE ident 1 100 0 255 ECU_ADDRESS 0x7FB3F4 /end MEASUREMENT
/begin MEASUREMENT uint8_05.I_uint8_8.R01_8bit "" UBYTE ident 1 100 0 255 ECU_ADDRESS 0x7FB3FC /end MEASUREMENT
/begin MEASUREMENT uint8_06.E_uint8.counter_send_fast "" UBYTE ident 1 100 0 255 ECU_ADDRESS 0x821584 /end MEASUREMENT
/begin MEASUREMENT uint8_06.E_uint8.R01 "" UBYTE ident 1 100 0 255 ECU_ADDRESS 0x82168D DISPLAY_IDENTIFIER uint8_06.E_uint8.R01_DISP_ID_R01 /end MEASUREMENT
/begin MEASUREMENT uint8_06.E_uint8.R02 "" UBYTE ident 1 100 0 255 ECU_ADDRESS 0x82185D DISPLAY_IDENTIFIER uint8_06.E_uint8.R02_DISP_ID_R02 /end MEASUREMENT
/begin MEASUREMENT uint8_06.E_uint8.R03 "" UBYTE ident 1 100 0 255 ECU_ADDRESS 0x82192D DISPLAY_IDENTIFIER uint8_06.E_uint8.R03_DISP_ID_R03 /end MEASUREMENT
/begin MEASUREMENT uint8_06.E_uint8.R04 "" UBYTE ident 1 100 0 255 ECU_ADDRESS 0x8219FD /end MEASUREMENT
/begin MEASUREMENT uint8_06.E_uint8.R05 "" UBYTE ident 1 100 0 255 ECU_ADDRESS 0x821ACD /end MEASUREMENT
/begin MEASUREMENT uint8_06.E_uint8.R06 "" UBYTE ident 1 100 0 255 ECU_ADDRESS 0x821AFD /end MEASUREMENT
/begin MEASUREMENT uint8_06.E_uint8.R07 "" UBYTE ident 1 100 0 255 ECU_ADDRESS 0x821B2D /end MEASUREMENT
/begin MEASUREMENT uint8_06.E_uint8.R08 "" UBYTE ident 1 100 0 255 ECU_ADDRESS 0x821B5D /end MEASUREMENT
/begin MEASUREMENT uint8_06.E_uint8.R09 "" UBYTE ident 1 100 0 255 ECU_ADDRESS 0x821B8D /end MEASUREMENT
/begin MEASUREMENT uint8_06.E_uint8.R10 "" UBYTE ident 1 100 0 255 ECU_ADDRESS 0x821BBD /end MEASUREMENT
/begin MEASUREMENT uint8_06.E_uint8.R11 "" UBYTE ident 1 100 0 255 ECU_ADDRESS 0x821BED /end MEASUREMENT
/begin MEASUREMENT uint8_06.E_uint8.R12 "" UBYTE ident 1 100 0 255 ECU_ADDRESS 0x821C1D /end MEASUREMENT
/begin MEASUREMENT uint8_06.E_uint8.R13 "" UBYTE ident 1 100 0 255 ECU_ADDRESS 0x821C4D /end MEASUREMENT
/begin MEASUREMENT uint8_06.E_uint8.R14 "" UBYTE ident 1 100 0 255 ECU_ADDRESS 0x821C7D /end MEASUREMENT
/begin MEASUREMENT uint8_06.E_uint8.R15 "" UBYTE ident 1 100 0 255 ECU_ADDRESS 0x821CAD /end MEASUREMENT
/begin MEASUREMENT uint8_06.E_uint8.R16 "" UBYTE ident 1 100 0 255 ECU_ADDRESS 0x821CBD /end MEASUREMENT
/begin MEASUREMENT uint8_06.E_uint8_1.R01_8bit "" UBYTE ident 1 100 0 255 ECU_ADDRESS 0x821755 /end MEASUREMENT
/begin MEASUREMENT uint8_06.E_uint8_2.R01_8bit "" UBYTE ident 1 100 0 255 ECU_ADDRESS 0x82175D /end MEASUREMENT
/begin MEASUREMENT uint8_06.E_uint8_3.R01_8bit "" UBYTE ident 1 100 0 255 ECU_ADDRESS 0x821765 /end MEASUREMENT
/begin MEASUREMENT uint8_06.E_uint8_4.R01_8bit "" UBYTE ident 1 100 0 255 ECU_ADDRESS 0x82176D /end MEASUREMENT
/begin MEASUREMENT uint8_06.E_uint8_5.R01_8bit "" UBYTE ident 1 100 0 255 ECU_ADDRESS 0x821775 /end MEASUREMENT
/begin MEASUREMENT uint8_06.E_uint8_6.R01_8bit "" UBYTE ident 1 100 0 255 ECU_ADDRESS 0x82177D /end MEASUREMENT
/begin MEASUREMENT uint8_06.E_uint8_7.R01_8bit "" UBYTE ident 1 100 0 255 ECU_ADDRESS 0x821785 /end MEASUREMENT
/begin MEASUREMENT uint8_06.E_uint8_8.R01_8bit "" UBYTE ident 1 100 0 255 ECU_ADDRESS 0x82178D /end MEASUREMENT
/begin MEASUREMENT uint8_06.I_uint8.R01 "" UBYTE ident 1 100 0 255 ECU_ADDRESS 0x7FB2F7 DISPLAY_IDENTIFIER uint8_06.I_uint8.R01_DISP_ID_R01 /end MEASUREMENT
/begin MEASUREMENT uint8_06.I_uint8.R02 "" UBYTE ident 1 100 0 255 ECU_ADDRESS 0x7FB42D DISPLAY_IDENTIFIER uint8_06.I_uint8.R02_DISP_ID_R02 /end MEASUREMENT
/begin MEASUREMENT uint8_06.I_uint8.R03 "" UBYTE ident 1 100 0 255 ECU_ADDRESS 0x7FB463 DISPLAY_IDENTIFIER uint8_06.I_uint8.R03_DISP_ID_R03 /end MEASUREMENT
/begin MEASUREMENT uint8_06.I_uint8.R04 "" UBYTE ident 1 100 0 255 ECU_ADDRESS 0x7FB497 /end MEASUREMENT
/begin MEASUREMENT uint8_06.I_uint8_1.R01_8bit "" UBYTE ident 1 100 0 255 ECU_ADDRESS 0x7FB3C5 /end MEASUREMENT
/begin MEASUREMENT uint8_06.I_uint8_2.R01_8bit "" UBYTE ident 1 100 0 255 ECU_ADDRESS 0x7FB3CD /end MEASUREMENT
/begin MEASUREMENT uint8_06.I_uint8_3.R01_8bit "" UBYTE ident 1 100 0 255 ECU_ADDRESS 0x7FB3D5 /end MEASUREMENT
/begin MEASUREMENT uint8_06.I_uint8_4.R01_8bit "" UBYTE ident 1 100 0 255 ECU_ADDRESS 0x7FB3DD /end MEASUREMENT
/begin MEASUREMENT uint8_06.I_uint8_5.R01_8bit "" UBYTE ident 1 100 0 255 ECU_ADDRESS 0x7FB3E5 /end MEASUREMENT
/begin MEASUREMENT uint8_06.I_uint8_6.R01_8bit "" UBYTE ident 1 100 0 255 ECU_ADDRESS 0x7FB3ED /end MEASUREMENT
/begin MEASUREMENT uint8_06.I_uint8_7.R01_8bit "" UBYTE ident 1 100 0 255 ECU_ADDRESS 0x7FB3F5 /end MEASUREMENT
/begin MEASUREMENT uint8_06.I_uint8_8.R01_8bit "" UBYTE ident 1 100 0 255 ECU_ADDRESS 0x7FB3FD /end MEASUREMENT
/begin MEASUREMENT uint8_07.E_uint8.counter_send_fast "" UBYTE ident 1 100 0 255 ECU_ADDRESS 0x821585 /end MEASUREMENT
/begin MEASUREMENT uint8_07.E_uint8.R01 "" UBYTE ident 1 100 0 255 ECU_ADDRESS 0x82168E DISPLAY_IDENTIFIER uint8_07.E_uint8.R01_DISP_ID_R01 /end MEASUREMENT
/begin MEASUREMENT uint8_07.E_uint8.R02 "" UBYTE ident 1 100 0 255 ECU_ADDRESS 0x82185E DISPLAY_IDENTIFIER uint8_07.E_uint8.R02_DISP_ID_R02 /end MEASUREMENT
/begin MEASUREMENT uint8_07.E_uint8.R03 "" UBYTE ident 1 100 0 255 ECU_ADDRESS 0x82192E DISPLAY_IDENTIFIER uint8_07.E_uint8.R03_DISP_ID_R03 /end MEASUREMENT
/begin MEASUREMENT uint8_07.E_uint8.R04 "" UBYTE ident 1 100 0 255 ECU_ADDRESS 0x8219FE /end MEASUREMENT
/begin MEASUREMENT uint8_07.E_uint8.R05 "" UBYTE ident 1 100 0 255 ECU_ADDRESS 0x821ACE /end MEASUREMENT
/begin MEASUREMENT uint8_07.E_uint8.R06 "" UBYTE ident 1 100 0 255 ECU_ADDRESS 0x821AFE /end MEASUREMENT
/begin MEASUREMENT uint8_07.E_uint8.R07 "" UBYTE ident 1 100 0 255 ECU_ADDRESS 0x821B2E /end MEASUREMENT
/begin MEASUREMENT uint8_07.E_uint8.R08 "" UBYTE ident 1 100 0 255 ECU_ADDRESS 0x821B5E /end MEASUREMENT
/begin MEASUREMENT uint8_07.E_uint8.R09 "" UBYTE ident 1 100 0 255 ECU_ADDRESS 0x821B8E /end MEASUREMENT
/begin MEASUREMENT uint8_07.E_uint8.R10 "" UBYTE ident 1 100 0 255 ECU_ADDRESS 0x821BBE /end MEASUREMENT
/begin MEASUREMENT uint8_07.E_uint8.R11 "" UBYTE ident 1 100 0 255 ECU_ADDRESS 0x821BEE /end MEASUREMENT
/begin MEASUREMENT uint8_07.E_uint8.R12 "" UBYTE ident 1 100 0 255 ECU_ADDRESS 0x821C1E /end MEASUREMENT
/begin MEASUREMENT uint8_07.E_uint8.R13 "" UBYTE ident 1 100 0 255 ECU_ADDRESS 0x821C4E /end MEASUREMENT
/begin MEASUREMENT uint8_07.E_uint8.R14 "" UBYTE ident 1 100 0 255 ECU_ADDRESS 0x821C7E /end MEASUREMENT
/begin MEASUREMENT uint8_07.E_uint8.R15 "" UBYTE ident 1 100 0 255 ECU_ADDRESS 0x821CAE /end MEASUREMENT
/begin MEASUREMENT uint8_07.E_uint8.R16 "" UBYTE ident 1 100 0 255 ECU_ADDRESS 0x821CBE /end MEASUREMENT
/begin MEASUREMENT uint8_07.E_uint8_1.R01_8bit "" UBYTE ident 1 100 0 255 ECU_ADDRESS 0x821756 /end MEASUREMENT
/begin MEASUREMENT uint8_07.E_uint8_2.R01_8bit "" UBYTE ident 1 100 0 255 ECU_ADDRESS 0x82175E /end MEASUREMENT
/begin MEASUREMENT uint8_07.E_uint8_3.R01_8bit "" UBYTE ident 1 100 0 255 ECU_ADDRESS 0x821766 /end MEASUREMENT
/begin MEASUREMENT uint8_07.E_uint8_4.R01_8bit "" UBYTE ident 1 100 0 255 ECU_ADDRESS 0x82176E /end MEASUREMENT
/begin MEASUREMENT uint8_07.E_uint8_5.R01_8bit "" UBYTE ident 1 100 0 255 ECU_ADDRESS 0x821776 /end MEASUREMENT
/begin MEASUREMENT uint8_07.E_uint8_6.R01_8bit "" UBYTE ident 1 100 0 255 ECU_ADDRESS 0x82177E /end MEASUREMENT
/begin MEASUREMENT uint8_07.E_uint8_7.R01_8bit "" UBYTE ident 1 100 0 255 ECU_ADDRESS 0x821786 /end MEASUREMENT
/begin MEASUREMENT uint8_07.E_uint8_8.R01_8bit "" UBYTE ident 1 100 0 255 ECU_ADDRESS 0x82178E /end MEASUREMENT
/begin MEASUREMENT uint8_07.I_uint8.R01 "" UBYTE ident 1 100 0 255 ECU_ADDRESS 0x7FB2F8 DISPLAY_IDENTIFIER uint8_07.I_uint8.R01_DISP_ID_R01 /end MEASUREMENT
/begin MEASUREMENT uint8_07.I_uint8.R02 "" UBYTE ident 1 100 0 255 ECU_ADDRESS 0x7FB42E DISPLAY_IDENTIFIER uint8_07.I_uint8.R02_DISP_ID_R02 /end MEASUREMENT
/begin MEASUREMENT uint8_07.I_uint8.R03 "" UBYTE ident 1 100 0 255 ECU_ADDRESS 0x7FB464 DISPLAY_IDENTIFIER uint8_07.I_uint8.R03_DISP_ID_R03 /end MEASUREMENT
/begin MEASUREMENT uint8_07.I_uint8.R04 "" UBYTE ident 1 100 0 255 ECU_ADDRESS 0x7FB498 /end MEASUREMENT
/begin MEASUREMENT uint8_07.I_uint8_1.R01_8bit "" UBYTE ident 1 100 0 255 ECU_ADDRESS 0x7FB3C6 /end MEASUREMENT
/begin MEASUREMENT uint8_07.I_uint8_2.R01_8bit "" UBYTE ident 1 100 0 255 ECU_ADDRESS 0x7FB3CE /end MEASUREMENT
/begin MEASUREMENT uint8_07.I_uint8_3.R01_8bit "" UBYTE ident 1 100 0 255 ECU_ADDRESS 0x7FB3D6 /end MEASUREMENT
/begin MEASUREMENT uint8_07.I_uint8_4.R01_8bit "" UBYTE ident 1 100 0 255 ECU_ADDRESS 0x7FB3DE /end MEASUREMENT
/begin MEASUREMENT uint8_07.I_uint8_5.R01_8bit "" UBYTE ident 1 100 0 255 ECU_ADDRESS 0x7FB3E6 /end MEASUREMENT
/begin MEASUREMENT uint8_07.I_uint8_6.R01_8bit "" UBYTE ident 1 100 0 255 ECU_ADDRESS 0x7FB3EE /end MEASUREMENT
/begin MEASUREMENT uint8_07.I_uint8_7.R01_8bit "" UBYTE ident 1 100 0 255 ECU_ADDRESS 0x7FB3F6 /end MEASUREMENT
/begin MEASUREMENT uint8_07.I_uint8_8.R01_8bit "" UBYTE ident 1 100 0 255 ECU_ADDRESS 0x7FB3FE /end MEASUREMENT
/begin MEASUREMENT uint8_08.E_uint8.counter_send_fast "" UBYTE ident 1 100 0 255 ECU_ADDRESS 0x821586 /end MEASUREMENT
/begin MEASUREMENT uint8_08.E_uint8.R01 "" UBYTE ident 1 100 0 255 ECU_ADDRESS 0x82168F DISPLAY_IDENTIFIER uint8_08.E_uint8.R01_DISP_ID_R01 /end MEASUREMENT
/begin MEASUREMENT uint8_08.E_uint8.R02 "" UBYTE ident 1 100 0 255 ECU_ADDRESS 0x82185F DISPLAY_IDENTIFIER uint8_08.E_uint8.R02_DISP_ID_R02 /end MEASUREMENT
/begin MEASUREMENT uint8_08.E_uint8.R03 "" UBYTE ident 1 100 0 255 ECU_ADDRESS 0x82192F DISPLAY_IDENTIFIER uint8_08.E_uint8.R03_DISP_ID_R03 /end MEASUREMENT
/begin MEASUREMENT uint8_08.E_uint8.R04 "" UBYTE ident 1 100 0 255 ECU_ADDRESS 0x8219FF /end MEASUREMENT
/begin MEASUREMENT uint8_08.E_uint8.R05 "" UBYTE ident 1 100 0 255 ECU_ADDRESS 0x821ACF /end MEASUREMENT
/begin MEASUREMENT uint8_08.E_uint8.R06 "" UBYTE ident 1 100 0 255 ECU_ADDRESS 0x821AFF /end MEASUREMENT
/begin MEASUREMENT uint8_08.E_uint8.R07 "" UBYTE ident 1 100 0 255 ECU_ADDRESS 0x821B2F /end MEASUREMENT
/begin MEASUREMENT uint8_08.E_uint8.R08 "" UBYTE ident 1 100 0 255 ECU_ADDRESS 0x821B5F /end MEASUREMENT
/begin MEASUREMENT uint8_08.E_uint8.R09 "" UBYTE ident 1 100 0 255 ECU_ADDRESS 0x821B8F /end MEASUREMENT
/begin MEASUREMENT uint8_08.E_uint8.R10 "" UBYTE ident 1 100 0 255 ECU_ADDRESS 0x821BBF /end MEASUREMENT
/begin MEASUREMENT uint8_08.E_uint8.R11 "" UBYTE ident 1 100 0 255 ECU_ADDRESS 0x821BEF /end MEASUREMENT
/begin MEASUREMENT uint8_08.E_uint8.R12 "" UBYTE ident 1 100 0 255 ECU_ADDRESS 0x821C1F /end MEASUREMENT
/begin MEASUREMENT uint8_08.E_uint8.R13 "" UBYTE ident 1 100 0 255 ECU_ADDRESS 0x821C4F /end MEASUREMENT
/begin MEASUREMENT uint8_08.E_uint8.R14 "" UBYTE ident 1 100 0 255 ECU_ADDRESS 0x821C7F /end MEASUREMENT
/begin MEASUREMENT uint8_08.E_uint8.R15 "" UBYTE ident 1 100 0 255 ECU_ADDRESS 0x821CAF /end MEASUREMENT
/begin MEASUREMENT uint8_08.E_uint8.R16 "" UBYTE ident 1 100 0 255 ECU_ADDRESS 0x821CBF /end MEASUREMENT
/begin MEASUREMENT uint8_08.E_uint8_1.R01_8bit "" UBYTE ident 1 100 0 255 ECU_ADDRESS 0x821757 /end MEASUREMENT
/begin MEASUREMENT uint8_08.E_uint8_2.R01_8bit "" UBYTE ident 1 100 0 255 ECU_ADDRESS 0x82175F /end MEASUREMENT
/begin MEASUREMENT uint8_08.E_uint8_3.R01_8bit "" UBYTE ident 1 100 0 255 ECU_ADDRESS 0x821767 /end MEASUREMENT
/begin MEASUREMENT uint8_08.E_uint8_4.R01_8bit "" UBYTE ident 1 100 0 255 ECU_ADDRESS 0x82176F /end MEASUREMENT
/begin MEASUREMENT uint8_08.E_uint8_5.R01_8bit "" UBYTE ident 1 100 0 255 ECU_ADDRESS 0x821777 /end MEASUREMENT
/begin MEASUREMENT uint8_08.E_uint8_6.R01_8bit "" UBYTE ident 1 100 0 255 ECU_ADDRESS 0x82177F /end MEASUREMENT
/begin MEASUREMENT uint8_08.E_uint8_7.R01_8bit "" UBYTE ident 1 100 0 255 ECU_ADDRESS 0x821787 /end MEASUREMENT
/begin MEASUREMENT uint8_08.E_uint8_8.R01_8bit "" UBYTE ident 1 100 0 255 ECU_ADDRESS 0x82178F /end MEASUREMENT
/begin MEASUREMENT uint8_08.I_uint8.R01 "" UBYTE ident 1 100 0 255 ECU_ADDRESS 0x7FB2F9 DISPLAY_IDENTIFIER uint8_08.I_uint8.R01_DISP_ID_R01 /end MEASUREMENT
/begin MEASUREMENT uint8_08.I_uint8.R02 "" UBYTE ident 1 100 0 255 ECU_ADDRESS 0x7FB42F DISPLAY_IDENTIFIER uint8_08.I_uint8.R02_DISP_ID_R02 /end MEASUREMENT
/begin MEASUREMENT uint8_08.I_uint8.R03 "" UBYTE ident 1 100 0 255 ECU_ADDRESS 0x7FB465 DISPLAY_IDENTIFIER uint8_08.I_uint8.R03_DISP_ID_R03 /end MEASUREMENT
/begin MEASUREMENT uint8_08.I_uint8.R04 "" UBYTE ident 1 100 0 255 ECU_ADDRESS 0x7FB499 /end MEASUREMENT
/begin MEASUREMENT uint8_08.I_uint8_1.R01_8bit "" UBYTE ident 1 100 0 255 ECU_ADDRESS 0x7FB3C7 /end MEASUREMENT
/begin MEASUREMENT uint8_08.I_uint8_2.R01_8bit "" UBYTE ident 1 100 0 255 ECU_ADDRESS 0x7FB3CF /end MEASUREMENT
/begin MEASUREMENT uint8_08.I_uint8_3.R01_8bit "" UBYTE ident 1 100 0 255 ECU_ADDRESS 0x7FB3D7 /end MEASUREMENT
/begin MEASUREMENT uint8_08.I_uint8_4.R01_8bit "" UBYTE ident 1 100 0 255 ECU_ADDRESS 0x7FB3DF /end MEASUREMENT
/begin MEASUREMENT uint8_08.I_uint8_5.R01_8bit "" UBYTE ident 1 100 0 255 ECU_ADDRESS 0x7FB3E7 /end MEASUREMENT
/begin MEASUREMENT uint8_08.I_uint8_6.R01_8bit "" UBYTE ident 1 100 0 255 ECU_ADDRESS 0x7FB3EF /end MEASUREMENT
/begin MEASUREMENT uint8_08.I_uint8_7.R01_8bit "" UBYTE ident 1 100 0 255 ECU_ADDRESS 0x7FB3F7 /end MEASUREMENT
/begin MEASUREMENT uint8_08.I_uint8_8.R01_8bit "" UBYTE ident 1 100 0 255 ECU_ADDRESS 0x7FB3FF /end MEASUREMENT
/begin COMPU_METHOD DASM_Ti "" RAT_FUNC "%12.4" "ms" COEFFS 0 10 0 0 0 1 /end COMPU_METHOD
/begin COMPU_METHOD formula_1_10 "" RAT_FUNC "%12.4" "" COEFFS 0 10 0 0 0 1 /end COMPU_METHOD
/begin COMPU_METHOD formula_1_100 "" RAT_FUNC "%12.4" "" COEFFS 0 100 0 0 0 1 /end COMPU_METHOD
/begin COMPU_METHOD formula_1_2 "" RAT_FUNC "%12.4" "" COEFFS 0 2 0 0 0 1 /end COMPU_METHOD
/begin COMPU_METHOD formula_10_1 "" RAT_FUNC "%12.4" "" COEFFS 0 0.1 0 0 0 1 /end COMPU_METHOD
/begin COMPU_METHOD ident "" RAT_FUNC "%12.4" "" COEFFS 0 1 0 0 0 1 /end COMPU_METHOD
/begin COMPU_METHOD qx100ms_Ticks_to_Sec "" RAT_FUNC "%12.4" "[s]" COEFFS 0 10.0 0 0 0 1 /end COMPU_METHOD
/begin GROUP E_uint16.R09 ""
 /begin REF_MEASUREMENT uint16_01.E_uint16.R09 uint16_02.E_uint16.R09 uint16_03.E_uint16.R09 uint16_04.E_uint16.R09 uint16_05.E_uint16.R09 uint16_06.E_uint16.R09 uint16_07.E_uint16.R09 uint16_08.E_uint16.R09 /end REF_MEASUREMENT
/end GROUP
/begin GROUP E_uint16.R10 ""
 /begin REF_MEASUREMENT uint16_01.E_uint16.R10 uint16_02.E_uint16.R10 uint16_03.E_uint16.R10 uint16_04.E_uint16.R10 uint16_05.E_uint16.R10 uint16_06.E_uint16.R10 uint16_07.E_uint16.R10 uint16_08.E_uint16.R10 /end REF_MEASUREMENT
/end GROUP
/begin GROUP E_uint16.R11 ""
 /begin REF_MEASUREMENT uint16_01.E_uint16.R11 uint16_02.E_uint16.R11 uint16_03.E_uint16.R11 uint16_04.E_uint16.R11 uint16_05.E_uint16.R11 uint16_06.E_uint16.R11 uint16_07.E_uint16.R11 uint16_08.E_uint16.R11 /end REF_MEASUREMENT
/end GROUP
/begin GROUP E_uint16.R12 ""
 /begin REF_MEASUREMENT uint16_01.E_uint16.R12 uint16_02.E_uint16.R12 uint16_03.E_uint16.R12 uint16_04.E_uint16.R12 uint16_05.E_uint16.R12 uint16_06.E_uint16.R12 uint16_07.E_uint16.R12 uint16_08.E_uint16.R12 /end REF_MEASUREMENT
/end GROUP
/begin GROUP E_uint16.R13 ""
 /begin REF_MEASUREMENT uint16_01.E_uint16.R13 uint16_02.E_uint16.R13 uint16_03.E_uint16.R13 uint16_04.E_uint16.R13 uint16_05.E_uint16.R13 uint16_06.E_uint16.R13 uint16_07.E_uint16.R13 uint16_08.E_uint16.R13 /end REF_MEASUREMENT
/end GROUP
/begin GROUP E_uint16.R14 ""
 /begin REF_MEASUREMENT uint16_01.E_uint16.R14 uint16_02.E_uint16.R14 uint16_03.E_uint16.R14 uint16_04.E_uint16.R14 uint16_05.E_uint16.R14 uint16_06.E_uint16.R14 uint16_07.E_uint16.R14 uint16_08.E_uint16.R14 /end REF_MEASUREMENT
/end GROUP
/begin GROUP E_uint16.R15 ""
 /begin REF_MEASUREMENT uint16_01.E_uint16.R15 uint16_02.E_uint16.R15 uint16_03.E_uint16.R15 uint16_04.E_uint16.R15 uint16_05.E_uint16.R15 uint16_06.E_uint16.R15 uint16_07.E_uint16.R15 uint16_08.E_uint16.R15 /end REF_MEASUREMENT
/end GROUP
/begin GROUP E_uint16_1.R01_16bit ""
 /begin REF_MEASUREMENT uint16_01.E_uint16_1.R01_16bit uint16_02.E_uint16_1.R01_16bit uint16_03.E_uint16_1.R01_16bit uint16_04.E_uint16_1.R01_16bit uint16_05.E_uint16_1.R01_16bit uint16_06.E_uint16_1.R01_16bit uint16_07.E_uint16_1.R01_16bit uint16_08.E_uint16_1.R01_16bit /end REF_MEASUREMENT
/end GROUP
/begin GROUP E_uint16_2.R01_16bit ""
 /begin REF_MEASUREMENT uint16_01.E_uint16_2.R01_16bit uint16_02.E_uint16_2.R01_16bit uint16_03.E_uint16_2.R01_16bit uint16_04.E_uint16_2.R01_16bit uint16_05.E_uint16_2.R01_16bit uint16_06.E_uint16_2.R01_16bit uint16_07.E_uint16_2.R01_16bit uint16_08.E_uint16_2.R01_16bit /end REF_MEASUREMENT
/end GROUP
/begin GROUP E_uint16_3.R01_16bit ""
 /begin REF_MEASUREMENT uint16_01.E_uint16_3.R01_16bit uint16_02.E_uint16_3.R01_16bit uint16_03.E_uint16_3.R01_16bit uint16_04.E_uint16_3.R01_16bit uint16_05.E_uint16_3.R01_16bit uint16_06.E_uint16_3.R01_16bit uint16_07.E_uint16_3.R01_16bit uint16_08.E_uint16_3.R01_16bit /end REF_MEASUREMENT
/end GROUP
/begin GROUP E_uint16_4.R01_16bit ""
 /begin REF_MEASUREMENT uint16_01.E_uint16_4.R01_16bit uint16_02.E_uint16_4.R01_16bit uint16_03.E_uint16_4.R01_16bit uint16_04.E_uint16_4.R01_16bit uint16_05.E_uint16_4.R01_16bit uint16_06.E_uint16_4.R01_16bit uint16_07.E_uint16_4.R01_16bit uint16_08.E_uint16_4.R01_16bit /end REF_MEASUREMENT
/end GROUP
/begin GROUP E_uint32.R01_B ""
 /begin REF_MEASUREMENT uint32_01.E_uint32.R01_B uint32_02.E_uint32.R01_B uint32_03.E_uint32.R01_B uint32_04.E_uint32.R01_B uint32_05.E_uint32.R01_B uint32_06.E_uint32.R01_B uint32_07.E_uint32.R01_B uint32_08.E_uint32.R01_B /end REF_MEASUREMENT
/end GROUP
/begin GROUP E_uint32.R02_B ""
 /begin REF_MEASUREMENT uint32_01.E_uint32.R02_B uint32_02.E_uint32.R02_B uint32_03.E_uint32.R02_B uint32_04.E_uint32.R02_B uint32_05.E_uint32.R02_B uint32_06.E_uint32.R02_B uint32_07.E_uint32.R02_B uint32_08.E_uint32.R02_B /end REF_MEASUREMENT
/end GROUP
/begin GROUP E_uint32.R03_B ""
 /begin REF_MEASUREMENT uint32_01.E_uint32.R03_B uint32_02.E_uint32.R03_B uint32_03.E_uint32.R03_B uint32_04.E_uint32.R03_B uint32_05.E_uint32.R03_B uint32_06.E_uint32.R03_B uint32_07.E_uint32.R03_B uint32_08.E_uint32.R03_B /end REF_MEASUREMENT
/end GROUP
/begin GROUP E_uint32.R04_B ""
 /begin REF_MEASUREMENT uint32_01.E_uint32.R04_B uint32_02.E_uint32.R04_B uint32_03.E_uint32.R04_B uint32_04.E_uint32.R04_B uint32_05.E_uint32.R04_B uint32_06.E_uint32.R04_B uint32_07.E_uint32.R04_B uint32_08.E_uint32.R04_B /end REF_MEASUREMENT
/end GROUP
/begin GROUP E_uint8.R01 ""
 /begin REF_MEASUREMENT uint8_01.E_uint8.R01 uint8_02.E_uint8.R01 uint8_03.E_uint8.R01 uint8_04.E_uint8.R01 uint8_05.E_uint8.R01 uint8_06.E_uint8.R01 uint8_07.E_uint8.R01 uint8_08.E_uint8.R01 /end REF_MEASUREMENT
/end GROUP
/begin GROUP E_uint8.R02 ""
 /begin REF_MEASUREMENT uint8_01.E_uint8.R02 uint8_02.E_uint8.R02 uint8_03.E_uint8.R02 uint8_04.E_uint8.R02 uint8_05.E_uint8.R02 uint8_06.E_uint8.R02 uint8_07.E_uint8.R02 uint8_08.E_uint8.R02 /end REF_MEASUREMENT
/end GROUP
/begin GROUP E_uint8.R03 ""
 /begin REF_MEASUREMENT uint8_01.E_uint8.R03 uint8_02.E_uint8.R03 uint8_03.E_uint8.R03 uint8_04.E_uint8.R03 uint8_05.E_uint8.R03 uint8_06.E_uint8.R03 uint8_07.E_uint8.R03 uint8_08.E_uint8.R03 /end REF_MEASUREMENT
/end GROUP
/begin GROUP E_uint8.R04 ""
 /begin REF_MEASUREMENT uint8_01.E_uint8.R04 uint8_02.E_uint8.R04 uint8_03.E_uint8.R04 uint8_04.E_uint8.R04 uint8_05.E_uint8.R04 uint8_06.E_uint8.R04 uint8_07.E_uint8.R04 uint8_08.E_uint8.R04 /end REF_MEASUREMENT
/end GROUP
/begin GROUP E_uint8.R05 ""
 /begin REF_MEASUREMENT uint8_01.E_uint8.R05 uint8_02.E_uint8.R05 uint8_03.E_uint8.R05 uint8_04.E_uint8.R05 uint8_05.E_uint8.R05 uint8_06.E_uint8.R05 uint8_07.E_uint8.R05 uint8_08.E_uint8.R05 /end REF_MEASUREMENT
/end GROUP
/begin GROUP E_uint8.R06 ""
 /begin REF_MEASUREMENT uint8_01.E_uint8.R06 uint8_02.E_uint8.R06 uint8_03.E_uint8.R06 uint8_04.E_uint8.R06 uint8_05.E_uint8.R06 uint8_06.E_uint8.R06 uint8_07.E_uint8.R06 uint8_08.E_uint8.R06 /end REF_MEASUREMENT
/end GROUP
/begin GROUP E_uint8.R07 ""
 /begin REF_MEASUREMENT uint8_01.E_uint8.R07 uint8_02.E_uint8.R07 uint8_03.E_uint8.R07 uint8_04.E_uint8.R07 uint8_05.E_uint8.R07 uint8_06.E_uint8.R07 uint8_07.E_uint8.R07 uint8_08.E_uint8.R07 /end REF_MEASUREMENT
/end GROUP
/begin GROUP E_uint8.R08 ""
 /begin REF_MEASUREMENT uint8_01.E_uint8.R08 uint8_02.E_uint8.R08 uint8_03.E_uint8.R08 uint8_04.E_uint8.R08 uint8_05.E_uint8.R08 uint8_06.E_uint8.R08 uint8_07.E_uint8.R08 uint8_08.E_uint8.R08 /end REF_MEASUREMENT
/end GROUP
/begin GROUP E_uint8.R09 ""
 /begin REF_MEASUREMENT uint8_01.E_uint8.R09 uint8_02.E_uint8.R09 uint8_03.E_uint8.R09 uint8_04.E_uint8.R09 uint8_05.E_uint8.R09 uint8_06.E_uint8.R09 uint8_07.E_uint8.R09 uint8_08.E_uint8.R09 /end REF_MEASUREMENT
/end GROUP
/begin GROUP E_uint8.R10 ""
 /begin REF_MEASUREMENT uint8_01.E_uint8.R10 uint8_02.E_uint8.R10 uint8_03.E_uint8.R10 uint8_04.E_uint8.R10 uint8_05.E_uint8.R10 uint8_06.E_uint8.R10 uint8_07.E_uint8.R10 uint8_08.E_uint8.R10 /end REF_MEASUREMENT
/end GROUP
/begin GROUP E_uint8.R11 ""
 /begin REF_MEASUREMENT uint8_01.E_uint8.R11 uint8_02.E_uint8.R11 uint8_03.E_uint8.R11 uint8_04.E_uint8.R11 uint8_05.E_uint8.R11 uint8_06.E_uint8.R11 uint8_07.E_uint8.R11 uint8_08.E_uint8.R11 /end REF_MEASUREMENT
/end GROUP
/begin GROUP E_uint8.R12 ""
 /begin REF_MEASUREMENT uint8_01.E_uint8.R12 uint8_02.E_uint8.R12 uint8_03.E_uint8.R12 uint8_04.E_uint8.R12 uint8_05.E_uint8.R12 uint8_06.E_uint8.R12 uint8_07.E_uint8.R12 uint8_08.E_uint8.R12 /end REF_MEASUREMENT
/end GROUP
/begin GROUP E_uint8.R13 ""
 /begin REF_MEASUREMENT uint8_01.E_uint8.R13 uint8_02.E_uint8.R13 uint8_03.E_uint8.R13 uint8_04.E_uint8.R13 uint8_05.E_uint8.R13 uint8_06.E_uint8.R13 uint8_07.E_uint8.R13 uint8_08.E_uint8.R13 /end REF_MEASUREMENT
/end GROUP
/begin GROUP E_uint8.R14 ""
 /begin REF_MEASUREMENT uint8_01.E_uint8.R14 uint8_02.E_uint8.R14 uint8_03.E_uint8.R14 uint8_04.E_uint8.R14 uint8_05.E_uint8.R14 uint8_06.E_uint8.R14 uint8_07.E_uint8.R14 uint8_08.E_uint8.R14 /end REF_MEASUREMENT
/end GROUP
/begin GROUP E_uint8.R15 ""
 /begin REF_MEASUREMENT uint8_01.E_uint8.R15 uint8_02.E_uint8.R15 uint8_03.E_uint8.R15 uint8_04.E_uint8.R15 uint8_05.E_uint8.R15 uint8_06.E_uint8.R15 uint8_07.E_uint8.R15 uint8_08.E_uint8.R15 /end REF_MEASUREMENT
/end GROUP
/begin GROUP E_uint8.R16 ""
 /begin REF_MEASUREMENT uint8_01.E_uint8.R16 uint8_02.E_uint8.R16 uint8_03.E_uint8.R16 uint8_04.E_uint8.R16 uint8_05.E_uint8.R16 uint8_06.E_uint8.R16 uint8_07.E_uint8.R16 uint8_08.E_uint8.R16 /end REF_MEASUREMENT
/end GROUP
/begin GROUP E_uint8.counter_send_fast ""
 /begin REF_MEASUREMENT uint8_01.E_uint8.counter_send_fast uint8_02.E_uint8.counter_send_fast uint8_03.E_uint8.counter_send_fast uint8_04.E_uint8.counter_send_fast uint8_05.E_uint8.counter_send_fast uint8_06.E_uint8.counter_send_fast uint8_07.E_uint8.counter_send_fast uint8_08.E_uint8.counter_send_fast /end REF_MEASUREMENT
/end GROUP
/begin GROUP E_uint8_1.R01_8bit ""
 /begin REF_MEASUREMENT uint8_01.E_uint8_1.R01_8bit uint8_02.E_uint8_1.R01_8bit uint8_03.E_uint8_1.R01_8bit uint8_04.E_uint8_1.R01_8bit uint8_05.E_uint8_1.R01_8bit uint8_06.E_uint8_1.R01_8bit uint8_07.E_uint8_1.R01_8bit uint8_08.E_uint8_1.R01_8bit /end REF_MEASUREMENT
/end GROUP
/begin GROUP E_uint8_2.R01_8bit ""
 /begin REF_MEASUREMENT uint8_01.E_uint8_2.R01_8bit uint8_02.E_uint8_2.R01_8bit uint8_03.E_uint8_2.R01_8bit uint8_04.E_uint8_2.R01_8bit uint8_05.E_uint8_2.R01_8bit uint8_06.E_uint8_2.R01_8bit uint8_07.E_uint8_2.R01_8bit uint8_08.E_uint8_2.R01_8bit /end REF_MEASUREMENT
/end GROUP
/begin GROUP E_uint8_3.R01_8bit ""
 /begin REF_MEASUREMENT uint8_01.E_uint8_3.R01_8bit uint8_02.E_uint8_3.R01_8bit uint8_03.E_uint8_3.R01_8bit uint8_04.E_uint8_3.R01_8bit uint8_05.E_uint8_3.R01_8bit uint8_06.E_uint8_3.R01_8bit uint8_07.E_uint8_3.R01_8bit uint8_08.E_uint8_3.R01_8bit /end REF_MEASUREMENT
/end GROUP
/begin GROUP E_uint8_4.R01_8bit ""
 /begin REF_MEASUREMENT uint8_01.E_uint8_4.R01_8bit uint8_02.E_uint8_4.R01_8bit uint8_03.E_uint8_4.R01_8bit uint8_04.E_uint8_4.R01_8bit uint8_05.E_uint8_4.R01_8bit uint8_06.E_uint8_4.R01_8bit uint8_07.E_uint8_4.R01_8bit uint8_08.E_uint8_4.R01_8bit /end REF_MEASUREMENT
/end GROUP
/begin GROUP E_uint8_5.R01_8bit ""
 /begin REF_MEASUREMENT uint8_01.E_uint8_5.R01_8bit uint8_02.E_uint8_5.R01_8bit uint8_03.E_uint8_5.R01_8bit uint8_04.E_uint8_5.R01_8bit uint8_05.E_uint8_5.R01_8bit uint8_06.E_uint8_5.R01_8bit uint8_07.E_uint8_5.R01_8bit uint8_08.E_uint8_5.R01_8bit /end REF_MEASUREMENT
/end GROUP
/begin GROUP E_uint8_6.R01_8bit ""
 /begin REF_MEASUREMENT uint8_01.E_uint8_6.R01_8bit uint8_02.E_uint8_6.R01_8bit uint8_03.E_uint8_6.R01_8bit uint8_04.E_uint8_6.R01_8bit uint8_05.E_uint8_6.R01_8bit uint8_06.E_uint8_6.R01_8bit uint8_07.E_uint8_6.R01_8bit uint8_08.E_uint8_6.R01_8bit /end REF_MEASUREMENT
/end GROUP
/begin GROUP E_uint8_7.R01_8bit ""
 /begin REF_MEASUREMENT uint8_01.E_uint8_7.R01_8bit uint8_02.E_uint8_7.R01_8bit uint8_03.E_uint8_7.R01_8bit uint8_04.E_uint8_7.R01_8bit uint8_05.E_uint8_7.R01_8bit uint8_06.E_uint8_7.R01_8bit uint8_07.E_uint8_7.R01_8bit uint8_08.E_uint8_7.R01_8bit /end REF_MEASUREMENT
/end GROUP
/begin GROUP E_uint8_8.R01_8bit ""
 /begin REF_MEASUREMENT uint8_01.E_uint8_8.R01_8bit uint8_02.E_uint8_8.R01_8bit uint8_03.E_uint8_8.R01_8bit uint8_04.E_uint8_8.R01_8bit uint8_05.E_uint8_8.R01_8bit uint8_06.E_uint8_8.R01_8bit uint8_07.E_uint8_8.R01_8bit uint8_08.E_uint8_8.R01_8bit /end REF_MEASUREMENT
/end GROUP
/begin GROUP EdgeRising.Reset_Schalter ""
 /begin REF_MEASUREMENT buffer.EdgeRising.Reset_Schalter oldSignal.EdgeRising.Reset_Schalter /end REF_MEASUREMENT
/end GROUP
/begin GROUP FEA_performance_array "" ROOT
 /begin REF_MEASUREMENT Result.FEA_performance_array TheMax.FEA_performance_array TheMin.FEA_performance_array i.FEA_performance_array /end REF_MEASUREMENT
 /begin REF_CHARACTERISTIC COUNT.FEA_performance_array Threshold.FEA_performance_array param.FEA_performance_array /end REF_CHARACTERISTIC
/end GROUP
/begin GROUP FEA_performance_scalar "" ROOT
 /begin REF_MEASUREMENT Result.FEA_performance_scalar ResultShort.FEA_performance_scalar TheLastMax.FEA_performance_scalar TheLastMaxShort.FEA_performance_scalar TheLastMin.FEA_performance_scalar TheLastMinShort.FEA_performance_scalar TheMax.FEA_performance_scalar TheMaxShort.FEA_performance_scalar TheMin.FEA_performance_scalar TheMinShort.FEA_performance_scalar /end REF_MEASUREMENT
 /begin REF_CHARACTERISTIC Param_00.FEA_performance_scalar Param_01.FEA_performance_scalar Param_02.FEA_performance_scalar Param_03.FEA_performance_scalar Param_04.FEA_performance_scalar Param_05.FEA_performance_scalar Param_06.FEA_performance_scalar Param_07.FEA_performance_scalar Param_08.FEA_performance_scalar Param_09.FEA_performance_scalar Param_10.FEA_performance_scalar Param_11.FEA_performance_scalar Param_12.FEA_performance_scalar Param_13.FEA_performance_scalar Param_14.FEA_performance_scalar Param_15.FEA_performance_scalar Param_16.FEA_performance_scalar Param_17.FEA_performance_scalar Param_18.FEA_performance_scalar Param_19.FEA_performance_scalar Param_20.FEA_performance_scalar Param_21.FEA_performance_scalar Param_22.FEA_performance_scalar Param_23.FEA_performance_scalar Param_24.FEA_performance_scalar Param_25.FEA_performance_scalar Param_26.FEA_performance_scalar Param_27.FEA_performance_scalar Param_28.FEA_performance_scalar Param_29.FEA_performance_scalar Param_30.FEA_performance_scalar Param_31.FEA_performance_scalar Param_32.FEA_performance_scalar Param_33.FEA_performance_scalar Param_34.FEA_performance_scalar Param_35.FEA_performance_scalar Param_36.FEA_performance_scalar Param_37.FEA_performance_scalar Param_38.FEA_performance_scalar Param_39.FEA_performance_scalar Param_40.FEA_performance_scalar Param_41.FEA_performance_scalar Param_42.FEA_performance_scalar Param_43.FEA_performance_scalar Param_44.FEA_performance_scalar Param_45.FEA_performance_scalar Param_46.FEA_performance_scalar Param_47.FEA_performance_scalar Param_48.FEA_performance_scalar Param_49.FEA_performance_scalar Threshold.FEA_performance_scalar /end REF_CHARACTERISTIC
/end GROUP
/begin GROUP HWE.BASE "" /begin SUB_GROUP Time_Calc.HWE.BASE /end SUB_GROUP /end GROUP
/begin GROUP I_fl32.R01_B ""
 /begin REF_MEASUREMENT fl32_01.I_fl32.R01_B fl32_02.I_fl32.R01_B fl32_03.I_fl32.R01_B fl32_04.I_fl32.R01_B fl32_05.I_fl32.R01_B fl32_06.I_fl32.R01_B fl32_07.I_fl32.R01_B fl32_08.I_fl32.R01_B /end REF_MEASUREMENT
/end GROUP
/begin GROUP I_fl32.R02_B ""
 /begin REF_MEASUREMENT fl32_01.I_fl32.R02_B fl32_02.I_fl32.R02_B fl32_03.I_fl32.R02_B fl32_04.I_fl32.R02_B fl32_05.I_fl32.R02_B fl32_06.I_fl32.R02_B fl32_07.I_fl32.R02_B fl32_08.I_fl32.R02_B /end REF_MEASUREMENT
/end GROUP
/begin GROUP I_fl32.R03_B ""
 /begin REF_MEASUREMENT fl32_01.I_fl32.R03_B fl32_02.I_fl32.R03_B fl32_03.I_fl32.R03_B fl32_04.I_fl32.R03_B fl32_05.I_fl32.R03_B fl32_06.I_fl32.R03_B fl32_07.I_fl32.R03_B fl32_08.I_fl32.R03_B /end REF_MEASUREMENT
/end GROUP
/begin GROUP I_fl32.R04_B ""
 /begin REF_MEASUREMENT fl32_01.I_fl32.R04_B fl32_02.I_fl32.R04_B fl32_03.I_fl32.R04_B fl32_04.I_fl32.R04_B fl32_05.I_fl32.R04_B fl32_06.I_fl32.R04_B fl32_07.I_fl32.R04_B fl32_08.I_fl32.R04_B /end REF_MEASUREMENT
/end GROUP
/begin GROUP I_fl64.R01_B ""
 /begin REF_MEASUREMENT fl64_01.I_fl64.R01_B fl64_02.I_fl64.R01_B fl64_03.I_fl64.R01_B fl64_04.I_fl64.R01_B fl64_05.I_fl64.R01_B fl64_06.I_fl64.R01_B fl64_07.I_fl64.R01_B fl64_08.I_fl64.R01_B /end REF_MEASUREMENT
/end GROUP
/begin GROUP I_fl64.R02_B ""
 /begin REF_MEASUREMENT fl64_01.I_fl64.R02_B fl64_02.I_fl64.R02_B fl64_03.I_fl64.R02_B fl64_04.I_fl64.R02_B fl64_05.I_fl64.R02_B fl64_06.I_fl64.R02_B fl64_07.I_fl64.R02_B fl64_08.I_fl64.R02_B /end REF_MEASUREMENT
/end GROUP
/begin GROUP I_fl64.R03_B ""
 /begin REF_MEASUREMENT fl64_01.I_fl64.R03_B fl64_02.I_fl64.R03_B fl64_03.I_fl64.R03_B fl64_04.I_fl64.R03_B fl64_05.I_fl64.R03_B fl64_06.I_fl64.R03_B fl64_07.I_fl64.R03_B fl64_08.I_fl64.R03_B /end REF_MEASUREMENT
/end GROUP
/begin GROUP I_fl64.R04_B ""
 /begin REF_MEASUREMENT fl64_01.I_fl64.R04_B fl64_02.I_fl64.R04_B fl64_03.I_fl64.R04_B fl64_04.I_fl64.R04_B fl64_05.I_fl64.R04_B fl64_06.I_fl64.R04_B fl64_07.I_fl64.R04_B fl64_08.I_fl64.R04_B /end REF_MEASUREMENT
/end GROUP
/begin GROUP I_sint16.R01 ""
 /begin REF_MEASUREMENT sint16_01.I_sint16.R01 sint16_02.I_sint16.R01 sint16_03.I_sint16.R01 sint16_04.I_sint16.R01 sint16_05.I_sint16.R01 sint16_06.I_sint16.R01 sint16_07.I_sint16.R01 sint16_08.I_sint16.R01 /end REF_MEASUREMENT
/end GROUP
/begin GROUP I_sint16.R02 ""
 /begin REF_MEASUREMENT sint16_01.I_sint16.R02 sint16_02.I_sint16.R02 sint16_03.I_sint16.R02 sint16_04.I_sint16.R02 sint16_05.I_sint16.R02 sint16_06.I_sint16.R02 sint16_07.I_sint16.R02 sint16_08.I_sint16.R02 /end REF_MEASUREMENT
/end GROUP
/begin GROUP I_sint16.R03 ""
 /begin REF_MEASUREMENT sint16_01.I_sint16.R03 sint16_02.I_sint16.R03 sint16_03.I_sint16.R03 sint16_04.I_sint16.R03 sint16_05.I_sint16.R03 sint16_06.I_sint16.R03 sint16_07.I_sint16.R03 sint16_08.I_sint16.R03 /end REF_MEASUREMENT
/end GROUP
/begin GROUP I_sint16.R04 ""
 /begin REF_MEASUREMENT sint16_01.I_sint16.R04 sint16_02.I_sint16.R04 sint16_03.I_sint16.R04 sint16_04.I_sint16.R04 sint16_05.I_sint16.R04 sint16_06.I_sint16.R04 sint16_07.I_sint16.R04 sint16_08.I_sint16.R04 /end REF_MEASUREMENT
/end GROUP
/begin GROUP I_sint16_1.R01_16bit ""
 /begin REF_MEASUREMENT sint16_01.I_sint16_1.R01_16bit sint16_02.I_sint16_1.R01_16bit sint16_03.I_sint16_1.R01_16bit sint16_04.I_sint16_1.R01_16bit sint16_05.I_sint16_1.R01_16bit sint16_06.I_sint16_1.R01_16bit sint16_07.I_sint16_1.R01_16bit sint16_08.I_sint16_1.R01_16bit /end REF_MEASUREMENT
/end GROUP
/begin GROUP I_sint16_2.R01_16bit ""
 /begin REF_MEASUREMENT sint16_01.I_sint16_2.R01_16bit sint16_02.I_sint16_2.R01_16bit sint16_03.I_sint16_2.R01_16bit sint16_04.I_sint16_2.R01_16bit sint16_05.I_sint16_2.R01_16bit sint16_06.I_sint16_2.R01_16bit sint16_07.I_sint16_2.R01_16bit sint16_08.I_sint16_2.R01_16bit /end REF_MEASUREMENT
/end GROUP
/begin GROUP I_sint16_3.R01_16bit ""
 /begin REF_MEASUREMENT sint16_01.I_sint16_3.R01_16bit sint16_02.I_sint16_3.R01_16bit sint16_03.I_sint16_3.R01_16bit sint16_04.I_sint16_3.R01_16bit sint16_05.I_sint16_3.R01_16bit sint16_06.I_sint16_3.R01_16bit sint16_07.I_sint16_3.R01_16bit sint16_08.I_sint16_3.R01_16bit /end REF_MEASUREMENT
/end GROUP
/begin GROUP I_sint16_4.R01_16bit ""
 /begin REF_MEASUREMENT sint16_01.I_sint16_4.R01_16bit sint16_02.I_sint16_4.R01_16bit sint16_03.I_sint16_4.R01_16bit sint16_04.I_sint16_4.R01_16bit sint16_05.I_sint16_4.R01_16bit sint16_06.I_sint16_4.R01_16bit sint16_07.I_sint16_4.R01_16bit sint16_08.I_sint16_4.R01_16bit /end REF_MEASUREMENT
/end GROUP
/begin GROUP I_sint32.R01_B ""
 /begin REF_MEASUREMENT sint32_01.I_sint32.R01_B sint32_02.I_sint32.R01_B sint32_03.I_sint32.R01_B sint32_04.I_sint32.R01_B sint32_05.I_sint32.R01_B sint32_06.I_sint32.R01_B sint32_07.I_sint32.R01_B sint32_08.I_sint32.R01_B /end REF_MEASUREMENT
/end GROUP
/begin GROUP I_sint32.R02_B ""
 /begin REF_MEASUREMENT sint32_01.I_sint32.R02_B sint32_02.I_sint32.R02_B sint32_03.I_sint32.R02_B sint32_04.I_sint32.R02_B sint32_05.I_sint32.R02_B sint32_06.I_sint32.R02_B sint32_07.I_sint32.R02_B sint32_08.I_sint32.R02_B /end REF_MEASUREMENT
/end GROUP
/begin GROUP I_sint32.R03_B ""
 /begin REF_MEASUREMENT sint32_01.I_sint32.R03_B sint32_02.I_sint32.R03_B sint32_03.I_sint32.R03_B sint32_04.I_sint32.R03_B sint32_05.I_sint32.R03_B sint32_06.I_sint32.R03_B sint32_07.I_sint32.R03_B sint32_08.I_sint32.R03_B /end REF_MEASUREMENT
/end GROUP
/begin GROUP I_sint32.R04_B ""
 /begin REF_MEASUREMENT sint32_01.I_sint32.R04_B sint32_02.I_sint32.R04_B sint32_03.I_sint32.R04_B sint32_04.I_sint32.R04_B sint32_05.I_sint32.R04_B sint32_06.I_sint32.R04_B sint32_07.I_sint32.R04_B sint32_08.I_sint32.R04_B /end REF_MEASUREMENT
/end GROUP
/begin GROUP I_sint8.R01 ""
 /begin REF_MEASUREMENT sint8_01.I_sint8.R01 sint8_02.I_sint8.R01 sint8_03.I_sint8.R01 sint8_04.I_sint8.R01 sint8_05.I_sint8.R01 sint8_06.I_sint8.R01 sint8_07.I_sint8.R01 sint8_08.I_sint8.R01 /end REF_MEASUREMENT
/end GROUP
/begin GROUP I_sint8.R02 ""
 /begin REF_MEASUREMENT sint8_01.I_sint8.R02 sint8_02.I_sint8.R02 sint8_03.I_sint8.R02 sint8_04.I_sint8.R02 sint8_05.I_sint8.R02 sint8_06.I_sint8.R02 sint8_07.I_sint8.R02 sint8_08.I_sint8.R02 /end REF_MEASUREMENT
/end GROUP
/begin GROUP I_sint8.R03 ""
 /begin REF_MEASUREMENT sint8_01.I_sint8.R03 sint8_02.I_sint8.R03 sint8_03.I_sint8.R03 sint8_04.I_sint8.R03 sint8_05.I_sint8.R03 sint8_06.I_sint8.R03 sint8_07.I_sint8.R03 sint8_08.I_sint8.R03 /end REF_MEASUREMENT
/end GROUP
/begin GROUP I_sint8.R04 ""
 /begin REF_MEASUREMENT sint8_01.I_sint8.R04 sint8_02.I_sint8.R04 sint8_03.I_sint8.R04 sint8_04.I_sint8.R04 sint8_05.I_sint8.R04 sint8_06.I_sint8.R04 sint8_07.I_sint8.R04 sint8_08.I_sint8.R04 /end REF_MEASUREMENT
/end GROUP
/begin GROUP I_sint8_1.R01_8bit ""
 /begin REF_MEASUREMENT sint8_01.I_sint8_1.R01_8bit sint8_02.I_sint8_1.R01_8bit sint8_03.I_sint8_1.R01_8bit sint8_04.I_sint8_1.R01_8bit sint8_05.I_sint8_1.R01_8bit sint8_06.I_sint8_1.R01_8bit sint8_07.I_sint8_1.R01_8bit sint8_08.I_sint8_1.R01_8bit /end REF_MEASUREMENT
/end GROUP
/begin GROUP I_sint8_2.R01_8bit ""
 /begin REF_MEASUREMENT sint8_01.I_sint8_2.R01_8bit sint8_02.I_sint8_2.R01_8bit sint8_03.I_sint8_2.R01_8bit sint8_04.I_sint8_2.R01_8bit sint8_05.I_sint8_2.R01_8bit sint8_06.I_sint8_2.R01_8bit sint8_07.I_sint8_2.R01_8bit sint8_08.I_sint8_2.R01_8bit /end REF_MEASUREMENT
/end GROUP
/begin GROUP I_sint8_3.R01_8bit ""
 /begin REF_MEASUREMENT sint8_01.I_sint8_3.R01_8bit sint8_02.I_sint8_3.R01_8bit sint8_03.I_sint8_3.R01_8bit sint8_04.I_sint8_3.R01_8bit sint8_05.I_sint8_3.R01_8bit sint8_06.I_sint8_3.R01_8bit sint8_07.I_sint8_3.R01_8bit sint8_08.I_sint8_3.R01_8bit /end REF_MEASUREMENT
/end GROUP
/begin GROUP I_sint8_4.R01_8bit ""
 /begin REF_MEASUREMENT sint8_01.I_sint8_4.R01_8bit sint8_02.I_sint8_4.R01_8bit sint8_03.I_sint8_4.R01_8bit sint8_04.I_sint8_4.R01_8bit sint8_05.I_sint8_4.R01_8bit sint8_06.I_sint8_4.R01_8bit sint8_07.I_sint8_4.R01_8bit sint8_08.I_sint8_4.R01_8bit /end REF_MEASUREMENT
/end GROUP
/begin GROUP I_sint8_5.R01_8bit ""
 /begin REF_MEASUREMENT sint8_01.I_sint8_5.R01_8bit sint8_02.I_sint8_5.R01_8bit sint8_03.I_sint8_5.R01_8bit sint8_04.I_sint8_5.R01_8bit sint8_05.I_sint8_5.R01_8bit sint8_06.I_sint8_5.R01_8bit sint8_07.I_sint8_5.R01_8bit sint8_08.I_sint8_5.R01_8bit /end REF_MEASUREMENT
/end GROUP
/begin GROUP I_sint8_6.R01_8bit ""
 /begin REF_MEASUREMENT sint8_01.I_sint8_6.R01_8bit sint8_02.I_sint8_6.R01_8bit sint8_03.I_sint8_6.R01_8bit sint8_04.I_sint8_6.R01_8bit sint8_05.I_sint8_6.R01_8bit sint8_06.I_sint8_6.R01_8bit sint8_07.I_sint8_6.R01_8bit sint8_08.I_sint8_6.R01_8bit /end REF_MEASUREMENT
/end GROUP
/begin GROUP I_sint8_7.R01_8bit ""
 /begin REF_MEASUREMENT sint8_01.I_sint8_7.R01_8bit sint8_02.I_sint8_7.R01_8bit sint8_03.I_sint8_7.R01_8bit sint8_04.I_sint8_7.R01_8bit sint8_05.I_sint8_7.R01_8bit sint8_06.I_sint8_7.R01_8bit sint8_07.I_sint8_7.R01_8bit sint8_08.I_sint8_7.R01_8bit /end REF_MEASUREMENT
/end GROUP
/begin GROUP I_sint8_8.R01_8bit ""
 /begin REF_MEASUREMENT sint8_01.I_sint8_8.R01_8bit sint8_02.I_sint8_8.R01_8bit sint8_03.I_sint8_8.R01_8bit sint8_04.I_sint8_8.R01_8bit sint8_05.I_sint8_8.R01_8bit sint8_06.I_sint8_8.R01_8bit sint8_07.I_sint8_8.R01_8bit sint8_08.I_sint8_8.R01_8bit /end REF_MEASUREMENT
/end GROUP
/begin GROUP I_uint16.R01 ""
 /begin REF_MEASUREMENT uint16_01.I_uint16.R01 uint16_02.I_uint16.R01 uint16_03.I_uint16.R01 uint16_04.I_uint16.R01 uint16_05.I_uint16.R01 uint16_06.I_uint16.R01 uint16_07.I_uint16.R01 uint16_08.I_uint16.R01 /end REF_MEASUREMENT
/end GROUP
/begin GROUP I_uint16.R02 ""
 /begin REF_MEASUREMENT uint16_01.I_uint16.R02 uint16_02.I_uint16.R02 uint16_03.I_uint16.R02 uint16_04.I_uint16.R02 uint16_05.I_uint16.R02 uint16_06.I_uint16.R02 uint16_07.I_uint16.R02 uint16_08.I_uint16.R02 /end REF_MEASUREMENT
/end GROUP
/begin GROUP I_uint16.R03 ""
 /begin REF_MEASUREMENT uint16_01.I_uint16.R03 uint16_02.I_uint16.R03 uint16_03.I_uint16.R03 uint16_04.I_uint16.R03 uint16_05.I_uint16.R03 uint16_06.I_uint16.R03 uint16_07.I_uint16.R03 uint16_08.I_uint16.R03 /end REF_MEASUREMENT
/end GROUP
/begin GROUP I_uint16.R04 ""
 /begin REF_MEASUREMENT uint16_01.I_uint16.R04 uint16_02.I_uint16.R04 uint16_03.I_uint16.R04 uint16_04.I_uint16.R04 uint16_05.I_uint16.R04 uint16_06.I_uint16.R04 uint16_07.I_uint16.R04 uint16_08.I_uint16.R04 /end REF_MEASUREMENT
/end GROUP
/begin GROUP I_uint16_1.R01_16bit ""
 /begin REF_MEASUREMENT uint16_01.I_uint16_1.R01_16bit uint16_02.I_uint16_1.R01_16bit uint16_03.I_uint16_1.R01_16bit uint16_04.I_uint16_1.R01_16bit uint16_05.I_uint16_1.R01_16bit uint16_06.I_uint16_1.R01_16bit uint16_07.I_uint16_1.R01_16bit uint16_08.I_uint16_1.R01_16bit /end REF_MEASUREMENT
/end GROUP
/begin GROUP I_uint16_2.R01_16bit ""
 /begin REF_MEASUREMENT uint16_01.I_uint16_2.R01_16bit uint16_02.I_uint16_2.R01_16bit uint16_03.I_uint16_2.R01_16bit uint16_04.I_uint16_2.R01_16bit uint16_05.I_uint16_2.R01_16bit uint16_06.I_uint16_2.R01_16bit uint16_07.I_uint16_2.R01_16bit uint16_08.I_uint16_2.R01_16bit /end REF_MEASUREMENT
/end GROUP
/begin GROUP I_uint16_3.R01_16bit ""
 /begin REF_MEASUREMENT uint16_01.I_uint16_3.R01_16bit uint16_02.I_uint16_3.R01_16bit uint16_03.I_uint16_3.R01_16bit uint16_04.I_uint16_3.R01_16bit uint16_05.I_uint16_3.R01_16bit uint16_06.I_uint16_3.R01_16bit uint16_07.I_uint16_3.R01_16bit uint16_08.I_uint16_3.R01_16bit /end REF_MEASUREMENT
/end GROUP
/begin GROUP I_uint16_4.R01_16bit ""
 /begin REF_MEASUREMENT uint16_01.I_uint16_4.R01_16bit uint16_02.I_uint16_4.R01_16bit uint16_03.I_uint16_4.R01_16bit uint16_04.I_uint16_4.R01_16bit uint16_05.I_uint16_4.R01_16bit uint16_06.I_uint16_4.R01_16bit uint16_07.I_uint16_4.R01_16bit uint16_08.I_uint16_4.R01_16bit /end REF_MEASUREMENT
/end GROUP
/begin GROUP I_uint32.R01_B ""
 /begin REF_MEASUREMENT uint32_01.I_uint32.R01_B uint32_02.I_uint32.R01_B uint32_03.I_uint32.R01_B uint32_04.I_uint32.R01_B uint32_05.I_uint32.R01_B uint32_06.I_uint32.R01_B uint32_07.I_uint32.R01_B uint32_08.I_uint32.R01_B /end REF_MEASUREMENT
/end GROUP
/begin GROUP I_uint32.R02_B ""
 /begin REF_MEASUREMENT uint32_01.I_uint32.R02_B uint32_02.I_uint32.R02_B uint32_03.I_uint32.R02_B uint32_04.I_uint32.R02_B uint32_05.I_uint32.R02_B uint32_06.I_uint32.R02_B uint32_07.I_uint32.R02_B uint32_08.I_uint32.R02_B /end REF_MEASUREMENT
/end GROUP
/begin GROUP I_uint32.R03_B ""
 /begin REF_MEASUREMENT uint32_01.I_uint32.R03_B uint32_02.I_uint32.R03_B uint32_03.I_uint32.R03_B uint32_04.I_uint32.R03_B uint32_05.I_uint32.R03_B uint32_06.I_uint32.R03_B uint32_07.I_uint32.R03_B uint32_08.I_uint32.R03_B /end REF_MEASUREMENT
/end GROUP
/begin GROUP I_uint32.R04_B ""
 /begin REF_MEASUREMENT uint32_01.I_uint32.R04_B uint32_02.I_uint32.R04_B uint32_03.I_uint32.R04_B uint32_04.I_uint32.R04_B uint32_05.I_uint32.R04_B uint32_06.I_uint32.R04_B uint32_07.I_uint32.R04_B uint32_08.I_uint32.R04_B /end REF_MEASUREMENT
/end GROUP
/begin GROUP I_uint8.R01 ""
 /begin REF_MEASUREMENT uint8_01.I_uint8.R01 uint8_02.I_uint8.R01 uint8_03.I_uint8.R01 uint8_04.I_uint8.R01 uint8_05.I_uint8.R01 uint8_06.I_uint8.R01 uint8_07.I_uint8.R01 uint8_08.I_uint8.R01 /end REF_MEASUREMENT
/end GROUP
/begin GROUP I_uint8.R02 ""
 /begin REF_MEASUREMENT uint8_01.I_uint8.R02 uint8_02.I_uint8.R02 uint8_03.I_uint8.R02 uint8_04.I_uint8.R02 uint8_05.I_uint8.R02 uint8_06.I_uint8.R02 uint8_07.I_uint8.R02 uint8_08.I_uint8.R02 /end REF_MEASUREMENT
/end GROUP
/begin GROUP I_uint8.R03 ""
 /begin REF_MEASUREMENT uint8_01.I_uint8.R03 uint8_02.I_uint8.R03 uint8_03.I_uint8.R03 uint8_04.I_uint8.R03 uint8_05.I_uint8.R03 uint8_06.I_uint8.R03 uint8_07.I_uint8.R03 uint8_08.I_uint8.R03 /end REF_MEASUREMENT
/end GROUP
/begin GROUP I_uint8.R04 ""
 /begin REF_MEASUREMENT uint8_01.I_uint8.R04 uint8_02.I_uint8.R04 uint8_03.I_uint8.R04 uint8_04.I_uint8.R04 uint8_05.I_uint8.R04 uint8_06.I_uint8.R04 uint8_07.I_uint8.R04 uint8_08.I_uint8.R04 /end REF_MEASUREMENT
/end GROUP
/begin GROUP I_uint8_1.R01_8bit ""
 /begin REF_MEASUREMENT uint8_01.I_uint8_1.R01_8bit uint8_02.I_uint8_1.R01_8bit uint8_03.I_uint8_1.R01_8bit uint8_04.I_uint8_1.R01_8bit uint8_05.I_uint8_1.R01_8bit uint8_06.I_uint8_1.R01_8bit uint8_07.I_uint8_1.R01_8bit uint8_08.I_uint8_1.R01_8bit /end REF_MEASUREMENT
/end GROUP
/begin GROUP I_uint8_2.R01_8bit ""
 /begin REF_MEASUREMENT uint8_01.I_uint8_2.R01_8bit uint8_02.I_uint8_2.R01_8bit uint8_03.I_uint8_2.R01_8bit uint8_04.I_uint8_2.R01_8bit uint8_05.I_uint8_2.R01_8bit uint8_06.I_uint8_2.R01_8bit uint8_07.I_uint8_2.R01_8bit uint8_08.I_uint8_2.R01_8bit /end REF_MEASUREMENT
/end GROUP
/begin GROUP I_uint8_3.R01_8bit ""
 /begin REF_MEASUREMENT uint8_01.I_uint8_3.R01_8bit uint8_02.I_uint8_3.R01_8bit uint8_03.I_uint8_3.R01_8bit uint8_04.I_uint8_3.R01_8bit uint8_05.I_uint8_3.R01_8bit uint8_06.I_uint8_3.R01_8bit uint8_07.I_uint8_3.R01_8bit uint8_08.I_uint8_3.R01_8bit /end REF_MEASUREMENT
/end GROUP
/begin GROUP I_uint8_4.R01_8bit ""
 /begin REF_MEASUREMENT uint8_01.I_uint8_4.R01_8bit uint8_02.I_uint8_4.R01_8bit uint8_03.I_uint8_4.R01_8bit uint8_04.I_uint8_4.R01_8bit uint8_05.I_uint8_4.R01_8bit uint8_06.I_uint8_4.R01_8bit uint8_07.I_uint8_4.R01_8bit uint8_08.I_uint8_4.R01_8bit /end REF_MEASUREMENT
/end GROUP
/begin GROUP I_uint8_5.R01_8bit ""
 /begin REF_MEASUREMENT uint8_01.I_uint8_5.R01_8bit uint8_02.I_uint8_5.R01_8bit uint8_03.I_uint8_5.R01_8bit uint8_04.I_uint8_5.R01_8bit uint8_05.I_uint8_5.R01_8bit uint8_06.I_uint8_5.R01_8bit uint8_07.I_uint8_5.R01_8bit uint8_08.I_uint8_5.R01_8bit /end REF_MEASUREMENT
/end GROUP
/begin GROUP I_uint8_6.R01_8bit ""
 /begin REF_MEASUREMENT uint8_01.I_uint8_6.R01_8bit uint8_02.I_uint8_6.R01_8bit uint8_03.I_uint8_6.R01_8bit uint8_04.I_uint8_6.R01_8bit uint8_05.I_uint8_6.R01_8bit uint8_06.I_uint8_6.R01_8bit uint8_07.I_uint8_6.R01_8bit uint8_08.I_uint8_6.R01_8bit /end REF_MEASUREMENT
/end GROUP
/begin GROUP I_uint8_7.R01_8bit ""
 /begin REF_MEASUREMENT uint8_01.I_uint8_7.R01_8bit uint8_02.I_uint8_7.R01_8bit uint8_03.I_uint8_7.R01_8bit uint8_04.I_uint8_7.R01_8bit uint8_05.I_uint8_7.R01_8bit uint8_06.I_uint8_7.R01_8bit uint8_07.I_uint8_7.R01_8bit uint8_08.I_uint8_7.R01_8bit /end REF_MEASUREMENT
/end GROUP
/begin GROUP I_uint8_8.R01_8bit ""
 /begin REF_MEASUREMENT uint8_01.I_uint8_8.R01_8bit uint8_02.I_uint8_8.R01_8bit uint8_03.I_uint8_8.R01_8bit uint8_04.I_uint8_8.R01_8bit uint8_05.I_uint8_8.R01_8bit uint8_06.I_uint8_8.R01_8bit uint8_07.I_uint8_8.R01_8bit uint8_08.I_uint8_8.R01_8bit /end REF_MEASUREMENT
/end GROUP
/begin GROUP M_Ultimate "" ROOT
 /begin REF_MEASUREMENT RM01_Op_u8.M_Ultimate RM01_Par01_u8.M_Ultimate RM01_Par02_u8.M_Ultimate RM01_Res_u8.M_Ultimate SM01_Par01_u8.M_Ultimate SM01_Par02_u8.M_Ultimate SM01_Res_u8.M_Ultimate SM_Err01_log.M_Ultimate SRM01_Res_u8.M_Ultimate SRM02_Res_u8.M_Ultimate SRM_Err01_log.M_Ultimate SRM_Stimu_Count01_u8.M_Ultimate fl32_01.M_Ultimate fl64_01.M_Ultimate s_uint8_01.M_Ultimate sint16_01.M_Ultimate sint32_01.M_Ultimate sint8_01.M_Ultimate uint16_01.M_Ultimate uint32_01.M_Ultimate uint8_01.M_Ultimate /end REF_MEASUREMENT
 /begin REF_CHARACTERISTIC P_F32_1.M_Ultimate P_F64_1.M_Ultimate P_Op_Val_u8.M_Ultimate P_Operation_case.M_Ultimate P_Result_case.M_Ultimate P_S16_1.M_Ultimate P_S32_1.M_Ultimate P_S8_1.M_Ultimate P_Stimu01_u8.M_Ultimate P_Stimu02_u8.M_Ultimate P_Stimu_case.M_Ultimate P_U16_1.M_Ultimate P_U32_1.M_Ultimate P_U8_1.M_Ultimate /end REF_CHARACTERISTIC
/end GROUP
/begin GROUP Map_Mod "" ROOT
 /begin REF_MEASUREMENT M_In_X_Dist.Map_Mod M_In_X_Two_D.Map_Mod M_In_Y_Dist.Map_Mod M_In_Y_Two_D.Map_Mod M_Out_Group_1.Map_Mod M_Out_Group_2.Map_Mod M_Out_Group_3.Map_Mod M_Out_X_Two_D.Map_Mod /end REF_MEASUREMENT
 /begin REF_CHARACTERISTIC Group_Two_D_1.Map_Mod Group_Two_D_2.Map_Mod Group_Two_D_3.Map_Mod P_In_X_Two_D.Map_Mod P_In_Y_Two_D.Map_Mod Two_D.Map_Mod /end REF_CHARACTERISTIC
/end GROUP
/begin GROUP Maps_Raster_1 "" ROOT /begin REF_CHARACTERISTIC P_Do_Maps.Maps_Raster_1 /end REF_CHARACTERISTIC
 /begin SUB_GROUP All_Maps_FIX.Maps_Raster_1 All_Maps_GRP.Maps_Raster_1 All_Maps_STD.Maps_Raster_1 /end SUB_GROUP
/end GROUP
/begin GROUP Maps_Raster_2 "" ROOT /begin REF_CHARACTERISTIC P_Do_Maps.Maps_Raster_2 /end REF_CHARACTERISTIC
 /begin SUB_GROUP All_Maps_FIX.Maps_Raster_2 All_Maps_GRP.Maps_Raster_2 All_Maps_STD.Maps_Raster_2 /end SUB_GROUP
/end GROUP
/begin GROUP Maps_Raster_3 "" ROOT /begin REF_CHARACTERISTIC P_Do_Maps.Maps_Raster_3 /end REF_CHARACTERISTIC
 /begin SUB_GROUP All_Maps_FIX.Maps_Raster_3 All_Maps_GRP.Maps_Raster_3 All_Maps_STD.Maps_Raster_3 /end SUB_GROUP
/end GROUP
/begin GROUP Model_Byp_B01 "" ROOT
 /begin REF_MEASUREMENT B_cntr_B01_ok.clsCounter_B01.Model_Byp_B01 bypass_B01_state.Model_Byp_B01 cntrold_B01.clsCounter_B01.Model_Byp_B01 cont_sint16_1_100_B01.Model_Byp_B01 cont_sint16_1_100_offset_cpy_B01.Model_Byp_B01 cont_sint16_B01.Model_Byp_B01 cont_sint16_offset_cpy_B01.Model_Byp_B01 cont_sint8_1_10_B01.Model_Byp_B01 cont_sint8_1_10_offset_cpy_B01.Model_Byp_B01 cont_sint8_B01.Model_Byp_B01 cont_sint8_offset_cpy_B01.Model_Byp_B01 cont_uint16_1_2_B01.Model_Byp_B01 cont_uint16_1_2_offset_cpy_B01.Model_Byp_B01 cont_uint8_10_1_B01.Model_Byp_B01 cont_uint8_10_1_offset_cpy_B01.Model_Byp_B01 errcntr_B01.clsCounter_B01.Model_Byp_B01 log_uint8_0_B01.Model_Byp_B01 log_uint8_0_bitOffset_cpy_B01.Model_Byp_B01 log_uint8_0_offset_cpy_B01.Model_Byp_B01 log_uint8_1_B01.Model_Byp_B01 log_uint8_1_bitOffset_cpy_B01.Model_Byp_B01 log_uint8_1_offset_cpy_B01.Model_Byp_B01 sdisc_sint16_B01.Model_Byp_B01 sdisc_sint16_offset_cpy_B01.Model_Byp_B01 sdisc_sint8_B01.Model_Byp_B01 sdisc_sint8_offset_cpy_B01.Model_Byp_B01 udisc_uint16_B01.Model_Byp_B01 udisc_uint16_offset_cpy_B01.Model_Byp_B01 udisc_uint8_B01.Model_Byp_B01 udisc_uint8_offset_cpy_B01.Model_Byp_B01 /end REF_MEASUREMENT
 /begin REF_CHARACTERISTIC bypass_B01_enable.Model_Byp_B01 cont_sint16_1_100_bypEnable_B01.Model_Byp_B01 cont_sint16_1_100_offset_B01.Model_Byp_B01 cont_sint16_bypEnable_B01.Model_Byp_B01 cont_sint16_offset_B01.Model_Byp_B01 cont_sint8_1_10_bypEnable_B01.Model_Byp_B01 cont_sint8_1_10_offset_B01.Model_Byp_B01 cont_sint8_bypEnable_B01.Model_Byp_B01 cont_sint8_offset_B01.Model_Byp_B01 cont_uint16_1_2_bypEnable_B01.Model_Byp_B01 cont_uint16_1_2_offset_B01.Model_Byp_B01 cont_uint8_10_1_bypEnable_B01.Model_Byp_B01 cont_uint8_10_1_offset_B01.Model_Byp_B01 log_uint8_0_bitOffset_B01.Model_Byp_B01 log_uint8_0_bypEnable_B01.Model_Byp_B01 log_uint8_0_offset_B01.Model_Byp_B01 log_uint8_1_bitOffset_B01.Model_Byp_B01 log_uint8_1_bypEnable_B01.Model_Byp_B01 log_uint8_1_offset_B01.Model_Byp_B01 p_cont_sint16_1_100_B01.Model_Byp_B01 p_cont_sint16_B01.Model_Byp_B01 p_cont_sint8_1_10_B01.Model_Byp_B01 p_cont_sint8_B01.Model_Byp_B01 p_cont_uint16_1_2_B01.Model_Byp_B01 p_cont_uint8_10_1_B01.Model_Byp_B01 p_log_uint8_0_B01.Model_Byp_B01 p_log_uint8_1_B01.Model_Byp_B01 p_sdisc_sint16_B01.Model_Byp_B01 p_sdisc_sint8_B01.Model_Byp_B01 p_udisc_uint16_B01.Model_Byp_B01 p_udisc_uint8_B01.Model_Byp_B01 sdisc_sint16_bypEnable_B01.Model_Byp_B01 sdisc_sint16_offset_B01.Model_Byp_B01 sdisc_sint8_bypEnable_B01.Model_Byp_B01 sdisc_sint8_offset_B01.Model_Byp_B01 udisc_uint16_bypEnable_B01.Model_Byp_B01 udisc_uint16_offset_B01.Model_Byp_B01 udisc_uint8_bypEnable_B01.Model_Byp_B01 udisc_uint8_offset_B01.Model_Byp_B01 /end REF_CHARACTERISTIC
 /begin SUB_GROUP clsCounter_B01.Model_Byp_B01 /end SUB_GROUP
/end GROUP
/begin GROUP R01 "" ROOT
 /begin REF_MEASUREMENT sint16_01.I_sint16.R01 sint16_02.I_sint16.R01 sint16_03.I_sint16.R01 sint16_04.I_sint16.R01 sint16_05.I_sint16.R01 sint16_06.I_sint16.R01 sint16_07.I_sint16.R01 sint16_08.I_sint16.R01 sint8_01.I_sint8.R01 sint8_02.I_sint8.R01 sint8_03.I_sint8.R01 sint8_04.I_sint8.R01 sint8_05.I_sint8.R01 sint8_06.I_sint8.R01 sint8_07.I_sint8.R01 sint8_08.I_sint8.R01 uint16_01.I_uint16.R01 uint16_02.I_uint16.R01 uint16_03.I_uint16.R01 uint16_04.I_uint16.R01 uint16_05.I_uint16.R01 uint16_06.I_uint16.R01 uint16_07.I_uint16.R01 uint16_08.I_uint16.R01 uint8_01.E_uint8.R01 uint8_01.I_uint8.R01 uint8_02.E_uint8.R01 uint8_02.I_uint8.R01 uint8_03.E_uint8.R01 uint8_03.I_uint8.R01 uint8_04.E_uint8.R01 uint8_04.I_uint8.R01 uint8_05.E_uint8.R01 uint8_05.I_uint8.R01 uint8_06.E_uint8.R01 uint8_06.I_uint8.R01 uint8_07.E_uint8.R01 uint8_07.I_uint8.R01 uint8_08.E_uint8.R01 uint8_08.I_uint8.R01 /end REF_MEASUREMENT
/end GROUP
/begin GROUP R01_16bit "" ROOT
 /begin REF_MEASUREMENT sint16_01.I_sint16_1.R01_16bit sint16_01.I_sint16_2.R01_16bit sint16_01.I_sint16_3.R01_16bit sint16_01.I_sint16_4.R01_16bit sint16_02.I_sint16_1.R01_16bit sint16_02.I_sint16_2.R01_16bit sint16_02.I_sint16_3.R01_16bit sint16_02.I_sint16_4.R01_16bit sint16_03.I_sint16_1.R01_16bit sint16_03.I_sint16_2.R01_16bit sint16_03.I_sint16_3.R01_16bit sint16_03.I_sint16_4.R01_16bit sint16_04.I_sint16_1.R01_16bit sint16_04.I_sint16_2.R01_16bit sint16_04.I_sint16_3.R01_16bit sint16_04.I_sint16_4.R01_16bit sint16_05.I_sint16_1.R01_16bit sint16_05.I_sint16_2.R01_16bit sint16_05.I_sint16_3.R01_16bit sint16_05.I_sint16_4.R01_16bit sint16_06.I_sint16_1.R01_16bit sint16_06.I_sint16_2.R01_16bit sint16_06.I_sint16_3.R01_16bit sint16_06.I_sint16_4.R01_16bit sint16_07.I_sint16_1.R01_16bit sint16_07.I_sint16_2.R01_16bit sint16_07.I_sint16_3.R01_16bit sint16_07.I_sint16_4.R01_16bit sint16_08.I_sint16_1.R01_16bit sint16_08.I_sint16_2.R01_16bit sint16_08.I_sint16_3.R01_16bit sint16_08.I_sint16_4.R01_16bit uint16_01.E_uint16_1.R01_16bit uint16_01.E_uint16_2.R01_16bit uint16_01.E_uint16_3.R01_16bit uint16_01.E_uint16_4.R01_16bit uint16_01.I_uint16_1.R01_16bit uint16_01.I_uint16_2.R01_16bit uint16_01.I_uint16_3.R01_16bit uint16_01.I_uint16_4.R01_16bit uint16_02.E_uint16_1.R01_16bit uint16_02.E_uint16_2.R01_16bit uint16_02.E_uint16_3.R01_16bit uint16_02.E_uint16_4.R01_16bit uint16_02.I_uint16_1.R01_16bit uint16_02.I_uint16_2.R01_16bit uint16_02.I_uint16_3.R01_16bit uint16_02.I_uint16_4.R01_16bit uint16_03.E_uint16_1.R01_16bit uint16_03.E_uint16_2.R01_16bit uint16_03.E_uint16_3.R01_16bit uint16_03.E_uint16_4.R01_16bit uint16_03.I_uint16_1.R01_16bit uint16_03.I_uint16_2.R01_16bit uint16_03.I_uint16_3.R01_16bit uint16_03.I_uint16_4.R01_16bit uint16_04.E_uint16_1.R01_16bit uint16_04.E_uint16_2.R01_16bit uint16_04.E_uint16_3.R01_16bit uint16_04.E_uint16_4.R01_16bit uint16_04.I_uint16_1.R01_16bit uint16_04.I_uint16_2.R01_16bit uint16_04.I_uint16_3.R01_16bit uint16_04.I_uint16_4.R01_16bit uint16_05.E_uint16_1.R01_16bit uint16_05.E_uint16_2.R01_16bit uint16_05.E_uint16_3.R01_16bit uint16_05.E_uint16_4.R01_16bit uint16_05.I_uint16_1.R01_16bit uint16_05.I_uint16_2.R01_16bit uint16_05.I_uint16_3.R01_16bit uint16_05.I_uint16_4.R01_16bit uint16_06.E_uint16_1.R01_16bit uint16_06.E_uint16_2.R01_16bit uint16_06.E_uint16_3.R01_16bit uint16_06.E_uint16_4.R01_16bit uint16_06.I_uint16_1.R01_16bit uint16_06.I_uint16_2.R01_16bit uint16_06.I_uint16_3.R01_16bit uint16_06.I_uint16_4.R01_16bit uint16_07.E_uint16_1.R01_16bit uint16_07.E_uint16_2.R01_16bit uint16_07.E_uint16_3.R01_16bit uint16_07.E_uint16_4.R01_16bit uint16_07.I_uint16_1.R01_16bit uint16_07.I_uint16_2.R01_16bit uint16_07.I_uint16_3.R01_16bit uint16_07.I_uint16_4.R01_16bit uint16_08.E_uint16_1.R01_16bit uint16_08.E_uint16_2.R01_16bit uint16_08.E_uint16_3.R01_16bit uint16_08.E_uint16_4.R01_16bit uint16_08.I_uint16_1.R01_16bit uint16_08.I_uint16_2.R01_16bit uint16_08.I_uint16_3.R01_16bit uint16_08.I_uint16_4.R01_16bit /end REF_MEASUREMENT
/end GROUP
/begin GROUP R01_8bit "" ROOT
 /begin REF_MEASUREMENT sint8_01.I_sint8_1.R01_8bit sint8_01.I_sint8_2.R01_8bit sint8_01.I_sint8_3.R01_8bit sint8_01.I_sint8_4.R01_8bit sint8_01.I_sint8_5.R01_8bit sint8_01.I_sint8_6.R01_8bit sint8_01.I_sint8_7.R01_8bit sint8_01.I_sint8_8.R01_8bit sint8_02.I_sint8_1.R01_8bit sint8_02.I_sint8_2.R01_8bit sint8_02.I_sint8_3.R01_8bit sint8_02.I_sint8_4.R01_8bit sint8_02.I_sint8_5.R01_8bit sint8_02.I_sint8_6.R01_8bit sint8_02.I_sint8_7.R01_8bit sint8_02.I_sint8_8.R01_8bit sint8_03.I_sint8_1.R01_8bit sint8_03.I_sint8_2.R01_8bit sint8_03.I_sint8_3.R01_8bit sint8_03.I_sint8_4.R01_8bit sint8_03.I_sint8_5.R01_8bit sint8_03.I_sint8_6.R01_8bit sint8_03.I_sint8_7.R01_8bit sint8_03.I_sint8_8.R01_8bit sint8_04.I_sint8_1.R01_8bit sint8_04.I_sint8_2.R01_8bit sint8_04.I_sint8_3.R01_8bit sint8_04.I_sint8_4.R01_8bit sint8_04.I_sint8_5.R01_8bit sint8_04.I_sint8_6.R01_8bit sint8_04.I_sint8_7.R01_8bit sint8_04.I_sint8_8.R01_8bit sint8_05.I_sint8_1.R01_8bit sint8_05.I_sint8_2.R01_8bit sint8_05.I_sint8_3.R01_8bit sint8_05.I_sint8_4.R01_8bit sint8_05.I_sint8_5.R01_8bit sint8_05.I_sint8_6.R01_8bit sint8_05.I_sint8_7.R01_8bit sint8_05.I_sint8_8.R01_8bit sint8_06.I_sint8_1.R01_8bit sint8_06.I_sint8_2.R01_8bit sint8_06.I_sint8_3.R01_8bit sint8_06.I_sint8_4.R01_8bit sint8_06.I_sint8_5.R01_8bit sint8_06.I_sint8_6.R01_8bit sint8_06.I_sint8_7.R01_8bit sint8_06.I_sint8_8.R01_8bit sint8_07.I_sint8_1.R01_8bit sint8_07.I_sint8_2.R01_8bit sint8_07.I_sint8_3.R01_8bit sint8_07.I_sint8_4.R01_8bit sint8_07.I_sint8_5.R01_8bit sint8_07.I_sint8_6.R01_8bit sint8_07.I_sint8_7.R01_8bit sint8_07.I_sint8_8.R01_8bit sint8_08.I_sint8_1.R01_8bit sint8_08.I_sint8_2.R01_8bit sint8_08.I_sint8_3.R01_8bit sint8_08.I_sint8_4.R01_8bit sint8_08.I_sint8_5.R01_8bit sint8_08.I_sint8_6.R01_8bit sint8_08.I_sint8_7.R01_8bit sint8_08.I_sint8_8.R01_8bit uint8_01.E_uint8_1.R01_8bit uint8_01.E_uint8_2.R01_8bit uint8_01.E_uint8_3.R01_8bit uint8_01.E_uint8_4.R01_8bit uint8_01.E_uint8_5.R01_8bit uint8_01.E_uint8_6.R01_8bit uint8_01.E_uint8_7.R01_8bit uint8_01.E_uint8_8.R01_8bit uint8_01.I_uint8_1.R01_8bit uint8_01.I_uint8_2.R01_8bit uint8_01.I_uint8_3.R01_8bit uint8_01.I_uint8_4.R01_8bit uint8_01.I_uint8_5.R01_8bit uint8_01.I_uint8_6.R01_8bit uint8_01.I_uint8_7.R01_8bit uint8_01.I_uint8_8.R01_8bit uint8_02.E_uint8_1.R01_8bit uint8_02.E_uint8_2.R01_8bit uint8_02.E_uint8_3.R01_8bit uint8_02.E_uint8_4.R01_8bit uint8_02.E_uint8_5.R01_8bit uint8_02.E_uint8_6.R01_8bit uint8_02.E_uint8_7.R01_8bit uint8_02.E_uint8_8.R01_8bit uint8_02.I_uint8_1.R01_8bit uint8_02.I_uint8_2.R01_8bit uint8_02.I_uint8_3.R01_8bit uint8_02.I_uint8_4.R01_8bit uint8_02.I_uint8_5.R01_8bit uint8_02.I_uint8_6.R01_8bit uint8_02.I_uint8_7.R01_8bit uint8_02.I_uint8_8.R01_8bit uint8_03.E_uint8_1.R01_8bit uint8_03.E_uint8_2.R01_8bit uint8_03.E_uint8_3.R01_8bit uint8_03.E_uint8_4.R01_8bit uint8_03.E_uint8_5.R01_8bit uint8_03.E_uint8_6.R01_8bit uint8_03.E_uint8_7.R01_8bit uint8_03.E_uint8_8.R01_8bit uint8_03.I_uint8_1.R01_8bit uint8_03.I_uint8_2.R01_8bit uint8_03.I_uint8_3.R01_8bit uint8_03.I_uint8_4.R01_8bit uint8_03.I_uint8_5.R01_8bit uint8_03.I_uint8_6.R01_8bit uint8_03.I_uint8_7.R01_8bit uint8_03.I_uint8_8.R01_8bit uint8_04.E_uint8_1.R01_8bit uint8_04.E_uint8_2.R01_8bit uint8_04.E_uint8_3.R01_8bit uint8_04.E_uint8_4.R01_8bit uint8_04.E_uint8_5.R01_8bit uint8_04.E_uint8_6.R01_8bit uint8_04.E_uint8_7.R01_8bit uint8_04.E_uint8_8.R01_8bit uint8_04.I_uint8_1.R01_8bit uint8_04.I_uint8_2.R01_8bit uint8_04.I_uint8_3.R01_8bit uint8_04.I_uint8_4.R01_8bit uint8_04.I_uint8_5.R01_8bit uint8_04.I_uint8_6.R01_8bit uint8_04.I_uint8_7.R01_8bit uint8_04.I_uint8_8.R01_8bit uint8_05.E_uint8_1.R01_8bit uint8_05.E_uint8_2.R01_8bit uint8_05.E_uint8_3.R01_8bit uint8_05.E_uint8_4.R01_8bit uint8_05.E_uint8_5.R01_8bit uint8_05.E_uint8_6.R01_8bit uint8_05.E_uint8_7.R01_8bit uint8_05.E_uint8_8.R01_8bit uint8_05.I_uint8_1.R01_8bit uint8_05.I_uint8_2.R01_8bit uint8_05.I_uint8_3.R01_8bit uint8_05.I_uint8_4.R01_8bit uint8_05.I_uint8_5.R01_8bit uint8_05.I_uint8_6.R01_8bit uint8_05.I_uint8_7.R01_8bit uint8_05.I_uint8_8.R01_8bit uint8_06.E_uint8_1.R01_8bit uint8_06.E_uint8_2.R01_8bit uint8_06.E_uint8_3.R01_8bit uint8_06.E_uint8_4.R01_8bit uint8_06.E_uint8_5.R01_8bit uint8_06.E_uint8_6.R01_8bit uint8_06.E_uint8_7.R01_8bit uint8_06.E_uint8_8.R01_8bit uint8_06.I_uint8_1.R01_8bit uint8_06.I_uint8_2.R01_8bit uint8_06.I_uint8_3.R01_8bit uint8_06.I_uint8_4.R01_8bit uint8_06.I_uint8_5.R01_8bit uint8_06.I_uint8_6.R01_8bit uint8_06.I_uint8_7.R01_8bit uint8_06.I_uint8_8.R01_8bit uint8_07.E_uint8_1.R01_8bit uint8_07.E_uint8_2.R01_8bit uint8_07.E_uint8_3.R01_8bit uint8_07.E_uint8_4.R01_8bit uint8_07.E_uint8_5.R01_8bit uint8_07.E_uint8_6.R01_8bit uint8_07.E_uint8_7.R01_8bit uint8_07.E_uint8_8.R01_8bit uint8_07.I_uint8_1.R01_8bit uint8_07.I_uint8_2.R01_8bit uint8_07.I_uint8_3.R01_8bit uint8_07.I_uint8_4.R01_8bit uint8_07.I_uint8_5.R01_8bit uint8_07.I_uint8_6.R01_8bit uint8_07.I_uint8_7.R01_8bit uint8_07.I_uint8_8.R01_8bit uint8_08.E_uint8_1.R01_8bit uint8_08.E_uint8_2.R01_8bit uint8_08.E_uint8_3.R01_8bit uint8_08.E_uint8_4.R01_8bit uint8_08.E_uint8_5.R01_8bit uint8_08.E_uint8_6.R01_8bit uint8_08.E_uint8_7.R01_8bit uint8_08.E_uint8_8.R01_8bit uint8_08.I_uint8_1.R01_8bit uint8_08.I_uint8_2.R01_8bit uint8_08.I_uint8_3.R01_8bit uint8_08.I_uint8_4.R01_8bit uint8_08.I_uint8_5.R01_8bit uint8_08.I_uint8_6.R01_8bit uint8_08.I_uint8_7.R01_8bit uint8_08.I_uint8_8.R01_8bit /end REF_MEASUREMENT
/end GROUP
/begin GROUP R01_B "" ROOT
 /begin REF_MEASUREMENT fl32_01.I_fl32.R01_B fl32_02.I_fl32.R01_B fl32_03.I_fl32.R01_B fl32_04.I_fl32.R01_B fl32_05.I_fl32.R01_B fl32_06.I_fl32.R01_B fl32_07.I_fl32.R01_B fl32_08.I_fl32.R01_B fl64_01.I_fl64.R01_B fl64_02.I_fl64.R01_B fl64_03.I_fl64.R01_B fl64_04.I_fl64.R01_B fl64_05.I_fl64.R01_B fl64_06.I_fl64.R01_B fl64_07.I_fl64.R01_B fl64_08.I_fl64.R01_B sint32_01.I_sint32.R01_B sint32_02.I_sint32.R01_B sint32_03.I_sint32.R01_B sint32_04.I_sint32.R01_B sint32_05.I_sint32.R01_B sint32_06.I_sint32.R01_B sint32_07.I_sint32.R01_B sint32_08.I_sint32.R01_B uint32_01.E_uint32.R01_B uint32_01.I_uint32.R01_B uint32_02.E_uint32.R01_B uint32_02.I_uint32.R01_B uint32_03.E_uint32.R01_B uint32_03.I_uint32.R01_B uint32_04.E_uint32.R01_B uint32_04.I_uint32.R01_B uint32_05.E_uint32.R01_B uint32_05.I_uint32.R01_B uint32_06.E_uint32.R01_B uint32_06.I_uint32.R01_B uint32_07.E_uint32.R01_B uint32_07.I_uint32.R01_B uint32_08.E_uint32.R01_B uint32_08.I_uint32.R01_B /end REF_MEASUREMENT
/end GROUP
/begin GROUP R02 "" ROOT
 /begin REF_MEASUREMENT sint16_01.I_sint16.R02 sint16_02.I_sint16.R02 sint16_03.I_sint16.R02 sint16_04.I_sint16.R02 sint16_05.I_sint16.R02 sint16_06.I_sint16.R02 sint16_07.I_sint16.R02 sint16_08.I_sint16.R02 sint8_01.I_sint8.R02 sint8_02.I_sint8.R02 sint8_03.I_sint8.R02 sint8_04.I_sint8.R02 sint8_05.I_sint8.R02 sint8_06.I_sint8.R02 sint8_07.I_sint8.R02 sint8_08.I_sint8.R02 uint16_01.I_uint16.R02 uint16_02.I_uint16.R02 uint16_03.I_uint16.R02 uint16_04.I_uint16.R02 uint16_05.I_uint16.R02 uint16_06.I_uint16.R02 uint16_07.I_uint16.R02 uint16_08.I_uint16.R02 uint8_01.E_uint8.R02 uint8_01.I_uint8.R02 uint8_02.E_uint8.R02 uint8_02.I_uint8.R02 uint8_03.E_uint8.R02 uint8_03.I_uint8.R02 uint8_04.E_uint8.R02 uint8_04.I_uint8.R02 uint8_05.E_uint8.R02 uint8_05.I_uint8.R02 uint8_06.E_uint8.R02 uint8_06.I_uint8.R02 uint8_07.E_uint8.R02 uint8_07.I_uint8.R02 uint8_08.E_uint8.R02 uint8_08.I_uint8.R02 /end REF_MEASUREMENT
/end GROUP
/begin GROUP R02_B "" ROOT
 /begin REF_MEASUREMENT fl32_01.I_fl32.R02_B fl32_02.I_fl32.R02_B fl32_03.I_fl32.R02_B fl32_04.I_fl32.R02_B fl32_05.I_fl32.R02_B fl32_06.I_fl32.R02_B fl32_07.I_fl32.R02_B fl32_08.I_fl32.R02_B fl64_01.I_fl64.R02_B fl64_02.I_fl64.R02_B fl64_03.I_fl64.R02_B fl64_04.I_fl64.R02_B fl64_05.I_fl64.R02_B fl64_06.I_fl64.R02_B fl64_07.I_fl64.R02_B fl64_08.I_fl64.R02_B sint32_01.I_sint32.R02_B sint32_02.I_sint32.R02_B sint32_03.I_sint32.R02_B sint32_04.I_sint32.R02_B sint32_05.I_sint32.R02_B sint32_06.I_sint32.R02_B sint32_07.I_sint32.R02_B sint32_08.I_sint32.R02_B uint32_01.E_uint32.R02_B uint32_01.I_uint32.R02_B uint32_02.E_uint32.R02_B uint32_02.I_uint32.R02_B uint32_03.E_uint32.R02_B uint32_03.I_uint32.R02_B uint32_04.E_uint32.R02_B uint32_04.I_uint32.R02_B uint32_05.E_uint32.R02_B uint32_05.I_uint32.R02_B uint32_06.E_uint32.R02_B uint32_06.I_uint32.R02_B uint32_07.E_uint32.R02_B uint32_07.I_uint32.R02_B uint32_08.E_uint32.R02_B uint32_08.I_uint32.R02_B /end REF_MEASUREMENT
/end GROUP
/begin GROUP R03 "" ROOT
 /begin REF_MEASUREMENT sint16_01.I_sint16.R03 sint16_02.I_sint16.R03 sint16_03.I_sint16.R03 sint16_04.I_sint16.R03 sint16_05.I_sint16.R03 sint16_06.I_sint16.R03 sint16_07.I_sint16.R03 sint16_08.I_sint16.R03 sint8_01.I_sint8.R03 sint8_02.I_sint8.R03 sint8_03.I_sint8.R03 sint8_04.I_sint8.R03 sint8_05.I_sint8.R03 sint8_06.I_sint8.R03 sint8_07.I_sint8.R03 sint8_08.I_sint8.R03 uint16_01.I_uint16.R03 uint16_02.I_uint16.R03 uint16_03.I_uint16.R03 uint16_04.I_uint16.R03 uint16_05.I_uint16.R03 uint16_06.I_uint16.R03 uint16_07.I_uint16.R03 uint16_08.I_uint16.R03 uint8_01.E_uint8.R03 uint8_01.I_uint8.R03 uint8_02.E_uint8.R03 uint8_02.I_uint8.R03 uint8_03.E_uint8.R03 uint8_03.I_uint8.R03 uint8_04.E_uint8.R03 uint8_04.I_uint8.R03 uint8_05.E_uint8.R03 uint8_05.I_uint8.R03 uint8_06.E_uint8.R03 uint8_06.I_uint8.R03 uint8_07.E_uint8.R03 uint8_07.I_uint8.R03 uint8_08.E_uint8.R03 uint8_08.I_uint8.R03 /end REF_MEASUREMENT
/end GROUP
/begin GROUP R03_B "" ROOT
 /begin REF_MEASUREMENT fl32_01.I_fl32.R03_B fl32_02.I_fl32.R03_B fl32_03.I_fl32.R03_B fl32_04.I_fl32.R03_B fl32_05.I_fl32.R03_B fl32_06.I_fl32.R03_B fl32_07.I_fl32.R03_B fl32_08.I_fl32.R03_B fl64_01.I_fl64.R03_B fl64_02.I_fl64.R03_B fl64_03.I_fl64.R03_B fl64_04.I_fl64.R03_B fl64_05.I_fl64.R03_B fl64_06.I_fl64.R03_B fl64_07.I_fl64.R03_B fl64_08.I_fl64.R03_B sint32_01.I_sint32.R03_B sint32_02.I_sint32.R03_B sint32_03.I_sint32.R03_B sint32_04.I_sint32.R03_B sint32_05.I_sint32.R03_B sint32_06.I_sint32.R03_B sint32_07.I_sint32.R03_B sint32_08.I_sint32.R03_B uint32_01.E_uint32.R03_B uint32_01.I_uint32.R03_B uint32_02.E_uint32.R03_B uint32_02.I_uint32.R03_B uint32_03.E_uint32.R03_B uint32_03.I_uint32.R03_B uint32_04.E_uint32.R03_B uint32_04.I_uint32.R03_B uint32_05.E_uint32.R03_B uint32_05.I_uint32.R03_B uint32_06.E_uint32.R03_B uint32_06.I_uint32.R03_B uint32_07.E_uint32.R03_B uint32_07.I_uint32.R03_B uint32_08.E_uint32.R03_B uint32_08.I_uint32.R03_B /end REF_MEASUREMENT
/end GROUP
/begin GROUP R04 "" ROOT
 /begin REF_MEASUREMENT sint16_01.I_sint16.R04 sint16_02.I_sint16.R04 sint16_03.I_sint16.R04 sint16_04.I_sint16.R04 sint16_05.I_sint16.R04 sint16_06.I_sint16.R04 sint16_07.I_sint16.R04 sint16_08.I_sint16.R04 sint8_01.I_sint8.R04 sint8_02.I_sint8.R04 sint8_03.I_sint8.R04 sint8_04.I_sint8.R04 sint8_05.I_sint8.R04 sint8_06.I_sint8.R04 sint8_07.I_sint8.R04 sint8_08.I_sint8.R04 uint16_01.I_uint16.R04 uint16_02.I_uint16.R04 uint16_03.I_uint16.R04 uint16_04.I_uint16.R04 uint16_05.I_uint16.R04 uint16_06.I_uint16.R04 uint16_07.I_uint16.R04 uint16_08.I_uint16.R04 uint8_01.E_uint8.R04 uint8_01.I_uint8.R04 uint8_02.E_uint8.R04 uint8_02.I_uint8.R04 uint8_03.E_uint8.R04 uint8_03.I_uint8.R04 uint8_04.E_uint8.R04 uint8_04.I_uint8.R04 uint8_05.E_uint8.R04 uint8_05.I_uint8.R04 uint8_06.E_uint8.R04 uint8_06.I_uint8.R04 uint8_07.E_uint8.R04 uint8_07.I_uint8.R04 uint8_08.E_uint8.R04 uint8_08.I_uint8.R04 /end REF_MEASUREMENT
/end GROUP
/begin GROUP R04_B "" ROOT
 /begin REF_MEASUREMENT fl32_01.I_fl32.R04_B fl32_02.I_fl32.R04_B fl32_03.I_fl32.R04_B fl32_04.I_fl32.R04_B fl32_05.I_fl32.R04_B fl32_06.I_fl32.R04_B fl32_07.I_fl32.R04_B fl32_08.I_fl32.R04_B fl64_01.I_fl64.R04_B fl64_02.I_fl64.R04_B fl64_03.I_fl64.R04_B fl64_04.I_fl64.R04_B fl64_05.I_fl64.R04_B fl64_06.I_fl64.R04_B fl64_07.I_fl64.R04_B fl64_08.I_fl64.R04_B sint32_01.I_sint32.R04_B sint32_02.I_sint32.R04_B sint32_03.I_sint32.R04_B sint32_04.I_sint32.R04_B sint32_05.I_sint32.R04_B sint32_06.I_sint32.R04_B sint32_07.I_sint32.R04_B sint32_08.I_sint32.R04_B uint32_01.E_uint32.R04_B uint32_01.I_uint32.R04_B uint32_02.E_uint32.R04_B uint32_02.I_uint32.R04_B uint32_03.E_uint32.R04_B uint32_03.I_uint32.R04_B uint32_04.E_uint32.R04_B uint32_04.I_uint32.R04_B uint32_05.E_uint32.R04_B uint32_05.I_uint32.R04_B uint32_06.E_uint32.R04_B uint32_06.I_uint32.R04_B uint32_07.E_uint32.R04_B uint32_07.I_uint32.R04_B uint32_08.E_uint32.R04_B uint32_08.I_uint32.R04_B /end REF_MEASUREMENT
/end GROUP
/begin GROUP R05 "" ROOT
 /begin REF_MEASUREMENT uint8_01.E_uint8.R05 uint8_02.E_uint8.R05 uint8_03.E_uint8.R05 uint8_04.E_uint8.R05 uint8_05.E_uint8.R05 uint8_06.E_uint8.R05 uint8_07.E_uint8.R05 uint8_08.E_uint8.R05 /end REF_MEASUREMENT
/end GROUP
/begin GROUP R06 "" ROOT
 /begin REF_MEASUREMENT uint8_01.E_uint8.R06 uint8_02.E_uint8.R06 uint8_03.E_uint8.R06 uint8_04.E_uint8.R06 uint8_05.E_uint8.R06 uint8_06.E_uint8.R06 uint8_07.E_uint8.R06 uint8_08.E_uint8.R06 /end REF_MEASUREMENT
/end GROUP
/begin GROUP R07 "" ROOT
 /begin REF_MEASUREMENT uint8_01.E_uint8.R07 uint8_02.E_uint8.R07 uint8_03.E_uint8.R07 uint8_04.E_uint8.R07 uint8_05.E_uint8.R07 uint8_06.E_uint8.R07 uint8_07.E_uint8.R07 uint8_08.E_uint8.R07 /end REF_MEASUREMENT
/end GROUP
/begin GROUP R08 "" ROOT
 /begin REF_MEASUREMENT uint8_01.E_uint8.R08 uint8_02.E_uint8.R08 uint8_03.E_uint8.R08 uint8_04.E_uint8.R08 uint8_05.E_uint8.R08 uint8_06.E_uint8.R08 uint8_07.E_uint8.R08 uint8_08.E_uint8.R08 /end REF_MEASUREMENT
/end GROUP
/begin GROUP R09 "" ROOT
 /begin REF_MEASUREMENT uint16_01.E_uint16.R09 uint16_02.E_uint16.R09 uint16_03.E_uint16.R09 uint16_04.E_uint16.R09 uint16_05.E_uint16.R09 uint16_06.E_uint16.R09 uint16_07.E_uint16.R09 uint16_08.E_uint16.R09 uint8_01.E_uint8.R09 uint8_02.E_uint8.R09 uint8_03.E_uint8.R09 uint8_04.E_uint8.R09 uint8_05.E_uint8.R09 uint8_06.E_uint8.R09 uint8_07.E_uint8.R09 uint8_08.E_uint8.R09 /end REF_MEASUREMENT
/end GROUP
/begin GROUP R10 "" ROOT
 /begin REF_MEASUREMENT uint16_01.E_uint16.R10 uint16_02.E_uint16.R10 uint16_03.E_uint16.R10 uint16_04.E_uint16.R10 uint16_05.E_uint16.R10 uint16_06.E_uint16.R10 uint16_07.E_uint16.R10 uint16_08.E_uint16.R10 uint8_01.E_uint8.R10 uint8_02.E_uint8.R10 uint8_03.E_uint8.R10 uint8_04.E_uint8.R10 uint8_05.E_uint8.R10 uint8_06.E_uint8.R10 uint8_07.E_uint8.R10 uint8_08.E_uint8.R10 /end REF_MEASUREMENT
/end GROUP
/begin GROUP R11 "" ROOT
 /begin REF_MEASUREMENT uint16_01.E_uint16.R11 uint16_02.E_uint16.R11 uint16_03.E_uint16.R11 uint16_04.E_uint16.R11 uint16_05.E_uint16.R11 uint16_06.E_uint16.R11 uint16_07.E_uint16.R11 uint16_08.E_uint16.R11 uint8_01.E_uint8.R11 uint8_02.E_uint8.R11 uint8_03.E_uint8.R11 uint8_04.E_uint8.R11 uint8_05.E_uint8.R11 uint8_06.E_uint8.R11 uint8_07.E_uint8.R11 uint8_08.E_uint8.R11 /end REF_MEASUREMENT
/end GROUP
/begin GROUP R12 "" ROOT
 /begin REF_MEASUREMENT uint16_01.E_uint16.R12 uint16_02.E_uint16.R12 uint16_03.E_uint16.R12 uint16_04.E_uint16.R12 uint16_05.E_uint16.R12 uint16_06.E_uint16.R12 uint16_07.E_uint16.R12 uint16_08.E_uint16.R12 uint8_01.E_uint8.R12 uint8_02.E_uint8.R12 uint8_03.E_uint8.R12 uint8_04.E_uint8.R12 uint8_05.E_uint8.R12 uint8_06.E_uint8.R12 uint8_07.E_uint8.R12 uint8_08.E_uint8.R12 /end REF_MEASUREMENT
/end GROUP
/begin GROUP R13 "" ROOT
 /begin REF_MEASUREMENT uint16_01.E_uint16.R13 uint16_02.E_uint16.R13 uint16_03.E_uint16.R13 uint16_04.E_uint16.R13 uint16_05.E_uint16.R13 uint16_06.E_uint16.R13 uint16_07.E_uint16.R13 uint16_08.E_uint16.R13 uint8_01.E_uint8.R13 uint8_02.E_uint8.R13 uint8_03.E_uint8.R13 uint8_04.E_uint8.R13 uint8_05.E_uint8.R13 uint8_06.E_uint8.R13 uint8_07.E_uint8.R13 uint8_08.E_uint8.R13 /end REF_MEASUREMENT
/end GROUP
/begin GROUP R14 "" ROOT
 /begin REF_MEASUREMENT uint16_01.E_uint16.R14 uint16_02.E_uint16.R14 uint16_03.E_uint16.R14 uint16_04.E_uint16.R14 uint16_05.E_uint16.R14 uint16_06.E_uint16.R14 uint16_07.E_uint16.R14 uint16_08.E_uint16.R14 uint8_01.E_uint8.R14 uint8_02.E_uint8.R14 uint8_03.E_uint8.R14 uint8_04.E_uint8.R14 uint8_05.E_uint8.R14 uint8_06.E_uint8.R14 uint8_07.E_uint8.R14 uint8_08.E_uint8.R14 /end REF_MEASUREMENT
/end GROUP
/begin GROUP R15 "" ROOT
 /begin REF_MEASUREMENT uint16_01.E_uint16.R15 uint16_02.E_uint16.R15 uint16_03.E_uint16.R15 uint16_04.E_uint16.R15 uint16_05.E_uint16.R15 uint16_06.E_uint16.R15 uint16_07.E_uint16.R15 uint16_08.E_uint16.R15 uint8_01.E_uint8.R15 uint8_02.E_uint8.R15 uint8_03.E_uint8.R15 uint8_04.E_uint8.R15 uint8_05.E_uint8.R15 uint8_06.E_uint8.R15 uint8_07.E_uint8.R15 uint8_08.E_uint8.R15 /end REF_MEASUREMENT
/end GROUP
/begin GROUP R16 "" ROOT
 /begin REF_MEASUREMENT uint8_01.E_uint8.R16 uint8_02.E_uint8.R16 uint8_03.E_uint8.R16 uint8_04.E_uint8.R16 uint8_05.E_uint8.R16 uint8_06.E_uint8.R16 uint8_07.E_uint8.R16 uint8_08.E_uint8.R16 /end REF_MEASUREMENT
/end GROUP
/begin GROUP Reset_Schalter "" ROOT
 /begin REF_MEASUREMENT buffer.EdgeRising.Reset_Schalter oldSignal.EdgeRising.Reset_Schalter /end REF_MEASUREMENT
/end GROUP
/begin GROUP clsCounter_B01.Model_Byp_B01 ""
 /begin REF_MEASUREMENT B_cntr_B01_ok.clsCounter_B01.Model_Byp_B01 cntrold_B01.clsCounter_B01.Model_Byp_B01 errcntr_B01.clsCounter_B01.Model_Byp_B01 /end REF_MEASUREMENT
/end GROUP
/begin GROUP counter_send_fast "" ROOT
 /begin REF_MEASUREMENT uint8_01.E_uint8.counter_send_fast uint8_02.E_uint8.counter_send_fast uint8_03.E_uint8.counter_send_fast uint8_04.E_uint8.counter_send_fast uint8_05.E_uint8.counter_send_fast uint8_06.E_uint8.counter_send_fast uint8_07.E_uint8.counter_send_fast uint8_08.E_uint8.counter_send_fast /end REF_MEASUREMENT
/end GROUP
/begin RECORD_LAYOUT STANDARD_DIST_R32 AXIS_PTS_X 2 FLOAT32_IEEE INDEX_INCR DIRECT NO_AXIS_PTS_X 1 UWORD /end RECORD_LAYOUT
/begin RECORD_LAYOUT STANDARD_GROUP_R32 FNC_VALUES 1 FLOAT32_IEEE COLUMN_DIR DIRECT /end RECORD_LAYOUT
/begin RECORD_LAYOUT STANDARD_MAP_R64R64R64 FNC_VALUES 5 FLOAT64_IEEE COLUMN_DIR DIRECT AXIS_PTS_X 3 FLOAT64_IEEE INDEX_INCR DIRECT AXIS_PTS_Y 4 FLOAT64_IEEE INDEX_INCR DIRECT NO_AXIS_PTS_X 1 UWORD NO_AXIS_PTS_Y 2 UWORD /end RECORD_LAYOUT
/begin RECORD_LAYOUT STANDARD_VALUE_R32 FNC_VALUES 1 FLOAT32_IEEE COLUMN_DIR DIRECT /end RECORD_LAYOUT
/begin RECORD_LAYOUT STANDARD_VALUE_R64 FNC_VALUES 1 FLOAT64_IEEE COLUMN_DIR DIRECT /end RECORD_LAYOUT
/begin RECORD_LAYOUT STANDARD_VALUE_S16 FNC_VALUES 1 SWORD COLUMN_DIR DIRECT /end RECORD_LAYOUT
/begin RECORD_LAYOUT STANDARD_VALUE_S32 FNC_VALUES 1 SLONG COLUMN_DIR DIRECT /end RECORD_LAYOUT
/begin RECORD_LAYOUT STANDARD_VALUE_S8 FNC_VALUES 1 SBYTE COLUMN_DIR DIRECT /end RECORD_LAYOUT
/begin RECORD_LAYOUT STANDARD_VALUE_U16 FNC_VALUES 1 UWORD COLUMN_DIR DIRECT /end RECORD_LAYOUT
/begin RECORD_LAYOUT STANDARD_VALUE_U32 FNC_VALUES 1 ULONG COLUMN_DIR DIRECT /end RECORD_LAYOUT
/begin RECORD_LAYOUT STANDARD_VALUE_U8 FNC_VALUES 1 UBYTE COLUMN_DIR DIRECT /end RECORD_LAYOUT
/end MODULE
/end PROJECT

ASAP2_VERSION 1 40
/begin PROJECT ECU_Base_Prj_CAN3Mon_UdsFlashing "Generated by ETAS from Project ECU_Base_Prj_CAN3Mon_UdsFlashing"
/begin HEADER "" VERSION "000" PROJECT_NO ASD /end HEADER
/begin MODULE ECU_Base_Prj_CAN3Mon_UdsFlashing "Generated by ETAS from Project ECU_Base_Prj_CAN3Mon_UdsFlashing"
/begin MOD_COMMON "2009-04-06 10:39:06	create by ETASHexVirtualAddressTableHeaderV2" BYTE_ORDER MSB_FIRST ALIGNMENT_BYTE 1 ALIGNMENT_WORD 2 ALIGNMENT_LONG 4 ALIGNMENT_FLOAT32_IEEE 4 ALIGNMENT_FLOAT64_IEEE 8 /end MOD_COMMON
/begin CHARACTERISTIC HWE_CAN_A_BAUDRATE_P.SHELL.BASE "" VALUE 0x1D9794 STANDARD_VALUE_U8 0.0 enum_HWE_CAN_BAUDRATE_ENUM 0 6 /end CHARACTERISTIC
/begin CHARACTERISTIC HWE_CAN_B_BAUDRATE_P.SHELL.BASE "" VALUE 0x1D9818 STANDARD_VALUE_U8 0.0 enum_HWE_CAN_BAUDRATE_ENUM 0 6 /end CHARACTERISTIC
/begin CHARACTERISTIC HWE_CAN_C_BAUDRATE_P.SHELL.BASE "" VALUE 0x1D978C STANDARD_VALUE_U8 0.0 enum_HWE_CAN_BAUDRATE_ENUM 0 6 /end CHARACTERISTIC
/begin CHARACTERISTIC HWE_CANA_OBD_TX_P7.SHELL.BASE "" VALUE 0x1D97A4 STANDARD_VALUE_U32 0.0 ident 0 4294967295 /end CHARACTERISTIC
/begin CHARACTERISTIC HWE_CANA_StopDebTicks.SHELL.BASE "" VALUE 0x1D9810 STANDARD_VALUE_U32 0.0 ident 0 4294967295 /end CHARACTERISTIC
/begin CHARACTERISTIC HWE_CANA_UseBusOffTimer.SHELL.BASE "" VALUE 0x1D97D8 STANDARD_VALUE_S8 0.0 ident 0 1 BIT_MASK 0x1 /end CHARACTERISTIC
/begin CHARACTERISTIC HWE_CANB_CCP_DAQ0_P4.SHELL.BASE "" VALUE 0x1D97B4 STANDARD_VALUE_U32 0.0 ident 0 4294967295 /end CHARACTERISTIC
/begin CHARACTERISTIC HWE_CANB_CCP_DAQ1_P5.SHELL.BASE "" VALUE 0x1D981C STANDARD_VALUE_U32 0.0 ident 0 4294967295 /end CHARACTERISTIC
/begin CHARACTERISTIC HWE_CANB_CCP_DAQ2_P6.SHELL.BASE "" VALUE 0x1D9784 STANDARD_VALUE_U32 0.0 ident 0 4294967295 /end CHARACTERISTIC
/begin CHARACTERISTIC HWE_CANB_CCP_RX_P2.SHELL.BASE "" VALUE 0x1D97A8 STANDARD_VALUE_U32 0.0 ident 0 4294967295 /end CHARACTERISTIC
/begin CHARACTERISTIC HWE_CANB_CCP_TX_P3.SHELL.BASE "" VALUE 0x1D97FC STANDARD_VALUE_U32 0.0 ident 0 4294967295 /end CHARACTERISTIC
/begin CHARACTERISTIC HWE_CANB_MUX_ID5xx_P8.SHELL.BASE "" VALUE 0x1D97E0 STANDARD_VALUE_U32 0.0 ident 0 4294967295 /end CHARACTERISTIC
/begin CHARACTERISTIC HWE_CANB_StopDebTicks.SHELL.BASE "" VALUE 0x1D97D0 STANDARD_VALUE_U32 0.0 ident 0 4294967295 /end CHARACTERISTIC
/begin CHARACTERISTIC HWE_CANB_UseBusOffTimer.SHELL.BASE "" VALUE 0x1D97D9 STANDARD_VALUE_S8 0.0 ident 0 1 BIT_MASK 0x1 /end CHARACTERISTIC
/begin CHARACTERISTIC HWE_CANB_XCP_CMD_RX_P4.SHELL.BASE "" VALUE 0x1D97D4 STANDARD_VALUE_U32 0.0 ident 0 4294967295 /end CHARACTERISTIC
/begin CHARACTERISTIC HWE_CANB_XCP_DAQ0_P6.SHELL.BASE "" VALUE 0x1D980C STANDARD_VALUE_U32 0.0 ident 0 4294967295 /end CHARACTERISTIC
/begin CHARACTERISTIC HWE_CANB_XCP_RES_TX_P5.SHELL.BASE "" VALUE 0x1D9788 STANDARD_VALUE_U32 0.0 ident 0 4294967295 /end CHARACTERISTIC
/begin CHARACTERISTIC HWE_CANB_XCP_STIM0_P0.SHELL.BASE "" VALUE 0x1D97C8 STANDARD_VALUE_U32 0.0 ident 0 4294967295 /end CHARACTERISTIC
/begin CHARACTERISTIC HWE_CANB_XCP_STIM1_P1.SHELL.BASE "" VALUE 0x1D97EC STANDARD_VALUE_U32 0.0 ident 0 4294967295 /end CHARACTERISTIC
/begin CHARACTERISTIC HWE_CANB_XCP_STIM2_P2.SHELL.BASE "" VALUE 0x1D97B0 STANDARD_VALUE_U32 0.0 ident 0 4294967295 /end CHARACTERISTIC
/begin CHARACTERISTIC HWE_CANB_XCP_STIM3_P3.SHELL.BASE "" VALUE 0x1D97C0 STANDARD_VALUE_U32 0.0 ident 0 4294967295 /end CHARACTERISTIC
/begin CHARACTERISTIC HWE_CANC_StopDebTicks.SHELL.BASE "" VALUE 0x1D9800 STANDARD_VALUE_U32 0.0 ident 0 4294967295 /end CHARACTERISTIC
/begin CHARACTERISTIC HWE_CANC_UseBusOffTimer.SHELL.BASE "" VALUE 0x1D97BA STANDARD_VALUE_S8 0.0 ident 0 1 BIT_MASK 0x1 /end CHARACTERISTIC
/begin CHARACTERISTIC HWE_IP09_DcycMax.SHELL.BASE "" VALUE 0x1D97CC STANDARD_VALUE_S16 0.0 TPU_Dcyc 0.0 327.67 /end CHARACTERISTIC
/begin CHARACTERISTIC HWE_IP09_DcycMin.SHELL.BASE "" VALUE 0x1D9808 STANDARD_VALUE_S16 0.0 TPU_Dcyc 0.0 327.67 /end CHARACTERISTIC
/begin CHARACTERISTIC HWE_IP09_PerMax.SHELL.BASE "" VALUE 0x1D97AC STANDARD_VALUE_S16 0.0 TPU_Dcyc 0.0 327.67 /end CHARACTERISTIC
/begin CHARACTERISTIC HWE_IP09_PerMin.SHELL.BASE "" VALUE 0x1D97E8 STANDARD_VALUE_S16 0.0 TPU_Dcyc 0.0 327.67 /end CHARACTERISTIC
/begin CHARACTERISTIC HWE_IP10_DcycMax.SHELL.BASE "" VALUE 0x1D97F8 STANDARD_VALUE_S16 0.0 TPU_Dcyc 0.0 327.67 /end CHARACTERISTIC
/begin CHARACTERISTIC HWE_IP10_DcycMin.SHELL.BASE "" VALUE 0x1D97DA STANDARD_VALUE_S16 0.0 TPU_Dcyc 0.0 327.67 /end CHARACTERISTIC
/begin CHARACTERISTIC HWE_IP10_PerMax.SHELL.BASE "" VALUE 0x1D97BC STANDARD_VALUE_S16 0.0 TPU_Dcyc 0.0 327.67 /end CHARACTERISTIC
/begin CHARACTERISTIC HWE_IP10_PerMin.SHELL.BASE "" VALUE 0x1D9816 STANDARD_VALUE_S16 0.0 TPU_Dcyc 0.0 327.67 /end CHARACTERISTIC
/begin CHARACTERISTIC HWE_IP11_DcycMax.SHELL.BASE "" VALUE 0x1D9814 STANDARD_VALUE_S16 0.0 TPU_Dcyc 0.0 327.67 /end CHARACTERISTIC
/begin CHARACTERISTIC HWE_IP11_DcycMin.SHELL.BASE "" VALUE 0x1D97F4 STANDARD_VALUE_S16 0.0 TPU_Dcyc 0.0 327.67 /end CHARACTERISTIC
/begin CHARACTERISTIC HWE_IP11_PerMax.SHELL.BASE "" VALUE 0x1D97A0 STANDARD_VALUE_S16 0.0 TPU_Dcyc 0.0 327.67 /end CHARACTERISTIC
/begin CHARACTERISTIC HWE_IP11_PerMin.SHELL.BASE "" VALUE 0x1D9804 STANDARD_VALUE_S16 0.0 TPU_Dcyc 0.0 327.67 /end CHARACTERISTIC
/begin CHARACTERISTIC HWE_IP12_DcycMax.SHELL.BASE "" VALUE 0x1D97DC STANDARD_VALUE_S16 0.0 TPU_Dcyc 0.0 327.67 /end CHARACTERISTIC
/begin CHARACTERISTIC HWE_IP12_DcycMin.SHELL.BASE "" VALUE 0x1D97F2 STANDARD_VALUE_S16 0.0 TPU_Dcyc 0.0 327.67 /end CHARACTERISTIC
/begin CHARACTERISTIC HWE_IP12_PerMax.SHELL.BASE "" VALUE 0x1D979E STANDARD_VALUE_S16 0.0 TPU_Dcyc 0.0 327.67 /end CHARACTERISTIC
/begin CHARACTERISTIC HWE_IP12_PerMin.SHELL.BASE "" VALUE 0x1D97B8 STANDARD_VALUE_S16 0.0 TPU_Dcyc 0.0 327.67 /end CHARACTERISTIC
/begin CHARACTERISTIC HWE_OIC01_Per.SHELL.BASE "" VALUE 0x1D97EA STANDARD_VALUE_S16 0.0 TPU_PerOut 0.0 3276.7 /end CHARACTERISTIC
/begin CHARACTERISTIC HWE_OIC02_Per.SHELL.BASE "" VALUE 0x1D9806 STANDARD_VALUE_S16 0.0 TPU_PerOut 0.0 3276.7 /end CHARACTERISTIC
/begin CHARACTERISTIC HWE_OPI01_Per.SHELL.BASE "" VALUE 0x1D9780 STANDARD_VALUE_S16 0.0 TPU_PerOut 0.0 3276.7 /end CHARACTERISTIC
/begin CHARACTERISTIC HWE_OPI02_Per.SHELL.BASE "" VALUE 0x1D9782 STANDARD_VALUE_S16 0.0 TPU_PerOut 0.0 3276.7 /end CHARACTERISTIC
/begin CHARACTERISTIC HWE_OPI03_Per.SHELL.BASE "" VALUE 0x1D979C STANDARD_VALUE_S16 0.0 TPU_PerOut 0.0 3276.7 /end CHARACTERISTIC
/begin CHARACTERISTIC HWE_OPI04_Per.SHELL.BASE "" VALUE 0x1D978E STANDARD_VALUE_S16 0.0 TPU_PerOut 0.0 3276.7 /end CHARACTERISTIC
/begin CHARACTERISTIC HWE_OPI05_Per.SHELL.BASE "" VALUE 0x1D979A STANDARD_VALUE_S16 0.0 TPU_PerOut 0.0 3276.7 /end CHARACTERISTIC
/begin CHARACTERISTIC HWE_OPI06_Per.SHELL.BASE "" VALUE 0x1D9796 STANDARD_VALUE_S16 0.0 TPU_PerOut 0.0 3276.7 /end CHARACTERISTIC
/begin CHARACTERISTIC HWE_OPI07_Per.SHELL.BASE "" VALUE 0x1D9790 STANDARD_VALUE_S16 0.0 TPU_PerOut 0.0 3276.7 /end CHARACTERISTIC
/begin CHARACTERISTIC HWE_OPI08_Per.SHELL.BASE "" VALUE 0x1D9792 STANDARD_VALUE_S16 0.0 TPU_PerOut 0.0 3276.7 /end CHARACTERISTIC
/begin CHARACTERISTIC HWE_OPI09_Per.SHELL.BASE "" VALUE 0x1D9798 STANDARD_VALUE_S16 0.0 TPU_PerOut 0.0 3276.7 /end CHARACTERISTIC
/begin CHARACTERISTIC HWE_OPI10_Per.SHELL.BASE "" VALUE 0x1D97F0 STANDARD_VALUE_S16 0.0 TPU_PerOut 0.0 3276.7 /end CHARACTERISTIC
/begin CHARACTERISTIC HWE_OPI11_Per.SHELL.BASE "" VALUE 0x1D97F6 STANDARD_VALUE_S16 0.0 TPU_PerOut 0.0 3276.7 /end CHARACTERISTIC
/begin CHARACTERISTIC HWE_OS01_S_Per.SHELL.BASE "" VALUE 0x1D97BE STANDARD_VALUE_U16 0.0 TPU_PerOut 0.0 6553.5 /end CHARACTERISTIC
/begin CHARACTERISTIC HWE_OS02_S_Per.SHELL.BASE "" VALUE 0x1D981A STANDARD_VALUE_U16 0.0 TPU_PerOut 0.0 6553.5 /end CHARACTERISTIC
/begin CHARACTERISTIC HWE_Rtmo_adStart.SHELL.BASE "" VALUE 0x1D97E4 STANDARD_VALUE_U32 0.0 ident 0 4294967295 /end CHARACTERISTIC
/begin CHARACTERISTIC HWE_Rtmo_stSampleTime.SHELL.BASE "" VALUE 0x1D97C4 STANDARD_VALUE_U32 0.0 ident 0 4294967295 /end CHARACTERISTIC
/begin CHARACTERISTIC HWE_Rtmo_Tasks.HWE.BASE "" VALUE 0x1D1BE0 STANDARD_VALUE_U8 0.0 enum_Tasks 0 4 /end CHARACTERISTIC
/begin CHARACTERISTIC iflag_mask.HWE.BASE "" VAL_BLK 0x1D1BD4 STANDARD_VALUE_U16 0.0 ident 0 65535 MATRIX_DIM 4 1 1 /end CHARACTERISTIC
/begin CHARACTERISTIC P_Curve_in_x.Axis_Input.CURVE_Axis "" VALUE 0x1D0054 STANDARD_VALUE_U16 0.0 ident 0 65535 /end CHARACTERISTIC
/begin CHARACTERISTIC p_dBRP_u8.HWE_CAN_A.SHELL.BASE "" VALUE 0x1D9760 STANDARD_VALUE_U8 0.0 ident 1 64 /end CHARACTERISTIC
/begin CHARACTERISTIC p_dBRP_u8.HWE_CAN_B.SHELL.BASE "" VALUE 0x1D976C STANDARD_VALUE_U8 0.0 ident 1 64 /end CHARACTERISTIC
/begin CHARACTERISTIC p_dBRP_u8.HWE_CAN_C.SHELL.BASE "" VALUE 0x1D9778 STANDARD_VALUE_U8 0.0 ident 1 64 /end CHARACTERISTIC
/begin CHARACTERISTIC P_Do_Active_Std.STD_float32_float32_float32.All_Maps_STD.Maps_Raster_1 "" VALUE 0x1D3284 STANDARD_VALUE_U8 0.0 ident 0 1 BIT_MASK 0x1 /end CHARACTERISTIC
/begin CHARACTERISTIC P_Do_Active_Std.STD_float32_float32_float32.All_Maps_STD.Maps_Raster_2 "" VALUE 0x1D4C48 STANDARD_VALUE_U8 0.0 ident 0 1 BIT_MASK 0x1 /end CHARACTERISTIC
/begin CHARACTERISTIC P_Do_Active_Std.STD_float32_float32_float32.All_Maps_STD.Maps_Raster_3 "" VALUE 0x1D660C STANDARD_VALUE_U8 0.0 ident 0 1 BIT_MASK 0x1 /end CHARACTERISTIC
/begin CHARACTERISTIC P_Do_Active_Std.STD_sint16_sint16_sint16.All_Maps_STD.Maps_Raster_1 "" VALUE 0x1D3474 STANDARD_VALUE_U8 0.0 ident 0 1 BIT_MASK 0x1 /end CHARACTERISTIC
/begin CHARACTERISTIC P_Do_Active_Std.STD_sint16_sint16_sint16.All_Maps_STD.Maps_Raster_2 "" VALUE 0x1D4E38 STANDARD_VALUE_U8 0.0 ident 0 1 BIT_MASK 0x1 /end CHARACTERISTIC
/begin CHARACTERISTIC P_Do_Active_Std.STD_sint16_sint16_sint16.All_Maps_STD.Maps_Raster_3 "" VALUE 0x1D67FC STANDARD_VALUE_U8 0.0 ident 0 1 BIT_MASK 0x1 /end CHARACTERISTIC
/begin CHARACTERISTIC P_Do_Active_Std.STD_sint32_sint32_sint32.All_Maps_STD.Maps_Raster_1 "" VALUE 0x1D3578 STANDARD_VALUE_U8 0.0 ident 0 1 BIT_MASK 0x1 /end CHARACTERISTIC
/begin CHARACTERISTIC P_Do_Active_Std.STD_sint32_sint32_sint32.All_Maps_STD.Maps_Raster_2 "" VALUE 0x1D4F3C STANDARD_VALUE_U8 0.0 ident 0 1 BIT_MASK 0x1 /end CHARACTERISTIC
/begin CHARACTERISTIC P_Do_Active_Std.STD_sint32_sint32_sint32.All_Maps_STD.Maps_Raster_3 "" VALUE 0x1D6900 STANDARD_VALUE_U8 0.0 ident 0 1 BIT_MASK 0x1 /end CHARACTERISTIC
/begin CHARACTERISTIC P_Do_Active_Std.STD_sint8_sint8_sint8.All_Maps_STD.Maps_Raster_1 "" VALUE 0x1D3764 STANDARD_VALUE_U8 0.0 ident 0 1 BIT_MASK 0x1 /end CHARACTERISTIC
/begin CHARACTERISTIC P_Do_Active_Std.STD_sint8_sint8_sint8.All_Maps_STD.Maps_Raster_2 "" VALUE 0x1D5128 STANDARD_VALUE_U8 0.0 ident 0 1 BIT_MASK 0x1 /end CHARACTERISTIC
/begin CHARACTERISTIC P_Do_Active_Std.STD_sint8_sint8_sint8.All_Maps_STD.Maps_Raster_3 "" VALUE 0x1D6AEC STANDARD_VALUE_U8 0.0 ident 0 1 BIT_MASK 0x1 /end CHARACTERISTIC
/begin CHARACTERISTIC P_Do_Active_Std.STD_uint16_uint16_uint16.All_Maps_STD.Maps_Raster_1 "" VALUE 0x1D37EC STANDARD_VALUE_U8 0.0 ident 0 1 BIT_MASK 0x1 /end CHARACTERISTIC
/begin CHARACTERISTIC P_Do_Active_Std.STD_uint16_uint16_uint16.All_Maps_STD.Maps_Raster_2 "" VALUE 0x1D51B0 STANDARD_VALUE_U8 0.0 ident 0 1 BIT_MASK 0x1 /end CHARACTERISTIC
/begin CHARACTERISTIC P_Do_Active_Std.STD_uint16_uint16_uint16.All_Maps_STD.Maps_Raster_3 "" VALUE 0x1D6B74 STANDARD_VALUE_U8 0.0 ident 0 1 BIT_MASK 0x1 /end CHARACTERISTIC
/begin CHARACTERISTIC P_Do_Active_Std.STD_uint32_uint32_uint32.All_Maps_STD.Maps_Raster_1 "" VALUE 0x1D38F0 STANDARD_VALUE_U8 0.0 ident 0 1 BIT_MASK 0x1 /end CHARACTERISTIC
/begin CHARACTERISTIC P_Do_Active_Std.STD_uint32_uint32_uint32.All_Maps_STD.Maps_Raster_2 "" VALUE 0x1D52B4 STANDARD_VALUE_U8 0.0 ident 0 1 BIT_MASK 0x1 /end CHARACTERISTIC
/begin CHARACTERISTIC P_Do_Active_Std.STD_uint32_uint32_uint32.All_Maps_STD.Maps_Raster_3 "" VALUE 0x1D6C78 STANDARD_VALUE_U8 0.0 ident 0 1 BIT_MASK 0x1 /end CHARACTERISTIC
/begin CHARACTERISTIC P_Do_Active_Std.STD_uint8_uint8_uint8.All_Maps_STD.Maps_Raster_1 "" VALUE 0x1D3ADC STANDARD_VALUE_U8 0.0 ident 0 1 BIT_MASK 0x1 /end CHARACTERISTIC
/begin CHARACTERISTIC P_Do_Active_Std.STD_uint8_uint8_uint8.All_Maps_STD.Maps_Raster_2 "" VALUE 0x1D54A0 STANDARD_VALUE_U8 0.0 ident 0 1 BIT_MASK 0x1 /end CHARACTERISTIC
/begin CHARACTERISTIC P_Do_Active_Std.STD_uint8_uint8_uint8.All_Maps_STD.Maps_Raster_3 "" VALUE 0x1D6E64 STANDARD_VALUE_U8 0.0 ident 0 1 BIT_MASK 0x1 /end CHARACTERISTIC
/begin CHARACTERISTIC P_Do_All_STD_Maps.All_Maps_STD.Maps_Raster_1 "" VALUE 0x1D3274 STANDARD_VALUE_U8 0.0 ident 0 1 BIT_MASK 0x1 /end CHARACTERISTIC
/begin CHARACTERISTIC P_Do_All_STD_Maps.All_Maps_STD.Maps_Raster_2 "" VALUE 0x1D4C38 STANDARD_VALUE_U8 0.0 ident 0 1 BIT_MASK 0x1 /end CHARACTERISTIC
/begin CHARACTERISTIC P_Do_All_STD_Maps.All_Maps_STD.Maps_Raster_3 "" VALUE 0x1D65FC STANDARD_VALUE_U8 0.0 ident 0 1 BIT_MASK 0x1 /end CHARACTERISTIC
/begin CHARACTERISTIC p_dPropSeg_u8.HWE_CAN_A.SHELL.BASE "" VALUE 0x1D9763 STANDARD_VALUE_U8 0.0 ident 1 8 /end CHARACTERISTIC
/begin CHARACTERISTIC p_dPropSeg_u8.HWE_CAN_B.SHELL.BASE "" VALUE 0x1D976F STANDARD_VALUE_U8 0.0 ident 1 8 /end CHARACTERISTIC
/begin CHARACTERISTIC p_dPropSeg_u8.HWE_CAN_C.SHELL.BASE "" VALUE 0x1D977B STANDARD_VALUE_U8 0.0 ident 1 8 /end CHARACTERISTIC
/begin CHARACTERISTIC p_dPSeg1_u8.HWE_CAN_A.SHELL.BASE "" VALUE 0x1D9761 STANDARD_VALUE_U8 0.0 ident 1 8 /end CHARACTERISTIC
/begin CHARACTERISTIC p_dPSeg1_u8.HWE_CAN_B.SHELL.BASE "" VALUE 0x1D976D STANDARD_VALUE_U8 0.0 ident 1 8 /end CHARACTERISTIC
/begin CHARACTERISTIC p_dPSeg1_u8.HWE_CAN_C.SHELL.BASE "" VALUE 0x1D9779 STANDARD_VALUE_U8 0.0 ident 1 8 /end CHARACTERISTIC
/begin CHARACTERISTIC p_dPSeg2_u8.HWE_CAN_A.SHELL.BASE "" VALUE 0x1D9762 STANDARD_VALUE_U8 0.0 ident 1 8 /end CHARACTERISTIC
/begin CHARACTERISTIC p_dPSeg2_u8.HWE_CAN_B.SHELL.BASE "" VALUE 0x1D976E STANDARD_VALUE_U8 0.0 ident 1 8 /end CHARACTERISTIC
/begin CHARACTERISTIC p_dPSeg2_u8.HWE_CAN_C.SHELL.BASE "" VALUE 0x1D977A STANDARD_VALUE_U8 0.0 ident 1 8 /end CHARACTERISTIC
/begin CHARACTERISTIC p_dSJW_u8.HWE_CAN_A.SHELL.BASE "" VALUE 0x1D9764 STANDARD_VALUE_U8 0.0 ident 1 4 /end CHARACTERISTIC
/begin CHARACTERISTIC p_dSJW_u8.HWE_CAN_B.SHELL.BASE "" VALUE 0x1D9770 STANDARD_VALUE_U8 0.0 ident 1 4 /end CHARACTERISTIC
/begin CHARACTERISTIC p_dSJW_u8.HWE_CAN_C.SHELL.BASE "" VALUE 0x1D977C STANDARD_VALUE_U8 0.0 ident 1 4 /end CHARACTERISTIC
/begin CHARACTERISTIC P_In_X.STD_float32_float32_float32.All_Maps_STD.Maps_Raster_1 "" VALUE 0x1D327C STANDARD_VALUE_R32 0.0 ident -1.e+037 1.e+037 /end CHARACTERISTIC
/begin CHARACTERISTIC P_In_X.STD_float32_float32_float32.All_Maps_STD.Maps_Raster_2 "" VALUE 0x1D4C40 STANDARD_VALUE_R32 0.0 ident -1.e+037 1.e+037 /end CHARACTERISTIC
/begin CHARACTERISTIC P_In_X.STD_float32_float32_float32.All_Maps_STD.Maps_Raster_3 "" VALUE 0x1D6604 STANDARD_VALUE_R32 0.0 ident -1.e+037 1.e+037 /end CHARACTERISTIC
/begin CHARACTERISTIC P_In_X.STD_sint16_sint16_sint16.All_Maps_STD.Maps_Raster_1 "" VALUE 0x1D3470 STANDARD_VALUE_S16 0.0 ident -32768.0 32767.0 /end CHARACTERISTIC
/begin CHARACTERISTIC P_In_X.STD_sint16_sint16_sint16.All_Maps_STD.Maps_Raster_2 "" VALUE 0x1D4E34 STANDARD_VALUE_S16 0.0 ident -32768.0 32767.0 /end CHARACTERISTIC
/begin CHARACTERISTIC P_In_X.STD_sint16_sint16_sint16.All_Maps_STD.Maps_Raster_3 "" VALUE 0x1D67F8 STANDARD_VALUE_S16 0.0 ident -32768.0 32767.0 /end CHARACTERISTIC
/begin CHARACTERISTIC P_In_X.STD_sint32_sint32_sint32.All_Maps_STD.Maps_Raster_1 "" VALUE 0x1D3570 STANDARD_VALUE_S32 0.0 ident -2147483648.0 2147483647.0 /end CHARACTERISTIC
/begin CHARACTERISTIC P_In_X.STD_sint32_sint32_sint32.All_Maps_STD.Maps_Raster_2 "" VALUE 0x1D4F34 STANDARD_VALUE_S32 0.0 ident -2147483648.0 2147483647.0 /end CHARACTERISTIC
/begin CHARACTERISTIC P_In_X.STD_sint32_sint32_sint32.All_Maps_STD.Maps_Raster_3 "" VALUE 0x1D68F8 STANDARD_VALUE_S32 0.0 ident -2147483648.0 2147483647.0 /end CHARACTERISTIC
/begin CHARACTERISTIC P_In_X.STD_sint8_sint8_sint8.All_Maps_STD.Maps_Raster_1 "" VALUE 0x1D3765 STANDARD_VALUE_S8 0.0 ident -128.0 127.0 /end CHARACTERISTIC
/begin CHARACTERISTIC P_In_X.STD_sint8_sint8_sint8.All_Maps_STD.Maps_Raster_2 "" VALUE 0x1D5129 STANDARD_VALUE_S8 0.0 ident -128.0 127.0 /end CHARACTERISTIC
/begin CHARACTERISTIC P_In_X.STD_sint8_sint8_sint8.All_Maps_STD.Maps_Raster_3 "" VALUE 0x1D6AED STANDARD_VALUE_S8 0.0 ident -128.0 127.0 /end CHARACTERISTIC
/begin CHARACTERISTIC P_In_X.STD_uint16_uint16_uint16.All_Maps_STD.Maps_Raster_1 "" VALUE 0x1D37E8 STANDARD_VALUE_U16 0.0 ident 0.0 65535.0 /end CHARACTERISTIC
/begin CHARACTERISTIC P_In_X.STD_uint16_uint16_uint16.All_Maps_STD.Maps_Raster_2 "" VALUE 0x1D51AC STANDARD_VALUE_U16 0.0 ident 0.0 65535.0 /end CHARACTERISTIC
/begin CHARACTERISTIC P_In_X.STD_uint16_uint16_uint16.All_Maps_STD.Maps_Raster_3 "" VALUE 0x1D6B70 STANDARD_VALUE_U16 0.0 ident 0.0 65535.0 /end CHARACTERISTIC
/begin CHARACTERISTIC P_In_X.STD_uint32_uint32_uint32.All_Maps_STD.Maps_Raster_1 "" VALUE 0x1D38E8 STANDARD_VALUE_U32 0.0 ident 0.0 4294967295.0 /end CHARACTERISTIC
/begin CHARACTERISTIC P_In_X.STD_uint32_uint32_uint32.All_Maps_STD.Maps_Raster_2 "" VALUE 0x1D52AC STANDARD_VALUE_U32 0.0 ident 0.0 4294967295.0 /end CHARACTERISTIC
/begin CHARACTERISTIC P_In_X.STD_uint32_uint32_uint32.All_Maps_STD.Maps_Raster_3 "" VALUE 0x1D6C70 STANDARD_VALUE_U32 0.0 ident 0.0 4294967295.0 /end CHARACTERISTIC
/begin CHARACTERISTIC P_In_X.STD_uint8_uint8_uint8.All_Maps_STD.Maps_Raster_1 "" VALUE 0x1D3ADD STANDARD_VALUE_U8 0.0 ident 0.0 255.0 /end CHARACTERISTIC
/begin CHARACTERISTIC P_In_X.STD_uint8_uint8_uint8.All_Maps_STD.Maps_Raster_2 "" VALUE 0x1D54A1 STANDARD_VALUE_U8 0.0 ident 0.0 255.0 /end CHARACTERISTIC
/begin CHARACTERISTIC P_In_X.STD_uint8_uint8_uint8.All_Maps_STD.Maps_Raster_3 "" VALUE 0x1D6E65 STANDARD_VALUE_U8 0.0 ident 0.0 255.0 /end CHARACTERISTIC
/begin CHARACTERISTIC P_In_Y.STD_float32_float32_float32.All_Maps_STD.Maps_Raster_1 "" VALUE 0x1D3280 STANDARD_VALUE_R32 0.0 ident -1.e+037 1.e+037 /end CHARACTERISTIC
/begin CHARACTERISTIC P_In_Y.STD_float32_float32_float32.All_Maps_STD.Maps_Raster_2 "" VALUE 0x1D4C44 STANDARD_VALUE_R32 0.0 ident -1.e+037 1.e+037 /end CHARACTERISTIC
/begin CHARACTERISTIC P_In_Y.STD_float32_float32_float32.All_Maps_STD.Maps_Raster_3 "" VALUE 0x1D6608 STANDARD_VALUE_R32 0.0 ident -1.e+037 1.e+037 /end CHARACTERISTIC
/begin CHARACTERISTIC P_In_Y.STD_sint16_sint16_sint16.All_Maps_STD.Maps_Raster_1 "" VALUE 0x1D3472 STANDARD_VALUE_S16 0.0 ident -32768.0 32767.0 /end CHARACTERISTIC
/begin CHARACTERISTIC P_In_Y.STD_sint16_sint16_sint16.All_Maps_STD.Maps_Raster_2 "" VALUE 0x1D4E36 STANDARD_VALUE_S16 0.0 ident -32768.0 32767.0 /end CHARACTERISTIC
/begin CHARACTERISTIC P_In_Y.STD_sint16_sint16_sint16.All_Maps_STD.Maps_Raster_3 "" VALUE 0x1D67FA STANDARD_VALUE_S16 0.0 ident -32768.0 32767.0 /end CHARACTERISTIC
/begin CHARACTERISTIC P_In_Y.STD_sint32_sint32_sint32.All_Maps_STD.Maps_Raster_1 "" VALUE 0x1D3574 STANDARD_VALUE_S32 0.0 ident -2147483648.0 2147483647.0 /end CHARACTERISTIC
/begin CHARACTERISTIC P_In_Y.STD_sint32_sint32_sint32.All_Maps_STD.Maps_Raster_2 "" VALUE 0x1D4F38 STANDARD_VALUE_S32 0.0 ident -2147483648.0 2147483647.0 /end CHARACTERISTIC
/begin CHARACTERISTIC P_In_Y.STD_sint32_sint32_sint32.All_Maps_STD.Maps_Raster_3 "" VALUE 0x1D68FC STANDARD_VALUE_S32 0.0 ident -2147483648.0 2147483647.0 /end CHARACTERISTIC
/begin CHARACTERISTIC P_In_Y.STD_sint8_sint8_sint8.All_Maps_STD.Maps_Raster_1 "" VALUE 0x1D3766 STANDARD_VALUE_S8 0.0 ident -128.0 127.0 /end CHARACTERISTIC
/begin CHARACTERISTIC P_In_Y.STD_sint8_sint8_sint8.All_Maps_STD.Maps_Raster_2 "" VALUE 0x1D512A STANDARD_VALUE_S8 0.0 ident -128.0 127.0 /end CHARACTERISTIC
/begin CHARACTERISTIC P_In_Y.STD_sint8_sint8_sint8.All_Maps_STD.Maps_Raster_3 "" VALUE 0x1D6AEE STANDARD_VALUE_S8 0.0 ident -128.0 127.0 /end CHARACTERISTIC
/begin CHARACTERISTIC P_In_Y.STD_uint16_uint16_uint16.All_Maps_STD.Maps_Raster_1 "" VALUE 0x1D37EA STANDARD_VALUE_U16 0.0 ident 0.0 65535.0 /end CHARACTERISTIC
/begin CHARACTERISTIC P_In_Y.STD_uint16_uint16_uint16.All_Maps_STD.Maps_Raster_2 "" VALUE 0x1D51AE STANDARD_VALUE_U16 0.0 ident 0.0 65535.0 /end CHARACTERISTIC
/begin CHARACTERISTIC P_In_Y.STD_uint16_uint16_uint16.All_Maps_STD.Maps_Raster_3 "" VALUE 0x1D6B72 STANDARD_VALUE_U16 0.0 ident 0.0 65535.0 /end CHARACTERISTIC
/begin CHARACTERISTIC P_In_Y.STD_uint32_uint32_uint32.All_Maps_STD.Maps_Raster_1 "" VALUE 0x1D38EC STANDARD_VALUE_U32 0.0 ident 0.0 4294967295.0 /end CHARACTERISTIC
/begin CHARACTERISTIC P_In_Y.STD_uint32_uint32_uint32.All_Maps_STD.Maps_Raster_2 "" VALUE 0x1D52B0 STANDARD_VALUE_U32 0.0 ident 0.0 4294967295.0 /end CHARACTERISTIC
/begin CHARACTERISTIC P_In_Y.STD_uint32_uint32_uint32.All_Maps_STD.Maps_Raster_3 "" VALUE 0x1D6C74 STANDARD_VALUE_U32 0.0 ident 0.0 4294967295.0 /end CHARACTERISTIC
/begin CHARACTERISTIC P_In_Y.STD_uint8_uint8_uint8.All_Maps_STD.Maps_Raster_1 "" VALUE 0x1D3ADE STANDARD_VALUE_U8 0.0 ident 0.0 255.0 /end CHARACTERISTIC
/begin CHARACTERISTIC P_In_Y.STD_uint8_uint8_uint8.All_Maps_STD.Maps_Raster_2 "" VALUE 0x1D54A2 STANDARD_VALUE_U8 0.0 ident 0.0 255.0 /end CHARACTERISTIC
/begin CHARACTERISTIC P_In_Y.STD_uint8_uint8_uint8.All_Maps_STD.Maps_Raster_3 "" VALUE 0x1D6E66 STANDARD_VALUE_U8 0.0 ident 0.0 255.0 /end CHARACTERISTIC
/begin CHARACTERISTIC P_Map_in_x.Axis_Input.CURVE_Axis "" VALUE 0x1D0056 STANDARD_VALUE_S16 0.0 ident -32768 32767 /end CHARACTERISTIC
/begin CHARACTERISTIC P_Map_in_y.Axis_Input.CURVE_Axis "" VALUE 0x1D0058 STANDARD_VALUE_S16 0.0 ident -32768 32767 /end CHARACTERISTIC
/begin CHARACTERISTIC Two_D.STD_float32_float32_float32.All_Maps_STD.Maps_Raster_1 "" MAP 0x1D3288 STANDARD_MAP_R32R32R32 0.0 ident -1.e+037 1.e+037
 /begin AXIS_DESCR STD_AXIS M_In_X.STD_float32_float32_float32.All_Maps_STD.Maps_Raster_1 ident 10 -1.e+037 1.e+037 /end AXIS_DESCR
 /begin AXIS_DESCR STD_AXIS M_In_Y.STD_float32_float32_float32.All_Maps_STD.Maps_Raster_1 ident 10 -1.e+037 1.e+037 /end AXIS_DESCR
/end CHARACTERISTIC
/begin CHARACTERISTIC Two_D.STD_float32_float32_float32.All_Maps_STD.Maps_Raster_2 "" MAP 0x1D4C4C STANDARD_MAP_R32R32R32 0.0 ident -1.e+037 1.e+037
 /begin AXIS_DESCR STD_AXIS M_In_X.STD_float32_float32_float32.All_Maps_STD.Maps_Raster_2 ident 10 -1.e+037 1.e+037 /end AXIS_DESCR
 /begin AXIS_DESCR STD_AXIS M_In_Y.STD_float32_float32_float32.All_Maps_STD.Maps_Raster_2 ident 10 -1.e+037 1.e+037 /end AXIS_DESCR
/end CHARACTERISTIC
/begin CHARACTERISTIC Two_D.STD_float32_float32_float32.All_Maps_STD.Maps_Raster_3 "" MAP 0x1D6610 STANDARD_MAP_R32R32R32 0.0 ident -1.e+037 1.e+037
 /begin AXIS_DESCR STD_AXIS M_In_X.STD_float32_float32_float32.All_Maps_STD.Maps_Raster_3 ident 10 -1.e+037 1.e+037 /end AXIS_DESCR
 /begin AXIS_DESCR STD_AXIS M_In_Y.STD_float32_float32_float32.All_Maps_STD.Maps_Raster_3 ident 10 -1.e+037 1.e+037 /end AXIS_DESCR
/end CHARACTERISTIC
/begin CHARACTERISTIC Two_D.STD_sint16_sint16_sint16.All_Maps_STD.Maps_Raster_1 "" MAP 0x1D3476 STANDARD_MAP_S16S16S16 0.0 ident -32768.0 32767.0
 /begin AXIS_DESCR STD_AXIS M_In_X.STD_sint16_sint16_sint16.All_Maps_STD.Maps_Raster_1 ident 10 -32768.0 32767.0 /end AXIS_DESCR
 /begin AXIS_DESCR STD_AXIS M_In_Y.STD_sint16_sint16_sint16.All_Maps_STD.Maps_Raster_1 ident 10 -32768.0 32767.0 /end AXIS_DESCR
/end CHARACTERISTIC
/begin CHARACTERISTIC Two_D.STD_sint16_sint16_sint16.All_Maps_STD.Maps_Raster_2 "" MAP 0x1D4E3A STANDARD_MAP_S16S16S16 0.0 ident -32768.0 32767.0
 /begin AXIS_DESCR STD_AXIS M_In_X.STD_sint16_sint16_sint16.All_Maps_STD.Maps_Raster_2 ident 10 -32768.0 32767.0 /end AXIS_DESCR
 /begin AXIS_DESCR STD_AXIS M_In_Y.STD_sint16_sint16_sint16.All_Maps_STD.Maps_Raster_2 ident 10 -32768.0 32767.0 /end AXIS_DESCR
/end CHARACTERISTIC
/begin CHARACTERISTIC Two_D.STD_sint16_sint16_sint16.All_Maps_STD.Maps_Raster_3 "" MAP 0x1D67FE STANDARD_MAP_S16S16S16 0.0 ident -32768.0 32767.0
 /begin AXIS_DESCR STD_AXIS M_In_X.STD_sint16_sint16_sint16.All_Maps_STD.Maps_Raster_3 ident 10 -32768.0 32767.0 /end AXIS_DESCR
 /begin AXIS_DESCR STD_AXIS M_In_Y.STD_sint16_sint16_sint16.All_Maps_STD.Maps_Raster_3 ident 10 -32768.0 32767.0 /end AXIS_DESCR
/end CHARACTERISTIC
/begin CHARACTERISTIC Two_D.STD_sint32_sint32_sint32.All_Maps_STD.Maps_Raster_1 "" MAP 0x1D357C STANDARD_MAP_S32S32S32 0.0 ident -2147483648.0 2147483647.0
 /begin AXIS_DESCR STD_AXIS M_In_X.STD_sint32_sint32_sint32.All_Maps_STD.Maps_Raster_1 ident 10 -2147483648.0 2147483647.0 /end AXIS_DESCR
 /begin AXIS_DESCR STD_AXIS M_In_Y.STD_sint32_sint32_sint32.All_Maps_STD.Maps_Raster_1 ident 10 -2147483648.0 2147483647.0 /end AXIS_DESCR
/end CHARACTERISTIC
/begin CHARACTERISTIC Two_D.STD_sint32_sint32_sint32.All_Maps_STD.Maps_Raster_2 "" MAP 0x1D4F40 STANDARD_MAP_S32S32S32 0.0 ident -2147483648.0 2147483647.0
 /begin AXIS_DESCR STD_AXIS M_In_X.STD_sint32_sint32_sint32.All_Maps_STD.Maps_Raster_2 ident 10 -2147483648.0 2147483647.0 /end AXIS_DESCR
 /begin AXIS_DESCR STD_AXIS M_In_Y.STD_sint32_sint32_sint32.All_Maps_STD.Maps_Raster_2 ident 10 -2147483648.0 2147483647.0 /end AXIS_DESCR
/end CHARACTERISTIC
/begin CHARACTERISTIC Two_D.STD_sint32_sint32_sint32.All_Maps_STD.Maps_Raster_3 "" MAP 0x1D6904 STANDARD_MAP_S32S32S32 0.0 ident -2147483648.0 2147483647.0
 /begin AXIS_DESCR STD_AXIS M_In_X.STD_sint32_sint32_sint32.All_Maps_STD.Maps_Raster_3 ident 10 -2147483648.0 2147483647.0 /end AXIS_DESCR
 /begin AXIS_DESCR STD_AXIS M_In_Y.STD_sint32_sint32_sint32.All_Maps_STD.Maps_Raster_3 ident 10 -2147483648.0 2147483647.0 /end AXIS_DESCR
/end CHARACTERISTIC
/begin CHARACTERISTIC Two_D.STD_sint8_sint8_sint8.All_Maps_STD.Maps_Raster_1 "" MAP 0x1D3767 STANDARD_MAP_S8S8S8 0.0 ident -128.0 127.0
 /begin AXIS_DESCR STD_AXIS M_In_X.STD_sint8_sint8_sint8.All_Maps_STD.Maps_Raster_1 ident 10 -128.0 127.0 /end AXIS_DESCR
 /begin AXIS_DESCR STD_AXIS M_In_Y.STD_sint8_sint8_sint8.All_Maps_STD.Maps_Raster_1 ident 10 -128.0 127.0 /end AXIS_DESCR
/end CHARACTERISTIC
/begin CHARACTERISTIC Two_D.STD_sint8_sint8_sint8.All_Maps_STD.Maps_Raster_2 "" MAP 0x1D512B STANDARD_MAP_S8S8S8 0.0 ident -128.0 127.0
 /begin AXIS_DESCR STD_AXIS M_In_X.STD_sint8_sint8_sint8.All_Maps_STD.Maps_Raster_2 ident 10 -128.0 127.0 /end AXIS_DESCR
 /begin AXIS_DESCR STD_AXIS M_In_Y.STD_sint8_sint8_sint8.All_Maps_STD.Maps_Raster_2 ident 10 -128.0 127.0 /end AXIS_DESCR
/end CHARACTERISTIC
/begin CHARACTERISTIC Two_D.STD_sint8_sint8_sint8.All_Maps_STD.Maps_Raster_3 "" MAP 0x1D6AEF STANDARD_MAP_S8S8S8 0.0 ident -128.0 127.0
 /begin AXIS_DESCR STD_AXIS M_In_X.STD_sint8_sint8_sint8.All_Maps_STD.Maps_Raster_3 ident 10 -128.0 127.0 /end AXIS_DESCR
 /begin AXIS_DESCR STD_AXIS M_In_Y.STD_sint8_sint8_sint8.All_Maps_STD.Maps_Raster_3 ident 10 -128.0 127.0 /end AXIS_DESCR
/end CHARACTERISTIC
/begin CHARACTERISTIC Two_D.STD_uint16_uint16_uint16.All_Maps_STD.Maps_Raster_1 "" MAP 0x1D37EE STANDARD_MAP_U16U16U16 0.0 ident 0.0 65535.0
 /begin AXIS_DESCR STD_AXIS M_In_X.STD_uint16_uint16_uint16.All_Maps_STD.Maps_Raster_1 ident 10 0.0 65535.0 /end AXIS_DESCR
 /begin AXIS_DESCR STD_AXIS M_In_Y.STD_uint16_uint16_uint16.All_Maps_STD.Maps_Raster_1 ident 10 0.0 65535.0 /end AXIS_DESCR
/end CHARACTERISTIC
/begin CHARACTERISTIC Two_D.STD_uint16_uint16_uint16.All_Maps_STD.Maps_Raster_2 "" MAP 0x1D51B2 STANDARD_MAP_U16U16U16 0.0 ident 0.0 65535.0
 /begin AXIS_DESCR STD_AXIS M_In_X.STD_uint16_uint16_uint16.All_Maps_STD.Maps_Raster_2 ident 10 0.0 65535.0 /end AXIS_DESCR
 /begin AXIS_DESCR STD_AXIS M_In_Y.STD_uint16_uint16_uint16.All_Maps_STD.Maps_Raster_2 ident 10 0.0 65535.0 /end AXIS_DESCR
/end CHARACTERISTIC
/begin CHARACTERISTIC Two_D.STD_uint16_uint16_uint16.All_Maps_STD.Maps_Raster_3 "" MAP 0x1D6B76 STANDARD_MAP_U16U16U16 0.0 ident 0.0 65535.0
 /begin AXIS_DESCR STD_AXIS M_In_X.STD_uint16_uint16_uint16.All_Maps_STD.Maps_Raster_3 ident 10 0.0 65535.0 /end AXIS_DESCR
 /begin AXIS_DESCR STD_AXIS M_In_Y.STD_uint16_uint16_uint16.All_Maps_STD.Maps_Raster_3 ident 10 0.0 65535.0 /end AXIS_DESCR
/end CHARACTERISTIC
/begin CHARACTERISTIC Two_D.STD_uint32_uint32_uint32.All_Maps_STD.Maps_Raster_1 "" MAP 0x1D38F4 STANDARD_MAP_U32U32U32 0.0 ident 0.0 4294967295.0
 /begin AXIS_DESCR STD_AXIS M_In_X.STD_uint32_uint32_uint32.All_Maps_STD.Maps_Raster_1 ident 10 0.0 4294967295.0 /end AXIS_DESCR
 /begin AXIS_DESCR STD_AXIS M_In_Y.STD_uint32_uint32_uint32.All_Maps_STD.Maps_Raster_1 ident 10 0.0 4294967295.0 /end AXIS_DESCR
/end CHARACTERISTIC
/begin CHARACTERISTIC Two_D.STD_uint32_uint32_uint32.All_Maps_STD.Maps_Raster_2 "" MAP 0x1D52B8 STANDARD_MAP_U32U32U32 0.0 ident 0.0 4294967295.0
 /begin AXIS_DESCR STD_AXIS M_In_X.STD_uint32_uint32_uint32.All_Maps_STD.Maps_Raster_2 ident 10 0.0 4294967295.0 /end AXIS_DESCR
 /begin AXIS_DESCR STD_AXIS M_In_Y.STD_uint32_uint32_uint32.All_Maps_STD.Maps_Raster_2 ident 10 0.0 4294967295.0 /end AXIS_DESCR
/end CHARACTERISTIC
/begin CHARACTERISTIC Two_D.STD_uint32_uint32_uint32.All_Maps_STD.Maps_Raster_3 "" MAP 0x1D6C7C STANDARD_MAP_U32U32U32 0.0 ident 0.0 4294967295.0
 /begin AXIS_DESCR STD_AXIS M_In_X.STD_uint32_uint32_uint32.All_Maps_STD.Maps_Raster_3 ident 10 0.0 4294967295.0 /end AXIS_DESCR
 /begin AXIS_DESCR STD_AXIS M_In_Y.STD_uint32_uint32_uint32.All_Maps_STD.Maps_Raster_3 ident 10 0.0 4294967295.0 /end AXIS_DESCR
/end CHARACTERISTIC
/begin CHARACTERISTIC Two_D.STD_uint8_uint8_uint8.All_Maps_STD.Maps_Raster_1 "" MAP 0x1D3ADF STANDARD_MAP_U8U8U8 0.0 ident 0.0 255.0
 /begin AXIS_DESCR STD_AXIS M_In_X.STD_uint8_uint8_uint8.All_Maps_STD.Maps_Raster_1 ident 10 0.0 255.0 /end AXIS_DESCR
 /begin AXIS_DESCR STD_AXIS M_In_Y.STD_uint8_uint8_uint8.All_Maps_STD.Maps_Raster_1 ident 10 0.0 255.0 /end AXIS_DESCR
/end CHARACTERISTIC
/begin CHARACTERISTIC Two_D.STD_uint8_uint8_uint8.All_Maps_STD.Maps_Raster_2 "" MAP 0x1D54A3 STANDARD_MAP_U8U8U8 0.0 ident 0.0 255.0
 /begin AXIS_DESCR STD_AXIS M_In_X.STD_uint8_uint8_uint8.All_Maps_STD.Maps_Raster_2 ident 10 0.0 255.0 /end AXIS_DESCR
 /begin AXIS_DESCR STD_AXIS M_In_Y.STD_uint8_uint8_uint8.All_Maps_STD.Maps_Raster_2 ident 10 0.0 255.0 /end AXIS_DESCR
/end CHARACTERISTIC
/begin CHARACTERISTIC Two_D.STD_uint8_uint8_uint8.All_Maps_STD.Maps_Raster_3 "" MAP 0x1D6E67 STANDARD_MAP_U8U8U8 0.0 ident 0.0 255.0
 /begin AXIS_DESCR STD_AXIS M_In_X.STD_uint8_uint8_uint8.All_Maps_STD.Maps_Raster_3 ident 10 0.0 255.0 /end AXIS_DESCR
 /begin AXIS_DESCR STD_AXIS M_In_Y.STD_uint8_uint8_uint8.All_Maps_STD.Maps_Raster_3 ident 10 0.0 255.0 /end AXIS_DESCR
/end CHARACTERISTIC
/begin MEASUREMENT Calculated.STD_float32_float32_float32.All_Maps_STD.Maps_Raster_1 "" UBYTE ident 1 100 0 1 BIT_MASK 0x1 ECU_ADDRESS 0x7F89E4 /end MEASUREMENT
/begin MEASUREMENT Calculated.STD_float32_float32_float32.All_Maps_STD.Maps_Raster_2 "" UBYTE ident 1 100 0 1 BIT_MASK 0x1 ECU_ADDRESS 0x7F8ABC /end MEASUREMENT
/begin MEASUREMENT Calculated.STD_float32_float32_float32.All_Maps_STD.Maps_Raster_3 "" UBYTE ident 1 100 0 1 BIT_MASK 0x1 ECU_ADDRESS 0x7F8B94 /end MEASUREMENT
/begin MEASUREMENT Calculated.STD_sint16_sint16_sint16.All_Maps_STD.Maps_Raster_1 "" UBYTE ident 1 100 0 1 BIT_MASK 0x1 ECU_ADDRESS 0x7F89EE /end MEASUREMENT
/begin MEASUREMENT Calculated.STD_sint16_sint16_sint16.All_Maps_STD.Maps_Raster_2 "" UBYTE ident 1 100 0 1 BIT_MASK 0x1 ECU_ADDRESS 0x7F8AC6 /end MEASUREMENT
/begin MEASUREMENT Calculated.STD_sint16_sint16_sint16.All_Maps_STD.Maps_Raster_3 "" UBYTE ident 1 100 0 1 BIT_MASK 0x1 ECU_ADDRESS 0x7F8B9E /end MEASUREMENT
/begin MEASUREMENT Calculated.STD_sint32_sint32_sint32.All_Maps_STD.Maps_Raster_1 "" UBYTE ident 1 100 0 1 BIT_MASK 0x1 ECU_ADDRESS 0x7F89FC /end MEASUREMENT
/begin MEASUREMENT Calculated.STD_sint32_sint32_sint32.All_Maps_STD.Maps_Raster_2 "" UBYTE ident 1 100 0 1 BIT_MASK 0x1 ECU_ADDRESS 0x7F8AD4 /end MEASUREMENT
/begin MEASUREMENT Calculated.STD_sint32_sint32_sint32.All_Maps_STD.Maps_Raster_3 "" UBYTE ident 1 100 0 1 BIT_MASK 0x1 ECU_ADDRESS 0x7F8BAC /end MEASUREMENT
/begin MEASUREMENT Calculated.STD_sint8_sint8_sint8.All_Maps_STD.Maps_Raster_1 "" UBYTE ident 1 100 0 1 BIT_MASK 0x1 ECU_ADDRESS 0x7F8A00 /end MEASUREMENT
/begin MEASUREMENT Calculated.STD_sint8_sint8_sint8.All_Maps_STD.Maps_Raster_2 "" UBYTE ident 1 100 0 1 BIT_MASK 0x1 ECU_ADDRESS 0x7F8AD8 /end MEASUREMENT
/begin MEASUREMENT Calculated.STD_sint8_sint8_sint8.All_Maps_STD.Maps_Raster_3 "" UBYTE ident 1 100 0 1 BIT_MASK 0x1 ECU_ADDRESS 0x7F8BB0 /end MEASUREMENT
/begin MEASUREMENT Calculated.STD_uint16_uint16_uint16.All_Maps_STD.Maps_Raster_1 "" UBYTE ident 1 100 0 1 BIT_MASK 0x1 ECU_ADDRESS 0x7F8A0A /end MEASUREMENT
/begin MEASUREMENT Calculated.STD_uint16_uint16_uint16.All_Maps_STD.Maps_Raster_2 "" UBYTE ident 1 100 0 1 BIT_MASK 0x1 ECU_ADDRESS 0x7F8AE2 /end MEASUREMENT
/begin MEASUREMENT Calculated.STD_uint16_uint16_uint16.All_Maps_STD.Maps_Raster_3 "" UBYTE ident 1 100 0 1 BIT_MASK 0x1 ECU_ADDRESS 0x7F8BBA /end MEASUREMENT
/begin MEASUREMENT Calculated.STD_uint32_uint32_uint32.All_Maps_STD.Maps_Raster_1 "" UBYTE ident 1 100 0 1 BIT_MASK 0x1 ECU_ADDRESS 0x7F8A18 /end MEASUREMENT
/begin MEASUREMENT Calculated.STD_uint32_uint32_uint32.All_Maps_STD.Maps_Raster_2 "" UBYTE ident 1 100 0 1 BIT_MASK 0x1 ECU_ADDRESS 0x7F8AF0 /end MEASUREMENT
/begin MEASUREMENT Calculated.STD_uint32_uint32_uint32.All_Maps_STD.Maps_Raster_3 "" UBYTE ident 1 100 0 1 BIT_MASK 0x1 ECU_ADDRESS 0x7F8BC8 /end MEASUREMENT
/begin MEASUREMENT Calculated.STD_uint8_uint8_uint8.All_Maps_STD.Maps_Raster_1 "" UBYTE ident 1 100 0 1 BIT_MASK 0x1 ECU_ADDRESS 0x7F8A1C /end MEASUREMENT
/begin MEASUREMENT Calculated.STD_uint8_uint8_uint8.All_Maps_STD.Maps_Raster_2 "" UBYTE ident 1 100 0 1 BIT_MASK 0x1 ECU_ADDRESS 0x7F8AF4 /end MEASUREMENT
/begin MEASUREMENT Calculated.STD_uint8_uint8_uint8.All_Maps_STD.Maps_Raster_3 "" UBYTE ident 1 100 0 1 BIT_MASK 0x1 ECU_ADDRESS 0x7F8BCC /end MEASUREMENT
/begin MEASUREMENT g_CAN_B_IRQ_MaxExeTime_u32.HWE.BASE "" UBYTE ident 1 100 0 255 ECU_ADDRESS 0x7FB0E3 /end MEASUREMENT
/begin MEASUREMENT g_Target_D_DIVF_u32.HWE_TARGET.BASE "" ULONG ident 1 100 0 4294967295 ECU_ADDRESS 0x7FB0E8 /end MEASUREMENT
/begin MEASUREMENT g_Target_D_IMBSPEED_u32.HWE_TARGET.BASE "" ULONG ident 1 100 0 4294967295 ECU_ADDRESS 0x7FB0EC /end MEASUREMENT
/begin MEASUREMENT g_Target_D_MF_u32.HWE_TARGET.BASE "" ULONG ident 1 100 0 4294967295 ECU_ADDRESS 0x7FB0F0 /end MEASUREMENT
/begin MEASUREMENT g_Target_D_TB_NORM_MUL_u32.HWE_TARGET.BASE "" ULONG ident 1 100 0 4294967295 ECU_ADDRESS 0x7FB0F8 /end MEASUREMENT
/begin MEASUREMENT g_Target_D_TBS_u32.HWE_TARGET.BASE "" ULONG ident 1 100 0 4294967295 ECU_ADDRESS 0x7FB0F4 /end MEASUREMENT
/begin MEASUREMENT g_Target_F_IMB_u32.HWE_TARGET.BASE "" ULONG ident 1 100 0 4294967295 ECU_ADDRESS 0x7FB0FC /end MEASUREMENT
/begin MEASUREMENT g_Target_F_OSC_u32.HWE_TARGET.BASE "" ULONG ident 1 100 0 4294967295 ECU_ADDRESS 0x7FB100 /end MEASUREMENT
/begin MEASUREMENT g_Target_F_SYS_u32.HWE_TARGET.BASE "" ULONG ident 1 100 0 4294967295 ECU_ADDRESS 0x7FB104 /end MEASUREMENT
/begin MEASUREMENT g_Target_F_TB_u32.HWE_TARGET.BASE "" ULONG ident 1 100 0 4294967295 ECU_ADDRESS 0x7FB108 /end MEASUREMENT
/begin MEASUREMENT g_Target_SysTick_in_ns_u32.HWE_TARGET.BASE "" ULONG ident 1 100 0 4294967295 ECU_ADDRESS 0x7FB10C /end MEASUREMENT
/begin MEASUREMENT HWE_A_U_5V1_Err.SHELL.BASE "" UWORD ident 1 100 0 65535 ECU_ADDRESS 0x821DAC /end MEASUREMENT
/begin MEASUREMENT HWE_A_U_5V1_Stat.SHELL.BASE "" UWORD ident 1 100 0 65535 ECU_ADDRESS 0x821DAE /end MEASUREMENT
/begin MEASUREMENT HWE_A_U_5V2_Err.SHELL.BASE "" UWORD ident 1 100 0 65535 ECU_ADDRESS 0x821DB0 /end MEASUREMENT
/begin MEASUREMENT HWE_A_U_5V2_Stat.SHELL.BASE "" UWORD ident 1 100 0 65535 ECU_ADDRESS 0x821DB2 /end MEASUREMENT
/begin MEASUREMENT HWE_A_U_5V3_Err.SHELL.BASE "" UWORD ident 1 100 0 65535 ECU_ADDRESS 0x821DB4 /end MEASUREMENT
/begin MEASUREMENT HWE_A_U_5V3_Stat.SHELL.BASE "" UWORD ident 1 100 0 65535 ECU_ADDRESS 0x821DB6 /end MEASUREMENT
/begin MEASUREMENT HWE_Alarm_Can_Num1_Driver.SHELL.BASE "" UWORD ident 1 100 0 65535 ECU_ADDRESS 0x821DB8 /end MEASUREMENT
/begin MEASUREMENT HWE_CAN_A_BAUDRATE_V.SHELL.BASE "" UBYTE enum_HWE_CAN_BAUDRATE_ENUM 1 100 0 6 ECU_ADDRESS 0x7FB61C /end MEASUREMENT
/begin MEASUREMENT HWE_CAN_B_BAUDRATE_V.SHELL.BASE "" UBYTE enum_HWE_CAN_BAUDRATE_ENUM 1 100 0 6 ECU_ADDRESS 0x7FB61D /end MEASUREMENT
/begin MEASUREMENT HWE_CAN_C_BAUDRATE_V.SHELL.BASE "" UBYTE enum_HWE_CAN_BAUDRATE_ENUM 1 100 0 6 ECU_ADDRESS 0x7FB61E /end MEASUREMENT
/begin MEASUREMENT HWE_Can_DiagOpSwitch.SHELL.BASE "" SBYTE ident 1 100 0 1 BIT_MASK 0x1 ECU_ADDRESS 0x821E7D /end MEASUREMENT
/begin MEASUREMENT HWE_CAN_DisableNormalMsgTx.SHELL.BASE "" SBYTE ident 1 100 0 1 BIT_MASK 0x1 ECU_ADDRESS 0x821E7C /end MEASUREMENT
/begin MEASUREMENT HWE_Can_Rx_Ok.SHELL.BASE "" SBYTE ident 1 100 0 1 BIT_MASK 0x1 ECU_ADDRESS 0x821E7E /end MEASUREMENT
/begin MEASUREMENT HWE_CANA_ID250RX_1.SHELL.BASE "" ULONG ident 1 100 0 4294967295 ECU_ADDRESS 0x821CC0 /end MEASUREMENT
/begin MEASUREMENT HWE_CANA_ID250RX_2.SHELL.BASE "" ULONG ident 1 100 0 4294967295 ECU_ADDRESS 0x821CC4 /end MEASUREMENT
/begin MEASUREMENT HWE_CANA_ID258RX_1.SHELL.BASE "" ULONG ident 1 100 0 4294967295 ECU_ADDRESS 0x821CC8 /end MEASUREMENT
/begin MEASUREMENT HWE_CANA_ID258RX_2.SHELL.BASE "" ULONG ident 1 100 0 4294967295 ECU_ADDRESS 0x821CCC /end MEASUREMENT
/begin MEASUREMENT HWE_CANA_ID260TX_1.SHELL.BASE "" ULONG ident 1 100 0 4294967295 ECU_ADDRESS 0x821CD0 /end MEASUREMENT
/begin MEASUREMENT HWE_CANA_ID260TX_2.SHELL.BASE "" ULONG ident 1 100 0 4294967295 ECU_ADDRESS 0x821CD4 /end MEASUREMENT
/begin MEASUREMENT HWE_CANA_ID288TX_1.SHELL.BASE "" ULONG ident 1 100 0 4294967295 ECU_ADDRESS 0x821CD8 /end MEASUREMENT
/begin MEASUREMENT HWE_CANA_ID288TX_2.SHELL.BASE "" ULONG ident 1 100 0 4294967295 ECU_ADDRESS 0x821CDC /end MEASUREMENT
/begin MEASUREMENT HWE_CANA_ID290RX_1.SHELL.BASE "" ULONG ident 1 100 0 4294967295 ECU_ADDRESS 0x821CE0 /end MEASUREMENT
/begin MEASUREMENT HWE_CANA_ID290RX_2.SHELL.BASE "" ULONG ident 1 100 0 4294967295 ECU_ADDRESS 0x821CE4 /end MEASUREMENT
/begin MEASUREMENT HWE_CANA_ID310TX_1.SHELL.BASE "" ULONG ident 1 100 0 4294967295 ECU_ADDRESS 0x821CE8 /end MEASUREMENT
/begin MEASUREMENT HWE_CANA_ID310TX_2.SHELL.BASE "" ULONG ident 1 100 0 4294967295 ECU_ADDRESS 0x821CEC /end MEASUREMENT
/begin MEASUREMENT HWE_CANA_ID320RX_1.SHELL.BASE "" ULONG ident 1 100 0 4294967295 ECU_ADDRESS 0x821CF0 /end MEASUREMENT
/begin MEASUREMENT HWE_CANA_ID320RX_2.SHELL.BASE "" ULONG ident 1 100 0 4294967295 ECU_ADDRESS 0x821CF4 /end MEASUREMENT
/begin MEASUREMENT HWE_CANA_ID330TX_1.SHELL.BASE "" ULONG ident 1 100 0 4294967295 ECU_ADDRESS 0x821CF8 /end MEASUREMENT
/begin MEASUREMENT HWE_CANA_ID330TX_2.SHELL.BASE "" ULONG ident 1 100 0 4294967295 ECU_ADDRESS 0x821CFC /end MEASUREMENT
/begin MEASUREMENT HWE_CANA_ID340RX_1.SHELL.BASE "" ULONG ident 1 100 0 4294967295 ECU_ADDRESS 0x821D00 /end MEASUREMENT
/begin MEASUREMENT HWE_CANA_ID340RX_2.SHELL.BASE "" ULONG ident 1 100 0 4294967295 ECU_ADDRESS 0x821D04 /end MEASUREMENT
/begin MEASUREMENT HWE_CANA_ID358RX_1.SHELL.BASE "" ULONG ident 1 100 0 4294967295 ECU_ADDRESS 0x821D08 /end MEASUREMENT
/begin MEASUREMENT HWE_CANA_ID358RX_2.SHELL.BASE "" ULONG ident 1 100 0 4294967295 ECU_ADDRESS 0x821D0C /end MEASUREMENT
/begin MEASUREMENT HWE_CANA_ID500RX_1.SHELL.BASE "" ULONG ident 1 100 0 4294967295 ECU_ADDRESS 0x821D10 /end MEASUREMENT
/begin MEASUREMENT HWE_CANA_ID500RX_2.SHELL.BASE "" ULONG ident 1 100 0 4294967295 ECU_ADDRESS 0x821D14 /end MEASUREMENT
/begin MEASUREMENT HWE_CANA_ID510RX_1.SHELL.BASE "" ULONG ident 1 100 0 4294967295 ECU_ADDRESS 0x821D18 /end MEASUREMENT
/begin MEASUREMENT HWE_CANA_ID510RX_2.SHELL.BASE "" ULONG ident 1 100 0 4294967295 ECU_ADDRESS 0x821D1C /end MEASUREMENT
/begin MEASUREMENT HWE_CANA_ID620TX_1.SHELL.BASE "" ULONG ident 1 100 0 4294967295 ECU_ADDRESS 0x821D20 /end MEASUREMENT
/begin MEASUREMENT HWE_CANA_ID620TX_2.SHELL.BASE "" ULONG ident 1 100 0 4294967295 ECU_ADDRESS 0x821D24 /end MEASUREMENT
/begin MEASUREMENT HWE_CANA_ID630RX_1.SHELL.BASE "" ULONG ident 1 100 0 4294967295 ECU_ADDRESS 0x821D28 /end MEASUREMENT
/begin MEASUREMENT HWE_CANA_ID630RX_2.SHELL.BASE "" ULONG ident 1 100 0 4294967295 ECU_ADDRESS 0x821D2C /end MEASUREMENT
/begin MEASUREMENT HWE_CANA_ID640RX_1.SHELL.BASE "" ULONG ident 1 100 0 4294967295 ECU_ADDRESS 0x821D30 /end MEASUREMENT
/begin MEASUREMENT HWE_CANA_ID640RX_2.SHELL.BASE "" ULONG ident 1 100 0 4294967295 ECU_ADDRESS 0x821D34 /end MEASUREMENT
/begin MEASUREMENT HWE_CANA_InitAfterBusOff.SHELL.BASE "" SBYTE ident 1 100 0 1 BIT_MASK 0x1 ECU_ADDRESS 0x7FB616 /end MEASUREMENT
/begin MEASUREMENT HWE_CANA_OBD_TX_V7.SHELL.BASE "" ULONG ident 1 100 0 4294967295 ECU_ADDRESS 0x7FB5A0 /end MEASUREMENT
/begin MEASUREMENT HWE_CANA_stBusOff.SHELL.BASE "" UBYTE ident 1 100 0 255 ECU_ADDRESS 0x7FB617 /end MEASUREMENT
/begin MEASUREMENT HWE_CANB_CCP_DAQ0_V4.SHELL.BASE "" ULONG ident 1 100 0 4294967295 ECU_ADDRESS 0x7FB5A4 /end MEASUREMENT
/begin MEASUREMENT HWE_CANB_CCP_DAQ1_V5.SHELL.BASE "" ULONG ident 1 100 0 4294967295 ECU_ADDRESS 0x7FB5A8 /end MEASUREMENT
/begin MEASUREMENT HWE_CANB_CCP_DAQ2_V6.SHELL.BASE "" ULONG ident 1 100 0 4294967295 ECU_ADDRESS 0x7FB5AC /end MEASUREMENT
/begin MEASUREMENT HWE_CANB_CCP_RX_V2.SHELL.BASE "" ULONG ident 1 100 0 4294967295 ECU_ADDRESS 0x7FB5B0 /end MEASUREMENT
/begin MEASUREMENT HWE_CANB_CCP_TX_V3.SHELL.BASE "" ULONG ident 1 100 0 4294967295 ECU_ADDRESS 0x7FB5B4 /end MEASUREMENT
/begin MEASUREMENT HWE_CANB_ID348RXB_1.SHELL.BASE "" ULONG ident 1 100 0 4294967295 ECU_ADDRESS 0x821D38 /end MEASUREMENT
/begin MEASUREMENT HWE_CANB_ID348RXB_2.SHELL.BASE "" ULONG ident 1 100 0 4294967295 ECU_ADDRESS 0x821D3C /end MEASUREMENT
/begin MEASUREMENT HWE_CANB_ID350TX_1.SHELL.BASE "" ULONG ident 1 100 0 4294967295 ECU_ADDRESS 0x821D40 /end MEASUREMENT
/begin MEASUREMENT HWE_CANB_ID350TX_2.SHELL.BASE "" ULONG ident 1 100 0 4294967295 ECU_ADDRESS 0x821D44 /end MEASUREMENT
/begin MEASUREMENT HWE_CANB_ID360TX_1.SHELL.BASE "" ULONG ident 1 100 0 4294967295 ECU_ADDRESS 0x821D48 /end MEASUREMENT
/begin MEASUREMENT HWE_CANB_ID360TX_2.SHELL.BASE "" ULONG ident 1 100 0 4294967295 ECU_ADDRESS 0x821D4C /end MEASUREMENT
/begin MEASUREMENT HWE_CANB_ID380TX_1.SHELL.BASE "" ULONG ident 1 100 0 4294967295 ECU_ADDRESS 0x821D50 /end MEASUREMENT
/begin MEASUREMENT HWE_CANB_ID380TX_2.SHELL.BASE "" ULONG ident 1 100 0 4294967295 ECU_ADDRESS 0x821D54 /end MEASUREMENT
/begin MEASUREMENT HWE_CANB_ID578RXB_1.SHELL.BASE "" ULONG ident 1 100 0 4294967295 ECU_ADDRESS 0x821D58 /end MEASUREMENT
/begin MEASUREMENT HWE_CANB_ID578RXB_2.SHELL.BASE "" ULONG ident 1 100 0 4294967295 ECU_ADDRESS 0x821D5C /end MEASUREMENT
/begin MEASUREMENT HWE_CANB_ID590RXB_1.SHELL.BASE "" ULONG ident 1 100 0 4294967295 ECU_ADDRESS 0x821D60 /end MEASUREMENT
/begin MEASUREMENT HWE_CANB_ID590RXB_2.SHELL.BASE "" ULONG ident 1 100 0 4294967295 ECU_ADDRESS 0x821D64 /end MEASUREMENT
/begin MEASUREMENT HWE_CANB_ID5FFTX_1.SHELL.BASE "" ULONG ident 1 100 0 4294967295 ECU_ADDRESS 0x821D68 /end MEASUREMENT
/begin MEASUREMENT HWE_CANB_ID5FFTX_2.SHELL.BASE "" ULONG ident 1 100 0 4294967295 ECU_ADDRESS 0x821D6C /end MEASUREMENT
/begin MEASUREMENT HWE_CANB_ID690TX_1.SHELL.BASE "" ULONG ident 1 100 0 4294967295 ECU_ADDRESS 0x821D70 /end MEASUREMENT
/begin MEASUREMENT HWE_CANB_ID690TX_2.SHELL.BASE "" ULONG ident 1 100 0 4294967295 ECU_ADDRESS 0x821D74 /end MEASUREMENT
/begin MEASUREMENT HWE_CANB_ID691TX_1.SHELL.BASE "" ULONG ident 1 100 0 4294967295 ECU_ADDRESS 0x821D78 /end MEASUREMENT
/begin MEASUREMENT HWE_CANB_ID691TX_2.SHELL.BASE "" ULONG ident 1 100 0 4294967295 ECU_ADDRESS 0x821D7C /end MEASUREMENT
/begin MEASUREMENT HWE_CANB_ID695TX_1.SHELL.BASE "" ULONG ident 1 100 0 4294967295 ECU_ADDRESS 0x821D80 /end MEASUREMENT
/begin MEASUREMENT HWE_CANB_ID695TX_2.SHELL.BASE "" ULONG ident 1 100 0 4294967295 ECU_ADDRESS 0x821D84 /end MEASUREMENT
/begin MEASUREMENT HWE_CANB_ID696RXB_1.SHELL.BASE "" ULONG ident 1 100 0 4294967295 ECU_ADDRESS 0x821D88 /end MEASUREMENT
/begin MEASUREMENT HWE_CANB_InitAfterBusOff.SHELL.BASE "" SBYTE ident 1 100 0 1 BIT_MASK 0x1 ECU_ADDRESS 0x7FB618 /end MEASUREMENT
/begin MEASUREMENT HWE_CANB_MUX_ID5xx_V8.SHELL.BASE "" ULONG ident 1 100 0 4294967295 ECU_ADDRESS 0x821D8C /end MEASUREMENT
/begin MEASUREMENT HWE_CANB_MUX_ID5xx_V8_U32_1.SHELL.BASE "" ULONG ident 1 100 0 4294967295 ECU_ADDRESS 0x821D90 /end MEASUREMENT
/begin MEASUREMENT HWE_CANB_MUX_ID5xx_V8_U32_2.SHELL.BASE "" ULONG ident 1 100 0 4294967295 ECU_ADDRESS 0x821D94 /end MEASUREMENT
/begin MEASUREMENT HWE_CANB_stBusOff.SHELL.BASE "" UBYTE ident 1 100 0 255 ECU_ADDRESS 0x7FB619 /end MEASUREMENT
/begin MEASUREMENT HWE_CANC_ID100TX_1.SHELL.BASE "" ULONG ident 1 100 0 4294967295 ECU_ADDRESS 0x821D98 /end MEASUREMENT
/begin MEASUREMENT HWE_CANC_ID100TX_2.SHELL.BASE "" ULONG ident 1 100 0 4294967295 ECU_ADDRESS 0x821D9C /end MEASUREMENT
/begin MEASUREMENT HWE_CANC_ID101RX_1.SHELL.BASE "" ULONG ident 1 100 0 4294967295 ECU_ADDRESS 0x821DA0 /end MEASUREMENT
/begin MEASUREMENT HWE_CANC_ID101RX_2.SHELL.BASE "" ULONG ident 1 100 0 4294967295 ECU_ADDRESS 0x821DA4 /end MEASUREMENT
/begin MEASUREMENT HWE_CANC_InitAfterBusOff.SHELL.BASE "" SBYTE ident 1 100 0 1 BIT_MASK 0x1 ECU_ADDRESS 0x7FB61A /end MEASUREMENT
/begin MEASUREMENT HWE_CANC_stBusOff.SHELL.BASE "" UBYTE ident 1 100 0 255 ECU_ADDRESS 0x7FB61B /end MEASUREMENT
/begin MEASUREMENT HWE_CJ230A_Err.SHELL.BASE "" UWORD ident 1 100 0 65535 ECU_ADDRESS 0x821DBA /end MEASUREMENT
/begin MEASUREMENT HWE_CJ230A_Stat.SHELL.BASE "" UWORD ident 1 100 0 65535 ECU_ADDRESS 0x821DBC /end MEASUREMENT
/begin MEASUREMENT HWE_CJ230B_Err.SHELL.BASE "" UWORD ident 1 100 0 65535 ECU_ADDRESS 0x821DBE /end MEASUREMENT
/begin MEASUREMENT HWE_CJ230B_Stat.SHELL.BASE "" UWORD ident 1 100 0 65535 ECU_ADDRESS 0x821DC0 /end MEASUREMENT
/begin MEASUREMENT HWE_CJ945A_Err.SHELL.BASE "" UWORD ident 1 100 0 65535 ECU_ADDRESS 0x821DC2 /end MEASUREMENT
/begin MEASUREMENT HWE_CJ945A_Stat.SHELL.BASE "" UWORD ident 1 100 0 65535 ECU_ADDRESS 0x821DC4 /end MEASUREMENT
/begin MEASUREMENT HWE_CJ945B_Err.SHELL.BASE "" UWORD ident 1 100 0 65535 ECU_ADDRESS 0x821DC6 /end MEASUREMENT
/begin MEASUREMENT HWE_CJ945B_Stat.SHELL.BASE "" UWORD ident 1 100 0 65535 ECU_ADDRESS 0x821DC8 /end MEASUREMENT
/begin MEASUREMENT HWE_Eep_AfterRun_st.SHELL.BASE "" UBYTE ident 1 100 0 255 ECU_ADDRESS 0x7FB61F /end MEASUREMENT
/begin MEASUREMENT HWE_Eep_Format.SHELL.BASE "" UBYTE ident 1 100 0 255 ECU_ADDRESS 0x7FB620 /end MEASUREMENT
/begin MEASUREMENT HWE_EepBlk_State.SHELL.BASE "" ULONG ident 1 100 0 4294967295 ECU_ADDRESS 0x7FB5B8 /end MEASUREMENT
/begin MEASUREMENT HWE_Enter_NL.SHELL.BASE "" SBYTE ident 1 100 0 1 BIT_MASK 0x1 ECU_ADDRESS 0x7FB621 /end MEASUREMENT
/begin MEASUREMENT HWE_IA_IPS.SHELL.BASE "" UWORD ADC_10bit 1 100 0.0 5.0 ECU_ADDRESS 0x821DFA /end MEASUREMENT
/begin MEASUREMENT HWE_IA_ITS.SHELL.BASE "" UWORD ADC_10bit 1 100 0.0 5.0 ECU_ADDRESS 0x821DFC /end MEASUREMENT
/begin MEASUREMENT HWE_IA_TER30.SHELL.BASE "" UWORD ADC_KL30B 1 100 0.0 24.1156462585034 ECU_ADDRESS 0x821DFE /end MEASUREMENT
/begin MEASUREMENT HWE_IA_TER30B.SHELL.BASE "" UWORD ADC_KL30B 1 100 0.0 24.1156462585034 ECU_ADDRESS 0x821E00 /end MEASUREMENT
/begin MEASUREMENT HWE_IA01.SHELL.BASE "" UWORD ADC_10bit 1 100 0.0 5.0 ECU_ADDRESS 0x821DCA /end MEASUREMENT
/begin MEASUREMENT HWE_IA02.SHELL.BASE "" UWORD ADC_10bit 1 100 0.0 5.0 ECU_ADDRESS 0x821DCC /end MEASUREMENT
/begin MEASUREMENT HWE_IA03.SHELL.BASE "" UWORD ADC_10bit 1 100 0.0 5.0 ECU_ADDRESS 0x821DCE /end MEASUREMENT
/begin MEASUREMENT HWE_IA04.SHELL.BASE "" UWORD ADC_10bit 1 100 0.0 5.0 ECU_ADDRESS 0x821DD0 /end MEASUREMENT
/begin MEASUREMENT HWE_IA05.SHELL.BASE "" UWORD ADC_10bit 1 100 0.0 5.0 ECU_ADDRESS 0x821DD2 /end MEASUREMENT
/begin MEASUREMENT HWE_IA06.SHELL.BASE "" UWORD ADC_10bit 1 100 0.0 5.0 ECU_ADDRESS 0x821DD4 /end MEASUREMENT
/begin MEASUREMENT HWE_IA07.SHELL.BASE "" UWORD ADC_10bit 1 100 0.0 5.0 ECU_ADDRESS 0x821DD6 /end MEASUREMENT
/begin MEASUREMENT HWE_IA08.SHELL.BASE "" UWORD ADC_10bit 1 100 0.0 5.0 ECU_ADDRESS 0x821DD8 /end MEASUREMENT
/begin MEASUREMENT HWE_IA09.SHELL.BASE "" UWORD ADC_10bit 1 100 0.0 5.0 ECU_ADDRESS 0x821DDA /end MEASUREMENT
/begin MEASUREMENT HWE_IA10.SHELL.BASE "" UWORD ADC_10bit 1 100 0.0 5.0 ECU_ADDRESS 0x821DDC /end MEASUREMENT
/begin MEASUREMENT HWE_IA11.SHELL.BASE "" UWORD ADC_10bit 1 100 0.0 5.0 ECU_ADDRESS 0x821DDE /end MEASUREMENT
/begin MEASUREMENT HWE_IA12.SHELL.BASE "" UWORD ADC_10bit 1 100 0.0 5.0 ECU_ADDRESS 0x821DE0 /end MEASUREMENT
/begin MEASUREMENT HWE_IA13.SHELL.BASE "" UWORD ADC_10bit 1 100 0.0 5.0 ECU_ADDRESS 0x821DE2 /end MEASUREMENT
/begin MEASUREMENT HWE_IA14.SHELL.BASE "" UWORD ADC_10bit 1 100 0.0 5.0 ECU_ADDRESS 0x821DE4 /end MEASUREMENT
/begin MEASUREMENT HWE_IA15.SHELL.BASE "" UWORD ADC_10bit 1 100 0.0 5.0 ECU_ADDRESS 0x821DE6 /end MEASUREMENT
/begin MEASUREMENT HWE_IA16.SHELL.BASE "" UWORD ADC_10bit 1 100 0.0 5.0 ECU_ADDRESS 0x821DE8 /end MEASUREMENT
/begin MEASUREMENT HWE_IA17.SHELL.BASE "" UWORD ADC_10bit 1 100 0.0 5.0 ECU_ADDRESS 0x821DEA /end MEASUREMENT
/begin MEASUREMENT HWE_IA18.SHELL.BASE "" UWORD ADC_10bit 1 100 0.0 5.0 ECU_ADDRESS 0x821DEC /end MEASUREMENT
/begin MEASUREMENT HWE_IA19.SHELL.BASE "" UWORD ADC_10bit 1 100 0.0 5.0 ECU_ADDRESS 0x821DEE /end MEASUREMENT
/begin MEASUREMENT HWE_IA20.SHELL.BASE "" UWORD ADC_10bit 1 100 0.0 5.0 ECU_ADDRESS 0x821DF0 /end MEASUREMENT
/begin MEASUREMENT HWE_IA21.SHELL.BASE "" UWORD ADC_10bit 1 100 0.0 5.0 ECU_ADDRESS 0x821DF2 /end MEASUREMENT
/begin MEASUREMENT HWE_IA22.SHELL.BASE "" UWORD ADC_10bit 1 100 0.0 5.0 ECU_ADDRESS 0x821DF4 /end MEASUREMENT
/begin MEASUREMENT HWE_IA25.SHELL.BASE "" UWORD ADC_10bit 1 100 0.0 5.0 ECU_ADDRESS 0x821DF6 /end MEASUREMENT
/begin MEASUREMENT HWE_IA26.SHELL.BASE "" UWORD ADC_10bit 1 100 0.0 5.0 ECU_ADDRESS 0x821DF8 /end MEASUREMENT
/begin MEASUREMENT HWE_ID101RX_failure.SHELL.BASE "" SBYTE ident 1 100 0 1 BIT_MASK 0x1 ECU_ADDRESS 0x821E7F /end MEASUREMENT
/begin MEASUREMENT HWE_ID250RX_failure.SHELL.BASE "" SBYTE ident 1 100 0 1 BIT_MASK 0x1 ECU_ADDRESS 0x821E80 /end MEASUREMENT
/begin MEASUREMENT HWE_ID258RX_failure.SHELL.BASE "" SBYTE ident 1 100 0 1 BIT_MASK 0x1 ECU_ADDRESS 0x821E81 /end MEASUREMENT
/begin MEASUREMENT HWE_ID290RX_failure.SHELL.BASE "" SBYTE ident 1 100 0 1 BIT_MASK 0x1 ECU_ADDRESS 0x821E82 /end MEASUREMENT
/begin MEASUREMENT HWE_ID320RX_failure.SHELL.BASE "" SBYTE ident 1 100 0 1 BIT_MASK 0x1 ECU_ADDRESS 0x821E83 /end MEASUREMENT
/begin MEASUREMENT HWE_ID340RX_failure.SHELL.BASE "" SBYTE ident 1 100 0 1 BIT_MASK 0x1 ECU_ADDRESS 0x821E84 /end MEASUREMENT
/begin MEASUREMENT HWE_ID348RXB_failure.SHELL.BASE "" SBYTE ident 1 100 0 1 BIT_MASK 0x1 ECU_ADDRESS 0x821E85 /end MEASUREMENT
/begin MEASUREMENT HWE_ID358RX_failure.SHELL.BASE "" SBYTE ident 1 100 0 1 BIT_MASK 0x1 ECU_ADDRESS 0x821E86 /end MEASUREMENT
/begin MEASUREMENT HWE_ID500RX_failure.SHELL.BASE "" SBYTE ident 1 100 0 1 BIT_MASK 0x1 ECU_ADDRESS 0x821E87 /end MEASUREMENT
/begin MEASUREMENT HWE_ID510RX_failure.SHELL.BASE "" SBYTE ident 1 100 0 1 BIT_MASK 0x1 ECU_ADDRESS 0x821E88 /end MEASUREMENT
/begin MEASUREMENT HWE_ID578RXB_failure.SHELL.BASE "" SBYTE ident 1 100 0 1 BIT_MASK 0x1 ECU_ADDRESS 0x821E89 /end MEASUREMENT
/begin MEASUREMENT HWE_ID590RXB_failure.SHELL.BASE "" SBYTE ident 1 100 0 1 BIT_MASK 0x1 ECU_ADDRESS 0x821E8A /end MEASUREMENT
/begin MEASUREMENT HWE_ID590RXB_failure_1.SHELL.BASE "" SBYTE ident 1 100 0 1 BIT_MASK 0x1 ECU_ADDRESS 0x821E8B /end MEASUREMENT
/begin MEASUREMENT HWE_ID630RX_failure.SHELL.BASE "" SBYTE ident 1 100 0 1 BIT_MASK 0x1 ECU_ADDRESS 0x821E8C /end MEASUREMENT
/begin MEASUREMENT HWE_ID640RX_failure.SHELL.BASE "" SBYTE ident 1 100 0 1 BIT_MASK 0x1 ECU_ADDRESS 0x821E8D /end MEASUREMENT
/begin MEASUREMENT HWE_ID696RXB_failure.SHELL.BASE "" SBYTE ident 1 100 0 1 BIT_MASK 0x1 ECU_ADDRESS 0x821E8E /end MEASUREMENT
/begin MEASUREMENT HWE_ID696RXB_failure_1.SHELL.BASE "" SBYTE ident 1 100 0 1 BIT_MASK 0x1 ECU_ADDRESS 0x821E8F /end MEASUREMENT
/begin MEASUREMENT HWE_ID710RX_failure.SHELL.BASE "" SBYTE ident 1 100 0 1 BIT_MASK 0x1 ECU_ADDRESS 0x821E90 /end MEASUREMENT
/begin MEASUREMENT HWE_ID760RX_failure.SHELL.BASE "" SBYTE ident 1 100 0 1 BIT_MASK 0x1 ECU_ADDRESS 0x821E91 /end MEASUREMENT
/begin MEASUREMENT HWE_IP01_Dio.SHELL.BASE "" SBYTE ident 1 100 0 1 BIT_MASK 0x1 ECU_ADDRESS 0x821E92 /end MEASUREMENT
/begin MEASUREMENT HWE_IP02_Dio.SHELL.BASE "" SBYTE ident 1 100 0 1 BIT_MASK 0x1 ECU_ADDRESS 0x821E93 /end MEASUREMENT
/begin MEASUREMENT HWE_IP03_Dio.SHELL.BASE "" SBYTE ident 1 100 0 1 BIT_MASK 0x1 ECU_ADDRESS 0x821E94 /end MEASUREMENT
/begin MEASUREMENT HWE_IP04_Dio.SHELL.BASE "" SBYTE ident 1 100 0 1 BIT_MASK 0x1 ECU_ADDRESS 0x821E95 /end MEASUREMENT
/begin MEASUREMENT HWE_IP05_Dio.SHELL.BASE "" SBYTE ident 1 100 0 1 BIT_MASK 0x1 ECU_ADDRESS 0x821E96 /end MEASUREMENT
/begin MEASUREMENT HWE_IP06_Dio.SHELL.BASE "" SBYTE ident 1 100 0 1 BIT_MASK 0x1 ECU_ADDRESS 0x821E97 /end MEASUREMENT
/begin MEASUREMENT HWE_IP07_Dio.SHELL.BASE "" SBYTE ident 1 100 0 1 BIT_MASK 0x1 ECU_ADDRESS 0x821E98 /end MEASUREMENT
/begin MEASUREMENT HWE_IP08_Dio.SHELL.BASE "" SBYTE ident 1 100 0 1 BIT_MASK 0x1 ECU_ADDRESS 0x821E99 /end MEASUREMENT
/begin MEASUREMENT HWE_IP09_Dcyc.SHELL.BASE "" SWORD TPU_Dcyc 1 100 0.0 327.67 ECU_ADDRESS 0x821E02 /end MEASUREMENT
/begin MEASUREMENT HWE_IP09_Err.SHELL.BASE "" UBYTE ident 1 100 0 255 ECU_ADDRESS 0x821E9A /end MEASUREMENT
/begin MEASUREMENT HWE_IP09_Per.SHELL.BASE "" SWORD TPU_PerIn 1 100 0.0 327.67 ECU_ADDRESS 0x821E04 /end MEASUREMENT
/begin MEASUREMENT HWE_IP10_Dcyc.SHELL.BASE "" SWORD TPU_Dcyc 1 100 0.0 327.67 ECU_ADDRESS 0x821E06 /end MEASUREMENT
/begin MEASUREMENT HWE_IP10_Err.SHELL.BASE "" UBYTE ident 1 100 0 255 ECU_ADDRESS 0x821E9B /end MEASUREMENT
/begin MEASUREMENT HWE_IP10_Per.SHELL.BASE "" SWORD TPU_PerIn 1 100 0.0 327.67 ECU_ADDRESS 0x821E08 /end MEASUREMENT
/begin MEASUREMENT HWE_IP11_Dcyc.SHELL.BASE "" SWORD TPU_Dcyc 1 100 0.0 327.67 ECU_ADDRESS 0x821E0A /end MEASUREMENT
/begin MEASUREMENT HWE_IP11_Err.SHELL.BASE "" UBYTE ident 1 100 0 255 ECU_ADDRESS 0x821E9C /end MEASUREMENT
/begin MEASUREMENT HWE_IP11_Per.SHELL.BASE "" SWORD TPU_PerIn 1 100 0.0 327.67 ECU_ADDRESS 0x821E0C /end MEASUREMENT
/begin MEASUREMENT HWE_IP12_Dcyc.SHELL.BASE "" SWORD TPU_Dcyc 1 100 0.0 327.67 ECU_ADDRESS 0x821E0E /end MEASUREMENT
/begin MEASUREMENT HWE_IP12_Err.SHELL.BASE "" UBYTE ident 1 100 0 255 ECU_ADDRESS 0x821E9D /end MEASUREMENT
/begin MEASUREMENT HWE_IP12_Per.SHELL.BASE "" SWORD TPU_PerIn 1 100 0.0 327.67 ECU_ADDRESS 0x821E10 /end MEASUREMENT
/begin MEASUREMENT HWE_IS_ON.SHELL.BASE "" SBYTE ident 1 100 0 1 BIT_MASK 0x1 ECU_ADDRESS 0x821EAA /end MEASUREMENT
/begin MEASUREMENT HWE_IS_TER15.SHELL.BASE "" SBYTE ident 1 100 0 1 BIT_MASK 0x1 ECU_ADDRESS 0x821EAB /end MEASUREMENT
/begin MEASUREMENT HWE_IS_TER15R.SHELL.BASE "" SBYTE ident 1 100 0 1 BIT_MASK 0x1 ECU_ADDRESS 0x821EAC /end MEASUREMENT
/begin MEASUREMENT HWE_IS_TER50.SHELL.BASE "" SBYTE ident 1 100 0 1 BIT_MASK 0x1 ECU_ADDRESS 0x821EAD /end MEASUREMENT
/begin MEASUREMENT HWE_IS_WDA.SHELL.BASE "" SBYTE ident 1 100 0 1 BIT_MASK 0x1 ECU_ADDRESS 0x821EAE /end MEASUREMENT
/begin MEASUREMENT HWE_IS01.SHELL.BASE "" SBYTE ident 1 100 0 1 BIT_MASK 0x1 ECU_ADDRESS 0x821E9E /end MEASUREMENT
/begin MEASUREMENT HWE_IS02.SHELL.BASE "" SBYTE ident 1 100 0 1 BIT_MASK 0x1 ECU_ADDRESS 0x821E9F /end MEASUREMENT
/begin MEASUREMENT HWE_IS03.SHELL.BASE "" SBYTE ident 1 100 0 1 BIT_MASK 0x1 ECU_ADDRESS 0x821EA0 /end MEASUREMENT
/begin MEASUREMENT HWE_IS04.SHELL.BASE "" SBYTE ident 1 100 0 1 BIT_MASK 0x1 ECU_ADDRESS 0x821EA1 /end MEASUREMENT
/begin MEASUREMENT HWE_IS05.SHELL.BASE "" SBYTE ident 1 100 0 1 BIT_MASK 0x1 ECU_ADDRESS 0x821EA2 /end MEASUREMENT
/begin MEASUREMENT HWE_IS06.SHELL.BASE "" SBYTE ident 1 100 0 1 BIT_MASK 0x1 ECU_ADDRESS 0x821EA3 /end MEASUREMENT
/begin MEASUREMENT HWE_IS07.SHELL.BASE "" SBYTE ident 1 100 0 1 BIT_MASK 0x1 ECU_ADDRESS 0x821EA4 /end MEASUREMENT
/begin MEASUREMENT HWE_IS08.SHELL.BASE "" SBYTE ident 1 100 0 1 BIT_MASK 0x1 ECU_ADDRESS 0x821EA5 /end MEASUREMENT
/begin MEASUREMENT HWE_IS09.SHELL.BASE "" SBYTE ident 1 100 0 1 BIT_MASK 0x1 ECU_ADDRESS 0x821EA6 /end MEASUREMENT
/begin MEASUREMENT HWE_IS10.SHELL.BASE "" SBYTE ident 1 100 0 1 BIT_MASK 0x1 ECU_ADDRESS 0x821EA7 /end MEASUREMENT
/begin MEASUREMENT HWE_IS11.SHELL.BASE "" SBYTE ident 1 100 0 1 BIT_MASK 0x1 ECU_ADDRESS 0x821EA8 /end MEASUREMENT
/begin MEASUREMENT HWE_IS12.SHELL.BASE "" SBYTE ident 1 100 0 1 BIT_MASK 0x1 ECU_ADDRESS 0x821EA9 /end MEASUREMENT
/begin MEASUREMENT HWE_OIC01_Dcyc.SHELL.BASE "" SWORD TPU_Dcyc 1 100 0.0 327.67 ECU_ADDRESS 0x821E12 /end MEASUREMENT
/begin MEASUREMENT HWE_OIC01_DiagReg.SHELL.BASE "" UBYTE ident 1 100 0 255 ECU_ADDRESS 0x821EAF /end MEASUREMENT
/begin MEASUREMENT HWE_OIC01_DiagRet.SHELL.BASE "" UBYTE ident 1 100 0 255 ECU_ADDRESS 0x821EB0 /end MEASUREMENT
/begin MEASUREMENT HWE_OIC01_Err.SHELL.BASE "" UWORD ident 1 100 0.0 65535.0 ECU_ADDRESS 0x821E14 /end MEASUREMENT
/begin MEASUREMENT HWE_OIC01_Stat.SHELL.BASE "" UWORD ident 1 100 0.0 65535.0 ECU_ADDRESS 0x821E16 /end MEASUREMENT
/begin MEASUREMENT HWE_OIC02_Dcyc.SHELL.BASE "" SWORD TPU_Dcyc 1 100 0.0 327.67 ECU_ADDRESS 0x821E18 /end MEASUREMENT
/begin MEASUREMENT HWE_OIC02_Diag.SHELL.BASE "" UBYTE ident 1 100 0 255 ECU_ADDRESS 0x821EB1 /end MEASUREMENT
/begin MEASUREMENT HWE_OIC02_DiagReg.SHELL.BASE "" UBYTE ident 1 100 0 255 ECU_ADDRESS 0x821EB2 /end MEASUREMENT
/begin MEASUREMENT HWE_OIC02_DiagRet.SHELL.BASE "" UBYTE ident 1 100 0 255 ECU_ADDRESS 0x821EB3 /end MEASUREMENT
/begin MEASUREMENT HWE_OIC02_Err.SHELL.BASE "" UWORD ident 1 100 0.0 65535.0 ECU_ADDRESS 0x821E1A /end MEASUREMENT
/begin MEASUREMENT HWE_OIC02_Stat.SHELL.BASE "" UWORD ident 1 100 0.0 65535.0 ECU_ADDRESS 0x821E1C /end MEASUREMENT
/begin MEASUREMENT HWE_OPI01_Dcyc.SHELL.BASE "" SWORD TPU_Dcyc 1 100 0.0 327.67 ECU_ADDRESS 0x821E1E /end MEASUREMENT
/begin MEASUREMENT HWE_OPI01_Err.SHELL.BASE "" UWORD ident 1 100 0 65535 ECU_ADDRESS 0x7FB5E8 /end MEASUREMENT
/begin MEASUREMENT HWE_OPI01_Stat.SHELL.BASE "" UWORD ident 1 100 0 65535 ECU_ADDRESS 0x7FB5EA /end MEASUREMENT
/begin MEASUREMENT HWE_OPI02_Dcyc.SHELL.BASE "" SWORD TPU_Dcyc 1 100 0.0 327.67 ECU_ADDRESS 0x821E20 /end MEASUREMENT
/begin MEASUREMENT HWE_OPI02_Err.SHELL.BASE "" UWORD ident 1 100 0 65535 ECU_ADDRESS 0x7FB5EC /end MEASUREMENT
/begin MEASUREMENT HWE_OPI02_Stat.SHELL.BASE "" UWORD ident 1 100 0 65535 ECU_ADDRESS 0x7FB5EE /end MEASUREMENT
/begin MEASUREMENT HWE_OPI03_Dcyc.SHELL.BASE "" SWORD TPU_Dcyc 1 100 0.0 327.67 ECU_ADDRESS 0x821E22 /end MEASUREMENT
/begin MEASUREMENT HWE_OPI03_Err.SHELL.BASE "" UWORD ident 1 100 0 65535 ECU_ADDRESS 0x7FB5F0 /end MEASUREMENT
/begin MEASUREMENT HWE_OPI03_Stat.SHELL.BASE "" UWORD ident 1 100 0 65535 ECU_ADDRESS 0x7FB5F2 /end MEASUREMENT
/begin MEASUREMENT HWE_OPI04_Dcyc.SHELL.BASE "" SWORD TPU_Dcyc 1 100 0.0 327.67 ECU_ADDRESS 0x821E24 /end MEASUREMENT
/begin MEASUREMENT HWE_OPI04_Err.SHELL.BASE "" UWORD ident 1 100 0 65535 ECU_ADDRESS 0x7FB5F4 /end MEASUREMENT
/begin MEASUREMENT HWE_OPI04_Stat.SHELL.BASE "" UWORD ident 1 100 0 65535 ECU_ADDRESS 0x7FB5F6 /end MEASUREMENT
/begin MEASUREMENT HWE_OPI05_Dcyc.SHELL.BASE "" SWORD TPU_Dcyc 1 100 0.0 327.67 ECU_ADDRESS 0x821E26 /end MEASUREMENT
/begin MEASUREMENT HWE_OPI05_Err.SHELL.BASE "" UWORD ident 1 100 0 65535 ECU_ADDRESS 0x7FB5F8 /end MEASUREMENT
/begin MEASUREMENT HWE_OPI05_Stat.SHELL.BASE "" UWORD ident 1 100 0 65535 ECU_ADDRESS 0x7FB5FA /end MEASUREMENT
/begin MEASUREMENT HWE_OPI06_Dcyc.SHELL.BASE "" SWORD TPU_Dcyc 1 100 0.0 327.67 ECU_ADDRESS 0x821E28 /end MEASUREMENT
/begin MEASUREMENT HWE_OPI06_Err.SHELL.BASE "" UWORD ident 1 100 0 65535 ECU_ADDRESS 0x7FB5FC /end MEASUREMENT
/begin MEASUREMENT HWE_OPI06_Stat.SHELL.BASE "" UWORD ident 1 100 0 65535 ECU_ADDRESS 0x7FB5FE /end MEASUREMENT
/begin MEASUREMENT HWE_OPI07_Dcyc.SHELL.BASE "" SWORD TPU_Dcyc 1 100 0.0 327.67 ECU_ADDRESS 0x821E2A /end MEASUREMENT
/begin MEASUREMENT HWE_OPI07_Err.SHELL.BASE "" UWORD ident 1 100 0 65535 ECU_ADDRESS 0x7FB600 /end MEASUREMENT
/begin MEASUREMENT HWE_OPI07_Stat.SHELL.BASE "" UWORD ident 1 100 0 65535 ECU_ADDRESS 0x7FB602 /end MEASUREMENT
/begin MEASUREMENT HWE_OPI08_Dcyc.SHELL.BASE "" SWORD TPU_Dcyc 1 100 0.0 327.67 ECU_ADDRESS 0x821E2C /end MEASUREMENT
/begin MEASUREMENT HWE_OPI08_Err.SHELL.BASE "" UWORD ident 1 100 0 65535 ECU_ADDRESS 0x7FB604 /end MEASUREMENT
/begin MEASUREMENT HWE_OPI08_Stat.SHELL.BASE "" UWORD ident 1 100 0 65535 ECU_ADDRESS 0x7FB606 /end MEASUREMENT
/begin MEASUREMENT HWE_OPI09_Dcyc.SHELL.BASE "" SWORD TPU_Dcyc 1 100 0.0 327.67 ECU_ADDRESS 0x821E2E /end MEASUREMENT
/begin MEASUREMENT HWE_OPI09_Err.SHELL.BASE "" UWORD ident 1 100 0 65535 ECU_ADDRESS 0x7FB608 /end MEASUREMENT
/begin MEASUREMENT HWE_OPI09_Stat.SHELL.BASE "" UWORD ident 1 100 0 65535 ECU_ADDRESS 0x7FB60A /end MEASUREMENT
/begin MEASUREMENT HWE_OPI10_Dcyc.SHELL.BASE "" SWORD TPU_Dcyc 1 100 0.0 327.67 ECU_ADDRESS 0x821E30 /end MEASUREMENT
/begin MEASUREMENT HWE_OPI10_Err.SHELL.BASE "" UWORD ident 1 100 0 65535 ECU_ADDRESS 0x7FB60C /end MEASUREMENT
/begin MEASUREMENT HWE_OPI10_Stat.SHELL.BASE "" UWORD ident 1 100 0 65535 ECU_ADDRESS 0x7FB60E /end MEASUREMENT
/begin MEASUREMENT HWE_OPI11_Dcyc.SHELL.BASE "" SWORD TPU_Dcyc 1 100 0.0 327.67 ECU_ADDRESS 0x821E32 /end MEASUREMENT
/begin MEASUREMENT HWE_OPI11_Err.SHELL.BASE "" UWORD ident 1 100 0 65535 ECU_ADDRESS 0x7FB610 /end MEASUREMENT
/begin MEASUREMENT HWE_OPI11_Stat.SHELL.BASE "" UWORD ident 1 100 0 65535 ECU_ADDRESS 0x7FB612 /end MEASUREMENT
/begin MEASUREMENT HWE_OS_ModelState.SHELL.BASE "" ULONG ident 1 100 0 4294967295 ECU_ADDRESS 0x821DA8 /end MEASUREMENT
/begin MEASUREMENT HWE_OS_MR.SHELL.BASE "" SBYTE ident 1 100 0 1 BIT_MASK 0x1 ECU_ADDRESS 0x821ECF /end MEASUREMENT
/begin MEASUREMENT HWE_OS01_DiagReg.SHELL.BASE "Diagnostic data of Hbridge #1" UBYTE ident 1 100 0 255 ECU_ADDRESS 0x821EB4 /end MEASUREMENT
/begin MEASUREMENT HWE_OS01_DiagRet.SHELL.BASE "" UBYTE ident 1 100 0 255 ECU_ADDRESS 0x821EB5 /end MEASUREMENT
/begin MEASUREMENT HWE_OS01_DiagStat.SHELL.BASE "" UBYTE ident 1 100 0 255 ECU_ADDRESS 0x821EB6 /end MEASUREMENT
/begin MEASUREMENT HWE_OS01_Disable.SHELL.BASE "" UBYTE ident 1 100 0 1 BIT_MASK 0x1 ECU_ADDRESS 0x821EB7 /end MEASUREMENT
/begin MEASUREMENT HWE_OS01_En.SHELL.BASE "" UBYTE ident 1 100 0 1 BIT_MASK 0x1 ECU_ADDRESS 0x821EB8 /end MEASUREMENT
/begin MEASUREMENT HWE_OS01_Err.SHELL.BASE "Diagnostic data of Hbridge #1" UWORD ident 1 100 0 65535 ECU_ADDRESS 0x821E34 /end MEASUREMENT
/begin MEASUREMENT HWE_OS01_S_Dcyc.SHELL.BASE "" UWORD TPU_Dcyc 1 100 0.0 100.0 ECU_ADDRESS 0x821E36 /end MEASUREMENT
/begin MEASUREMENT HWE_OS01_Stat.SHELL.BASE "Diagnostic data of Hbridge #1" UWORD ident 1 100 0 65535 ECU_ADDRESS 0x821E38 /end MEASUREMENT
/begin MEASUREMENT HWE_OS01_V.SHELL.BASE "" SBYTE ident 1 100 0 1 BIT_MASK 0x1 ECU_ADDRESS 0x821EB9 /end MEASUREMENT
/begin MEASUREMENT HWE_OS02_DiagReg.SHELL.BASE "Diagnostic data of Hbridge #1" UBYTE ident 1 100 0 255 ECU_ADDRESS 0x821EBA /end MEASUREMENT
/begin MEASUREMENT HWE_OS02_DiagRet.SHELL.BASE "" UBYTE ident 1 100 0 255 ECU_ADDRESS 0x821EBB /end MEASUREMENT
/begin MEASUREMENT HWE_OS02_DiagStat.SHELL.BASE "" UBYTE ident 1 100 0 255 ECU_ADDRESS 0x821EBC /end MEASUREMENT
/begin MEASUREMENT HWE_OS02_Disable.SHELL.BASE "" SBYTE ident 1 100 0 1 BIT_MASK 0x1 ECU_ADDRESS 0x821EBD /end MEASUREMENT
/begin MEASUREMENT HWE_OS02_En.SHELL.BASE "" SBYTE ident 1 100 0 1 BIT_MASK 0x1 ECU_ADDRESS 0x821EBE /end MEASUREMENT
/begin MEASUREMENT HWE_OS02_Err.SHELL.BASE "Diagnostic data of Hbridge #1" UWORD ident 1 100 0 65535 ECU_ADDRESS 0x821E3A /end MEASUREMENT
/begin MEASUREMENT HWE_OS02_S_Dcyc.SHELL.BASE "" UWORD TPU_Dcyc 1 100 0.0 100.0 ECU_ADDRESS 0x821E3C /end MEASUREMENT
/begin MEASUREMENT HWE_OS02_Stat.SHELL.BASE "Diagnostic data of Hbridge #1" UWORD ident 1 100 0 65535 ECU_ADDRESS 0x821E3E /end MEASUREMENT
/begin MEASUREMENT HWE_OS02_V.SHELL.BASE "" SBYTE ident 1 100 0 1 BIT_MASK 0x1 ECU_ADDRESS 0x821EBF /end MEASUREMENT
/begin MEASUREMENT HWE_OS03.SHELL.BASE "" SBYTE ident 1 100 0 1 BIT_MASK 0x1 ECU_ADDRESS 0x821EC0 /end MEASUREMENT
/begin MEASUREMENT HWE_OS03_Err.SHELL.BASE "" UWORD ident 1 100 0 65535 ECU_ADDRESS 0x821E40 /end MEASUREMENT
/begin MEASUREMENT HWE_OS03_Stat.SHELL.BASE "" UWORD ident 1 100 0 65535 ECU_ADDRESS 0x821E42 /end MEASUREMENT
/begin MEASUREMENT HWE_OS04.SHELL.BASE "" SBYTE ident 1 100 0 1 BIT_MASK 0x1 ECU_ADDRESS 0x821EC1 /end MEASUREMENT
/begin MEASUREMENT HWE_OS04_Err.SHELL.BASE "" UWORD ident 1 100 0 65535 ECU_ADDRESS 0x821E44 /end MEASUREMENT
/begin MEASUREMENT HWE_OS04_Stat.SHELL.BASE "" UWORD ident 1 100 0 65535 ECU_ADDRESS 0x821E46 /end MEASUREMENT
/begin MEASUREMENT HWE_OS05a.SHELL.BASE "" SBYTE ident 1 100 0 1 BIT_MASK 0x1 ECU_ADDRESS 0x821EC2 /end MEASUREMENT
/begin MEASUREMENT HWE_OS05a_Err.SHELL.BASE "" UWORD ident 1 100 0 65535 ECU_ADDRESS 0x821E48 /end MEASUREMENT
/begin MEASUREMENT HWE_OS05a_Stat.SHELL.BASE "" UWORD ident 1 100 0 65535 ECU_ADDRESS 0x821E4A /end MEASUREMENT
/begin MEASUREMENT HWE_OS05b.SHELL.BASE "" SBYTE ident 1 100 0 1 BIT_MASK 0x1 ECU_ADDRESS 0x821EC3 /end MEASUREMENT
/begin MEASUREMENT HWE_OS05b_Err.SHELL.BASE "" UWORD ident 1 100 0 65535 ECU_ADDRESS 0x821E4C /end MEASUREMENT
/begin MEASUREMENT HWE_OS05b_Stat.SHELL.BASE "" UWORD ident 1 100 0 65535 ECU_ADDRESS 0x821E4E /end MEASUREMENT
/begin MEASUREMENT HWE_OS05c.SHELL.BASE "" SBYTE ident 1 100 0 1 BIT_MASK 0x1 ECU_ADDRESS 0x821EC4 /end MEASUREMENT
/begin MEASUREMENT HWE_OS05c_Err.SHELL.BASE "" UWORD ident 1 100 0 65535 ECU_ADDRESS 0x821E50 /end MEASUREMENT
/begin MEASUREMENT HWE_OS05c_Stat.SHELL.BASE "" UWORD ident 1 100 0 65535 ECU_ADDRESS 0x821E52 /end MEASUREMENT
/begin MEASUREMENT HWE_OS06.SHELL.BASE "" SBYTE ident 1 100 0 1 BIT_MASK 0x1 ECU_ADDRESS 0x821EC5 /end MEASUREMENT
/begin MEASUREMENT HWE_OS06_Err.SHELL.BASE "" UWORD ident 1 100 0 65535 ECU_ADDRESS 0x821E54 /end MEASUREMENT
/begin MEASUREMENT HWE_OS06_Stat.SHELL.BASE "" UWORD ident 1 100 0 65535 ECU_ADDRESS 0x821E56 /end MEASUREMENT
/begin MEASUREMENT HWE_OS07.SHELL.BASE "" SBYTE ident 1 100 0 1 BIT_MASK 0x1 ECU_ADDRESS 0x821EC6 /end MEASUREMENT
/begin MEASUREMENT HWE_OS07_Err.SHELL.BASE "" UWORD ident 1 100 0 65535 ECU_ADDRESS 0x821E58 /end MEASUREMENT
/begin MEASUREMENT HWE_OS07_Stat.SHELL.BASE "" UWORD ident 1 100 0 65535 ECU_ADDRESS 0x821E5A /end MEASUREMENT
/begin MEASUREMENT HWE_OS08.SHELL.BASE "" SBYTE ident 1 100 0 1 BIT_MASK 0x1 ECU_ADDRESS 0x821EC7 /end MEASUREMENT
/begin MEASUREMENT HWE_OS08_Err.SHELL.BASE "" UWORD ident 1 100 0 65535 ECU_ADDRESS 0x821E5C /end MEASUREMENT
/begin MEASUREMENT HWE_OS08_Stat.SHELL.BASE "" UWORD ident 1 100 0 65535 ECU_ADDRESS 0x821E5E /end MEASUREMENT
/begin MEASUREMENT HWE_OS09.SHELL.BASE "" SBYTE ident 1 100 0 1 BIT_MASK 0x1 ECU_ADDRESS 0x821EC8 /end MEASUREMENT
/begin MEASUREMENT HWE_OS09_Err.SHELL.BASE "" UWORD ident 1 100 0 65535 ECU_ADDRESS 0x821E60 /end MEASUREMENT
/begin MEASUREMENT HWE_OS09_Stat.SHELL.BASE "" UWORD ident 1 100 0 65535 ECU_ADDRESS 0x821E62 /end MEASUREMENT
/begin MEASUREMENT HWE_OS10.SHELL.BASE "" SBYTE ident 1 100 0 1 BIT_MASK 0x1 ECU_ADDRESS 0x821EC9 /end MEASUREMENT
/begin MEASUREMENT HWE_OS10_Err.SHELL.BASE "" UWORD ident 1 100 0 65535 ECU_ADDRESS 0x821E64 /end MEASUREMENT
/begin MEASUREMENT HWE_OS10_Stat.SHELL.BASE "" UWORD ident 1 100 0 65535 ECU_ADDRESS 0x821E66 /end MEASUREMENT
/begin MEASUREMENT HWE_OS11.SHELL.BASE "" SBYTE ident 1 100 0 1 BIT_MASK 0x1 ECU_ADDRESS 0x821ECA /end MEASUREMENT
/begin MEASUREMENT HWE_OS11_Err.SHELL.BASE "" UWORD ident 1 100 0 65535 ECU_ADDRESS 0x821E68 /end MEASUREMENT
/begin MEASUREMENT HWE_OS11_Stat.SHELL.BASE "" UWORD ident 1 100 0 65535 ECU_ADDRESS 0x821E6A /end MEASUREMENT
/begin MEASUREMENT HWE_OS12.SHELL.BASE "" SBYTE ident 1 100 0 1 BIT_MASK 0x1 ECU_ADDRESS 0x821ECB /end MEASUREMENT
/begin MEASUREMENT HWE_OS12_Err.SHELL.BASE "" UWORD ident 1 100 0 65535 ECU_ADDRESS 0x821E6C /end MEASUREMENT
/begin MEASUREMENT HWE_OS12_Stat.SHELL.BASE "" UWORD ident 1 100 0 65535 ECU_ADDRESS 0x821E6E /end MEASUREMENT
/begin MEASUREMENT HWE_OS13.SHELL.BASE "" SBYTE ident 1 100 0 1 BIT_MASK 0x1 ECU_ADDRESS 0x821ECC /end MEASUREMENT
/begin MEASUREMENT HWE_OS13_Err.SHELL.BASE "" UWORD ident 1 100 0 65535 ECU_ADDRESS 0x821E70 /end MEASUREMENT
/begin MEASUREMENT HWE_OS13_Stat.SHELL.BASE "" UWORD ident 1 100 0 65535 ECU_ADDRESS 0x821E72 /end MEASUREMENT
/begin MEASUREMENT HWE_OS14.SHELL.BASE "" SBYTE ident 1 100 0 1 BIT_MASK 0x1 ECU_ADDRESS 0x821ECD /end MEASUREMENT
/begin MEASUREMENT HWE_OS14_Err.SHELL.BASE "" UWORD ident 1 100 0 65535 ECU_ADDRESS 0x821E74 /end MEASUREMENT
/begin MEASUREMENT HWE_OS14_Stat.SHELL.BASE "" UWORD ident 1 100 0 65535 ECU_ADDRESS 0x821E76 /end MEASUREMENT
/begin MEASUREMENT HWE_OS15.SHELL.BASE "" SBYTE ident 1 100 0 1 BIT_MASK 0x1 ECU_ADDRESS 0x821ECE /end MEASUREMENT
/begin MEASUREMENT HWE_OS15_Err.SHELL.BASE "" UWORD ident 1 100 0 65535 ECU_ADDRESS 0x821E78 /end MEASUREMENT
/begin MEASUREMENT HWE_OS15_Stat.SHELL.BASE "" UWORD ident 1 100 0 65535 ECU_ADDRESS 0x821E7A /end MEASUREMENT
/begin MEASUREMENT HWE_PowerfailDetected.HWE.BASE "This messages indicates that there has been a  KL30 failure has occurred before the actual init" SBYTE ident 1 100 0 1 BIT_MASK 0x1 ECU_ADDRESS 0x7FB0E4 /end MEASUREMENT
/begin MEASUREMENT HWE_ResetMonitor_Adr.HWE.BASE "" ULONG ident 1 100 0 4294967295 ECU_ADDRESS 0x8215BC MATRIX_DIM 10 1 1 /end MEASUREMENT
/begin MEASUREMENT HWE_ResetMonitor_Counter.HWE.BASE "" UWORD ident 1 100 0 65535 ECU_ADDRESS 0x821634 /end MEASUREMENT
/begin MEASUREMENT HWE_ResetMonitor_ID.HWE.BASE "" ULONG ident 1 100 0 4294967295 ECU_ADDRESS 0x82160C MATRIX_DIM 10 1 1 /end MEASUREMENT
/begin MEASUREMENT HWE_ResetMonitor_RSR.HWE.BASE "" ULONG ident 1 100 0 4294967295 ECU_ADDRESS 0x8215E4 MATRIX_DIM 10 1 1 /end MEASUREMENT
/begin MEASUREMENT HWE_ResetMonitor_Time.HWE.BASE "" FLOAT32_IEEE ident 1 100 -1.e+037 1.e+037 ECU_ADDRESS 0x821638 MATRIX_DIM 10 1 1 /end MEASUREMENT
/begin MEASUREMENT HWE_Rtmo_ctSample.SHELL.BASE "" UWORD ident 1 100 0 65535 ECU_ADDRESS 0x7FB614 /end MEASUREMENT
/begin MEASUREMENT HWE_Rtmo_ctSampleProc.SHELL.BASE "" ULONG ident 1 100 0 4294967295 ECU_ADDRESS 0x7FB5BC /end MEASUREMENT
/begin MEASUREMENT HWE_Rtmo_pLoadMax.SHELL.BASE "" FLOAT32_IEEE ident 1 100 0.0 100.0 ECU_ADDRESS 0x7FB5C0 /end MEASUREMENT
/begin MEASUREMENT HWE_Rtmo_tiAbsMax.SHELL.BASE "" ULONG Rtm_TicksToUs 1 100 0.0 1227133512.857143 ECU_ADDRESS 0x7FB5C4 /end MEASUREMENT
/begin MEASUREMENT HWE_Rtmo_tiAbsMax_1.SHELL.BASE "" ULONG Rtm_TicksToUs 1 100 0.0 1227133512.857143 ECU_ADDRESS 0x7FB5C8 /end MEASUREMENT
/begin MEASUREMENT HWE_Rtmo_tiAbsMin.SHELL.BASE "" ULONG Rtm_TicksToUs 1 100 0.0 1227133512.85714 ECU_ADDRESS 0x7FB5CC /end MEASUREMENT
/begin MEASUREMENT HWE_Rtmo_tiAvrg.SHELL.BASE "" ULONG Rtm_TicksToUs 1 100 0.0 1227133512.857143 ECU_ADDRESS 0x7FB5D0 /end MEASUREMENT
/begin MEASUREMENT HWE_Rtmo_tiMax.SHELL.BASE "" ULONG Rtm_TicksToUs 1 100 0.0 1227133512.85714 ECU_ADDRESS 0x7FB5D4 /end MEASUREMENT
/begin MEASUREMENT HWE_Rtmo_tiMaxCallDist.SHELL.BASE "" ULONG Rtm_TicksToUs 1 100 0.0 1227133512.85714 ECU_ADDRESS 0x7FB5D8 /end MEASUREMENT
/begin MEASUREMENT HWE_Rtmo_tiMin.SHELL.BASE "" ULONG Rtm_TicksToUs 1 100 0.0 1227133512.85714 ECU_ADDRESS 0x7FB5DC /end MEASUREMENT
/begin MEASUREMENT HWE_Rtmo_tiMinCallDist.SHELL.BASE "" ULONG Rtm_TicksToUs 1 100 0.0 1227133512.85714 ECU_ADDRESS 0x7FB5E0 /end MEASUREMENT
/begin MEASUREMENT HWE_ServiceCounter_st.SHELL.BASE "" ULONG ident 1 100 0 4294967295 ECU_ADDRESS 0x7FB5E4 /end MEASUREMENT
/begin MEASUREMENT HWE_SwitchOff.SHELL.BASE "" SBYTE ident 1 100 0 1 BIT_MASK 0x1 ECU_ADDRESS 0x7FB622 /end MEASUREMENT
/begin MEASUREMENT is_started.Time_Calc.HWE.BASE "" UBYTE ident 1 100 0 1 ECU_ADDRESS 0x7F8944 MATRIX_DIM 3 1 1 /end MEASUREMENT
/begin MEASUREMENT l_baudrate_calculated_f32.HWE_CAN_A.SHELL.BASE "" FLOAT32_IEEE ident 1 100 0.0 1000000.0 ECU_ADDRESS 0x7F8EC0 /end MEASUREMENT
/begin MEASUREMENT l_baudrate_calculated_f32.HWE_CAN_B.SHELL.BASE "" FLOAT32_IEEE ident 1 100 0.0 1000000.0 ECU_ADDRESS 0x7F8ECC /end MEASUREMENT
/begin MEASUREMENT l_baudrate_calculated_f32.HWE_CAN_C.SHELL.BASE "" FLOAT32_IEEE ident 1 100 0.0 1000000.0 ECU_ADDRESS 0x7F8ED8 /end MEASUREMENT
/begin MEASUREMENT l_baudrate_e.HWE_CAN_A.SHELL.BASE "" UBYTE enum_HWE_CAN_BAUDRATE_ENUM 1 100 0 6 ECU_ADDRESS 0x7F8EC4 /end MEASUREMENT
/begin MEASUREMENT l_baudrate_e.HWE_CAN_B.SHELL.BASE "" UBYTE enum_HWE_CAN_BAUDRATE_ENUM 1 100 0 6 ECU_ADDRESS 0x7F8ED0 /end MEASUREMENT
/begin MEASUREMENT l_baudrate_e.HWE_CAN_C.SHELL.BASE "" UBYTE enum_HWE_CAN_BAUDRATE_ENUM 1 100 0 6 ECU_ADDRESS 0x7F8EDC /end MEASUREMENT
/begin MEASUREMENT l_CAN_B_IRQ_begin_u32.HWE.BASE "" ULONG TickType2ms 1 100 0.1428571428571429 600000.0 ECU_ADDRESS 0x7F8910 /end MEASUREMENT
/begin MEASUREMENT l_CAN_B_IRQ_ExeTime_u32.HWE.BASE "" ULONG TickType2ms 1 100 0.1428571428571429 600000.0 ECU_ADDRESS 0x7F890C /end MEASUREMENT
/begin MEASUREMENT l_dBRP_u8.HWE_CAN_A.SHELL.BASE "" UBYTE ident 1 100 1 64 ECU_ADDRESS 0x7F8EC5 /end MEASUREMENT
/begin MEASUREMENT l_dBRP_u8.HWE_CAN_B.SHELL.BASE "" UBYTE ident 1 100 1 64 ECU_ADDRESS 0x7F8ED1 /end MEASUREMENT
/begin MEASUREMENT l_dBRP_u8.HWE_CAN_C.SHELL.BASE "" UBYTE ident 1 100 1 64 ECU_ADDRESS 0x7F8EDD /end MEASUREMENT
/begin MEASUREMENT l_dPropSeg_u8.HWE_CAN_A.SHELL.BASE "" UBYTE ident 1 100 1 8 ECU_ADDRESS 0x7F8EC8 /end MEASUREMENT
/begin MEASUREMENT l_dPropSeg_u8.HWE_CAN_B.SHELL.BASE "" UBYTE ident 1 100 1 8 ECU_ADDRESS 0x7F8ED4 /end MEASUREMENT
/begin MEASUREMENT l_dPropSeg_u8.HWE_CAN_C.SHELL.BASE "" UBYTE ident 1 100 1 8 ECU_ADDRESS 0x7F8EE0 /end MEASUREMENT
/begin MEASUREMENT l_dPSeg1_u8.HWE_CAN_A.SHELL.BASE "" UBYTE ident 1 100 1 8 ECU_ADDRESS 0x7F8EC6 /end MEASUREMENT
/begin MEASUREMENT l_dPSeg1_u8.HWE_CAN_B.SHELL.BASE "" UBYTE ident 1 100 1 8 ECU_ADDRESS 0x7F8ED2 /end MEASUREMENT
/begin MEASUREMENT l_dPSeg1_u8.HWE_CAN_C.SHELL.BASE "" UBYTE ident 1 100 1 8 ECU_ADDRESS 0x7F8EDE /end MEASUREMENT
/begin MEASUREMENT l_dPSeg2_u8.HWE_CAN_A.SHELL.BASE "" UBYTE ident 1 100 1 8 ECU_ADDRESS 0x7F8EC7 /end MEASUREMENT
/begin MEASUREMENT l_dPSeg2_u8.HWE_CAN_B.SHELL.BASE "" UBYTE ident 1 100 1 8 ECU_ADDRESS 0x7F8ED3 /end MEASUREMENT
/begin MEASUREMENT l_dPSeg2_u8.HWE_CAN_C.SHELL.BASE "" UBYTE ident 1 100 1 8 ECU_ADDRESS 0x7F8EDF /end MEASUREMENT
/begin MEASUREMENT l_dSJW_u8.HWE_CAN_A.SHELL.BASE "" UBYTE ident 1 100 1 4 ECU_ADDRESS 0x7F8EC9 /end MEASUREMENT
/begin MEASUREMENT l_dSJW_u8.HWE_CAN_B.SHELL.BASE "" UBYTE ident 1 100 1 4 ECU_ADDRESS 0x7F8ED5 /end MEASUREMENT
/begin MEASUREMENT l_dSJW_u8.HWE_CAN_C.SHELL.BASE "" UBYTE ident 1 100 1 4 ECU_ADDRESS 0x7F8EE1 /end MEASUREMENT
/begin MEASUREMENT M_Curve_in_x.Axis_Input.CURVE_Axis "" UWORD ident 1 100 0 65535 ECU_ADDRESS 0x7FAFAC /end MEASUREMENT
/begin MEASUREMENT M_In_X.STD_float32_float32_float32.All_Maps_STD.Maps_Raster_1 "" FLOAT32_IEEE ident 1 100 -1.e+037 1.e+037 ECU_ADDRESS 0x7F89D8 /end MEASUREMENT
/begin MEASUREMENT M_In_X.STD_float32_float32_float32.All_Maps_STD.Maps_Raster_2 "" FLOAT32_IEEE ident 1 100 -1.e+037 1.e+037 ECU_ADDRESS 0x7F8AB0 /end MEASUREMENT
/begin MEASUREMENT M_In_X.STD_float32_float32_float32.All_Maps_STD.Maps_Raster_3 "" FLOAT32_IEEE ident 1 100 -1.e+037 1.e+037 ECU_ADDRESS 0x7F8B88 /end MEASUREMENT
/begin MEASUREMENT M_In_X.STD_sint16_sint16_sint16.All_Maps_STD.Maps_Raster_1 "" SWORD ident 1 100 -32768.0 32767.0 ECU_ADDRESS 0x7F89E8 /end MEASUREMENT
/begin MEASUREMENT M_In_X.STD_sint16_sint16_sint16.All_Maps_STD.Maps_Raster_2 "" SWORD ident 1 100 -32768.0 32767.0 ECU_ADDRESS 0x7F8AC0 /end MEASUREMENT
/begin MEASUREMENT M_In_X.STD_sint16_sint16_sint16.All_Maps_STD.Maps_Raster_3 "" SWORD ident 1 100 -32768.0 32767.0 ECU_ADDRESS 0x7F8B98 /end MEASUREMENT
/begin MEASUREMENT M_In_X.STD_sint32_sint32_sint32.All_Maps_STD.Maps_Raster_1 "" SLONG ident 1 100 -2147483648.0 2147483647.0 ECU_ADDRESS 0x7F89F0 /end MEASUREMENT
/begin MEASUREMENT M_In_X.STD_sint32_sint32_sint32.All_Maps_STD.Maps_Raster_2 "" SLONG ident 1 100 -2147483648.0 2147483647.0 ECU_ADDRESS 0x7F8AC8 /end MEASUREMENT
/begin MEASUREMENT M_In_X.STD_sint32_sint32_sint32.All_Maps_STD.Maps_Raster_3 "" SLONG ident 1 100 -2147483648.0 2147483647.0 ECU_ADDRESS 0x7F8BA0 /end MEASUREMENT
/begin MEASUREMENT M_In_X.STD_sint8_sint8_sint8.All_Maps_STD.Maps_Raster_1 "" SBYTE ident 1 100 -128.0 127.0 ECU_ADDRESS 0x7F8A01 /end MEASUREMENT
/begin MEASUREMENT M_In_X.STD_sint8_sint8_sint8.All_Maps_STD.Maps_Raster_2 "" SBYTE ident 1 100 -128.0 127.0 ECU_ADDRESS 0x7F8AD9 /end MEASUREMENT
/begin MEASUREMENT M_In_X.STD_sint8_sint8_sint8.All_Maps_STD.Maps_Raster_3 "" SBYTE ident 1 100 -128.0 127.0 ECU_ADDRESS 0x7F8BB1 /end MEASUREMENT
/begin MEASUREMENT M_In_X.STD_uint16_uint16_uint16.All_Maps_STD.Maps_Raster_1 "" UWORD ident 1 100 0.0 65535.0 ECU_ADDRESS 0x7F8A04 /end MEASUREMENT
/begin MEASUREMENT M_In_X.STD_uint16_uint16_uint16.All_Maps_STD.Maps_Raster_2 "" UWORD ident 1 100 0.0 65535.0 ECU_ADDRESS 0x7F8ADC /end MEASUREMENT
/begin MEASUREMENT M_In_X.STD_uint16_uint16_uint16.All_Maps_STD.Maps_Raster_3 "" UWORD ident 1 100 0.0 65535.0 ECU_ADDRESS 0x7F8BB4 /end MEASUREMENT
/begin MEASUREMENT M_In_X.STD_uint32_uint32_uint32.All_Maps_STD.Maps_Raster_1 "" ULONG ident 1 100 0.0 4294967295.0 ECU_ADDRESS 0x7F8A0C /end MEASUREMENT
/begin MEASUREMENT M_In_X.STD_uint32_uint32_uint32.All_Maps_STD.Maps_Raster_2 "" ULONG ident 1 100 0.0 4294967295.0 ECU_ADDRESS 0x7F8AE4 /end MEASUREMENT
/begin MEASUREMENT M_In_X.STD_uint32_uint32_uint32.All_Maps_STD.Maps_Raster_3 "" ULONG ident 1 100 0.0 4294967295.0 ECU_ADDRESS 0x7F8BBC /end MEASUREMENT
/begin MEASUREMENT M_In_X.STD_uint8_uint8_uint8.All_Maps_STD.Maps_Raster_1 "" UBYTE ident 1 100 0.0 255.0 ECU_ADDRESS 0x7F8A1D /end MEASUREMENT
/begin MEASUREMENT M_In_X.STD_uint8_uint8_uint8.All_Maps_STD.Maps_Raster_2 "" UBYTE ident 1 100 0.0 255.0 ECU_ADDRESS 0x7F8AF5 /end MEASUREMENT
/begin MEASUREMENT M_In_X.STD_uint8_uint8_uint8.All_Maps_STD.Maps_Raster_3 "" UBYTE ident 1 100 0.0 255.0 ECU_ADDRESS 0x7F8BCD /end MEASUREMENT
/begin MEASUREMENT M_In_Y.STD_float32_float32_float32.All_Maps_STD.Maps_Raster_1 "" FLOAT32_IEEE ident 1 100 -1.e+037 1.e+037 ECU_ADDRESS 0x7F89DC /end MEASUREMENT
/begin MEASUREMENT M_In_Y.STD_float32_float32_float32.All_Maps_STD.Maps_Raster_2 "" FLOAT32_IEEE ident 1 100 -1.e+037 1.e+037 ECU_ADDRESS 0x7F8AB4 /end MEASUREMENT
/begin MEASUREMENT M_In_Y.STD_float32_float32_float32.All_Maps_STD.Maps_Raster_3 "" FLOAT32_IEEE ident 1 100 -1.e+037 1.e+037 ECU_ADDRESS 0x7F8B8C /end MEASUREMENT
/begin MEASUREMENT M_In_Y.STD_sint16_sint16_sint16.All_Maps_STD.Maps_Raster_1 "" SWORD ident 1 100 -32768.0 32767.0 ECU_ADDRESS 0x7F89EA /end MEASUREMENT
/begin MEASUREMENT M_In_Y.STD_sint16_sint16_sint16.All_Maps_STD.Maps_Raster_2 "" SWORD ident 1 100 -32768.0 32767.0 ECU_ADDRESS 0x7F8AC2 /end MEASUREMENT
/begin MEASUREMENT M_In_Y.STD_sint16_sint16_sint16.All_Maps_STD.Maps_Raster_3 "" SWORD ident 1 100 -32768.0 32767.0 ECU_ADDRESS 0x7F8B9A /end MEASUREMENT
/begin MEASUREMENT M_In_Y.STD_sint32_sint32_sint32.All_Maps_STD.Maps_Raster_1 "" SLONG ident 1 100 -2147483648.0 2147483647.0 ECU_ADDRESS 0x7F89F4 /end MEASUREMENT
/begin MEASUREMENT M_In_Y.STD_sint32_sint32_sint32.All_Maps_STD.Maps_Raster_2 "" SLONG ident 1 100 -2147483648.0 2147483647.0 ECU_ADDRESS 0x7F8ACC /end MEASUREMENT
/begin MEASUREMENT M_In_Y.STD_sint32_sint32_sint32.All_Maps_STD.Maps_Raster_3 "" SLONG ident 1 100 -2147483648.0 2147483647.0 ECU_ADDRESS 0x7F8BA4 /end MEASUREMENT
/begin MEASUREMENT M_In_Y.STD_sint8_sint8_sint8.All_Maps_STD.Maps_Raster_1 "" SBYTE ident 1 100 -128.0 127.0 ECU_ADDRESS 0x7F8A02 /end MEASUREMENT
/begin MEASUREMENT M_In_Y.STD_sint8_sint8_sint8.All_Maps_STD.Maps_Raster_2 "" SBYTE ident 1 100 -128.0 127.0 ECU_ADDRESS 0x7F8ADA /end MEASUREMENT
/begin MEASUREMENT M_In_Y.STD_sint8_sint8_sint8.All_Maps_STD.Maps_Raster_3 "" SBYTE ident 1 100 -128.0 127.0 ECU_ADDRESS 0x7F8BB2 /end MEASUREMENT
/begin MEASUREMENT M_In_Y.STD_uint16_uint16_uint16.All_Maps_STD.Maps_Raster_1 "" UWORD ident 1 100 0.0 65535.0 ECU_ADDRESS 0x7F8A06 /end MEASUREMENT
/begin MEASUREMENT M_In_Y.STD_uint16_uint16_uint16.All_Maps_STD.Maps_Raster_2 "" UWORD ident 1 100 0.0 65535.0 ECU_ADDRESS 0x7F8ADE /end MEASUREMENT
/begin MEASUREMENT M_In_Y.STD_uint16_uint16_uint16.All_Maps_STD.Maps_Raster_3 "" UWORD ident 1 100 0.0 65535.0 ECU_ADDRESS 0x7F8BB6 /end MEASUREMENT
/begin MEASUREMENT M_In_Y.STD_uint32_uint32_uint32.All_Maps_STD.Maps_Raster_1 "" ULONG ident 1 100 0.0 4294967295.0 ECU_ADDRESS 0x7F8A10 /end MEASUREMENT
/begin MEASUREMENT M_In_Y.STD_uint32_uint32_uint32.All_Maps_STD.Maps_Raster_2 "" ULONG ident 1 100 0.0 4294967295.0 ECU_ADDRESS 0x7F8AE8 /end MEASUREMENT
/begin MEASUREMENT M_In_Y.STD_uint32_uint32_uint32.All_Maps_STD.Maps_Raster_3 "" ULONG ident 1 100 0.0 4294967295.0 ECU_ADDRESS 0x7F8BC0 /end MEASUREMENT
/begin MEASUREMENT M_In_Y.STD_uint8_uint8_uint8.All_Maps_STD.Maps_Raster_1 "" UBYTE ident 1 100 0.0 255.0 ECU_ADDRESS 0x7F8A1E /end MEASUREMENT
/begin MEASUREMENT M_In_Y.STD_uint8_uint8_uint8.All_Maps_STD.Maps_Raster_2 "" UBYTE ident 1 100 0.0 255.0 ECU_ADDRESS 0x7F8AF6 /end MEASUREMENT
/begin MEASUREMENT M_In_Y.STD_uint8_uint8_uint8.All_Maps_STD.Maps_Raster_3 "" UBYTE ident 1 100 0.0 255.0 ECU_ADDRESS 0x7F8BCE /end MEASUREMENT
/begin MEASUREMENT M_Map_in_x.Axis_Input.CURVE_Axis "" SWORD ident 1 100 -32768 32767 ECU_ADDRESS 0x7FAFAE /end MEASUREMENT
/begin MEASUREMENT M_Map_in_y.Axis_Input.CURVE_Axis "" SWORD ident 1 100 -32768 32767 ECU_ADDRESS 0x7FAFB0 /end MEASUREMENT
/begin MEASUREMENT M_out.STD_float32_float32_float32.All_Maps_STD.Maps_Raster_1 "" FLOAT32_IEEE ident 1 100 -1.e+037 1.e+037 ECU_ADDRESS 0x7F89E0 /end MEASUREMENT
/begin MEASUREMENT M_out.STD_float32_float32_float32.All_Maps_STD.Maps_Raster_2 "" FLOAT32_IEEE ident 1 100 -1.e+037 1.e+037 ECU_ADDRESS 0x7F8AB8 /end MEASUREMENT
/begin MEASUREMENT M_out.STD_float32_float32_float32.All_Maps_STD.Maps_Raster_3 "" FLOAT32_IEEE ident 1 100 -1.e+037 1.e+037 ECU_ADDRESS 0x7F8B90 /end MEASUREMENT
/begin MEASUREMENT M_out.STD_sint16_sint16_sint16.All_Maps_STD.Maps_Raster_1 "" SWORD ident 1 100 -32768.0 32767.0 ECU_ADDRESS 0x7F89EC /end MEASUREMENT
/begin MEASUREMENT M_out.STD_sint16_sint16_sint16.All_Maps_STD.Maps_Raster_2 "" SWORD ident 1 100 -32768.0 32767.0 ECU_ADDRESS 0x7F8AC4 /end MEASUREMENT
/begin MEASUREMENT M_out.STD_sint16_sint16_sint16.All_Maps_STD.Maps_Raster_3 "" SWORD ident 1 100 -32768.0 32767.0 ECU_ADDRESS 0x7F8B9C /end MEASUREMENT
/begin MEASUREMENT M_out.STD_sint32_sint32_sint32.All_Maps_STD.Maps_Raster_1 "" SLONG ident 1 100 -2147483648.0 2147483647.0 ECU_ADDRESS 0x7F89F8 /end MEASUREMENT
/begin MEASUREMENT M_out.STD_sint32_sint32_sint32.All_Maps_STD.Maps_Raster_2 "" SLONG ident 1 100 -2147483648.0 2147483647.0 ECU_ADDRESS 0x7F8AD0 /end MEASUREMENT
/begin MEASUREMENT M_out.STD_sint32_sint32_sint32.All_Maps_STD.Maps_Raster_3 "" SLONG ident 1 100 -2147483648.0 2147483647.0 ECU_ADDRESS 0x7F8BA8 /end MEASUREMENT
/begin MEASUREMENT M_out.STD_sint8_sint8_sint8.All_Maps_STD.Maps_Raster_1 "" SBYTE ident 1 100 -128.0 127.0 ECU_ADDRESS 0x7F8A03 /end MEASUREMENT
/begin MEASUREMENT M_out.STD_sint8_sint8_sint8.All_Maps_STD.Maps_Raster_2 "" SBYTE ident 1 100 -128.0 127.0 ECU_ADDRESS 0x7F8ADB /end MEASUREMENT
/begin MEASUREMENT M_out.STD_sint8_sint8_sint8.All_Maps_STD.Maps_Raster_3 "" SBYTE ident 1 100 -128.0 127.0 ECU_ADDRESS 0x7F8BB3 /end MEASUREMENT
/begin MEASUREMENT M_out.STD_uint16_uint16_uint16.All_Maps_STD.Maps_Raster_1 "" UWORD ident 1 100 0.0 65535.0 ECU_ADDRESS 0x7F8A08 /end MEASUREMENT
/begin MEASUREMENT M_out.STD_uint16_uint16_uint16.All_Maps_STD.Maps_Raster_2 "" UWORD ident 1 100 0.0 65535.0 ECU_ADDRESS 0x7F8AE0 /end MEASUREMENT
/begin MEASUREMENT M_out.STD_uint16_uint16_uint16.All_Maps_STD.Maps_Raster_3 "" UWORD ident 1 100 0.0 65535.0 ECU_ADDRESS 0x7F8BB8 /end MEASUREMENT
/begin MEASUREMENT M_out.STD_uint32_uint32_uint32.All_Maps_STD.Maps_Raster_1 "" ULONG ident 1 100 0.0 4294967295.0 ECU_ADDRESS 0x7F8A14 /end MEASUREMENT
/begin MEASUREMENT M_out.STD_uint32_uint32_uint32.All_Maps_STD.Maps_Raster_2 "" ULONG ident 1 100 0.0 4294967295.0 ECU_ADDRESS 0x7F8AEC /end MEASUREMENT
/begin MEASUREMENT M_out.STD_uint32_uint32_uint32.All_Maps_STD.Maps_Raster_3 "" ULONG ident 1 100 0.0 4294967295.0 ECU_ADDRESS 0x7F8BC4 /end MEASUREMENT
/begin MEASUREMENT M_out.STD_uint8_uint8_uint8.All_Maps_STD.Maps_Raster_1 "" UBYTE ident 1 100 0.0 255.0 ECU_ADDRESS 0x7F8A1F /end MEASUREMENT
/begin MEASUREMENT M_out.STD_uint8_uint8_uint8.All_Maps_STD.Maps_Raster_2 "" UBYTE ident 1 100 0.0 255.0 ECU_ADDRESS 0x7F8AF7 /end MEASUREMENT
/begin MEASUREMENT M_out.STD_uint8_uint8_uint8.All_Maps_STD.Maps_Raster_3 "" UBYTE ident 1 100 0.0 255.0 ECU_ADDRESS 0x7F8BCF /end MEASUREMENT
/begin MEASUREMENT Result.Time_Calc.HWE.BASE "" ULONG TickType2ms 1 100 0.1428571428571429 600000.0 ECU_ADDRESS 0x7F8920 MATRIX_DIM 3 1 1 /end MEASUREMENT
/begin MEASUREMENT Samp_Time_result.HWE.BASE "" ULONG TickType2ms 1 100 0.1428571428571429 600000.0 ECU_ADDRESS 0x7F88FC /end MEASUREMENT
/begin MEASUREMENT test_counter.HWE.BASE "" UWORD ident 1 100 0 50000 ECU_ADDRESS 0x7F8914 MATRIX_DIM 5 1 1 /end MEASUREMENT
/begin MEASUREMENT Timer_Zero_Error.HWE.BASE "" SLONG TickType2ms 1 100 0.1428571428571429 600000.0 ECU_ADDRESS 0x7F8900 /end MEASUREMENT
/begin MEASUREMENT TimeStampOne.Time_Calc.HWE.BASE "" ULONG TickType2ms 1 100 0.1428571428571429 600000.0 ECU_ADDRESS 0x7F892C MATRIX_DIM 3 1 1 /end MEASUREMENT
/begin MEASUREMENT TimeStampTwo.Time_Calc.HWE.BASE "" ULONG TickType2ms 1 100 0.1428571428571429 600000.0 ECU_ADDRESS 0x7F8938 MATRIX_DIM 3 1 1 /end MEASUREMENT
/begin MEASUREMENT Tx_time_result.HWE.BASE "" ULONG TickType2ms 1 100 0.1428571428571429 600000.0 ECU_ADDRESS 0x7F8904 /end MEASUREMENT
/begin MEASUREMENT Tx_time_sum.HWE.BASE "" ULONG TickType2ms 1 100 0.1428571428571429 600000.0 ECU_ADDRESS 0x7F8908 /end MEASUREMENT
/begin COMPU_METHOD ADC_10bit "" RAT_FUNC "%12.4" "V" COEFFS 0 204.6 0 0 0 1 /end COMPU_METHOD
/begin COMPU_METHOD ADC_KL30B "Voltage Divide: 147/709" RAT_FUNC "%12.4" "V" COEFFS 0 42.42059238363893 0 0 0 1 /end COMPU_METHOD
/begin COMPU_METHOD enum_HWE_CAN_BAUDRATE_ENUM "" TAB_VERB "%8.4" "" COEFFS 0 1 0 0 0 1 COMPU_TAB_REF enum_HWE_CAN_BAUDRATE_ENUM_tab_ref /end COMPU_METHOD
/begin COMPU_METHOD enum_Tasks "" TAB_VERB "%8.4" "" COEFFS 0 1 0 0 0 1 COMPU_TAB_REF enum_Tasks_tab_ref /end COMPU_METHOD
/begin COMPU_METHOD ident "" RAT_FUNC "%12.4" "" COEFFS 0 1 0 0 0 1 /end COMPU_METHOD
/begin COMPU_METHOD Rtm_TicksToUs "" RAT_FUNC "%12.4" "us" COEFFS 0 3.5 0 0 0 1 /end COMPU_METHOD
/begin COMPU_METHOD TickType2ms "" RAT_FUNC "%12.4" "ms" COEFFS 0 3500.0 0 0 0 1 /end COMPU_METHOD
/begin COMPU_METHOD TPU_Dcyc "" RAT_FUNC "%12.4" "%" COEFFS 0 100 0 0 0 1 /end COMPU_METHOD
/begin COMPU_METHOD TPU_PerIn "" RAT_FUNC "%12.4" "ms" COEFFS 0 100 0 0 0 1 /end COMPU_METHOD
/begin COMPU_METHOD TPU_PerOut "" RAT_FUNC "%12.4" "ms" COEFFS 0 10 0 0 0 1 /end COMPU_METHOD
/begin COMPU_VTAB enum_HWE_CAN_BAUDRATE_ENUM_tab_ref "" TAB_VERB 7 0 "Userdefined" 1 "_83_3_kHz" 2 "_100_kHz" 3 "_125_kHz" 4 "_250_kHz" 5 "_500_kHz" 6 "_1000_kHz" DEFAULT_VALUE "Error" /end COMPU_VTAB
/begin COMPU_VTAB enum_Tasks_tab_ref "" TAB_VERB 5 0 "NO_TASK" 1 "TASK_2MS" 2 "TASK_10MS" 3 "TASK_50MS" 4 "TASK_100MS" DEFAULT_VALUE "Error" /end COMPU_VTAB
/begin GROUP All_Maps_STD.Maps_Raster_1 ""
 /begin REF_MEASUREMENT Calculated.STD_float32_float32_float32.All_Maps_STD.Maps_Raster_1 Calculated.STD_sint16_sint16_sint16.All_Maps_STD.Maps_Raster_1 Calculated.STD_sint32_sint32_sint32.All_Maps_STD.Maps_Raster_1 Calculated.STD_sint8_sint8_sint8.All_Maps_STD.Maps_Raster_1 Calculated.STD_uint16_uint16_uint16.All_Maps_STD.Maps_Raster_1 Calculated.STD_uint32_uint32_uint32.All_Maps_STD.Maps_Raster_1 Calculated.STD_uint8_uint8_uint8.All_Maps_STD.Maps_Raster_1 M_In_X.STD_float32_float32_float32.All_Maps_STD.Maps_Raster_1 M_In_X.STD_sint16_sint16_sint16.All_Maps_STD.Maps_Raster_1 M_In_X.STD_sint32_sint32_sint32.All_Maps_STD.Maps_Raster_1 M_In_X.STD_sint8_sint8_sint8.All_Maps_STD.Maps_Raster_1 M_In_X.STD_uint16_uint16_uint16.All_Maps_STD.Maps_Raster_1 M_In_X.STD_uint32_uint32_uint32.All_Maps_STD.Maps_Raster_1 M_In_X.STD_uint8_uint8_uint8.All_Maps_STD.Maps_Raster_1 M_In_Y.STD_float32_float32_float32.All_Maps_STD.Maps_Raster_1 M_In_Y.STD_sint16_sint16_sint16.All_Maps_STD.Maps_Raster_1 M_In_Y.STD_sint32_sint32_sint32.All_Maps_STD.Maps_Raster_1 M_In_Y.STD_sint8_sint8_sint8.All_Maps_STD.Maps_Raster_1 M_In_Y.STD_uint16_uint16_uint16.All_Maps_STD.Maps_Raster_1 M_In_Y.STD_uint32_uint32_uint32.All_Maps_STD.Maps_Raster_1 M_In_Y.STD_uint8_uint8_uint8.All_Maps_STD.Maps_Raster_1 M_out.STD_float32_float32_float32.All_Maps_STD.Maps_Raster_1 M_out.STD_sint16_sint16_sint16.All_Maps_STD.Maps_Raster_1 M_out.STD_sint32_sint32_sint32.All_Maps_STD.Maps_Raster_1 M_out.STD_sint8_sint8_sint8.All_Maps_STD.Maps_Raster_1 M_out.STD_uint16_uint16_uint16.All_Maps_STD.Maps_Raster_1 M_out.STD_uint32_uint32_uint32.All_Maps_STD.Maps_Raster_1 M_out.STD_uint8_uint8_uint8.All_Maps_STD.Maps_Raster_1 /end REF_MEASUREMENT
 /begin REF_CHARACTERISTIC P_Do_Active_Std.STD_float32_float32_float32.All_Maps_STD.Maps_Raster_1 P_Do_Active_Std.STD_sint16_sint16_sint16.All_Maps_STD.Maps_Raster_1 P_Do_Active_Std.STD_sint32_sint32_sint32.All_Maps_STD.Maps_Raster_1 P_Do_Active_Std.STD_sint8_sint8_sint8.All_Maps_STD.Maps_Raster_1 P_Do_Active_Std.STD_uint16_uint16_uint16.All_Maps_STD.Maps_Raster_1 P_Do_Active_Std.STD_uint32_uint32_uint32.All_Maps_STD.Maps_Raster_1 P_Do_Active_Std.STD_uint8_uint8_uint8.All_Maps_STD.Maps_Raster_1 P_Do_All_STD_Maps.All_Maps_STD.Maps_Raster_1 P_In_X.STD_float32_float32_float32.All_Maps_STD.Maps_Raster_1 P_In_X.STD_sint16_sint16_sint16.All_Maps_STD.Maps_Raster_1 P_In_X.STD_sint32_sint32_sint32.All_Maps_STD.Maps_Raster_1 P_In_X.STD_sint8_sint8_sint8.All_Maps_STD.Maps_Raster_1 P_In_X.STD_uint16_uint16_uint16.All_Maps_STD.Maps_Raster_1 P_In_X.STD_uint32_uint32_uint32.All_Maps_STD.Maps_Raster_1 P_In_X.STD_uint8_uint8_uint8.All_Maps_STD.Maps_Raster_1 P_In_Y.STD_float32_float32_float32.All_Maps_STD.Maps_Raster_1 P_In_Y.STD_sint16_sint16_sint16.All_Maps_STD.Maps_Raster_1 P_In_Y.STD_sint32_sint32_sint32.All_Maps_STD.Maps_Raster_1 P_In_Y.STD_sint8_sint8_sint8.All_Maps_STD.Maps_Raster_1 P_In_Y.STD_uint16_uint16_uint16.All_Maps_STD.Maps_Raster_1 P_In_Y.STD_uint32_uint32_uint32.All_Maps_STD.Maps_Raster_1 P_In_Y.STD_uint8_uint8_uint8.All_Maps_STD.Maps_Raster_1 Two_D.STD_float32_float32_float32.All_Maps_STD.Maps_Raster_1 Two_D.STD_sint16_sint16_sint16.All_Maps_STD.Maps_Raster_1 Two_D.STD_sint32_sint32_sint32.All_Maps_STD.Maps_Raster_1 Two_D.STD_sint8_sint8_sint8.All_Maps_STD.Maps_Raster_1 Two_D.STD_uint16_uint16_uint16.All_Maps_STD.Maps_Raster_1 Two_D.STD_uint32_uint32_uint32.All_Maps_STD.Maps_Raster_1 Two_D.STD_uint8_uint8_uint8.All_Maps_STD.Maps_Raster_1 /end REF_CHARACTERISTIC
 /begin SUB_GROUP STD_float32_float32_float32.All_Maps_STD.Maps_Raster_1 STD_sint16_sint16_sint16.All_Maps_STD.Maps_Raster_1 STD_sint32_sint32_sint32.All_Maps_STD.Maps_Raster_1 STD_sint8_sint8_sint8.All_Maps_STD.Maps_Raster_1 STD_uint16_uint16_uint16.All_Maps_STD.Maps_Raster_1 STD_uint32_uint32_uint32.All_Maps_STD.Maps_Raster_1 STD_uint8_uint8_uint8.All_Maps_STD.Maps_Raster_1 /end SUB_GROUP
/end GROUP
/begin GROUP All_Maps_STD.Maps_Raster_2 ""
 /begin REF_MEASUREMENT Calculated.STD_float32_float32_float32.All_Maps_STD.Maps_Raster_2 Calculated.STD_sint16_sint16_sint16.All_Maps_STD.Maps_Raster_2 Calculated.STD_sint32_sint32_sint32.All_Maps_STD.Maps_Raster_2 Calculated.STD_sint8_sint8_sint8.All_Maps_STD.Maps_Raster_2 Calculated.STD_uint16_uint16_uint16.All_Maps_STD.Maps_Raster_2 Calculated.STD_uint32_uint32_uint32.All_Maps_STD.Maps_Raster_2 Calculated.STD_uint8_uint8_uint8.All_Maps_STD.Maps_Raster_2 M_In_X.STD_float32_float32_float32.All_Maps_STD.Maps_Raster_2 M_In_X.STD_sint16_sint16_sint16.All_Maps_STD.Maps_Raster_2 M_In_X.STD_sint32_sint32_sint32.All_Maps_STD.Maps_Raster_2 M_In_X.STD_sint8_sint8_sint8.All_Maps_STD.Maps_Raster_2 M_In_X.STD_uint16_uint16_uint16.All_Maps_STD.Maps_Raster_2 M_In_X.STD_uint32_uint32_uint32.All_Maps_STD.Maps_Raster_2 M_In_X.STD_uint8_uint8_uint8.All_Maps_STD.Maps_Raster_2 M_In_Y.STD_float32_float32_float32.All_Maps_STD.Maps_Raster_2 M_In_Y.STD_sint16_sint16_sint16.All_Maps_STD.Maps_Raster_2 M_In_Y.STD_sint32_sint32_sint32.All_Maps_STD.Maps_Raster_2 M_In_Y.STD_sint8_sint8_sint8.All_Maps_STD.Maps_Raster_2 M_In_Y.STD_uint16_uint16_uint16.All_Maps_STD.Maps_Raster_2 M_In_Y.STD_uint32_uint32_uint32.All_Maps_STD.Maps_Raster_2 M_In_Y.STD_uint8_uint8_uint8.All_Maps_STD.Maps_Raster_2 M_out.STD_float32_float32_float32.All_Maps_STD.Maps_Raster_2 M_out.STD_sint16_sint16_sint16.All_Maps_STD.Maps_Raster_2 M_out.STD_sint32_sint32_sint32.All_Maps_STD.Maps_Raster_2 M_out.STD_sint8_sint8_sint8.All_Maps_STD.Maps_Raster_2 M_out.STD_uint16_uint16_uint16.All_Maps_STD.Maps_Raster_2 M_out.STD_uint32_uint32_uint32.All_Maps_STD.Maps_Raster_2 M_out.STD_uint8_uint8_uint8.All_Maps_STD.Maps_Raster_2 /end REF_MEASUREMENT
 /begin REF_CHARACTERISTIC P_Do_Active_Std.STD_float32_float32_float32.All_Maps_STD.Maps_Raster_2 P_Do_Active_Std.STD_sint16_sint16_sint16.All_Maps_STD.Maps_Raster_2 P_Do_Active_Std.STD_sint32_sint32_sint32.All_Maps_STD.Maps_Raster_2 P_Do_Active_Std.STD_sint8_sint8_sint8.All_Maps_STD.Maps_Raster_2 P_Do_Active_Std.STD_uint16_uint16_uint16.All_Maps_STD.Maps_Raster_2 P_Do_Active_Std.STD_uint32_uint32_uint32.All_Maps_STD.Maps_Raster_2 P_Do_Active_Std.STD_uint8_uint8_uint8.All_Maps_STD.Maps_Raster_2 P_Do_All_STD_Maps.All_Maps_STD.Maps_Raster_2 P_In_X.STD_float32_float32_float32.All_Maps_STD.Maps_Raster_2 P_In_X.STD_sint16_sint16_sint16.All_Maps_STD.Maps_Raster_2 P_In_X.STD_sint32_sint32_sint32.All_Maps_STD.Maps_Raster_2 P_In_X.STD_sint8_sint8_sint8.All_Maps_STD.Maps_Raster_2 P_In_X.STD_uint16_uint16_uint16.All_Maps_STD.Maps_Raster_2 P_In_X.STD_uint32_uint32_uint32.All_Maps_STD.Maps_Raster_2 P_In_X.STD_uint8_uint8_uint8.All_Maps_STD.Maps_Raster_2 P_In_Y.STD_float32_float32_float32.All_Maps_STD.Maps_Raster_2 P_In_Y.STD_sint16_sint16_sint16.All_Maps_STD.Maps_Raster_2 P_In_Y.STD_sint32_sint32_sint32.All_Maps_STD.Maps_Raster_2 P_In_Y.STD_sint8_sint8_sint8.All_Maps_STD.Maps_Raster_2 P_In_Y.STD_uint16_uint16_uint16.All_Maps_STD.Maps_Raster_2 P_In_Y.STD_uint32_uint32_uint32.All_Maps_STD.Maps_Raster_2 P_In_Y.STD_uint8_uint8_uint8.All_Maps_STD.Maps_Raster_2 Two_D.STD_float32_float32_float32.All_Maps_STD.Maps_Raster_2 Two_D.STD_sint16_sint16_sint16.All_Maps_STD.Maps_Raster_2 Two_D.STD_sint32_sint32_sint32.All_Maps_STD.Maps_Raster_2 Two_D.STD_sint8_sint8_sint8.All_Maps_STD.Maps_Raster_2 Two_D.STD_uint16_uint16_uint16.All_Maps_STD.Maps_Raster_2 Two_D.STD_uint32_uint32_uint32.All_Maps_STD.Maps_Raster_2 Two_D.STD_uint8_uint8_uint8.All_Maps_STD.Maps_Raster_2 /end REF_CHARACTERISTIC
 /begin SUB_GROUP STD_float32_float32_float32.All_Maps_STD.Maps_Raster_2 STD_sint16_sint16_sint16.All_Maps_STD.Maps_Raster_2 STD_sint32_sint32_sint32.All_Maps_STD.Maps_Raster_2 STD_sint8_sint8_sint8.All_Maps_STD.Maps_Raster_2 STD_uint16_uint16_uint16.All_Maps_STD.Maps_Raster_2 STD_uint32_uint32_uint32.All_Maps_STD.Maps_Raster_2 STD_uint8_uint8_uint8.All_Maps_STD.Maps_Raster_2 /end SUB_GROUP
/end GROUP
/begin GROUP All_Maps_STD.Maps_Raster_3 ""
 /begin REF_MEASUREMENT Calculated.STD_float32_float32_float32.All_Maps_STD.Maps_Raster_3 Calculated.STD_sint16_sint16_sint16.All_Maps_STD.Maps_Raster_3 Calculated.STD_sint32_sint32_sint32.All_Maps_STD.Maps_Raster_3 Calculated.STD_sint8_sint8_sint8.All_Maps_STD.Maps_Raster_3 Calculated.STD_uint16_uint16_uint16.All_Maps_STD.Maps_Raster_3 Calculated.STD_uint32_uint32_uint32.All_Maps_STD.Maps_Raster_3 Calculated.STD_uint8_uint8_uint8.All_Maps_STD.Maps_Raster_3 M_In_X.STD_float32_float32_float32.All_Maps_STD.Maps_Raster_3 M_In_X.STD_sint16_sint16_sint16.All_Maps_STD.Maps_Raster_3 M_In_X.STD_sint32_sint32_sint32.All_Maps_STD.Maps_Raster_3 M_In_X.STD_sint8_sint8_sint8.All_Maps_STD.Maps_Raster_3 M_In_X.STD_uint16_uint16_uint16.All_Maps_STD.Maps_Raster_3 M_In_X.STD_uint32_uint32_uint32.All_Maps_STD.Maps_Raster_3 M_In_X.STD_uint8_uint8_uint8.All_Maps_STD.Maps_Raster_3 M_In_Y.STD_float32_float32_float32.All_Maps_STD.Maps_Raster_3 M_In_Y.STD_sint16_sint16_sint16.All_Maps_STD.Maps_Raster_3 M_In_Y.STD_sint32_sint32_sint32.All_Maps_STD.Maps_Raster_3 M_In_Y.STD_sint8_sint8_sint8.All_Maps_STD.Maps_Raster_3 M_In_Y.STD_uint16_uint16_uint16.All_Maps_STD.Maps_Raster_3 M_In_Y.STD_uint32_uint32_uint32.All_Maps_STD.Maps_Raster_3 M_In_Y.STD_uint8_uint8_uint8.All_Maps_STD.Maps_Raster_3 M_out.STD_float32_float32_float32.All_Maps_STD.Maps_Raster_3 M_out.STD_sint16_sint16_sint16.All_Maps_STD.Maps_Raster_3 M_out.STD_sint32_sint32_sint32.All_Maps_STD.Maps_Raster_3 M_out.STD_sint8_sint8_sint8.All_Maps_STD.Maps_Raster_3 M_out.STD_uint16_uint16_uint16.All_Maps_STD.Maps_Raster_3 M_out.STD_uint32_uint32_uint32.All_Maps_STD.Maps_Raster_3 M_out.STD_uint8_uint8_uint8.All_Maps_STD.Maps_Raster_3 /end REF_MEASUREMENT
 /begin REF_CHARACTERISTIC P_Do_Active_Std.STD_float32_float32_float32.All_Maps_STD.Maps_Raster_3 P_Do_Active_Std.STD_sint16_sint16_sint16.All_Maps_STD.Maps_Raster_3 P_Do_Active_Std.STD_sint32_sint32_sint32.All_Maps_STD.Maps_Raster_3 P_Do_Active_Std.STD_sint8_sint8_sint8.All_Maps_STD.Maps_Raster_3 P_Do_Active_Std.STD_uint16_uint16_uint16.All_Maps_STD.Maps_Raster_3 P_Do_Active_Std.STD_uint32_uint32_uint32.All_Maps_STD.Maps_Raster_3 P_Do_Active_Std.STD_uint8_uint8_uint8.All_Maps_STD.Maps_Raster_3 P_Do_All_STD_Maps.All_Maps_STD.Maps_Raster_3 P_In_X.STD_float32_float32_float32.All_Maps_STD.Maps_Raster_3 P_In_X.STD_sint16_sint16_sint16.All_Maps_STD.Maps_Raster_3 P_In_X.STD_sint32_sint32_sint32.All_Maps_STD.Maps_Raster_3 P_In_X.STD_sint8_sint8_sint8.All_Maps_STD.Maps_Raster_3 P_In_X.STD_uint16_uint16_uint16.All_Maps_STD.Maps_Raster_3 P_In_X.STD_uint32_uint32_uint32.All_Maps_STD.Maps_Raster_3 P_In_X.STD_uint8_uint8_uint8.All_Maps_STD.Maps_Raster_3 P_In_Y.STD_float32_float32_float32.All_Maps_STD.Maps_Raster_3 P_In_Y.STD_sint16_sint16_sint16.All_Maps_STD.Maps_Raster_3 P_In_Y.STD_sint32_sint32_sint32.All_Maps_STD.Maps_Raster_3 P_In_Y.STD_sint8_sint8_sint8.All_Maps_STD.Maps_Raster_3 P_In_Y.STD_uint16_uint16_uint16.All_Maps_STD.Maps_Raster_3 P_In_Y.STD_uint32_uint32_uint32.All_Maps_STD.Maps_Raster_3 P_In_Y.STD_uint8_uint8_uint8.All_Maps_STD.Maps_Raster_3 Two_D.STD_float32_float32_float32.All_Maps_STD.Maps_Raster_3 Two_D.STD_sint16_sint16_sint16.All_Maps_STD.Maps_Raster_3 Two_D.STD_sint32_sint32_sint32.All_Maps_STD.Maps_Raster_3 Two_D.STD_sint8_sint8_sint8.All_Maps_STD.Maps_Raster_3 Two_D.STD_uint16_uint16_uint16.All_Maps_STD.Maps_Raster_3 Two_D.STD_uint32_uint32_uint32.All_Maps_STD.Maps_Raster_3 Two_D.STD_uint8_uint8_uint8.All_Maps_STD.Maps_Raster_3 /end REF_CHARACTERISTIC
 /begin SUB_GROUP STD_float32_float32_float32.All_Maps_STD.Maps_Raster_3 STD_sint16_sint16_sint16.All_Maps_STD.Maps_Raster_3 STD_sint32_sint32_sint32.All_Maps_STD.Maps_Raster_3 STD_sint8_sint8_sint8.All_Maps_STD.Maps_Raster_3 STD_uint16_uint16_uint16.All_Maps_STD.Maps_Raster_3 STD_uint32_uint32_uint32.All_Maps_STD.Maps_Raster_3 STD_uint8_uint8_uint8.All_Maps_STD.Maps_Raster_3 /end SUB_GROUP
/end GROUP
/begin GROUP Axis_Input.CURVE_Axis ""
 /begin REF_MEASUREMENT M_Curve_in_x.Axis_Input.CURVE_Axis M_Map_in_x.Axis_Input.CURVE_Axis M_Map_in_y.Axis_Input.CURVE_Axis /end REF_MEASUREMENT
 /begin REF_CHARACTERISTIC P_Curve_in_x.Axis_Input.CURVE_Axis P_Map_in_x.Axis_Input.CURVE_Axis P_Map_in_y.Axis_Input.CURVE_Axis /end REF_CHARACTERISTIC
/end GROUP
/begin GROUP BASE "" ROOT
 /begin REF_MEASUREMENT HWE_A_U_5V1_Err.SHELL.BASE HWE_A_U_5V1_Stat.SHELL.BASE HWE_A_U_5V2_Err.SHELL.BASE HWE_A_U_5V2_Stat.SHELL.BASE HWE_A_U_5V3_Err.SHELL.BASE HWE_A_U_5V3_Stat.SHELL.BASE HWE_Alarm_Can_Num1_Driver.SHELL.BASE HWE_CANA_ID250RX_1.SHELL.BASE HWE_CANA_ID250RX_2.SHELL.BASE HWE_CANA_ID258RX_1.SHELL.BASE HWE_CANA_ID258RX_2.SHELL.BASE HWE_CANA_ID260TX_1.SHELL.BASE HWE_CANA_ID260TX_2.SHELL.BASE HWE_CANA_ID288TX_1.SHELL.BASE HWE_CANA_ID288TX_2.SHELL.BASE HWE_CANA_ID290RX_1.SHELL.BASE HWE_CANA_ID290RX_2.SHELL.BASE HWE_CANA_ID310TX_1.SHELL.BASE HWE_CANA_ID310TX_2.SHELL.BASE HWE_CANA_ID320RX_1.SHELL.BASE HWE_CANA_ID320RX_2.SHELL.BASE HWE_CANA_ID330TX_1.SHELL.BASE HWE_CANA_ID330TX_2.SHELL.BASE HWE_CANA_ID340RX_1.SHELL.BASE HWE_CANA_ID340RX_2.SHELL.BASE HWE_CANA_ID358RX_1.SHELL.BASE HWE_CANA_ID358RX_2.SHELL.BASE HWE_CANA_ID500RX_1.SHELL.BASE HWE_CANA_ID500RX_2.SHELL.BASE HWE_CANA_ID510RX_1.SHELL.BASE HWE_CANA_ID510RX_2.SHELL.BASE HWE_CANA_ID620TX_1.SHELL.BASE HWE_CANA_ID620TX_2.SHELL.BASE HWE_CANA_ID630RX_1.SHELL.BASE HWE_CANA_ID630RX_2.SHELL.BASE HWE_CANA_ID640RX_1.SHELL.BASE HWE_CANA_ID640RX_2.SHELL.BASE HWE_CANA_InitAfterBusOff.SHELL.BASE HWE_CANA_OBD_TX_V7.SHELL.BASE HWE_CANA_stBusOff.SHELL.BASE HWE_CANB_CCP_DAQ0_V4.SHELL.BASE HWE_CANB_CCP_DAQ1_V5.SHELL.BASE HWE_CANB_CCP_DAQ2_V6.SHELL.BASE HWE_CANB_CCP_RX_V2.SHELL.BASE HWE_CANB_CCP_TX_V3.SHELL.BASE HWE_CANB_ID348RXB_1.SHELL.BASE HWE_CANB_ID348RXB_2.SHELL.BASE HWE_CANB_ID350TX_1.SHELL.BASE HWE_CANB_ID350TX_2.SHELL.BASE HWE_CANB_ID360TX_1.SHELL.BASE HWE_CANB_ID360TX_2.SHELL.BASE HWE_CANB_ID380TX_1.SHELL.BASE HWE_CANB_ID380TX_2.SHELL.BASE HWE_CANB_ID578RXB_1.SHELL.BASE HWE_CANB_ID578RXB_2.SHELL.BASE HWE_CANB_ID590RXB_1.SHELL.BASE HWE_CANB_ID590RXB_2.SHELL.BASE HWE_CANB_ID5FFTX_1.SHELL.BASE HWE_CANB_ID5FFTX_2.SHELL.BASE HWE_CANB_ID690TX_1.SHELL.BASE HWE_CANB_ID690TX_2.SHELL.BASE HWE_CANB_ID691TX_1.SHELL.BASE HWE_CANB_ID691TX_2.SHELL.BASE HWE_CANB_ID695TX_1.SHELL.BASE HWE_CANB_ID695TX_2.SHELL.BASE HWE_CANB_ID696RXB_1.SHELL.BASE HWE_CANB_InitAfterBusOff.SHELL.BASE HWE_CANB_MUX_ID5xx_V8.SHELL.BASE HWE_CANB_MUX_ID5xx_V8_U32_1.SHELL.BASE HWE_CANB_MUX_ID5xx_V8_U32_2.SHELL.BASE HWE_CANB_stBusOff.SHELL.BASE HWE_CANC_ID100TX_1.SHELL.BASE HWE_CANC_ID100TX_2.SHELL.BASE HWE_CANC_ID101RX_1.SHELL.BASE HWE_CANC_ID101RX_2.SHELL.BASE HWE_CANC_InitAfterBusOff.SHELL.BASE HWE_CANC_stBusOff.SHELL.BASE HWE_CAN_A_BAUDRATE_V.SHELL.BASE HWE_CAN_B_BAUDRATE_V.SHELL.BASE HWE_CAN_C_BAUDRATE_V.SHELL.BASE HWE_CAN_DisableNormalMsgTx.SHELL.BASE HWE_CJ230A_Err.SHELL.BASE HWE_CJ230A_Stat.SHELL.BASE HWE_CJ230B_Err.SHELL.BASE HWE_CJ230B_Stat.SHELL.BASE HWE_CJ945A_Err.SHELL.BASE HWE_CJ945A_Stat.SHELL.BASE HWE_CJ945B_Err.SHELL.BASE HWE_CJ945B_Stat.SHELL.BASE HWE_Can_DiagOpSwitch.SHELL.BASE HWE_Can_Rx_Ok.SHELL.BASE HWE_EepBlk_State.SHELL.BASE HWE_Eep_AfterRun_st.SHELL.BASE HWE_Eep_Format.SHELL.BASE HWE_Enter_NL.SHELL.BASE HWE_IA01.SHELL.BASE HWE_IA02.SHELL.BASE HWE_IA03.SHELL.BASE HWE_IA04.SHELL.BASE HWE_IA05.SHELL.BASE HWE_IA06.SHELL.BASE HWE_IA07.SHELL.BASE HWE_IA08.SHELL.BASE HWE_IA09.SHELL.BASE HWE_IA10.SHELL.BASE HWE_IA11.SHELL.BASE HWE_IA12.SHELL.BASE HWE_IA13.SHELL.BASE HWE_IA14.SHELL.BASE HWE_IA15.SHELL.BASE HWE_IA16.SHELL.BASE HWE_IA17.SHELL.BASE HWE_IA18.SHELL.BASE HWE_IA19.SHELL.BASE HWE_IA20.SHELL.BASE HWE_IA21.SHELL.BASE HWE_IA22.SHELL.BASE HWE_IA25.SHELL.BASE HWE_IA26.SHELL.BASE HWE_IA_IPS.SHELL.BASE HWE_IA_ITS.SHELL.BASE HWE_IA_TER30.SHELL.BASE HWE_IA_TER30B.SHELL.BASE HWE_ID101RX_failure.SHELL.BASE HWE_ID250RX_failure.SHELL.BASE HWE_ID258RX_failure.SHELL.BASE HWE_ID290RX_failure.SHELL.BASE HWE_ID320RX_failure.SHELL.BASE HWE_ID340RX_failure.SHELL.BASE HWE_ID348RXB_failure.SHELL.BASE HWE_ID358RX_failure.SHELL.BASE HWE_ID500RX_failure.SHELL.BASE HWE_ID510RX_failure.SHELL.BASE HWE_ID578RXB_failure.SHELL.BASE HWE_ID590RXB_failure.SHELL.BASE HWE_ID590RXB_failure_1.SHELL.BASE HWE_ID630RX_failure.SHELL.BASE HWE_ID640RX_failure.SHELL.BASE HWE_ID696RXB_failure.SHELL.BASE HWE_ID696RXB_failure_1.SHELL.BASE HWE_ID710RX_failure.SHELL.BASE HWE_ID760RX_failure.SHELL.BASE HWE_IP01_Dio.SHELL.BASE HWE_IP02_Dio.SHELL.BASE HWE_IP03_Dio.SHELL.BASE HWE_IP04_Dio.SHELL.BASE HWE_IP05_Dio.SHELL.BASE HWE_IP06_Dio.SHELL.BASE HWE_IP07_Dio.SHELL.BASE HWE_IP08_Dio.SHELL.BASE HWE_IP09_Dcyc.SHELL.BASE HWE_IP09_Err.SHELL.BASE HWE_IP09_Per.SHELL.BASE HWE_IP10_Dcyc.SHELL.BASE HWE_IP10_Err.SHELL.BASE HWE_IP10_Per.SHELL.BASE HWE_IP11_Dcyc.SHELL.BASE HWE_IP11_Err.SHELL.BASE HWE_IP11_Per.SHELL.BASE HWE_IP12_Dcyc.SHELL.BASE HWE_IP12_Err.SHELL.BASE HWE_IP12_Per.SHELL.BASE HWE_IS01.SHELL.BASE HWE_IS02.SHELL.BASE HWE_IS03.SHELL.BASE HWE_IS04.SHELL.BASE HWE_IS05.SHELL.BASE HWE_IS06.SHELL.BASE HWE_IS07.SHELL.BASE HWE_IS08.SHELL.BASE HWE_IS09.SHELL.BASE HWE_IS10.SHELL.BASE HWE_IS11.SHELL.BASE HWE_IS12.SHELL.BASE HWE_IS_ON.SHELL.BASE HWE_IS_TER15.SHELL.BASE HWE_IS_TER15R.SHELL.BASE HWE_IS_TER50.SHELL.BASE HWE_IS_WDA.SHELL.BASE HWE_OIC01_Dcyc.SHELL.BASE HWE_OIC01_DiagReg.SHELL.BASE HWE_OIC01_DiagRet.SHELL.BASE HWE_OIC01_Err.SHELL.BASE HWE_OIC01_Stat.SHELL.BASE HWE_OIC02_Dcyc.SHELL.BASE HWE_OIC02_Diag.SHELL.BASE HWE_OIC02_DiagReg.SHELL.BASE HWE_OIC02_DiagRet.SHELL.BASE HWE_OIC02_Err.SHELL.BASE HWE_OIC02_Stat.SHELL.BASE HWE_OPI01_Dcyc.SHELL.BASE HWE_OPI01_Err.SHELL.BASE HWE_OPI01_Stat.SHELL.BASE HWE_OPI02_Dcyc.SHELL.BASE HWE_OPI02_Err.SHELL.BASE HWE_OPI02_Stat.SHELL.BASE HWE_OPI03_Dcyc.SHELL.BASE HWE_OPI03_Err.SHELL.BASE HWE_OPI03_Stat.SHELL.BASE HWE_OPI04_Dcyc.SHELL.BASE HWE_OPI04_Err.SHELL.BASE HWE_OPI04_Stat.SHELL.BASE HWE_OPI05_Dcyc.SHELL.BASE HWE_OPI05_Err.SHELL.BASE HWE_OPI05_Stat.SHELL.BASE HWE_OPI06_Dcyc.SHELL.BASE HWE_OPI06_Err.SHELL.BASE HWE_OPI06_Stat.SHELL.BASE HWE_OPI07_Dcyc.SHELL.BASE HWE_OPI07_Err.SHELL.BASE HWE_OPI07_Stat.SHELL.BASE HWE_OPI08_Dcyc.SHELL.BASE HWE_OPI08_Err.SHELL.BASE HWE_OPI08_Stat.SHELL.BASE HWE_OPI09_Dcyc.SHELL.BASE HWE_OPI09_Err.SHELL.BASE HWE_OPI09_Stat.SHELL.BASE HWE_OPI10_Dcyc.SHELL.BASE HWE_OPI10_Err.SHELL.BASE HWE_OPI10_Stat.SHELL.BASE HWE_OPI11_Dcyc.SHELL.BASE HWE_OPI11_Err.SHELL.BASE HWE_OPI11_Stat.SHELL.BASE HWE_OS01_DiagReg.SHELL.BASE HWE_OS01_DiagRet.SHELL.BASE HWE_OS01_DiagStat.SHELL.BASE HWE_OS01_Disable.SHELL.BASE HWE_OS01_En.SHELL.BASE HWE_OS01_Err.SHELL.BASE HWE_OS01_S_Dcyc.SHELL.BASE HWE_OS01_Stat.SHELL.BASE HWE_OS01_V.SHELL.BASE HWE_OS02_DiagReg.SHELL.BASE HWE_OS02_DiagRet.SHELL.BASE HWE_OS02_DiagStat.SHELL.BASE HWE_OS02_Disable.SHELL.BASE HWE_OS02_En.SHELL.BASE HWE_OS02_Err.SHELL.BASE HWE_OS02_S_Dcyc.SHELL.BASE HWE_OS02_Stat.SHELL.BASE HWE_OS02_V.SHELL.BASE HWE_OS03.SHELL.BASE HWE_OS03_Err.SHELL.BASE HWE_OS03_Stat.SHELL.BASE HWE_OS04.SHELL.BASE HWE_OS04_Err.SHELL.BASE HWE_OS04_Stat.SHELL.BASE HWE_OS05a.SHELL.BASE HWE_OS05a_Err.SHELL.BASE HWE_OS05a_Stat.SHELL.BASE HWE_OS05b.SHELL.BASE HWE_OS05b_Err.SHELL.BASE HWE_OS05b_Stat.SHELL.BASE HWE_OS05c.SHELL.BASE HWE_OS05c_Err.SHELL.BASE HWE_OS05c_Stat.SHELL.BASE HWE_OS06.SHELL.BASE HWE_OS06_Err.SHELL.BASE HWE_OS06_Stat.SHELL.BASE HWE_OS07.SHELL.BASE HWE_OS07_Err.SHELL.BASE HWE_OS07_Stat.SHELL.BASE HWE_OS08.SHELL.BASE HWE_OS08_Err.SHELL.BASE HWE_OS08_Stat.SHELL.BASE HWE_OS09.SHELL.BASE HWE_OS09_Err.SHELL.BASE HWE_OS09_Stat.SHELL.BASE HWE_OS10.SHELL.BASE HWE_OS10_Err.SHELL.BASE HWE_OS10_Stat.SHELL.BASE HWE_OS11.SHELL.BASE HWE_OS11_Err.SHELL.BASE HWE_OS11_Stat.SHELL.BASE HWE_OS12.SHELL.BASE HWE_OS12_Err.SHELL.BASE HWE_OS12_Stat.SHELL.BASE HWE_OS13.SHELL.BASE HWE_OS13_Err.SHELL.BASE HWE_OS13_Stat.SHELL.BASE HWE_OS14.SHELL.BASE HWE_OS14_Err.SHELL.BASE HWE_OS14_Stat.SHELL.BASE HWE_OS15.SHELL.BASE HWE_OS15_Err.SHELL.BASE HWE_OS15_Stat.SHELL.BASE HWE_OS_MR.SHELL.BASE HWE_OS_ModelState.SHELL.BASE HWE_PowerfailDetected.HWE.BASE HWE_ResetMonitor_Adr.HWE.BASE HWE_ResetMonitor_Counter.HWE.BASE HWE_ResetMonitor_ID.HWE.BASE HWE_ResetMonitor_RSR.HWE.BASE HWE_ResetMonitor_Time.HWE.BASE HWE_Rtmo_ctSample.SHELL.BASE HWE_Rtmo_ctSampleProc.SHELL.BASE HWE_Rtmo_pLoadMax.SHELL.BASE HWE_Rtmo_tiAbsMax.SHELL.BASE HWE_Rtmo_tiAbsMax_1.SHELL.BASE HWE_Rtmo_tiAbsMin.SHELL.BASE HWE_Rtmo_tiAvrg.SHELL.BASE HWE_Rtmo_tiMax.SHELL.BASE HWE_Rtmo_tiMaxCallDist.SHELL.BASE HWE_Rtmo_tiMin.SHELL.BASE HWE_Rtmo_tiMinCallDist.SHELL.BASE HWE_ServiceCounter_st.SHELL.BASE HWE_SwitchOff.SHELL.BASE Result.Time_Calc.HWE.BASE Samp_Time_result.HWE.BASE TimeStampOne.Time_Calc.HWE.BASE TimeStampTwo.Time_Calc.HWE.BASE Timer_Zero_Error.HWE.BASE Tx_time_result.HWE.BASE Tx_time_sum.HWE.BASE g_CAN_B_IRQ_MaxExeTime_u32.HWE.BASE g_Target_D_DIVF_u32.HWE_TARGET.BASE g_Target_D_IMBSPEED_u32.HWE_TARGET.BASE g_Target_D_MF_u32.HWE_TARGET.BASE g_Target_D_TBS_u32.HWE_TARGET.BASE g_Target_D_TB_NORM_MUL_u32.HWE_TARGET.BASE g_Target_F_IMB_u32.HWE_TARGET.BASE g_Target_F_OSC_u32.HWE_TARGET.BASE g_Target_F_SYS_u32.HWE_TARGET.BASE g_Target_F_TB_u32.HWE_TARGET.BASE g_Target_SysTick_in_ns_u32.HWE_TARGET.BASE is_started.Time_Calc.HWE.BASE l_CAN_B_IRQ_ExeTime_u32.HWE.BASE l_CAN_B_IRQ_begin_u32.HWE.BASE l_baudrate_calculated_f32.HWE_CAN_A.SHELL.BASE l_baudrate_calculated_f32.HWE_CAN_B.SHELL.BASE l_baudrate_calculated_f32.HWE_CAN_C.SHELL.BASE l_baudrate_e.HWE_CAN_A.SHELL.BASE l_baudrate_e.HWE_CAN_B.SHELL.BASE l_baudrate_e.HWE_CAN_C.SHELL.BASE l_dBRP_u8.HWE_CAN_A.SHELL.BASE l_dBRP_u8.HWE_CAN_B.SHELL.BASE l_dBRP_u8.HWE_CAN_C.SHELL.BASE l_dPSeg1_u8.HWE_CAN_A.SHELL.BASE l_dPSeg1_u8.HWE_CAN_B.SHELL.BASE l_dPSeg1_u8.HWE_CAN_C.SHELL.BASE l_dPSeg2_u8.HWE_CAN_A.SHELL.BASE l_dPSeg2_u8.HWE_CAN_B.SHELL.BASE l_dPSeg2_u8.HWE_CAN_C.SHELL.BASE l_dPropSeg_u8.HWE_CAN_A.SHELL.BASE l_dPropSeg_u8.HWE_CAN_B.SHELL.BASE l_dPropSeg_u8.HWE_CAN_C.SHELL.BASE l_dSJW_u8.HWE_CAN_A.SHELL.BASE l_dSJW_u8.HWE_CAN_B.SHELL.BASE l_dSJW_u8.HWE_CAN_C.SHELL.BASE test_counter.HWE.BASE /end REF_MEASUREMENT
 /begin REF_CHARACTERISTIC HWE_CANA_OBD_TX_P7.SHELL.BASE HWE_CANA_StopDebTicks.SHELL.BASE HWE_CANA_UseBusOffTimer.SHELL.BASE HWE_CANB_CCP_DAQ0_P4.SHELL.BASE HWE_CANB_CCP_DAQ1_P5.SHELL.BASE HWE_CANB_CCP_DAQ2_P6.SHELL.BASE HWE_CANB_CCP_RX_P2.SHELL.BASE HWE_CANB_CCP_TX_P3.SHELL.BASE HWE_CANB_MUX_ID5xx_P8.SHELL.BASE HWE_CANB_StopDebTicks.SHELL.BASE HWE_CANB_UseBusOffTimer.SHELL.BASE HWE_CANB_XCP_CMD_RX_P4.SHELL.BASE HWE_CANB_XCP_DAQ0_P6.SHELL.BASE HWE_CANB_XCP_RES_TX_P5.SHELL.BASE HWE_CANB_XCP_STIM0_P0.SHELL.BASE HWE_CANB_XCP_STIM1_P1.SHELL.BASE HWE_CANB_XCP_STIM2_P2.SHELL.BASE HWE_CANB_XCP_STIM3_P3.SHELL.BASE HWE_CANC_StopDebTicks.SHELL.BASE HWE_CANC_UseBusOffTimer.SHELL.BASE HWE_CAN_A_BAUDRATE_P.SHELL.BASE HWE_CAN_B_BAUDRATE_P.SHELL.BASE HWE_CAN_C_BAUDRATE_P.SHELL.BASE HWE_IP09_DcycMax.SHELL.BASE HWE_IP09_DcycMin.SHELL.BASE HWE_IP09_PerMax.SHELL.BASE HWE_IP09_PerMin.SHELL.BASE HWE_IP10_DcycMax.SHELL.BASE HWE_IP10_DcycMin.SHELL.BASE HWE_IP10_PerMax.SHELL.BASE HWE_IP10_PerMin.SHELL.BASE HWE_IP11_DcycMax.SHELL.BASE HWE_IP11_DcycMin.SHELL.BASE HWE_IP11_PerMax.SHELL.BASE HWE_IP11_PerMin.SHELL.BASE HWE_IP12_DcycMax.SHELL.BASE HWE_IP12_DcycMin.SHELL.BASE HWE_IP12_PerMax.SHELL.BASE HWE_IP12_PerMin.SHELL.BASE HWE_OIC01_Per.SHELL.BASE HWE_OIC02_Per.SHELL.BASE HWE_OPI01_Per.SHELL.BASE HWE_OPI02_Per.SHELL.BASE HWE_OPI03_Per.SHELL.BASE HWE_OPI04_Per.SHELL.BASE HWE_OPI05_Per.SHELL.BASE HWE_OPI06_Per.SHELL.BASE HWE_OPI07_Per.SHELL.BASE HWE_OPI08_Per.SHELL.BASE HWE_OPI09_Per.SHELL.BASE HWE_OPI10_Per.SHELL.BASE HWE_OPI11_Per.SHELL.BASE HWE_OS01_S_Per.SHELL.BASE HWE_OS02_S_Per.SHELL.BASE HWE_Rtmo_Tasks.HWE.BASE HWE_Rtmo_adStart.SHELL.BASE HWE_Rtmo_stSampleTime.SHELL.BASE iflag_mask.HWE.BASE p_dBRP_u8.HWE_CAN_A.SHELL.BASE p_dBRP_u8.HWE_CAN_B.SHELL.BASE p_dBRP_u8.HWE_CAN_C.SHELL.BASE p_dPSeg1_u8.HWE_CAN_A.SHELL.BASE p_dPSeg1_u8.HWE_CAN_B.SHELL.BASE p_dPSeg1_u8.HWE_CAN_C.SHELL.BASE p_dPSeg2_u8.HWE_CAN_A.SHELL.BASE p_dPSeg2_u8.HWE_CAN_B.SHELL.BASE p_dPSeg2_u8.HWE_CAN_C.SHELL.BASE p_dPropSeg_u8.HWE_CAN_A.SHELL.BASE p_dPropSeg_u8.HWE_CAN_B.SHELL.BASE p_dPropSeg_u8.HWE_CAN_C.SHELL.BASE p_dSJW_u8.HWE_CAN_A.SHELL.BASE p_dSJW_u8.HWE_CAN_B.SHELL.BASE p_dSJW_u8.HWE_CAN_C.SHELL.BASE /end REF_CHARACTERISTIC
 /begin SUB_GROUP AS.BASE HWE.BASE HWE_TARGET.BASE SHELL.BASE /end SUB_GROUP
/end GROUP
/begin GROUP CURVE_Axis "" ROOT
 /begin REF_MEASUREMENT M_Curve_in_x.Axis_Input.CURVE_Axis M_Map_in_x.Axis_Input.CURVE_Axis M_Map_in_y.Axis_Input.CURVE_Axis /end REF_MEASUREMENT
 /begin REF_CHARACTERISTIC P_Curve_in_x.Axis_Input.CURVE_Axis P_Map_in_x.Axis_Input.CURVE_Axis P_Map_in_y.Axis_Input.CURVE_Axis /end REF_CHARACTERISTIC
/end GROUP
/begin GROUP HWE.BASE ""
 /begin REF_MEASUREMENT HWE_PowerfailDetected.HWE.BASE HWE_ResetMonitor_Adr.HWE.BASE HWE_ResetMonitor_Counter.HWE.BASE HWE_ResetMonitor_ID.HWE.BASE HWE_ResetMonitor_RSR.HWE.BASE HWE_ResetMonitor_Time.HWE.BASE Result.Time_Calc.HWE.BASE Samp_Time_result.HWE.BASE TimeStampOne.Time_Calc.HWE.BASE TimeStampTwo.Time_Calc.HWE.BASE Timer_Zero_Error.HWE.BASE Tx_time_result.HWE.BASE Tx_time_sum.HWE.BASE g_CAN_B_IRQ_MaxExeTime_u32.HWE.BASE is_started.Time_Calc.HWE.BASE l_CAN_B_IRQ_ExeTime_u32.HWE.BASE l_CAN_B_IRQ_begin_u32.HWE.BASE test_counter.HWE.BASE /end REF_MEASUREMENT
 /begin REF_CHARACTERISTIC HWE_Rtmo_Tasks.HWE.BASE iflag_mask.HWE.BASE /end REF_CHARACTERISTIC
/end GROUP
/begin GROUP HWE_CAN_A.SHELL.BASE ""
 /begin REF_MEASUREMENT l_baudrate_calculated_f32.HWE_CAN_A.SHELL.BASE l_baudrate_e.HWE_CAN_A.SHELL.BASE l_dBRP_u8.HWE_CAN_A.SHELL.BASE l_dPSeg1_u8.HWE_CAN_A.SHELL.BASE l_dPSeg2_u8.HWE_CAN_A.SHELL.BASE l_dPropSeg_u8.HWE_CAN_A.SHELL.BASE l_dSJW_u8.HWE_CAN_A.SHELL.BASE /end REF_MEASUREMENT
 /begin REF_CHARACTERISTIC p_dBRP_u8.HWE_CAN_A.SHELL.BASE p_dPSeg1_u8.HWE_CAN_A.SHELL.BASE p_dPSeg2_u8.HWE_CAN_A.SHELL.BASE p_dPropSeg_u8.HWE_CAN_A.SHELL.BASE p_dSJW_u8.HWE_CAN_A.SHELL.BASE /end REF_CHARACTERISTIC
/end GROUP
/begin GROUP HWE_CAN_B.SHELL.BASE ""
 /begin REF_MEASUREMENT l_baudrate_calculated_f32.HWE_CAN_B.SHELL.BASE l_baudrate_e.HWE_CAN_B.SHELL.BASE l_dBRP_u8.HWE_CAN_B.SHELL.BASE l_dPSeg1_u8.HWE_CAN_B.SHELL.BASE l_dPSeg2_u8.HWE_CAN_B.SHELL.BASE l_dPropSeg_u8.HWE_CAN_B.SHELL.BASE l_dSJW_u8.HWE_CAN_B.SHELL.BASE /end REF_MEASUREMENT
 /begin REF_CHARACTERISTIC p_dBRP_u8.HWE_CAN_B.SHELL.BASE p_dPSeg1_u8.HWE_CAN_B.SHELL.BASE p_dPSeg2_u8.HWE_CAN_B.SHELL.BASE p_dPropSeg_u8.HWE_CAN_B.SHELL.BASE p_dSJW_u8.HWE_CAN_B.SHELL.BASE /end REF_CHARACTERISTIC
/end GROUP
/begin GROUP HWE_CAN_C.SHELL.BASE ""
 /begin REF_MEASUREMENT l_baudrate_calculated_f32.HWE_CAN_C.SHELL.BASE l_baudrate_e.HWE_CAN_C.SHELL.BASE l_dBRP_u8.HWE_CAN_C.SHELL.BASE l_dPSeg1_u8.HWE_CAN_C.SHELL.BASE l_dPSeg2_u8.HWE_CAN_C.SHELL.BASE l_dPropSeg_u8.HWE_CAN_C.SHELL.BASE l_dSJW_u8.HWE_CAN_C.SHELL.BASE /end REF_MEASUREMENT
 /begin REF_CHARACTERISTIC p_dBRP_u8.HWE_CAN_C.SHELL.BASE p_dPSeg1_u8.HWE_CAN_C.SHELL.BASE p_dPSeg2_u8.HWE_CAN_C.SHELL.BASE p_dPropSeg_u8.HWE_CAN_C.SHELL.BASE p_dSJW_u8.HWE_CAN_C.SHELL.BASE /end REF_CHARACTERISTIC
/end GROUP
/begin GROUP HWE_TARGET.BASE ""
 /begin REF_MEASUREMENT g_Target_D_DIVF_u32.HWE_TARGET.BASE g_Target_D_IMBSPEED_u32.HWE_TARGET.BASE g_Target_D_MF_u32.HWE_TARGET.BASE g_Target_D_TBS_u32.HWE_TARGET.BASE g_Target_D_TB_NORM_MUL_u32.HWE_TARGET.BASE g_Target_F_IMB_u32.HWE_TARGET.BASE g_Target_F_OSC_u32.HWE_TARGET.BASE g_Target_F_SYS_u32.HWE_TARGET.BASE g_Target_F_TB_u32.HWE_TARGET.BASE g_Target_SysTick_in_ns_u32.HWE_TARGET.BASE /end REF_MEASUREMENT
/end GROUP
/begin GROUP Maps_Raster_1 "" ROOT
 /begin REF_MEASUREMENT Calculated.STD_float32_float32_float32.All_Maps_STD.Maps_Raster_1 Calculated.STD_sint16_sint16_sint16.All_Maps_STD.Maps_Raster_1 Calculated.STD_sint32_sint32_sint32.All_Maps_STD.Maps_Raster_1 Calculated.STD_sint8_sint8_sint8.All_Maps_STD.Maps_Raster_1 Calculated.STD_uint16_uint16_uint16.All_Maps_STD.Maps_Raster_1 Calculated.STD_uint32_uint32_uint32.All_Maps_STD.Maps_Raster_1 Calculated.STD_uint8_uint8_uint8.All_Maps_STD.Maps_Raster_1 M_In_X.STD_float32_float32_float32.All_Maps_STD.Maps_Raster_1 M_In_X.STD_sint16_sint16_sint16.All_Maps_STD.Maps_Raster_1 M_In_X.STD_sint32_sint32_sint32.All_Maps_STD.Maps_Raster_1 M_In_X.STD_sint8_sint8_sint8.All_Maps_STD.Maps_Raster_1 M_In_X.STD_uint16_uint16_uint16.All_Maps_STD.Maps_Raster_1 M_In_X.STD_uint32_uint32_uint32.All_Maps_STD.Maps_Raster_1 M_In_X.STD_uint8_uint8_uint8.All_Maps_STD.Maps_Raster_1 M_In_Y.STD_float32_float32_float32.All_Maps_STD.Maps_Raster_1 M_In_Y.STD_sint16_sint16_sint16.All_Maps_STD.Maps_Raster_1 M_In_Y.STD_sint32_sint32_sint32.All_Maps_STD.Maps_Raster_1 M_In_Y.STD_sint8_sint8_sint8.All_Maps_STD.Maps_Raster_1 M_In_Y.STD_uint16_uint16_uint16.All_Maps_STD.Maps_Raster_1 M_In_Y.STD_uint32_uint32_uint32.All_Maps_STD.Maps_Raster_1 M_In_Y.STD_uint8_uint8_uint8.All_Maps_STD.Maps_Raster_1 M_out.STD_float32_float32_float32.All_Maps_STD.Maps_Raster_1 M_out.STD_sint16_sint16_sint16.All_Maps_STD.Maps_Raster_1 M_out.STD_sint32_sint32_sint32.All_Maps_STD.Maps_Raster_1 M_out.STD_sint8_sint8_sint8.All_Maps_STD.Maps_Raster_1 M_out.STD_uint16_uint16_uint16.All_Maps_STD.Maps_Raster_1 M_out.STD_uint32_uint32_uint32.All_Maps_STD.Maps_Raster_1 M_out.STD_uint8_uint8_uint8.All_Maps_STD.Maps_Raster_1 /end REF_MEASUREMENT
 /begin REF_CHARACTERISTIC P_Do_Active_Std.STD_float32_float32_float32.All_Maps_STD.Maps_Raster_1 P_Do_Active_Std.STD_sint16_sint16_sint16.All_Maps_STD.Maps_Raster_1 P_Do_Active_Std.STD_sint32_sint32_sint32.All_Maps_STD.Maps_Raster_1 P_Do_Active_Std.STD_sint8_sint8_sint8.All_Maps_STD.Maps_Raster_1 P_Do_Active_Std.STD_uint16_uint16_uint16.All_Maps_STD.Maps_Raster_1 P_Do_Active_Std.STD_uint32_uint32_uint32.All_Maps_STD.Maps_Raster_1 P_Do_Active_Std.STD_uint8_uint8_uint8.All_Maps_STD.Maps_Raster_1 P_Do_All_STD_Maps.All_Maps_STD.Maps_Raster_1 P_In_X.STD_float32_float32_float32.All_Maps_STD.Maps_Raster_1 P_In_X.STD_sint16_sint16_sint16.All_Maps_STD.Maps_Raster_1 P_In_X.STD_sint32_sint32_sint32.All_Maps_STD.Maps_Raster_1 P_In_X.STD_sint8_sint8_sint8.All_Maps_STD.Maps_Raster_1 P_In_X.STD_uint16_uint16_uint16.All_Maps_STD.Maps_Raster_1 P_In_X.STD_uint32_uint32_uint32.All_Maps_STD.Maps_Raster_1 P_In_X.STD_uint8_uint8_uint8.All_Maps_STD.Maps_Raster_1 P_In_Y.STD_float32_float32_float32.All_Maps_STD.Maps_Raster_1 P_In_Y.STD_sint16_sint16_sint16.All_Maps_STD.Maps_Raster_1 P_In_Y.STD_sint32_sint32_sint32.All_Maps_STD.Maps_Raster_1 P_In_Y.STD_sint8_sint8_sint8.All_Maps_STD.Maps_Raster_1 P_In_Y.STD_uint16_uint16_uint16.All_Maps_STD.Maps_Raster_1 P_In_Y.STD_uint32_uint32_uint32.All_Maps_STD.Maps_Raster_1 P_In_Y.STD_uint8_uint8_uint8.All_Maps_STD.Maps_Raster_1 Two_D.STD_float32_float32_float32.All_Maps_STD.Maps_Raster_1 Two_D.STD_sint16_sint16_sint16.All_Maps_STD.Maps_Raster_1 Two_D.STD_sint32_sint32_sint32.All_Maps_STD.Maps_Raster_1 Two_D.STD_sint8_sint8_sint8.All_Maps_STD.Maps_Raster_1 Two_D.STD_uint16_uint16_uint16.All_Maps_STD.Maps_Raster_1 Two_D.STD_uint32_uint32_uint32.All_Maps_STD.Maps_Raster_1 Two_D.STD_uint8_uint8_uint8.All_Maps_STD.Maps_Raster_1 /end REF_CHARACTERISTIC
/end GROUP
/begin GROUP Maps_Raster_2 "" ROOT
 /begin REF_MEASUREMENT Calculated.STD_float32_float32_float32.All_Maps_STD.Maps_Raster_2 Calculated.STD_sint16_sint16_sint16.All_Maps_STD.Maps_Raster_2 Calculated.STD_sint32_sint32_sint32.All_Maps_STD.Maps_Raster_2 Calculated.STD_sint8_sint8_sint8.All_Maps_STD.Maps_Raster_2 Calculated.STD_uint16_uint16_uint16.All_Maps_STD.Maps_Raster_2 Calculated.STD_uint32_uint32_uint32.All_Maps_STD.Maps_Raster_2 Calculated.STD_uint8_uint8_uint8.All_Maps_STD.Maps_Raster_2 M_In_X.STD_float32_float32_float32.All_Maps_STD.Maps_Raster_2 M_In_X.STD_sint16_sint16_sint16.All_Maps_STD.Maps_Raster_2 M_In_X.STD_sint32_sint32_sint32.All_Maps_STD.Maps_Raster_2 M_In_X.STD_sint8_sint8_sint8.All_Maps_STD.Maps_Raster_2 M_In_X.STD_uint16_uint16_uint16.All_Maps_STD.Maps_Raster_2 M_In_X.STD_uint32_uint32_uint32.All_Maps_STD.Maps_Raster_2 M_In_X.STD_uint8_uint8_uint8.All_Maps_STD.Maps_Raster_2 M_In_Y.STD_float32_float32_float32.All_Maps_STD.Maps_Raster_2 M_In_Y.STD_sint16_sint16_sint16.All_Maps_STD.Maps_Raster_2 M_In_Y.STD_sint32_sint32_sint32.All_Maps_STD.Maps_Raster_2 M_In_Y.STD_sint8_sint8_sint8.All_Maps_STD.Maps_Raster_2 M_In_Y.STD_uint16_uint16_uint16.All_Maps_STD.Maps_Raster_2 M_In_Y.STD_uint32_uint32_uint32.All_Maps_STD.Maps_Raster_2 M_In_Y.STD_uint8_uint8_uint8.All_Maps_STD.Maps_Raster_2 M_out.STD_float32_float32_float32.All_Maps_STD.Maps_Raster_2 M_out.STD_sint16_sint16_sint16.All_Maps_STD.Maps_Raster_2 M_out.STD_sint32_sint32_sint32.All_Maps_STD.Maps_Raster_2 M_out.STD_sint8_sint8_sint8.All_Maps_STD.Maps_Raster_2 M_out.STD_uint16_uint16_uint16.All_Maps_STD.Maps_Raster_2 M_out.STD_uint32_uint32_uint32.All_Maps_STD.Maps_Raster_2 M_out.STD_uint8_uint8_uint8.All_Maps_STD.Maps_Raster_2 /end REF_MEASUREMENT
 /begin REF_CHARACTERISTIC P_Do_Active_Std.STD_float32_float32_float32.All_Maps_STD.Maps_Raster_2 P_Do_Active_Std.STD_sint16_sint16_sint16.All_Maps_STD.Maps_Raster_2 P_Do_Active_Std.STD_sint32_sint32_sint32.All_Maps_STD.Maps_Raster_2 P_Do_Active_Std.STD_sint8_sint8_sint8.All_Maps_STD.Maps_Raster_2 P_Do_Active_Std.STD_uint16_uint16_uint16.All_Maps_STD.Maps_Raster_2 P_Do_Active_Std.STD_uint32_uint32_uint32.All_Maps_STD.Maps_Raster_2 P_Do_Active_Std.STD_uint8_uint8_uint8.All_Maps_STD.Maps_Raster_2 P_Do_All_STD_Maps.All_Maps_STD.Maps_Raster_2 P_In_X.STD_float32_float32_float32.All_Maps_STD.Maps_Raster_2 P_In_X.STD_sint16_sint16_sint16.All_Maps_STD.Maps_Raster_2 P_In_X.STD_sint32_sint32_sint32.All_Maps_STD.Maps_Raster_2 P_In_X.STD_sint8_sint8_sint8.All_Maps_STD.Maps_Raster_2 P_In_X.STD_uint16_uint16_uint16.All_Maps_STD.Maps_Raster_2 P_In_X.STD_uint32_uint32_uint32.All_Maps_STD.Maps_Raster_2 P_In_X.STD_uint8_uint8_uint8.All_Maps_STD.Maps_Raster_2 P_In_Y.STD_float32_float32_float32.All_Maps_STD.Maps_Raster_2 P_In_Y.STD_sint16_sint16_sint16.All_Maps_STD.Maps_Raster_2 P_In_Y.STD_sint32_sint32_sint32.All_Maps_STD.Maps_Raster_2 P_In_Y.STD_sint8_sint8_sint8.All_Maps_STD.Maps_Raster_2 P_In_Y.STD_uint16_uint16_uint16.All_Maps_STD.Maps_Raster_2 P_In_Y.STD_uint32_uint32_uint32.All_Maps_STD.Maps_Raster_2 P_In_Y.STD_uint8_uint8_uint8.All_Maps_STD.Maps_Raster_2 Two_D.STD_float32_float32_float32.All_Maps_STD.Maps_Raster_2 Two_D.STD_sint16_sint16_sint16.All_Maps_STD.Maps_Raster_2 Two_D.STD_sint32_sint32_sint32.All_Maps_STD.Maps_Raster_2 Two_D.STD_sint8_sint8_sint8.All_Maps_STD.Maps_Raster_2 Two_D.STD_uint16_uint16_uint16.All_Maps_STD.Maps_Raster_2 Two_D.STD_uint32_uint32_uint32.All_Maps_STD.Maps_Raster_2 Two_D.STD_uint8_uint8_uint8.All_Maps_STD.Maps_Raster_2 /end REF_CHARACTERISTIC
/end GROUP
/begin GROUP Maps_Raster_3 "" ROOT
 /begin REF_MEASUREMENT Calculated.STD_float32_float32_float32.All_Maps_STD.Maps_Raster_3 Calculated.STD_sint16_sint16_sint16.All_Maps_STD.Maps_Raster_3 Calculated.STD_sint32_sint32_sint32.All_Maps_STD.Maps_Raster_3 Calculated.STD_sint8_sint8_sint8.All_Maps_STD.Maps_Raster_3 Calculated.STD_uint16_uint16_uint16.All_Maps_STD.Maps_Raster_3 Calculated.STD_uint32_uint32_uint32.All_Maps_STD.Maps_Raster_3 Calculated.STD_uint8_uint8_uint8.All_Maps_STD.Maps_Raster_3 M_In_X.STD_float32_float32_float32.All_Maps_STD.Maps_Raster_3 M_In_X.STD_sint16_sint16_sint16.All_Maps_STD.Maps_Raster_3 M_In_X.STD_sint32_sint32_sint32.All_Maps_STD.Maps_Raster_3 M_In_X.STD_sint8_sint8_sint8.All_Maps_STD.Maps_Raster_3 M_In_X.STD_uint16_uint16_uint16.All_Maps_STD.Maps_Raster_3 M_In_X.STD_uint32_uint32_uint32.All_Maps_STD.Maps_Raster_3 M_In_X.STD_uint8_uint8_uint8.All_Maps_STD.Maps_Raster_3 M_In_Y.STD_float32_float32_float32.All_Maps_STD.Maps_Raster_3 M_In_Y.STD_sint16_sint16_sint16.All_Maps_STD.Maps_Raster_3 M_In_Y.STD_sint32_sint32_sint32.All_Maps_STD.Maps_Raster_3 M_In_Y.STD_sint8_sint8_sint8.All_Maps_STD.Maps_Raster_3 M_In_Y.STD_uint16_uint16_uint16.All_Maps_STD.Maps_Raster_3 M_In_Y.STD_uint32_uint32_uint32.All_Maps_STD.Maps_Raster_3 M_In_Y.STD_uint8_uint8_uint8.All_Maps_STD.Maps_Raster_3 M_out.STD_float32_float32_float32.All_Maps_STD.Maps_Raster_3 M_out.STD_sint16_sint16_sint16.All_Maps_STD.Maps_Raster_3 M_out.STD_sint32_sint32_sint32.All_Maps_STD.Maps_Raster_3 M_out.STD_sint8_sint8_sint8.All_Maps_STD.Maps_Raster_3 M_out.STD_uint16_uint16_uint16.All_Maps_STD.Maps_Raster_3 M_out.STD_uint32_uint32_uint32.All_Maps_STD.Maps_Raster_3 M_out.STD_uint8_uint8_uint8.All_Maps_STD.Maps_Raster_3 /end REF_MEASUREMENT
 /begin REF_CHARACTERISTIC P_Do_Active_Std.STD_float32_float32_float32.All_Maps_STD.Maps_Raster_3 P_Do_Active_Std.STD_sint16_sint16_sint16.All_Maps_STD.Maps_Raster_3 P_Do_Active_Std.STD_sint32_sint32_sint32.All_Maps_STD.Maps_Raster_3 P_Do_Active_Std.STD_sint8_sint8_sint8.All_Maps_STD.Maps_Raster_3 P_Do_Active_Std.STD_uint16_uint16_uint16.All_Maps_STD.Maps_Raster_3 P_Do_Active_Std.STD_uint32_uint32_uint32.All_Maps_STD.Maps_Raster_3 P_Do_Active_Std.STD_uint8_uint8_uint8.All_Maps_STD.Maps_Raster_3 P_Do_All_STD_Maps.All_Maps_STD.Maps_Raster_3 P_In_X.STD_float32_float32_float32.All_Maps_STD.Maps_Raster_3 P_In_X.STD_sint16_sint16_sint16.All_Maps_STD.Maps_Raster_3 P_In_X.STD_sint32_sint32_sint32.All_Maps_STD.Maps_Raster_3 P_In_X.STD_sint8_sint8_sint8.All_Maps_STD.Maps_Raster_3 P_In_X.STD_uint16_uint16_uint16.All_Maps_STD.Maps_Raster_3 P_In_X.STD_uint32_uint32_uint32.All_Maps_STD.Maps_Raster_3 P_In_X.STD_uint8_uint8_uint8.All_Maps_STD.Maps_Raster_3 P_In_Y.STD_float32_float32_float32.All_Maps_STD.Maps_Raster_3 P_In_Y.STD_sint16_sint16_sint16.All_Maps_STD.Maps_Raster_3 P_In_Y.STD_sint32_sint32_sint32.All_Maps_STD.Maps_Raster_3 P_In_Y.STD_sint8_sint8_sint8.All_Maps_STD.Maps_Raster_3 P_In_Y.STD_uint16_uint16_uint16.All_Maps_STD.Maps_Raster_3 P_In_Y.STD_uint32_uint32_uint32.All_Maps_STD.Maps_Raster_3 P_In_Y.STD_uint8_uint8_uint8.All_Maps_STD.Maps_Raster_3 Two_D.STD_float32_float32_float32.All_Maps_STD.Maps_Raster_3 Two_D.STD_sint16_sint16_sint16.All_Maps_STD.Maps_Raster_3 Two_D.STD_sint32_sint32_sint32.All_Maps_STD.Maps_Raster_3 Two_D.STD_sint8_sint8_sint8.All_Maps_STD.Maps_Raster_3 Two_D.STD_uint16_uint16_uint16.All_Maps_STD.Maps_Raster_3 Two_D.STD_uint32_uint32_uint32.All_Maps_STD.Maps_Raster_3 Two_D.STD_uint8_uint8_uint8.All_Maps_STD.Maps_Raster_3 /end REF_CHARACTERISTIC
/end GROUP
/begin GROUP SHELL.BASE ""
 /begin REF_MEASUREMENT HWE_A_U_5V1_Err.SHELL.BASE HWE_A_U_5V1_Stat.SHELL.BASE HWE_A_U_5V2_Err.SHELL.BASE HWE_A_U_5V2_Stat.SHELL.BASE HWE_A_U_5V3_Err.SHELL.BASE HWE_A_U_5V3_Stat.SHELL.BASE HWE_Alarm_Can_Num1_Driver.SHELL.BASE HWE_CANA_ID250RX_1.SHELL.BASE HWE_CANA_ID250RX_2.SHELL.BASE HWE_CANA_ID258RX_1.SHELL.BASE HWE_CANA_ID258RX_2.SHELL.BASE HWE_CANA_ID260TX_1.SHELL.BASE HWE_CANA_ID260TX_2.SHELL.BASE HWE_CANA_ID288TX_1.SHELL.BASE HWE_CANA_ID288TX_2.SHELL.BASE HWE_CANA_ID290RX_1.SHELL.BASE HWE_CANA_ID290RX_2.SHELL.BASE HWE_CANA_ID310TX_1.SHELL.BASE HWE_CANA_ID310TX_2.SHELL.BASE HWE_CANA_ID320RX_1.SHELL.BASE HWE_CANA_ID320RX_2.SHELL.BASE HWE_CANA_ID330TX_1.SHELL.BASE HWE_CANA_ID330TX_2.SHELL.BASE HWE_CANA_ID340RX_1.SHELL.BASE HWE_CANA_ID340RX_2.SHELL.BASE HWE_CANA_ID358RX_1.SHELL.BASE HWE_CANA_ID358RX_2.SHELL.BASE HWE_CANA_ID500RX_1.SHELL.BASE HWE_CANA_ID500RX_2.SHELL.BASE HWE_CANA_ID510RX_1.SHELL.BASE HWE_CANA_ID510RX_2.SHELL.BASE HWE_CANA_ID620TX_1.SHELL.BASE HWE_CANA_ID620TX_2.SHELL.BASE HWE_CANA_ID630RX_1.SHELL.BASE HWE_CANA_ID630RX_2.SHELL.BASE HWE_CANA_ID640RX_1.SHELL.BASE HWE_CANA_ID640RX_2.SHELL.BASE HWE_CANA_InitAfterBusOff.SHELL.BASE HWE_CANA_OBD_TX_V7.SHELL.BASE HWE_CANA_stBusOff.SHELL.BASE HWE_CANB_CCP_DAQ0_V4.SHELL.BASE HWE_CANB_CCP_DAQ1_V5.SHELL.BASE HWE_CANB_CCP_DAQ2_V6.SHELL.BASE HWE_CANB_CCP_RX_V2.SHELL.BASE HWE_CANB_CCP_TX_V3.SHELL.BASE HWE_CANB_ID348RXB_1.SHELL.BASE HWE_CANB_ID348RXB_2.SHELL.BASE HWE_CANB_ID350TX_1.SHELL.BASE HWE_CANB_ID350TX_2.SHELL.BASE HWE_CANB_ID360TX_1.SHELL.BASE HWE_CANB_ID360TX_2.SHELL.BASE HWE_CANB_ID380TX_1.SHELL.BASE HWE_CANB_ID380TX_2.SHELL.BASE HWE_CANB_ID578RXB_1.SHELL.BASE HWE_CANB_ID578RXB_2.SHELL.BASE HWE_CANB_ID590RXB_1.SHELL.BASE HWE_CANB_ID590RXB_2.SHELL.BASE HWE_CANB_ID5FFTX_1.SHELL.BASE HWE_CANB_ID5FFTX_2.SHELL.BASE HWE_CANB_ID690TX_1.SHELL.BASE HWE_CANB_ID690TX_2.SHELL.BASE HWE_CANB_ID691TX_1.SHELL.BASE HWE_CANB_ID691TX_2.SHELL.BASE HWE_CANB_ID695TX_1.SHELL.BASE HWE_CANB_ID695TX_2.SHELL.BASE HWE_CANB_ID696RXB_1.SHELL.BASE HWE_CANB_InitAfterBusOff.SHELL.BASE HWE_CANB_MUX_ID5xx_V8.SHELL.BASE HWE_CANB_MUX_ID5xx_V8_U32_1.SHELL.BASE HWE_CANB_MUX_ID5xx_V8_U32_2.SHELL.BASE HWE_CANB_stBusOff.SHELL.BASE HWE_CANC_ID100TX_1.SHELL.BASE HWE_CANC_ID100TX_2.SHELL.BASE HWE_CANC_ID101RX_1.SHELL.BASE HWE_CANC_ID101RX_2.SHELL.BASE HWE_CANC_InitAfterBusOff.SHELL.BASE HWE_CANC_stBusOff.SHELL.BASE HWE_CAN_A_BAUDRATE_V.SHELL.BASE HWE_CAN_B_BAUDRATE_V.SHELL.BASE HWE_CAN_C_BAUDRATE_V.SHELL.BASE HWE_CAN_DisableNormalMsgTx.SHELL.BASE HWE_CJ230A_Err.SHELL.BASE HWE_CJ230A_Stat.SHELL.BASE HWE_CJ230B_Err.SHELL.BASE HWE_CJ230B_Stat.SHELL.BASE HWE_CJ945A_Err.SHELL.BASE HWE_CJ945A_Stat.SHELL.BASE HWE_CJ945B_Err.SHELL.BASE HWE_CJ945B_Stat.SHELL.BASE HWE_Can_DiagOpSwitch.SHELL.BASE HWE_Can_Rx_Ok.SHELL.BASE HWE_EepBlk_State.SHELL.BASE HWE_Eep_AfterRun_st.SHELL.BASE HWE_Eep_Format.SHELL.BASE HWE_Enter_NL.SHELL.BASE HWE_IA01.SHELL.BASE HWE_IA02.SHELL.BASE HWE_IA03.SHELL.BASE HWE_IA04.SHELL.BASE HWE_IA05.SHELL.BASE HWE_IA06.SHELL.BASE HWE_IA07.SHELL.BASE HWE_IA08.SHELL.BASE HWE_IA09.SHELL.BASE HWE_IA10.SHELL.BASE HWE_IA11.SHELL.BASE HWE_IA12.SHELL.BASE HWE_IA13.SHELL.BASE HWE_IA14.SHELL.BASE HWE_IA15.SHELL.BASE HWE_IA16.SHELL.BASE HWE_IA17.SHELL.BASE HWE_IA18.SHELL.BASE HWE_IA19.SHELL.BASE HWE_IA20.SHELL.BASE HWE_IA21.SHELL.BASE HWE_IA22.SHELL.BASE HWE_IA25.SHELL.BASE HWE_IA26.SHELL.BASE HWE_IA_IPS.SHELL.BASE HWE_IA_ITS.SHELL.BASE HWE_IA_TER30.SHELL.BASE HWE_IA_TER30B.SHELL.BASE HWE_ID101RX_failure.SHELL.BASE HWE_ID250RX_failure.SHELL.BASE HWE_ID258RX_failure.SHELL.BASE HWE_ID290RX_failure.SHELL.BASE HWE_ID320RX_failure.SHELL.BASE HWE_ID340RX_failure.SHELL.BASE HWE_ID348RXB_failure.SHELL.BASE HWE_ID358RX_failure.SHELL.BASE HWE_ID500RX_failure.SHELL.BASE HWE_ID510RX_failure.SHELL.BASE HWE_ID578RXB_failure.SHELL.BASE HWE_ID590RXB_failure.SHELL.BASE HWE_ID590RXB_failure_1.SHELL.BASE HWE_ID630RX_failure.SHELL.BASE HWE_ID640RX_failure.SHELL.BASE HWE_ID696RXB_failure.SHELL.BASE HWE_ID696RXB_failure_1.SHELL.BASE HWE_ID710RX_failure.SHELL.BASE HWE_ID760RX_failure.SHELL.BASE HWE_IP01_Dio.SHELL.BASE HWE_IP02_Dio.SHELL.BASE HWE_IP03_Dio.SHELL.BASE HWE_IP04_Dio.SHELL.BASE HWE_IP05_Dio.SHELL.BASE HWE_IP06_Dio.SHELL.BASE HWE_IP07_Dio.SHELL.BASE HWE_IP08_Dio.SHELL.BASE HWE_IP09_Dcyc.SHELL.BASE HWE_IP09_Err.SHELL.BASE HWE_IP09_Per.SHELL.BASE HWE_IP10_Dcyc.SHELL.BASE HWE_IP10_Err.SHELL.BASE HWE_IP10_Per.SHELL.BASE HWE_IP11_Dcyc.SHELL.BASE HWE_IP11_Err.SHELL.BASE HWE_IP11_Per.SHELL.BASE HWE_IP12_Dcyc.SHELL.BASE HWE_IP12_Err.SHELL.BASE HWE_IP12_Per.SHELL.BASE HWE_IS01.SHELL.BASE HWE_IS02.SHELL.BASE HWE_IS03.SHELL.BASE HWE_IS04.SHELL.BASE HWE_IS05.SHELL.BASE HWE_IS06.SHELL.BASE HWE_IS07.SHELL.BASE HWE_IS08.SHELL.BASE HWE_IS09.SHELL.BASE HWE_IS10.SHELL.BASE HWE_IS11.SHELL.BASE HWE_IS12.SHELL.BASE HWE_IS_ON.SHELL.BASE HWE_IS_TER15.SHELL.BASE HWE_IS_TER15R.SHELL.BASE HWE_IS_TER50.SHELL.BASE HWE_IS_WDA.SHELL.BASE HWE_OIC01_Dcyc.SHELL.BASE HWE_OIC01_DiagReg.SHELL.BASE HWE_OIC01_DiagRet.SHELL.BASE HWE_OIC01_Err.SHELL.BASE HWE_OIC01_Stat.SHELL.BASE HWE_OIC02_Dcyc.SHELL.BASE HWE_OIC02_Diag.SHELL.BASE HWE_OIC02_DiagReg.SHELL.BASE HWE_OIC02_DiagRet.SHELL.BASE HWE_OIC02_Err.SHELL.BASE HWE_OIC02_Stat.SHELL.BASE HWE_OPI01_Dcyc.SHELL.BASE HWE_OPI01_Err.SHELL.BASE HWE_OPI01_Stat.SHELL.BASE HWE_OPI02_Dcyc.SHELL.BASE HWE_OPI02_Err.SHELL.BASE HWE_OPI02_Stat.SHELL.BASE HWE_OPI03_Dcyc.SHELL.BASE HWE_OPI03_Err.SHELL.BASE HWE_OPI03_Stat.SHELL.BASE HWE_OPI04_Dcyc.SHELL.BASE HWE_OPI04_Err.SHELL.BASE HWE_OPI04_Stat.SHELL.BASE HWE_OPI05_Dcyc.SHELL.BASE HWE_OPI05_Err.SHELL.BASE HWE_OPI05_Stat.SHELL.BASE HWE_OPI06_Dcyc.SHELL.BASE HWE_OPI06_Err.SHELL.BASE HWE_OPI06_Stat.SHELL.BASE HWE_OPI07_Dcyc.SHELL.BASE HWE_OPI07_Err.SHELL.BASE HWE_OPI07_Stat.SHELL.BASE HWE_OPI08_Dcyc.SHELL.BASE HWE_OPI08_Err.SHELL.BASE HWE_OPI08_Stat.SHELL.BASE HWE_OPI09_Dcyc.SHELL.BASE HWE_OPI09_Err.SHELL.BASE HWE_OPI09_Stat.SHELL.BASE HWE_OPI10_Dcyc.SHELL.BASE HWE_OPI10_Err.SHELL.BASE HWE_OPI10_Stat.SHELL.BASE HWE_OPI11_Dcyc.SHELL.BASE HWE_OPI11_Err.SHELL.BASE HWE_OPI11_Stat.SHELL.BASE HWE_OS01_DiagReg.SHELL.BASE HWE_OS01_DiagRet.SHELL.BASE HWE_OS01_DiagStat.SHELL.BASE HWE_OS01_Disable.SHELL.BASE HWE_OS01_En.SHELL.BASE HWE_OS01_Err.SHELL.BASE HWE_OS01_S_Dcyc.SHELL.BASE HWE_OS01_Stat.SHELL.BASE HWE_OS01_V.SHELL.BASE HWE_OS02_DiagReg.SHELL.BASE HWE_OS02_DiagRet.SHELL.BASE HWE_OS02_DiagStat.SHELL.BASE HWE_OS02_Disable.SHELL.BASE HWE_OS02_En.SHELL.BASE HWE_OS02_Err.SHELL.BASE HWE_OS02_S_Dcyc.SHELL.BASE HWE_OS02_Stat.SHELL.BASE HWE_OS02_V.SHELL.BASE HWE_OS03.SHELL.BASE HWE_OS03_Err.SHELL.BASE HWE_OS03_Stat.SHELL.BASE HWE_OS04.SHELL.BASE HWE_OS04_Err.SHELL.BASE HWE_OS04_Stat.SHELL.BASE HWE_OS05a.SHELL.BASE HWE_OS05a_Err.SHELL.BASE HWE_OS05a_Stat.SHELL.BASE HWE_OS05b.SHELL.BASE HWE_OS05b_Err.SHELL.BASE HWE_OS05b_Stat.SHELL.BASE HWE_OS05c.SHELL.BASE HWE_OS05c_Err.SHELL.BASE HWE_OS05c_Stat.SHELL.BASE HWE_OS06.SHELL.BASE HWE_OS06_Err.SHELL.BASE HWE_OS06_Stat.SHELL.BASE HWE_OS07.SHELL.BASE HWE_OS07_Err.SHELL.BASE HWE_OS07_Stat.SHELL.BASE HWE_OS08.SHELL.BASE HWE_OS08_Err.SHELL.BASE HWE_OS08_Stat.SHELL.BASE HWE_OS09.SHELL.BASE HWE_OS09_Err.SHELL.BASE HWE_OS09_Stat.SHELL.BASE HWE_OS10.SHELL.BASE HWE_OS10_Err.SHELL.BASE HWE_OS10_Stat.SHELL.BASE HWE_OS11.SHELL.BASE HWE_OS11_Err.SHELL.BASE HWE_OS11_Stat.SHELL.BASE HWE_OS12.SHELL.BASE HWE_OS12_Err.SHELL.BASE HWE_OS12_Stat.SHELL.BASE HWE_OS13.SHELL.BASE HWE_OS13_Err.SHELL.BASE HWE_OS13_Stat.SHELL.BASE HWE_OS14.SHELL.BASE HWE_OS14_Err.SHELL.BASE HWE_OS14_Stat.SHELL.BASE HWE_OS15.SHELL.BASE HWE_OS15_Err.SHELL.BASE HWE_OS15_Stat.SHELL.BASE HWE_OS_MR.SHELL.BASE HWE_OS_ModelState.SHELL.BASE HWE_Rtmo_ctSample.SHELL.BASE HWE_Rtmo_ctSampleProc.SHELL.BASE HWE_Rtmo_pLoadMax.SHELL.BASE HWE_Rtmo_tiAbsMax.SHELL.BASE HWE_Rtmo_tiAbsMax_1.SHELL.BASE HWE_Rtmo_tiAbsMin.SHELL.BASE HWE_Rtmo_tiAvrg.SHELL.BASE HWE_Rtmo_tiMax.SHELL.BASE HWE_Rtmo_tiMaxCallDist.SHELL.BASE HWE_Rtmo_tiMin.SHELL.BASE HWE_Rtmo_tiMinCallDist.SHELL.BASE HWE_ServiceCounter_st.SHELL.BASE HWE_SwitchOff.SHELL.BASE l_baudrate_calculated_f32.HWE_CAN_A.SHELL.BASE l_baudrate_calculated_f32.HWE_CAN_B.SHELL.BASE l_baudrate_calculated_f32.HWE_CAN_C.SHELL.BASE l_baudrate_e.HWE_CAN_A.SHELL.BASE l_baudrate_e.HWE_CAN_B.SHELL.BASE l_baudrate_e.HWE_CAN_C.SHELL.BASE l_dBRP_u8.HWE_CAN_A.SHELL.BASE l_dBRP_u8.HWE_CAN_B.SHELL.BASE l_dBRP_u8.HWE_CAN_C.SHELL.BASE l_dPSeg1_u8.HWE_CAN_A.SHELL.BASE l_dPSeg1_u8.HWE_CAN_B.SHELL.BASE l_dPSeg1_u8.HWE_CAN_C.SHELL.BASE l_dPSeg2_u8.HWE_CAN_A.SHELL.BASE l_dPSeg2_u8.HWE_CAN_B.SHELL.BASE l_dPSeg2_u8.HWE_CAN_C.SHELL.BASE l_dPropSeg_u8.HWE_CAN_A.SHELL.BASE l_dPropSeg_u8.HWE_CAN_B.SHELL.BASE l_dPropSeg_u8.HWE_CAN_C.SHELL.BASE l_dSJW_u8.HWE_CAN_A.SHELL.BASE l_dSJW_u8.HWE_CAN_B.SHELL.BASE l_dSJW_u8.HWE_CAN_C.SHELL.BASE /end REF_MEASUREMENT
 /begin REF_CHARACTERISTIC HWE_CANA_OBD_TX_P7.SHELL.BASE HWE_CANA_StopDebTicks.SHELL.BASE HWE_CANA_UseBusOffTimer.SHELL.BASE HWE_CANB_CCP_DAQ0_P4.SHELL.BASE HWE_CANB_CCP_DAQ1_P5.SHELL.BASE HWE_CANB_CCP_DAQ2_P6.SHELL.BASE HWE_CANB_CCP_RX_P2.SHELL.BASE HWE_CANB_CCP_TX_P3.SHELL.BASE HWE_CANB_MUX_ID5xx_P8.SHELL.BASE HWE_CANB_StopDebTicks.SHELL.BASE HWE_CANB_UseBusOffTimer.SHELL.BASE HWE_CANB_XCP_CMD_RX_P4.SHELL.BASE HWE_CANB_XCP_DAQ0_P6.SHELL.BASE HWE_CANB_XCP_RES_TX_P5.SHELL.BASE HWE_CANB_XCP_STIM0_P0.SHELL.BASE HWE_CANB_XCP_STIM1_P1.SHELL.BASE HWE_CANB_XCP_STIM2_P2.SHELL.BASE HWE_CANB_XCP_STIM3_P3.SHELL.BASE HWE_CANC_StopDebTicks.SHELL.BASE HWE_CANC_UseBusOffTimer.SHELL.BASE HWE_CAN_A_BAUDRATE_P.SHELL.BASE HWE_CAN_B_BAUDRATE_P.SHELL.BASE HWE_CAN_C_BAUDRATE_P.SHELL.BASE HWE_IP09_DcycMax.SHELL.BASE HWE_IP09_DcycMin.SHELL.BASE HWE_IP09_PerMax.SHELL.BASE HWE_IP09_PerMin.SHELL.BASE HWE_IP10_DcycMax.SHELL.BASE HWE_IP10_DcycMin.SHELL.BASE HWE_IP10_PerMax.SHELL.BASE HWE_IP10_PerMin.SHELL.BASE HWE_IP11_DcycMax.SHELL.BASE HWE_IP11_DcycMin.SHELL.BASE HWE_IP11_PerMax.SHELL.BASE HWE_IP11_PerMin.SHELL.BASE HWE_IP12_DcycMax.SHELL.BASE HWE_IP12_DcycMin.SHELL.BASE HWE_IP12_PerMax.SHELL.BASE HWE_IP12_PerMin.SHELL.BASE HWE_OIC01_Per.SHELL.BASE HWE_OIC02_Per.SHELL.BASE HWE_OPI01_Per.SHELL.BASE HWE_OPI02_Per.SHELL.BASE HWE_OPI03_Per.SHELL.BASE HWE_OPI04_Per.SHELL.BASE HWE_OPI05_Per.SHELL.BASE HWE_OPI06_Per.SHELL.BASE HWE_OPI07_Per.SHELL.BASE HWE_OPI08_Per.SHELL.BASE HWE_OPI09_Per.SHELL.BASE HWE_OPI10_Per.SHELL.BASE HWE_OPI11_Per.SHELL.BASE HWE_OS01_S_Per.SHELL.BASE HWE_OS02_S_Per.SHELL.BASE HWE_Rtmo_adStart.SHELL.BASE HWE_Rtmo_stSampleTime.SHELL.BASE p_dBRP_u8.HWE_CAN_A.SHELL.BASE p_dBRP_u8.HWE_CAN_B.SHELL.BASE p_dBRP_u8.HWE_CAN_C.SHELL.BASE p_dPSeg1_u8.HWE_CAN_A.SHELL.BASE p_dPSeg1_u8.HWE_CAN_B.SHELL.BASE p_dPSeg1_u8.HWE_CAN_C.SHELL.BASE p_dPSeg2_u8.HWE_CAN_A.SHELL.BASE p_dPSeg2_u8.HWE_CAN_B.SHELL.BASE p_dPSeg2_u8.HWE_CAN_C.SHELL.BASE p_dPropSeg_u8.HWE_CAN_A.SHELL.BASE p_dPropSeg_u8.HWE_CAN_B.SHELL.BASE p_dPropSeg_u8.HWE_CAN_C.SHELL.BASE p_dSJW_u8.HWE_CAN_A.SHELL.BASE p_dSJW_u8.HWE_CAN_B.SHELL.BASE p_dSJW_u8.HWE_CAN_C.SHELL.BASE /end REF_CHARACTERISTIC
/end GROUP
/begin GROUP STD_float32_float32_float32.All_Maps_STD.Maps_Raster_1 ""
 /begin REF_MEASUREMENT Calculated.STD_float32_float32_float32.All_Maps_STD.Maps_Raster_1 M_In_X.STD_float32_float32_float32.All_Maps_STD.Maps_Raster_1 M_In_Y.STD_float32_float32_float32.All_Maps_STD.Maps_Raster_1 M_out.STD_float32_float32_float32.All_Maps_STD.Maps_Raster_1 /end REF_MEASUREMENT
 /begin REF_CHARACTERISTIC P_Do_Active_Std.STD_float32_float32_float32.All_Maps_STD.Maps_Raster_1 P_In_X.STD_float32_float32_float32.All_Maps_STD.Maps_Raster_1 P_In_Y.STD_float32_float32_float32.All_Maps_STD.Maps_Raster_1 Two_D.STD_float32_float32_float32.All_Maps_STD.Maps_Raster_1 /end REF_CHARACTERISTIC
/end GROUP
/begin GROUP STD_float32_float32_float32.All_Maps_STD.Maps_Raster_2 ""
 /begin REF_MEASUREMENT Calculated.STD_float32_float32_float32.All_Maps_STD.Maps_Raster_2 M_In_X.STD_float32_float32_float32.All_Maps_STD.Maps_Raster_2 M_In_Y.STD_float32_float32_float32.All_Maps_STD.Maps_Raster_2 M_out.STD_float32_float32_float32.All_Maps_STD.Maps_Raster_2 /end REF_MEASUREMENT
 /begin REF_CHARACTERISTIC P_Do_Active_Std.STD_float32_float32_float32.All_Maps_STD.Maps_Raster_2 P_In_X.STD_float32_float32_float32.All_Maps_STD.Maps_Raster_2 P_In_Y.STD_float32_float32_float32.All_Maps_STD.Maps_Raster_2 Two_D.STD_float32_float32_float32.All_Maps_STD.Maps_Raster_2 /end REF_CHARACTERISTIC
/end GROUP
/begin GROUP STD_float32_float32_float32.All_Maps_STD.Maps_Raster_3 ""
 /begin REF_MEASUREMENT Calculated.STD_float32_float32_float32.All_Maps_STD.Maps_Raster_3 M_In_X.STD_float32_float32_float32.All_Maps_STD.Maps_Raster_3 M_In_Y.STD_float32_float32_float32.All_Maps_STD.Maps_Raster_3 M_out.STD_float32_float32_float32.All_Maps_STD.Maps_Raster_3 /end REF_MEASUREMENT
 /begin REF_CHARACTERISTIC P_Do_Active_Std.STD_float32_float32_float32.All_Maps_STD.Maps_Raster_3 P_In_X.STD_float32_float32_float32.All_Maps_STD.Maps_Raster_3 P_In_Y.STD_float32_float32_float32.All_Maps_STD.Maps_Raster_3 Two_D.STD_float32_float32_float32.All_Maps_STD.Maps_Raster_3 /end REF_CHARACTERISTIC
/end GROUP
/begin GROUP STD_sint16_sint16_sint16.All_Maps_STD.Maps_Raster_1 ""
 /begin REF_MEASUREMENT Calculated.STD_sint16_sint16_sint16.All_Maps_STD.Maps_Raster_1 M_In_X.STD_sint16_sint16_sint16.All_Maps_STD.Maps_Raster_1 M_In_Y.STD_sint16_sint16_sint16.All_Maps_STD.Maps_Raster_1 M_out.STD_sint16_sint16_sint16.All_Maps_STD.Maps_Raster_1 /end REF_MEASUREMENT
 /begin REF_CHARACTERISTIC P_Do_Active_Std.STD_sint16_sint16_sint16.All_Maps_STD.Maps_Raster_1 P_In_X.STD_sint16_sint16_sint16.All_Maps_STD.Maps_Raster_1 P_In_Y.STD_sint16_sint16_sint16.All_Maps_STD.Maps_Raster_1 Two_D.STD_sint16_sint16_sint16.All_Maps_STD.Maps_Raster_1 /end REF_CHARACTERISTIC
/end GROUP
/begin GROUP STD_sint16_sint16_sint16.All_Maps_STD.Maps_Raster_2 ""
 /begin REF_MEASUREMENT Calculated.STD_sint16_sint16_sint16.All_Maps_STD.Maps_Raster_2 M_In_X.STD_sint16_sint16_sint16.All_Maps_STD.Maps_Raster_2 M_In_Y.STD_sint16_sint16_sint16.All_Maps_STD.Maps_Raster_2 M_out.STD_sint16_sint16_sint16.All_Maps_STD.Maps_Raster_2 /end REF_MEASUREMENT
 /begin REF_CHARACTERISTIC P_Do_Active_Std.STD_sint16_sint16_sint16.All_Maps_STD.Maps_Raster_2 P_In_X.STD_sint16_sint16_sint16.All_Maps_STD.Maps_Raster_2 P_In_Y.STD_sint16_sint16_sint16.All_Maps_STD.Maps_Raster_2 Two_D.STD_sint16_sint16_sint16.All_Maps_STD.Maps_Raster_2 /end REF_CHARACTERISTIC
/end GROUP
/begin GROUP STD_sint16_sint16_sint16.All_Maps_STD.Maps_Raster_3 ""
 /begin REF_MEASUREMENT Calculated.STD_sint16_sint16_sint16.All_Maps_STD.Maps_Raster_3 M_In_X.STD_sint16_sint16_sint16.All_Maps_STD.Maps_Raster_3 M_In_Y.STD_sint16_sint16_sint16.All_Maps_STD.Maps_Raster_3 M_out.STD_sint16_sint16_sint16.All_Maps_STD.Maps_Raster_3 /end REF_MEASUREMENT
 /begin REF_CHARACTERISTIC P_Do_Active_Std.STD_sint16_sint16_sint16.All_Maps_STD.Maps_Raster_3 P_In_X.STD_sint16_sint16_sint16.All_Maps_STD.Maps_Raster_3 P_In_Y.STD_sint16_sint16_sint16.All_Maps_STD.Maps_Raster_3 Two_D.STD_sint16_sint16_sint16.All_Maps_STD.Maps_Raster_3 /end REF_CHARACTERISTIC
/end GROUP
/begin GROUP STD_sint32_sint32_sint32.All_Maps_STD.Maps_Raster_1 ""
 /begin REF_MEASUREMENT Calculated.STD_sint32_sint32_sint32.All_Maps_STD.Maps_Raster_1 M_In_X.STD_sint32_sint32_sint32.All_Maps_STD.Maps_Raster_1 M_In_Y.STD_sint32_sint32_sint32.All_Maps_STD.Maps_Raster_1 M_out.STD_sint32_sint32_sint32.All_Maps_STD.Maps_Raster_1 /end REF_MEASUREMENT
 /begin REF_CHARACTERISTIC P_Do_Active_Std.STD_sint32_sint32_sint32.All_Maps_STD.Maps_Raster_1 P_In_X.STD_sint32_sint32_sint32.All_Maps_STD.Maps_Raster_1 P_In_Y.STD_sint32_sint32_sint32.All_Maps_STD.Maps_Raster_1 Two_D.STD_sint32_sint32_sint32.All_Maps_STD.Maps_Raster_1 /end REF_CHARACTERISTIC
/end GROUP
/begin GROUP STD_sint32_sint32_sint32.All_Maps_STD.Maps_Raster_2 ""
 /begin REF_MEASUREMENT Calculated.STD_sint32_sint32_sint32.All_Maps_STD.Maps_Raster_2 M_In_X.STD_sint32_sint32_sint32.All_Maps_STD.Maps_Raster_2 M_In_Y.STD_sint32_sint32_sint32.All_Maps_STD.Maps_Raster_2 M_out.STD_sint32_sint32_sint32.All_Maps_STD.Maps_Raster_2 /end REF_MEASUREMENT
 /begin REF_CHARACTERISTIC P_Do_Active_Std.STD_sint32_sint32_sint32.All_Maps_STD.Maps_Raster_2 P_In_X.STD_sint32_sint32_sint32.All_Maps_STD.Maps_Raster_2 P_In_Y.STD_sint32_sint32_sint32.All_Maps_STD.Maps_Raster_2 Two_D.STD_sint32_sint32_sint32.All_Maps_STD.Maps_Raster_2 /end REF_CHARACTERISTIC
/end GROUP
/begin GROUP STD_sint32_sint32_sint32.All_Maps_STD.Maps_Raster_3 ""
 /begin REF_MEASUREMENT Calculated.STD_sint32_sint32_sint32.All_Maps_STD.Maps_Raster_3 M_In_X.STD_sint32_sint32_sint32.All_Maps_STD.Maps_Raster_3 M_In_Y.STD_sint32_sint32_sint32.All_Maps_STD.Maps_Raster_3 M_out.STD_sint32_sint32_sint32.All_Maps_STD.Maps_Raster_3 /end REF_MEASUREMENT
 /begin REF_CHARACTERISTIC P_Do_Active_Std.STD_sint32_sint32_sint32.All_Maps_STD.Maps_Raster_3 P_In_X.STD_sint32_sint32_sint32.All_Maps_STD.Maps_Raster_3 P_In_Y.STD_sint32_sint32_sint32.All_Maps_STD.Maps_Raster_3 Two_D.STD_sint32_sint32_sint32.All_Maps_STD.Maps_Raster_3 /end REF_CHARACTERISTIC
/end GROUP
/begin GROUP STD_sint8_sint8_sint8.All_Maps_STD.Maps_Raster_1 ""
 /begin REF_MEASUREMENT Calculated.STD_sint8_sint8_sint8.All_Maps_STD.Maps_Raster_1 M_In_X.STD_sint8_sint8_sint8.All_Maps_STD.Maps_Raster_1 M_In_Y.STD_sint8_sint8_sint8.All_Maps_STD.Maps_Raster_1 M_out.STD_sint8_sint8_sint8.All_Maps_STD.Maps_Raster_1 /end REF_MEASUREMENT
 /begin REF_CHARACTERISTIC P_Do_Active_Std.STD_sint8_sint8_sint8.All_Maps_STD.Maps_Raster_1 P_In_X.STD_sint8_sint8_sint8.All_Maps_STD.Maps_Raster_1 P_In_Y.STD_sint8_sint8_sint8.All_Maps_STD.Maps_Raster_1 Two_D.STD_sint8_sint8_sint8.All_Maps_STD.Maps_Raster_1 /end REF_CHARACTERISTIC
/end GROUP
/begin GROUP STD_sint8_sint8_sint8.All_Maps_STD.Maps_Raster_2 ""
 /begin REF_MEASUREMENT Calculated.STD_sint8_sint8_sint8.All_Maps_STD.Maps_Raster_2 M_In_X.STD_sint8_sint8_sint8.All_Maps_STD.Maps_Raster_2 M_In_Y.STD_sint8_sint8_sint8.All_Maps_STD.Maps_Raster_2 M_out.STD_sint8_sint8_sint8.All_Maps_STD.Maps_Raster_2 /end REF_MEASUREMENT
 /begin REF_CHARACTERISTIC P_Do_Active_Std.STD_sint8_sint8_sint8.All_Maps_STD.Maps_Raster_2 P_In_X.STD_sint8_sint8_sint8.All_Maps_STD.Maps_Raster_2 P_In_Y.STD_sint8_sint8_sint8.All_Maps_STD.Maps_Raster_2 Two_D.STD_sint8_sint8_sint8.All_Maps_STD.Maps_Raster_2 /end REF_CHARACTERISTIC
/end GROUP
/begin GROUP STD_sint8_sint8_sint8.All_Maps_STD.Maps_Raster_3 ""
 /begin REF_MEASUREMENT Calculated.STD_sint8_sint8_sint8.All_Maps_STD.Maps_Raster_3 M_In_X.STD_sint8_sint8_sint8.All_Maps_STD.Maps_Raster_3 M_In_Y.STD_sint8_sint8_sint8.All_Maps_STD.Maps_Raster_3 M_out.STD_sint8_sint8_sint8.All_Maps_STD.Maps_Raster_3 /end REF_MEASUREMENT
 /begin REF_CHARACTERISTIC P_Do_Active_Std.STD_sint8_sint8_sint8.All_Maps_STD.Maps_Raster_3 P_In_X.STD_sint8_sint8_sint8.All_Maps_STD.Maps_Raster_3 P_In_Y.STD_sint8_sint8_sint8.All_Maps_STD.Maps_Raster_3 Two_D.STD_sint8_sint8_sint8.All_Maps_STD.Maps_Raster_3 /end REF_CHARACTERISTIC
/end GROUP
/begin GROUP STD_uint16_uint16_uint16.All_Maps_STD.Maps_Raster_1 ""
 /begin REF_MEASUREMENT Calculated.STD_uint16_uint16_uint16.All_Maps_STD.Maps_Raster_1 M_In_X.STD_uint16_uint16_uint16.All_Maps_STD.Maps_Raster_1 M_In_Y.STD_uint16_uint16_uint16.All_Maps_STD.Maps_Raster_1 M_out.STD_uint16_uint16_uint16.All_Maps_STD.Maps_Raster_1 /end REF_MEASUREMENT
 /begin REF_CHARACTERISTIC P_Do_Active_Std.STD_uint16_uint16_uint16.All_Maps_STD.Maps_Raster_1 P_In_X.STD_uint16_uint16_uint16.All_Maps_STD.Maps_Raster_1 P_In_Y.STD_uint16_uint16_uint16.All_Maps_STD.Maps_Raster_1 Two_D.STD_uint16_uint16_uint16.All_Maps_STD.Maps_Raster_1 /end REF_CHARACTERISTIC
/end GROUP
/begin GROUP STD_uint16_uint16_uint16.All_Maps_STD.Maps_Raster_2 ""
 /begin REF_MEASUREMENT Calculated.STD_uint16_uint16_uint16.All_Maps_STD.Maps_Raster_2 M_In_X.STD_uint16_uint16_uint16.All_Maps_STD.Maps_Raster_2 M_In_Y.STD_uint16_uint16_uint16.All_Maps_STD.Maps_Raster_2 M_out.STD_uint16_uint16_uint16.All_Maps_STD.Maps_Raster_2 /end REF_MEASUREMENT
 /begin REF_CHARACTERISTIC P_Do_Active_Std.STD_uint16_uint16_uint16.All_Maps_STD.Maps_Raster_2 P_In_X.STD_uint16_uint16_uint16.All_Maps_STD.Maps_Raster_2 P_In_Y.STD_uint16_uint16_uint16.All_Maps_STD.Maps_Raster_2 Two_D.STD_uint16_uint16_uint16.All_Maps_STD.Maps_Raster_2 /end REF_CHARACTERISTIC
/end GROUP
/begin GROUP STD_uint16_uint16_uint16.All_Maps_STD.Maps_Raster_3 ""
 /begin REF_MEASUREMENT Calculated.STD_uint16_uint16_uint16.All_Maps_STD.Maps_Raster_3 M_In_X.STD_uint16_uint16_uint16.All_Maps_STD.Maps_Raster_3 M_In_Y.STD_uint16_uint16_uint16.All_Maps_STD.Maps_Raster_3 M_out.STD_uint16_uint16_uint16.All_Maps_STD.Maps_Raster_3 /end REF_MEASUREMENT
 /begin REF_CHARACTERISTIC P_Do_Active_Std.STD_uint16_uint16_uint16.All_Maps_STD.Maps_Raster_3 P_In_X.STD_uint16_uint16_uint16.All_Maps_STD.Maps_Raster_3 P_In_Y.STD_uint16_uint16_uint16.All_Maps_STD.Maps_Raster_3 Two_D.STD_uint16_uint16_uint16.All_Maps_STD.Maps_Raster_3 /end REF_CHARACTERISTIC
/end GROUP
/begin GROUP STD_uint32_uint32_uint32.All_Maps_STD.Maps_Raster_1 ""
 /begin REF_MEASUREMENT Calculated.STD_uint32_uint32_uint32.All_Maps_STD.Maps_Raster_1 M_In_X.STD_uint32_uint32_uint32.All_Maps_STD.Maps_Raster_1 M_In_Y.STD_uint32_uint32_uint32.All_Maps_STD.Maps_Raster_1 M_out.STD_uint32_uint32_uint32.All_Maps_STD.Maps_Raster_1 /end REF_MEASUREMENT
 /begin REF_CHARACTERISTIC P_Do_Active_Std.STD_uint32_uint32_uint32.All_Maps_STD.Maps_Raster_1 P_In_X.STD_uint32_uint32_uint32.All_Maps_STD.Maps_Raster_1 P_In_Y.STD_uint32_uint32_uint32.All_Maps_STD.Maps_Raster_1 Two_D.STD_uint32_uint32_uint32.All_Maps_STD.Maps_Raster_1 /end REF_CHARACTERISTIC
/end GROUP
/begin GROUP STD_uint32_uint32_uint32.All_Maps_STD.Maps_Raster_2 ""
 /begin REF_MEASUREMENT Calculated.STD_uint32_uint32_uint32.All_Maps_STD.Maps_Raster_2 M_In_X.STD_uint32_uint32_uint32.All_Maps_STD.Maps_Raster_2 M_In_Y.STD_uint32_uint32_uint32.All_Maps_STD.Maps_Raster_2 M_out.STD_uint32_uint32_uint32.All_Maps_STD.Maps_Raster_2 /end REF_MEASUREMENT
 /begin REF_CHARACTERISTIC P_Do_Active_Std.STD_uint32_uint32_uint32.All_Maps_STD.Maps_Raster_2 P_In_X.STD_uint32_uint32_uint32.All_Maps_STD.Maps_Raster_2 P_In_Y.STD_uint32_uint32_uint32.All_Maps_STD.Maps_Raster_2 Two_D.STD_uint32_uint32_uint32.All_Maps_STD.Maps_Raster_2 /end REF_CHARACTERISTIC
/end GROUP
/begin GROUP STD_uint32_uint32_uint32.All_Maps_STD.Maps_Raster_3 ""
 /begin REF_MEASUREMENT Calculated.STD_uint32_uint32_uint32.All_Maps_STD.Maps_Raster_3 M_In_X.STD_uint32_uint32_uint32.All_Maps_STD.Maps_Raster_3 M_In_Y.STD_uint32_uint32_uint32.All_Maps_STD.Maps_Raster_3 M_out.STD_uint32_uint32_uint32.All_Maps_STD.Maps_Raster_3 /end REF_MEASUREMENT
 /begin REF_CHARACTERISTIC P_Do_Active_Std.STD_uint32_uint32_uint32.All_Maps_STD.Maps_Raster_3 P_In_X.STD_uint32_uint32_uint32.All_Maps_STD.Maps_Raster_3 P_In_Y.STD_uint32_uint32_uint32.All_Maps_STD.Maps_Raster_3 Two_D.STD_uint32_uint32_uint32.All_Maps_STD.Maps_Raster_3 /end REF_CHARACTERISTIC
/end GROUP
/begin GROUP STD_uint8_uint8_uint8.All_Maps_STD.Maps_Raster_1 ""
 /begin REF_MEASUREMENT Calculated.STD_uint8_uint8_uint8.All_Maps_STD.Maps_Raster_1 M_In_X.STD_uint8_uint8_uint8.All_Maps_STD.Maps_Raster_1 M_In_Y.STD_uint8_uint8_uint8.All_Maps_STD.Maps_Raster_1 M_out.STD_uint8_uint8_uint8.All_Maps_STD.Maps_Raster_1 /end REF_MEASUREMENT
 /begin REF_CHARACTERISTIC P_Do_Active_Std.STD_uint8_uint8_uint8.All_Maps_STD.Maps_Raster_1 P_In_X.STD_uint8_uint8_uint8.All_Maps_STD.Maps_Raster_1 P_In_Y.STD_uint8_uint8_uint8.All_Maps_STD.Maps_Raster_1 Two_D.STD_uint8_uint8_uint8.All_Maps_STD.Maps_Raster_1 /end REF_CHARACTERISTIC
/end GROUP
/begin GROUP STD_uint8_uint8_uint8.All_Maps_STD.Maps_Raster_2 ""
 /begin REF_MEASUREMENT Calculated.STD_uint8_uint8_uint8.All_Maps_STD.Maps_Raster_2 M_In_X.STD_uint8_uint8_uint8.All_Maps_STD.Maps_Raster_2 M_In_Y.STD_uint8_uint8_uint8.All_Maps_STD.Maps_Raster_2 M_out.STD_uint8_uint8_uint8.All_Maps_STD.Maps_Raster_2 /end REF_MEASUREMENT
 /begin REF_CHARACTERISTIC P_Do_Active_Std.STD_uint8_uint8_uint8.All_Maps_STD.Maps_Raster_2 P_In_X.STD_uint8_uint8_uint8.All_Maps_STD.Maps_Raster_2 P_In_Y.STD_uint8_uint8_uint8.All_Maps_STD.Maps_Raster_2 Two_D.STD_uint8_uint8_uint8.All_Maps_STD.Maps_Raster_2 /end REF_CHARACTERISTIC
/end GROUP
/begin GROUP STD_uint8_uint8_uint8.All_Maps_STD.Maps_Raster_3 ""
 /begin REF_MEASUREMENT Calculated.STD_uint8_uint8_uint8.All_Maps_STD.Maps_Raster_3 M_In_X.STD_uint8_uint8_uint8.All_Maps_STD.Maps_Raster_3 M_In_Y.STD_uint8_uint8_uint8.All_Maps_STD.Maps_Raster_3 M_out.STD_uint8_uint8_uint8.All_Maps_STD.Maps_Raster_3 /end REF_MEASUREMENT
 /begin REF_CHARACTERISTIC P_Do_Active_Std.STD_uint8_uint8_uint8.All_Maps_STD.Maps_Raster_3 P_In_X.STD_uint8_uint8_uint8.All_Maps_STD.Maps_Raster_3 P_In_Y.STD_uint8_uint8_uint8.All_Maps_STD.Maps_Raster_3 Two_D.STD_uint8_uint8_uint8.All_Maps_STD.Maps_Raster_3 /end REF_CHARACTERISTIC
/end GROUP
/begin GROUP Time_Calc.HWE.BASE ""
 /begin REF_MEASUREMENT Result.Time_Calc.HWE.BASE TimeStampOne.Time_Calc.HWE.BASE TimeStampTwo.Time_Calc.HWE.BASE is_started.Time_Calc.HWE.BASE /end REF_MEASUREMENT
/end GROUP
/begin RECORD_LAYOUT STANDARD_MAP_R32R32R32 FNC_VALUES 5 FLOAT32_IEEE COLUMN_DIR DIRECT AXIS_PTS_X 3 FLOAT32_IEEE INDEX_INCR DIRECT AXIS_PTS_Y 4 FLOAT32_IEEE INDEX_INCR DIRECT NO_AXIS_PTS_X 1 UWORD NO_AXIS_PTS_Y 2 UWORD /end RECORD_LAYOUT
/begin RECORD_LAYOUT STANDARD_MAP_S16S16S16 FNC_VALUES 5 SWORD COLUMN_DIR DIRECT AXIS_PTS_X 3 SWORD INDEX_INCR DIRECT AXIS_PTS_Y 4 SWORD INDEX_INCR DIRECT NO_AXIS_PTS_X 1 UWORD NO_AXIS_PTS_Y 2 UWORD /end RECORD_LAYOUT
/begin RECORD_LAYOUT STANDARD_MAP_S32S32S32 FNC_VALUES 5 SLONG COLUMN_DIR DIRECT AXIS_PTS_X 3 SLONG INDEX_INCR DIRECT AXIS_PTS_Y 4 SLONG INDEX_INCR DIRECT NO_AXIS_PTS_X 1 UWORD NO_AXIS_PTS_Y 2 UWORD /end RECORD_LAYOUT
/begin RECORD_LAYOUT STANDARD_MAP_S8S8S8 FNC_VALUES 5 SBYTE COLUMN_DIR DIRECT AXIS_PTS_X 3 SBYTE INDEX_INCR DIRECT AXIS_PTS_Y 4 SBYTE INDEX_INCR DIRECT NO_AXIS_PTS_X 1 UBYTE NO_AXIS_PTS_Y 2 UBYTE /end RECORD_LAYOUT
/begin RECORD_LAYOUT STANDARD_MAP_U16U16U16 FNC_VALUES 5 UWORD COLUMN_DIR DIRECT AXIS_PTS_X 3 UWORD INDEX_INCR DIRECT AXIS_PTS_Y 4 UWORD INDEX_INCR DIRECT NO_AXIS_PTS_X 1 UWORD NO_AXIS_PTS_Y 2 UWORD /end RECORD_LAYOUT
/begin RECORD_LAYOUT STANDARD_MAP_U32U32U32 FNC_VALUES 5 ULONG COLUMN_DIR DIRECT AXIS_PTS_X 3 ULONG INDEX_INCR DIRECT AXIS_PTS_Y 4 ULONG INDEX_INCR DIRECT NO_AXIS_PTS_X 1 UWORD NO_AXIS_PTS_Y 2 UWORD /end RECORD_LAYOUT
/begin RECORD_LAYOUT STANDARD_MAP_U8U8U8 FNC_VALUES 5 UBYTE COLUMN_DIR DIRECT AXIS_PTS_X 3 UBYTE INDEX_INCR DIRECT AXIS_PTS_Y 4 UBYTE INDEX_INCR DIRECT NO_AXIS_PTS_X 1 UBYTE NO_AXIS_PTS_Y 2 UBYTE /end RECORD_LAYOUT
/begin RECORD_LAYOUT STANDARD_VALUE_R32 FNC_VALUES 1 FLOAT32_IEEE COLUMN_DIR DIRECT /end RECORD_LAYOUT
/begin RECORD_LAYOUT STANDARD_VALUE_S16 FNC_VALUES 1 SWORD COLUMN_DIR DIRECT /end RECORD_LAYOUT
/begin RECORD_LAYOUT STANDARD_VALUE_S32 FNC_VALUES 1 SLONG COLUMN_DIR DIRECT /end RECORD_LAYOUT
/begin RECORD_LAYOUT STANDARD_VALUE_S8 FNC_VALUES 1 SBYTE COLUMN_DIR DIRECT /end RECORD_LAYOUT
/begin RECORD_LAYOUT STANDARD_VALUE_U16 FNC_VALUES 1 UWORD COLUMN_DIR DIRECT /end RECORD_LAYOUT
/begin RECORD_LAYOUT STANDARD_VALUE_U32 FNC_VALUES 1 ULONG COLUMN_DIR DIRECT /end RECORD_LAYOUT
/begin RECORD_LAYOUT STANDARD_VALUE_U8 FNC_VALUES 1 UBYTE COLUMN_DIR DIRECT /end RECORD_LAYOUT
/end MODULE
/end PROJECT

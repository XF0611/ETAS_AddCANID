AUTOSAR XML (schema 4-2-2)
package /ETAS_BIP/EcucModuleConfigurationValuess
  module config Mcu
    McuModuleConfiguration
      McuClockSettingConfig_0 (McuClockSettingConfig): McuClockSettingId=1
        F_MCU_SYSTIMER (McuClockReferencePoint): McuClockReferencePointFrequency=1.0E8

AUTOSAR XML (schema 00047)
package /ETAS_BIP/EcucModuleConfigurationValuess
  module config Mcu: implementation-config-variant=VARIANT-POST-BUILD-LOADABLE, module-description=Mcu_Implementation
    McuGeneralConfiguration:
      McuDevErrorDetect = false
      McuGetRamStateApi = true
      McuInitClock = true
      McuNoPll = false
      McuPerformResetApi = true
      McuVersionInfoApi = true
      McuVersionCheckExternalModules = false
      McuCriticalSectionProtection = true
      McuInternalBusInterfaceCheck = true
      McuConfigurationRegisterCheck = true
      McuConfigurationExtraRegisterCheck = true
      McuWriteVerifyCheck = true
      McuExclusiveControl = false
      McuExclusiveTimeout = 250000
      McuExclusiveSelection = MFISLCKR2
      McuSwResetCallApi = false
      McuDeviceName = RCar_V3M
      McuConfigurationCANFDCKCRRegisterCheck = true
      McuConfigurationCPGWPCRRegisterCheck = true
      McuConfigurationMSOCKCRRegisterCheck = true
      McuConfigurationRMSTPCR{1..5}RegisterCheck = true
      McuConfigurationRMSTPCR8RegisterCheck = true
      McuConfigurationRMSTPCR9RegisterCheck = true
      McuRFSOConfigurationRegisterCheck = RFSO_DISABLE
      McuRFSOInternalBusInterfaceCheck = RFSO_DISABLE
      McuLoopCount = 5
    McuModuleConfiguration: McuClockSrcFailureNotification=NOT_USED, McuNumberOfMcuModes=1, McuRamSectors=0
      McuClockSettingConfig: McuClockSettingId=0, McuCpuMainSysClk=800000000, McuUnitName=CPUCLK
        McuClockReferencePoint: McuClockReferencePointFrequency=8.0E8
        McuRwdtClockSetting: McuRwdtStandbyModeEnable=true, McuUnitName=RWDT
        McuMsiofClockSetting:
          McuClockFrequencyControlDiv = 19
          McuMSIOF{0..3}StandbyModeEnable = false
          McuUnitName = MSIOF
          McuPeripheralClock = 40000000
        McuRCLKClockSetting: McuUnitName=RCLK, McuPeripheralClock=32768
        McuS2D2ClockSetting: McuUnitName=S2D2, McuPeripheralClock=133333333
        McuS2D4ClockSetting: McuUnitName=S2D4, McuPeripheralClock=66666666
        McuCP0ClockSetting: McuUnitName=CP0, McuPeripheralClock=10000000
        McuCanFDClockSetting: McuClockFrequencyControlDiv=9, McuCANFDStandbyModeEnable=false, McuUnitName=CANFD, McuPeripheralClock=80000000
        McuTMUClockSetting:
          McuTMU{0..4}StandbyModeEnable = true
          McuUnitName = TMU
        McuGPIOClockSetting:
          McuGPIO{0..5}StandbyModeEnable = false
          McuUnitName = GPIO
          McuPeripheralClock = 10000000
        McuEthernetClockSetting: McuEthernetStandbyModeEnable=false, McuUnitName=ETHERNET, McuPeripheralClock=133333333
        McuADCClockSetting: McuADCStandbyModeEnable=false, McuUnitName=ADC
        McuRPCClockSetting: McuRPCStandbyModeEnable=false, McuUnitName=RPC, McuPeripheralClock=320000000
        McuFlexrayClockSetting: McuFlexrayStandbyModeEnable=false, McuUnitName=FLEXRAY, McuPeripheralClock=80000000
        McuTHSClockSetting: McuTHSStandbyModeEnable=false, McuUnitName=THS
        McuSUCMTClockSetting: McuSUCMTStandbyModeEnable=false, McuUnitName=SUCMT
        McuS2D1ClockSetting: McuUnitName=S2D1, McuPeripheralClock=266666666
        McuMFISClockSetting: McuMFISStandbyModeEnable=false, McuUnitName=MFIS
        McuIICClockSetting:
          McuIIC{0..4}StandbyModeEnable = false
          McuUnitName = IIC
        McuCRCClockSetting: McuCRC0StandbyModeEnable=false, McuCRC1StandbyModeEnable=false, McuCRC2StandbyModeEnable=false, McuCRC3StandbyModeEnable=false, McuUnitName=CRC
        McuRPCD2ClockSetting: McuUnitName=RPCD2, McuPeripheralClock=160000000
        McuCMTClockSetting: McuCMT1StandbyModeEnable=false, McuCMT2StandbyModeEnable=false, McuUnitName=CMT
      McuModeSettingConf_0 (McuModeSettingConf):
        McuModeType = SLEEP_MODE
        McuMode = 0
        McuWakeupMaskCSD = false
        McuWakeupMaskFIQ = true
        McuWakeupMaskIRQ = true
        McuStatusUpdateFIQ = false
        McuStatusUpdateIRQ = false
        McuModeTransitionReq = true
      McuRamSectorSettingConf: McuRamDefaultValue=55, McuRamSectionBaseAddress=3861905408, McuRamSectionSize=5
      McuDemEventParameterRefs:
        MCU_E_CONFIGURATION_CHECK_PERMANENT_FAILURE = MCU_E_CONFIGURATION_CHECK_PERMANENT_FAILURE
        MCU_E_CONFIGURATION_CHECK_TRANSIENT_FAILURE = MCU_E_CONFIGURATION_CHECK_TRANSIENT_FAILURE
        MCU_E_GET_CONTROL_FAILURE = MCU_E_GET_CONTROL_FAILURE
        MCU_E_INTERNAL_BUS_FAILURE = MCU_E_INTERNAL_BUS_FAILURE
        MCU_E_READ_BACK_FAILURE = MCU_E_READ_BACK_FAILURE
        MCU_E_TIMEOUT_FAILURE = MCU_E_TIMEOUT_FAILURE
      McuConfigurationExtraRegisterConf: McuAdressRegisterCheck=3860136232, McuMaskRegisterCheck=8388616, McuExpectedRegisterCheck=8388616
    McuPublishedInformation
      McuResetReasonConf: McuResetReason=0
      McuRstRsnConfUndefined: McuResetReason=0
      McuRstRsnConfRwdtRst: McuResetReason=1
      McuRstRsnConfSwdtRst: McuResetReason=2
      McuRstRsnConfSwRst: McuResetReason=3
      3 x McuResetReasonConf:
        McuResetReasonConf_001: McuResetReason=1
        McuResetReasonConf_002: McuResetReason=2
        McuResetReasonConf_003: McuResetReason=3

AUTOSAR XML (schema 4-2-2)
package /ETAS_BIP/EcucDefs_Mcu
  ecuc definition collection RenesasParameterDefinition_Mcu: module=Mcu
  module definition Mcu [0..1]: post-build-variant-support=true, refined-module-def=Mcu, variants post-build  # Configuration of the Mcu (Mcu Unit) module.
    container McuGeneralConfiguration  # This container contains the configuration (parameters) of the MCU driver.
      boolean McuDevErrorDetect: set at pre-compile, default-value=false  # Pre-processor switch to enable or disable the development error detection and reporting. | true: Enables development error detection and reporting. false: Disables development error detection and reporting.
      boolean McuGetRamStateApi: set at pre-compile, default-value=false  # Pre-processor switch to enable/disable the API Mcu_GetRamState. | e.g. If the H/W does not support the functionality, this parameter can be used to disable the API). true: API Mcu_GetRamState is enabled. false: API Mcu_GetRamState is disabled.
      boolean McuInitClock: set at pre-compile, default-value=true  # If this parameter is set to FALSE, the clock initialization has to be disabled from the MCU driver. This concept applies when there are some write once clock registers and a bootloader is present. If this parameter is set to TRUE, the MCU driver is responsible for the clock initialization. | true: The MCU driver is responsible for the clock initialization. false: The clock initialization is disabled from the MCU driver.
      boolean McuNoPll: set at pre-compile, default-value=false  # This parameter has to set as false since RCAR devices always use PLL as clock source. | true: The H/W does not have a PLL and the PLL circuitry is enabled after the power on without S/W intervention. false: The H/W have a PLL and the PLL circuitry is disabled after the power on without S/W intervention.
      boolean McuPerformResetApi: set at pre-compile, default-value=false  # Pre-processor switch to enable or disable the use of the function Mcu_PerformReset(). | true: Enables the use of the function Mcu_PerformReset(). false: Disables the use of the function Mcu_PerformReset().
      boolean McuVersionInfoApi: set at pre-compile, default-value=false  # Pre-processor switch to enable or disable the API to read out the modules version information. | true: Enables the API to read out the modules version information. false: Disables the API to read out the modules version information.
      boolean McuVersionCheckExternalModules: origin=Renesas_v1.0.0, set at pre-compile, default-value=true  # Enable / disable AUTOSAR Version check for inter-module dependencies. | true: AUTOSAR Version check for inter-module dependencies is enabled. false: AUTOSAR Version check for inter-module dependencies is disabled.
      boolean McuCriticalSectionProtection: origin=Renesas_v1.0.0, set at pre-compile, default-value=true  # This parameter specifies if the MCU driver CPU load can be reduced by disabling the enter/exit critical section functionality by adding a precompiled configuration parameter to the MCU driver configuration. | true: Enables the critical section functionality for the restricted area. false: Disables the critical section functionality for the restricted area.
      boolean McuInternalBusInterfaceCheck: origin=Renesas_v1.0.0, set at pre-compile, default-value=false  # This parameter enables or disables the internal bus interface check service for CPG, RESET | true: Enables the internal bus interface check service. false: Disables the internal bus interface check service.
      boolean McuConfigurationRegisterCheck: origin=Renesas_v1.0.0, set at pre-compile, default-value=false  # This parameter enables or disables the configuration register check service. This parameter is for functional safety, user shall refer Safety Application Note for description or leave it with default value. | true: Enables the configuration register check service. false: Disables the configuration register check service.
      boolean McuConfigurationExtraRegisterCheck: origin=Renesas_v1.0.0, set at pre-compile, default-value=false  # This parameter enables or disables the configuration extra register check service. This parameter is for functional safety, user shall refer Safety Application Note for description or leave it with default value. | true: Enables the configuration extra register check service. false: Disables the configuration extra register check service.
      boolean McuConfigurationCPGWPCRRegisterCheck: origin=Renesas_v1.0.0, set at pre-compile, default-value=false  # This parameter enables or disables checking CPGWPCR register in the configuration register check service. This parameter is for functional safety, user shall refer Safety Application Note for description or leave it with default value. | true: Enables checking CPGWPCR register in the configuration register check service. false: Disables checking CPGWPCR register in the configuration register check service.
      boolean McuConfigurationCANFDCKCRRegisterCheck: origin=Renesas_v1.0.0, set at pre-compile, default-value=false  # This parameter enables or disables checking CANFDCKCR register in the configuration register check service. This parameter is for functional safety, user shall refer Safety Application Note for description or leave it with default value. | true: Enables checking CANFDCKCR register in the configuration register check service. false: Disables checking CANFDCKCR register in the configuration register check service.
      boolean McuConfigurationMSOCKCRRegisterCheck: origin=Renesas_v1.0.0, set at pre-compile, default-value=false  # This parameter enables or disables checking MSOCKCR register in the configuration register check service. This parameter is for functional safety, user shall refer Safety Application Note for description or leave it with default value. | true: Enables checking MSOCKCR register in the configuration register check service. false: Disables checking MSOCKCR register in the configuration register check service.
      boolean McuConfigurationRMSTPCR{1..5}RegisterCheck: origin=Renesas_v1.0.0, set at pre-compile, default-value=false  # This parameter enables or disables checking RMSTPCR{1..5} register in the configuration register check service. This parameter is for functional safety, user shall refer Safety Application Note for description or leave it with default value. | true: Enables checking RMSTPCR{1..5} register in the configuration register check service. false: Disables checking RMSTPCR{1..5} register in the configuration register check service.
      boolean McuConfigurationRMSTPCR8RegisterCheck: origin=Renesas_v1.0.0, set at pre-compile, default-value=false  # This parameter enables or disables checking RMSTPCR8 register in the configuration register check service. This parameter is for functional safety, user shall refer Safety Application Note for description or leave it with default value. | true: Enables checking RMSTPCR8 register in the configuration register check service. false: Disables checking RMSTPCR8 register in the configuration register check service.
      boolean McuConfigurationRMSTPCR9RegisterCheck: origin=Renesas_v1.0.0, set at pre-compile, default-value=false  # This parameter enables or disables checking RMSTPCR9 register in the configuration register check service. This parameter is for functional safety, user shall refer Safety Application Note for description or leave it with default value. | true: Enables checking RMSTPCR9 register in the configuration register check service. false: Disables checking RMSTPCR9 register in the configuration register check service.
      enumeration McuRFSOConfigurationRegisterCheck: {RFSO_DISABLE, RFSO_0, RFSO_1, RFSO_2, RFSO_3, RFSO_4, RFSO_5, RFSO_6, RFSO_7, RFSO_8, RFSO_9, RFSO_10}, origin=Renesas_v1.0.0, set at pre-compile, default-value=RFSO_0  # This parameter contains RFSO modules to report safety error to external terminal for configuration register check. This parameter is for functional safety, user shall refer Safety Application Note for description or leave it with default value.
      enumeration McuRFSOInternalBusInterfaceCheck: {RFSO_DISABLE, RFSO_0, RFSO_1, RFSO_2, RFSO_3, RFSO_4, RFSO_5, RFSO_6, RFSO_7, RFSO_8, RFSO_9, RFSO_10}, origin=Renesas_v1.0.0, set at pre-compile, default-value=RFSO_0  # This parameter contains RFSO modules to report safety error to external terminal for internal bus interface check. This parameter is for functional safety, user shall refer Safety Application Note for description or leave it with default value.
      boolean McuWriteVerifyCheck: origin=Renesas_v1.0.0, set at pre-compile, default-value=true  # This parameter enables or disables the read back feature used to check writing value. This parameter is for functional safety, user shall refer Safety Application Note for description or leave it with default value. | true: Enables the read back service. false: Disables the read back service.
      boolean McuExclusiveControl: origin=Renesas_v1.0.0, set at pre-compile, default-value=true  # This parameter enables or disables the exclusive control feature. | true: Enables the exclusive control service. false: Disables the exclusive control service.
      integer McuExclusiveTimeout: 1..4294967295, origin=Renesas_v1.0.0, set at pre-compile, default-value=256410  # The timeout value for the resource getting loop in Mcu module. It shall be given in number of clock count. Example for how to calculate is as following: With CPU operated at 800Mhz, cache activated. It takes about 0.078 microsecond for one loop time. Minimum time for waiting exclusive control is 20 milisecond. So, this parameter should be configured as 256410 from previous calculation.
      enumeration McuExclusiveSelection: {MFISLCKR0, MFISLCKR1, MFISLCKR2, MFISLCKR3, MFISLCKR4, MFISLCKR5, MFISLCKR6, MFISLCKR7}, origin=Renesas_v1.0.0, set at pre-compile, default-value=MFISLCKR2  # This parameter contains MFIS registers to implement exclusive control.
      integer McuLoopCount: 1..4294967295, origin=Renesas_v1.0.0, set at pre-compile, default-value=5  # The count value for the feed back loop in Mcu module. The loop can be minimum 1 to maximum 4294967295.
      boolean McuSwResetCallApi: origin=Renesas_v1.0.0, set at pre-compile, default-value=false  # This parameter shall decide if MCU_RESET_CALLOUT API will be used for to reset software. | true: MCU_RESET_CALLOUT API will be used for reset software. false: MCU_RESET_CALLOUT API will not be used for reset software.
      enumeration McuDeviceName: {RCar_V3M}, origin=Renesas_v1.0.0, set at pre-compile, default-value=RCar_V3M  # This parameter contains the supported device name to identify the device specific C header file through Translation XML File. | Description format is following. Device name: Common Common Description: [This value should be child tag of TRANSLATION-FILE-PATH and DEVICE-FILE-PATH tag in Translation XML File.] Device name V3M:
    container McuModuleConfiguration  # This container contains the configuration (parameters) of the MCU driver.
      enumeration McuClockSrcFailureNotification: {NOT_USED}, post-build-variant-value=true, set at post-build, default-value=NOT_USED  # This parameter enables or disables clock failure notification. In case this feature is not supported by HW the setting should be disabled. This parameter is not used for implementation.
      integer McuNumberOfMcuModes: 1..1, post-build-variant-value=true, set at post-build, default-value=1  # This parameter shall represent the number of Modes available for the MCU. This parameter is not used for implementation. | calculationFormula = Number of configured McuModeSettingConf
      integer McuRamSectors: 0..0, post-build-variant-value=true, set at post-build, default-value=0  # This parameter shall represent the number of RAM sectors available for the MCU. This parameter is not used for implementation. | calculationFormula = Number of configured McuRamSectorSettingConf
      integer McuResetSetting [0..1]: 1..1, multiplicity set at pre-compile, set at pre-compile, default-value=1  # This parameter relates to the MCU specific reset configuration. This applies to the function Mcu_PerformReset, which performs a microcontroller reset using the hardware feature of the microcontroller. This parameter is not used for implementation.
      container McuClockSettingConfig [1..*]: multiplicity set at pre-compile  # This container contains the configuration (parameters) for the Clock settings of the MCU. Please see MCU031 for more information on the MCU clock settings.
        integer McuClockSettingId: 0..255, set at pre-compile, symbolic-name-value=true, default-value=0  # The Id of this McuClockSettingConfig to be used as argument for the API call "Mcu_InitClock".
        integer McuCpuMainSysClk: 800000000..800000000, origin=Renesas_v1.0.0, set at pre-compile, default-value=800000000  # This parameter contains the CPU main system clock frequency. This parameter does not affect the behavior of the MCU driver. It is a frequency that will be available to other modules for reference. It either needs to be calculated manually or by the configuration editor.
        enumeration McuUnitName: {CPUCLK}, origin=Renesas_v1.0.0, set at pre-compile, default-value=CPUCLK  # This parameter contains the functional unit name for the CPU. | CPUCLK: CPU clock is unit name.
        container McuRwdtClockSetting [0..1]: multiplicity set at pre-compile  # This container contains the clock settings for Rwdt peripheral
          boolean McuRwdtStandbyModeEnable: origin=Renesas_v1.0.0, post-build-variant-value=true, set at post-build, default-value=false  # This parameter enables or disables the operation of peripheral when CPU enters standby mode. | false: Stops the operation in Stand-by mode. true: Continues the operation in stand-by mode.
          enumeration McuUnitName: {RWDT}, origin=Renesas_v1.0.0, set at pre-compile, default-value=RWDT  # This parameter contains the functional unit name for the RWDT.
        container McuMsiofClockSetting [0..1]: multiplicity set at pre-compile  # This container contains the clock settings for Msiof peripheral
          integer McuClockFrequencyControlDiv: 0..63, origin=Renesas_v1.0.0, post-build-variant-value=true, set at post-build, default-value=0  # This parameter contains the clock frequency division ratio setting for Msiof. MSIOF clock source is divided by the division ratio of 1 / (setting + 1).
          boolean McuMSIOF{0..3}StandbyModeEnable: origin=Renesas_v1.0.0, post-build-variant-value=true, set at post-build, default-value=false  # This parameter enables or disables the operation of peripheral when CPU enters standby mode. | false: Stops the operation in Stand-by mode. true: Continues the operation in stand-by mode.
          enumeration McuUnitName: {MSIOF}, origin=Renesas_v1.0.0, set at pre-compile, default-value=MSIOF  # This parameter contains the functional unit name for the MSIOF.
          float McuPeripheralClock: 12500000..133333333.333, origin=Renesas_v1.0.0, set at pre-compile, default-value=133333333.333  # This parameter contains the Peripheral clock value. This parameter can be calculated as following: McuPeripheralClock = (1 / (McuClockFrequencyControlDiv + 1)) * 800000000
        container McuRCLKClockSetting [0..1]: multiplicity set at pre-compile  # This container contains the clock settings for RCLK clock source.
          enumeration McuUnitName: {RCLK}, origin=Renesas_v1.0.0, set at pre-compile, default-value=RCLK  # This parameter contains the functional unit name for the RCLK
          float McuPeripheralClock: 32500..32768, origin=Renesas_v1.0.0, set at pre-compile, default-value=32768  # This parameter contains the Peripheral clock value.
        container McuS2D1ClockSetting [0..1]: multiplicity set at pre-compile  # This container contains the clock settings for S2D1 clock source.
          enumeration McuUnitName: {S2D1}, origin=Renesas_v1.0.0, set at pre-compile, default-value=S2D1  # This parameter contains the functional unit name for the S2D1
          float McuPeripheralClock: 266666666..266666666, origin=Renesas_v1.0.0, set at pre-compile, default-value=266666666  # This parameter contains the Peripheral clock value.
        container McuS2D2ClockSetting [0..1]: multiplicity set at pre-compile  # This container contains the clock settings for S2D2 clock source.
          enumeration McuUnitName: {S2D2}, origin=Renesas_v1.0.0, set at pre-compile, default-value=S2D2  # This parameter contains the functional unit name for the S2D2
          float McuPeripheralClock: 133333333..133333333, origin=Renesas_v1.0.0, set at pre-compile, default-value=133333333  # This parameter contains the Peripheral clock value.
        container McuS2D4ClockSetting [0..1]: multiplicity set at pre-compile  # This container contains the clock settings for S2D4 clock source.
          enumeration McuUnitName: {S2D4}, origin=Renesas_v1.0.0, set at pre-compile, default-value=S2D4  # This parameter contains the functional unit name for the S2D4
          float McuPeripheralClock: 66666666..66666666, origin=Renesas_v1.0.0, set at pre-compile, default-value=66666666  # This parameter contains the Peripheral clock value.
        container McuCP0ClockSetting [0..1]: multiplicity set at pre-compile  # This container contains the clock settings for common peripheral clock source.
          enumeration McuUnitName: {CP0}, origin=Renesas_v1.0.0, set at pre-compile, default-value=CP0  # This parameter contains the functional unit name for the common peripheral clock source
          float McuPeripheralClock: 8333333..10000000, origin=Renesas_v1.0.0, set at pre-compile, default-value=10000000  # This parameter contains the Peripheral clock value.
        container McuCanFDClockSetting [0..1]: multiplicity set at pre-compile  # This container contains the clock settings for Can peripheral.
          integer McuClockFrequencyControlDiv: 0..63, origin=Renesas_v1.0.0, post-build-variant-value=true, set at post-build, default-value=0  # This parameter contains the clock frequency division ratio setting for Canfd. CANFD clock source is divided by the division ratio of 1 / (setting + 1).
          boolean McuCANFDStandbyModeEnable: origin=Renesas_v1.0.0, post-build-variant-value=true, set at post-build, default-value=false  # This parameter enables or disables the operation of peripheral when CPU enters standby mode. | false: Stops the operation in Stand-by mode. true: Continues the operation in stand-by mode.
          enumeration McuUnitName: {CANFD}, origin=Renesas_v1.0.0, set at pre-compile, default-value=CANFD  # This parameter contains the functional unit name for the CANFD
          float McuPeripheralClock: 12500000..80000000, origin=Renesas_v1.0.0, set at pre-compile, default-value=80000000  # This parameter contains the Peripheral clock value. This parameter can be calculated as following: McuPeripheralClock = (1 / (McuClockFrequencyControlDiv + 1)) * 800000000
        container McuTMUClockSetting [0..1]: multiplicity set at pre-compile  # This container contains the clock settings for TMU.
          boolean McuTMU{0..4}StandbyModeEnable: origin=Renesas_v1.0.0, post-build-variant-value=true, set at post-build, default-value=false  # This parameter enables or disables the operation of peripheral when CPU enters standby mode. | false: Stops the operation in Stand-by mode. true: Continues the operation in stand-by mode.
          enumeration McuUnitName: {TMU}, origin=Renesas_v1.0.0, set at pre-compile, default-value=TMU  # This parameter contains the functional unit name for TMU.
        container McuGPIOClockSetting [0..1]: multiplicity set at pre-compile  # This container contains the clock settings for GPIO peripheral.
          boolean McuGPIO{0..5}StandbyModeEnable: origin=Renesas_v1.0.0, post-build-variant-value=true, set at post-build, default-value=false  # This parameter enables or disables the operation of peripheral when CPU enters standby mode. | false: Stops the operation in Stand-by mode. true: Continues the operation in stand-by mode.
          enumeration McuUnitName: {GPIO}, origin=Renesas_v1.0.0, set at pre-compile, default-value=GPIO  # This parameter contains the functional unit name for the GPIO.
          float McuPeripheralClock: 8333333..10000000, origin=Renesas_v1.0.0, set at pre-compile, default-value=10000000  # This parameter contains the Peripheral clock value.
        container McuEthernetClockSetting [0..1]: multiplicity set at pre-compile  # This container contains the clock settings for Ethernet.
          boolean McuEthernetStandbyModeEnable: origin=Renesas_v1.0.0, post-build-variant-value=true, set at post-build, default-value=false  # This parameter enables or disables the operation of peripheral when CPU enters standby mode. | false: Stops the operation in Stand-by mode. true: Continues the operation in stand-by mode.
          enumeration McuUnitName: {ETHERNET}, origin=Renesas_v1.0.0, set at pre-compile, default-value=ETHERNET  # This parameter contains the functional unit name for the ETHERNET.
          float McuPeripheralClock: 133333333..133333333, origin=Renesas_v1.0.0, set at pre-compile, default-value=133333333  # This parameter contains the Peripheral clock value.
        container McuADCClockSetting [0..1]: multiplicity set at pre-compile  # This container contains the clock settings for ADC.
          boolean McuADCStandbyModeEnable: origin=Renesas_v1.0.0, post-build-variant-value=true, set at post-build, default-value=false  # This parameter enables or disables the operation of peripheral when CPU enters standby mode. | false: Stops the operation in Stand-by mode. true: Continues the operation in stand-by mode.
          enumeration McuUnitName: {ADC}, origin=Renesas_v1.0.0, set at pre-compile, default-value=ADC  # This parameter contains the functional unit name for the ADC.
        container McuRPCClockSetting [0..1]: multiplicity set at pre-compile  # This container contains the clock settings for RPC.
          boolean McuRPCStandbyModeEnable: origin=Renesas_v1.0.0, post-build-variant-value=true, set at post-build, default-value=false  # This parameter enables or disables the operation of peripheral when CPU enters standby mode. | false: Stops the operation in Stand-by mode. true: Continues the operation in stand-by mode.
          enumeration McuUnitName: {RPC}, origin=Renesas_v1.0.0, set at pre-compile, default-value=RPC  # This parameter contains the functional unit name for the RPC.
          float McuPeripheralClock: 320000000..320000000, origin=Renesas_v1.0.0, set at pre-compile, default-value=320000000  # This parameter contains the Peripheral clock value.
        container McuRPCD2ClockSetting [0..1]: multiplicity set at pre-compile  # This container contains the clock settings for RPCD2 clock source.
          enumeration McuUnitName: {RPCD2}, origin=Renesas_v1.0.0, set at pre-compile, default-value=RPCD2  # This parameter contains the functional unit name for the RPCD2
          float McuPeripheralClock: 160000000..160000000, origin=Renesas_v1.0.0, set at pre-compile, default-value=160000000  # This parameter contains the Peripheral clock value.
        container McuFlexrayClockSetting [0..1]: multiplicity set at pre-compile  # This container contains the clock settings for Flexray.
          boolean McuFlexrayStandbyModeEnable: origin=Renesas_v1.0.0, post-build-variant-value=true, set at post-build, default-value=false  # This parameter enables or disables the operation of peripheral when CPU enters standby mode. | false: Stops the operation in Stand-by mode. true: Continues the operation in stand-by mode.
          enumeration McuUnitName: {FLEXRAY}, origin=Renesas_v1.0.0, set at pre-compile, default-value=FLEXRAY  # This parameter contains the functional unit name for the Flexray.
          float McuPeripheralClock: 80000000..80000000, origin=Renesas_v1.0.0, set at pre-compile, default-value=80000000  # This parameter contains the Peripheral clock value.
        container McuTHSClockSetting [0..1]: multiplicity set at pre-compile  # This container contains the clock settings for THS.
          boolean McuTHSStandbyModeEnable: origin=Renesas_v1.0.0, post-build-variant-value=true, set at post-build, default-value=false  # This parameter enables or disables the operation of peripheral when CPU enters standby mode. | false: Stops the operation in Stand-by mode. true: Continues the operation in stand-by mode.
          enumeration McuUnitName: {THS}, origin=Renesas_v1.0.0, set at pre-compile, default-value=THS  # This parameter contains the functional unit name for the THS.
        container McuSUCMTClockSetting [0..1]: multiplicity set at pre-compile  # This container contains the clock settings for SUCMT.
          boolean McuSUCMTStandbyModeEnable: origin=Renesas_v1.0.0, post-build-variant-value=true, set at post-build, default-value=false  # This parameter enables or disables the operation of peripheral when CPU enters standby mode. | false: Stops the operation in Stand-by mode. true: Continues the operation in stand-by mode.
          enumeration McuUnitName: {SUCMT}, origin=Renesas_v1.0.0, set at pre-compile, default-value=SUCMT  # This parameter contains the functional unit name for the SUCMT.
        container McuCMTClockSetting [0..1]: multiplicity set at pre-compile  # This container contains the clock settings for CMT.
          boolean McuCMT1StandbyModeEnable: origin=Renesas_v1.0.0, post-build-variant-value=true, set at post-build, default-value=false  # This parameter enables or disables the operation of peripheral when CPU enters standby mode. | false: Stops the operation in Stand-by mode. true: Continues the operation in stand-by mode.
          boolean McuCMT2StandbyModeEnable: origin=Renesas_v1.0.0, post-build-variant-value=true, set at post-build, default-value=false  # This parameter enables or disables the operation of peripheral when CPU enters standby mode. | false: Stops the operation in Stand-by mode. true: Continues the operation in stand-by mode.
          enumeration McuUnitName: {CMT}, origin=Renesas_v1.0.0, set at pre-compile, default-value=CMT  # This parameter contains the functional unit name for the CMT.
        container McuMFISClockSetting [0..1]: multiplicity set at pre-compile  # This container contains the clock settings for MFIS.
          boolean McuMFISStandbyModeEnable: origin=Renesas_v1.0.0, post-build-variant-value=true, set at post-build, default-value=false  # This parameter enables or disables the operation of peripheral when CPU enters standby mode. | false: Stops the operation in Stand-by mode. true: Continues the operation in stand-by mode.
          enumeration McuUnitName: {MFIS}, origin=Renesas_v1.0.0, set at pre-compile, default-value=MFIS  # This parameter contains the functional unit name for the MFIS.
        container McuIICClockSetting [0..1]: multiplicity set at pre-compile  # This container contains the clock settings for IIC.
          boolean McuIIC{0..4}StandbyModeEnable: origin=Renesas_v1.0.0, post-build-variant-value=true, set at post-build, default-value=false  # This parameter enables or disables the operation of peripheral when CPU enters standby mode. | false: Stops the operation in Stand-by mode. true: Continues the operation in stand-by mode.
          enumeration McuUnitName: {IIC}, origin=Renesas_v1.0.0, set at pre-compile, default-value=IIC  # This parameter contains the functional unit name for IIC.
        container McuCRCClockSetting [0..1]: multiplicity set at pre-compile  # This container contains the clock settings for CRC.
          boolean McuCRC{0..3}StandbyModeEnable: origin=Renesas_v1.0.0, post-build-variant-value=true, set at post-build, default-value=false  # This parameter enables or disables the operation of peripheral when CPU enters standby mode. | false: Stops the operation in Stand-by mode. true: Continues the operation in stand-by mode.
          enumeration McuUnitName: {CRC}, origin=Renesas_v1.0.0, set at pre-compile, default-value=CRC  # This parameter contains the functional unit name for CRC.
        container McuClockReferencePoint [1..*]: multiplicity set at pre-compile  # This container defines a reference point in the Mcu Clock tree. It defines the frequency which can be used by other modules as an input value. Lower multiplicity is 1, as even in the simplest case (only one frequency is used), there is one frequency to be defined. This container is not used for implementation.
          float McuClockReferencePointFrequency: 25000000..800000000, scope=ECU, post-build-variant-value=true, set at post-build, default-value=800000000  # This is the frequency for the specific instance of the McuClockReferencePoint container. It shall be given in Hz. This parameter is not used for implementation. So if its used for reference frequency then user has to take care for configuration of valid clock domain associated with it.
      container McuDemEventParameterRefs [0..1]: multiplicity set at pre-compile  # Container for the references to DemEventParameter elements which shall be invoked using the API Dem_ReportErrorStatus API in case the corresponding error occurs. The EventId is taken from the referenced DemEventParameter's DemEventId value. The standardized errors are provided in the container and can be extended by vendor specific error references.
        symbolic name reference MCU_E_CLOCK_FAILURE [0..1]: multiplicity set at pre-compile, set at pre-compile, destination=DemEventParameter  # Reference to configured DEM event to report "Clock source failure". If clock failure notification is enabled in the configuration set and a clock source failure error occurs, the error code MCU_E_CLOCK_FAILURE shall be reported. This parameter is not used for implementation.
        symbolic name reference MCU_E_TIMEOUT_FAILURE: origin=Renesas_v1.0.0, set at pre-compile, destination=DemEventParameter  # Reference to configured DEM event to report "Timeout Failure".
        symbolic name reference MCU_E_GET_CONTROL_FAILURE [0..1]: multiplicity set at pre-compile, origin=Renesas_v1.0.0, set at pre-compile, destination=DemEventParameter  # Reference to configured DEM event to report "get control failure".
        symbolic name reference MCU_E_READ_BACK_FAILURE [0..1]: multiplicity set at pre-compile, origin=Renesas_v1.0.0, set at pre-compile, destination=DemEventParameter  # Reference to configured DEM event to report "read back failure". This parameter is for functional safety, user shall refer Safety Application Note for description or leave it with default value.
        symbolic name reference MCU_E_CONFIGURATION_CHECK_PERMANENT_FAILURE [0..1]: multiplicity set at pre-compile, origin=Renesas_v1.0.0, set at pre-compile, destination=DemEventParameter  # Reference to configured DEM event to report "configuration check permanent failure". This parameter is for functional safety, user shall refer Safety Application Note for description or leave it with default value.
        symbolic name reference MCU_E_CONFIGURATION_CHECK_TRANSIENT_FAILURE [0..1]: multiplicity set at pre-compile, origin=Renesas_v1.0.0, set at pre-compile, destination=DemEventParameter  # Reference to configured DEM event to report "configuration check transient failure". This parameter is for functional safety, user shall refer Safety Application Note for description or leave it with default value.
        symbolic name reference MCU_E_INTERNAL_BUS_FAILURE [0..1]: multiplicity set at pre-compile, origin=Renesas_v1.0.0, set at pre-compile, destination=DemEventParameter  # Reference to configured DEM event to report "internal bus check failure". This parameter is for functional safety, user shall refer Safety Application Note for description or leave it with default value.
      container McuModeSettingConf [1..*]: multiplicity set at pre-compile  # This container contains the configuration (parameters) for the Mode setting of the MCU. Please see MCU035 for more information on the MCU mode settings.
        enumeration McuModeType: {RUN_MODE, SLEEP_MODE, CORE_POWER_DOWN_MODE}, origin=Renesas_v1.0.0, post-build-variant-value=true, set at post-build, default-value=RUN_MODE  # This parameter contains the power save mode type. The value for this parameter should not be repeated within same configuration set. | RUN_MODE: Everything is running. SLEEP_MODE: Clock for ARM Cortex R7 is switched off. CORE_POWER_DOWN_MODE: Power and clock of ARM Cortex R7 is switched off.
        integer McuMode: 0..255, set at pre-compile, symbolic-name-value=true, default-value=0  # The parameter represents the MCU Mode settings.
        boolean McuWakeupMaskCSD: origin=Renesas_v1.0.0, post-build-variant-value=true, set at post-build, default-value=false  # This parameter enables or disables the CSD wakeup mask for Arm Cortex R7. | false: Disable CSD wakeup mask. true: Enable CSD wakeup mask.
        boolean McuWakeupMaskFIQ: origin=Renesas_v1.0.0, post-build-variant-value=true, set at post-build, default-value=false  # This parameter enables or disables the FIQ wakeup mask for Arm Cortex R7. | false: Disable FIQ wakeup mask. true: Enable FIQ wakeup mask.
        boolean McuWakeupMaskIRQ: origin=Renesas_v1.0.0, post-build-variant-value=true, set at post-build, default-value=false  # This parameter enables or disables the IRQ wakeup mask for Arm Cortex R7. | false: Disable IRQ wakeup mask. true: Enable IRQ wakeup mask.
        boolean McuStatusUpdateFIQ: origin=Renesas_v1.0.0, post-build-variant-value=true, set at post-build, default-value=false  # This parameter enables or disables for updating FIQ interrupt status when a power resume is accepted. | false: Disable for updating FIQ interrupt status. true: Enable for updating FIQ interrupt status.
        boolean McuStatusUpdateIRQ: origin=Renesas_v1.0.0, post-build-variant-value=true, set at post-build, default-value=false  # This parameter enables or disables for updating IRQ interrupt status when a power resume is accepted. | false: Disable for updating IRQ interrupt status. true: Enable for updating IRQ interrupt status.
        boolean McuModeTransitionReq: origin=Renesas_v1.0.0, post-build-variant-value=true, set at post-build, default-value=true  # This parameter enables or disables the actual transition to the low power mode from inside Mcu_SetMode API. | true: enables transition required to the low power mode( Mode transition at Mcu_SetMode function ). false: disables transition required to the low power mode( Not Mode transition at Mcu_SetMode function ).
      container McuRamSectorSettingConf [0..*]: multiplicity set at pre-compile  # This container contains the configuration (parameters) for the RAM Sector setting. Please see MCU030 for more information on RAM sector settings.
        integer McuRamDefaultValue: 0..255, post-build-variant-value=true, set at post-build, default-value=0  # This parameter shall represent the Data pre-setting to be initialized.
        integer McuRamSectionBaseAddress: 0..4294967295, post-build-variant-value=true, set at post-build, default-value=0  # This parameter shall represent the MCU RAM section base address. | V3M: Range : 0x00000000...0xFFFFFFFF
        integer McuRamSectionSize: 0..4294967295, post-build-variant-value=true, set at post-build, default-value=0  # This parameter shall represent the MCU RAM Section size in bytes. | V3M: Range : 0x00000000...0xFFFFFFFF
      container McuConfigurationExtraRegisterConf [0..*]: multiplicity set at pre-compile  # This container contains the configuration for extra register need configuration register check This parameter is for functional safety, user shall refer Safety Application Note for description or leave it with default value.
        integer McuAdressRegisterCheck: 0..4294967295, origin=Renesas_v1.0.0, post-build-variant-value=true, set at post-build, default-value=0  # This parameter shall present address of register which need to check This parameter is for functional safety, user shall refer Safety Application Note for description or leave it with default value.
        integer McuMaskRegisterCheck: 0..4294967295, origin=Renesas_v1.0.0, post-build-variant-value=true, set at post-build, default-value=0  # This parameter shall present mask of register which need to check This parameter is for functional safety, user shall refer Safety Application Note for description or leave it with default value.
        integer McuExpectedRegisterCheck: 0..4294967295, origin=Renesas_v1.0.0, post-build-variant-value=true, set at post-build, default-value=0  # This parameter shall present expected value of register which need to check This parameter is for functional safety, user shall refer Safety Application Note for description or leave it with default value.
    container McuPublishedInformation  # Container holding all MCU specific published information parameters.
      container McuResetReasonConf [1..4]: multiplicity set at pre-compile  # This container contains the configuration for the different type of reset reason that can be retrieved from Mcu_GetResetReason API.
        integer McuResetReason: 0..255, scope=ECU, set at published-information, symbolic-name-value=true, default-value=0  # The parameter represents the different type of reset that a Micro supports. This parameter is referenced by the parameter EcuMResetReason in the ECU State manager module.
      container McuRstRsnConfUndefined  # This container contains the configuration for the different type of reset reason that can be retrieved from Mcu_GetResetReason API.
        integer McuResetReason: 0..0, scope=ECU, origin=Renesas_v1.0.0, set at published-information, symbolic-name-value=true, default-value=0  # The parameter represents the different type of reset that a Micro supports. This parameter is referenced by the parameter EcuMResetReason in the ECU State manager module, MCU_RESET_UNDEFINED.
      container McuRstRsnConfRwdtRst  # This container contains the configuration for the different type of reset reason that can be retrieved from Mcu_GetResetReason API.
        integer McuResetReason: 1..1, scope=ECU, origin=Renesas_v1.0.0, set at published-information, symbolic-name-value=true, default-value=1  # The parameter represents the different type of reset that a Micro supports. This parameter is referenced by the parameter EcuMResetReason in the ECU State manager module, MCU_WATCHDOG_REALTIME_RESET.
      container McuRstRsnConfSwdtRst  # This container contains the configuration for the different type of reset reason that can be retrieved from Mcu_GetResetReason API.
        integer McuResetReason: 2..2, scope=ECU, origin=Renesas_v1.0.0, set at published-information, symbolic-name-value=true, default-value=2  # The parameter represents the different type of reset that a Micro supports. This parameter is referenced by the parameter EcuMResetReason in the ECU State manager module, MCU_WATCHDOG_SECURE_RESET.
      container McuRstRsnConfSwRst  # This container contains the configuration for the different type of reset reason that can be retrieved from Mcu_GetResetReason API.
        integer McuResetReason: 3..3, scope=ECU, origin=Renesas_v1.0.0, set at published-information, symbolic-name-value=true, default-value=3  # The parameter represents the different type of reset that a Micro supports. This parameter is referenced by the parameter EcuMResetReason in the ECU State manager module, MCU_SW_RESET.

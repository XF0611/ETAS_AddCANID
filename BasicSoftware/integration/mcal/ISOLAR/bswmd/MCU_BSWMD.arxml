AUTOSAR XML (schema 4-2-2)
package /ETAS_BIP/BswModuleImplementation
  bsw implementation Mcu_Implementation: programming-language=C, sw-version=1.2.7, vendor-id=59, ar-release-version=4.2.2, vendor-api-infix=Renesas, vendor-specific-module-def=Mcu
    code-descriptors:
      code Code_Files
        artifact-descriptors:
          short-label=Autosar::include::Mcu.h, category=SWHDR
          short-label=Autosar::include::Mcu_Debug.h, category=SWHDR
          short-label=Autosar::include::Mcu_Irq.h, category=SWHDR
          short-label=Autosar::include::Mcu_PBTypes.h, category=SWHDR
          short-label=Autosar::include::Mcu_Ram.h, category=SWHDR
          short-label=Autosar::include::Mcu_Type.h, category=SWHDR
          short-label=Autosar::include::Mcu_Version.h, category=SWHDR
          short-label=Autosar::src::Mcu.c, category=SWSRC
          short-label=Autosar::src::Mcu_Ram.c, category=SWSRC
          short-label=Autosar::src::Mcu_Irq.c, category=SWSRC
          short-label=Autosar::src::Mcu_Version.c, category=SWSRC
    compiler ARM_Assembler: name=ARM Assembler, options=-g --cpu=cortex-r7 --fpu=VFPv3_D16 --no_unaligned_access, vendor=ARM, version=ARM compiler version 6.6.3
    compiler ARM_Compiler: name=ARM Compiler, options=-c -O3 --target=arm-arm-none-eabi -mcpu=cortex-r7 -mfpu=vfpv3-d16 -g -gdwarf-2 -fshort-enums -mfloat-abi=hard -nostdlib -nostdlibinc -mno-unaligned-access -MD -MP -Wundef -std=c99 -pedantic-errors -Werror -Wall -Wextra -Wconversion -Wunused -Wuninitialized -DNDEBUG, vendor=ARM, version=ARM compiler version 6.6.3
    linker ARM_Linker: name=ARM Linker, options=--cpu=cortex-r7 --datacompressor off --entry=Start --callgraph --map --info=sizes --info=totals --info=unused --info=compression --info=stack --info=inline --diag_error=warning, vendor=ARM, version=ARM compiler version 6.6.3

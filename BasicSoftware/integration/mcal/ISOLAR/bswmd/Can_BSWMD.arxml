AUTOSAR XML (schema 4-2-2)
package /AUTOSAR_Can/BswModuleEntrys
  6 x bsw module entry, all with is-synchronous=true, sw-service-impl-policy=STANDARD:
    Can_Write: service-id=6, is-reentrant=true, call-type=SCHEDULED, execution-context=TASK
    Can_MainFunction_Mode: service-id=12, is-reentrant=false, call-type=SCHEDULED, execution-context=TASK
    Can_MainFunction_Write: service-id=1, is-reentrant=false, call-type=SCHEDULED, execution-context=TASK
    Can_MainFunction_Read: service-id=8, is-reentrant=false, call-type=SCHEDULED, execution-context=TASK
    Can_MainFunction_BusOff: service-id=9, is-reentrant=false, call-type=SCHEDULED, execution-context=TASK
    Can_Init: service-id=0x00, is-reentrant=false, call-type=REGULAR, execution-context=UNSPECIFIED
package /AUTOSAR_Can/BswModuleDescriptions
  bsw module description Can: category=MCAL_MODULE, module-id=80
    bsw internal behavior Can_BswInternalBehaviour
      exclusive area CAN_WRITE_PROTECTION_AREA
      5 x bsw schedulable entity:
        Can_Write: can-enter-exclusive-area=CAN_WRITE_PROTECTION_AREA, reentrancy-level=SINGLE-CORE-REENTRANT, implemented-entry=Can_Write
        BSWSE_MainFunction_Mode: reentrancy-level=NON-REENTRANT, implemented-entry=Can_MainFunction_Mode
        BSWSE_MainFunction_Write: implemented-entry=Can_MainFunction_Write
        BSWSE_MainFunction_Read: implemented-entry=Can_MainFunction_Read
        BSWSE_MainFunction_BusOff: implemented-entry=Can_MainFunction_BusOff
      bsw called entity Can_Init: implemented-entry=Can_Init
      4 x bsw timing event, all with period=0.001:
        Can_MainFunction_Mode: starts-on-event=BSWSE_MainFunction_Mode
        Can_MainFunction_Read: starts-on-event=BSWSE_MainFunction_Read
        Can_MainFunction_Write: starts-on-event=BSWSE_MainFunction_Write
        Can_MainFunction_BusOff: starts-on-event=BSWSE_MainFunction_BusOff
package /AUTOSAR_Can/BswImplementations
  bsw implementation BSWIMPL_Can: programming-language=C, ar-release-version=4.0.2, behavior=Can_BswInternalBehaviour
    code-descriptors:
      code CodeDescriptor: artifact-descriptors=autosar-engineering-object={short-label=EngObject, category=SWSRC}
package /AUTOSAR_Can/ImplementationDataTypes
  impl type Can_IdType: category=VALUE, base-type=uint32, compu {0..0x400007FF=Standard32Bit, 0..0xDFFFFFFF=Extended32Bit}, type-emitter=HEADER_FILE  # Represents the Identifier of an L-PDU. The two most significant bits specify the frame type: 00 CAN message with Standard CAN ID 01 CAN FD frame with Standard CAN ID 10 CAN message with Extended CAN ID 11 CAN FD frame with Extended CAN ID
  impl type Can_HwType: category=STRUCTURE, type-emitter=HEADER_FILE  # This type defines a data structure which clearly provides an Hardware Object Handle including its corresponding CAN Controller and therefore CanDrv as well as the specific CanId.
    element CanId: implementation-data-type=Can_IdType
    element Hoh: implementation-data-type=Can_HwHandleType
    element ControllerId: implementation-data-type=uint8
  impl type Can_HwHandleType: category=VALUE, base-type=uint32, compu {0..0x0FF=Standard, 0..0xFFFF=Extended}, type-emitter=HEADER_FILE  # Represents the hardware object handles of a CAN hardware unit. For CAN hardware units with more than 255 HW objects use extended range.Represents the hardware object handles of a CAN hardware unit. For CAN hardware units with more than 255 HW objects use extended range.

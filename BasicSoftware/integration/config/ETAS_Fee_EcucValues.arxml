AUTOSAR XML (schema 00047)
package /ETAS_BIP/EcucModuleConfigurationValuess
  module config Fee
    FeeGeneral: FeeRbFsSelect=FS1
      FeeRbSectorTable: FeeRbFastCacheInitActive=true, FeeRbHeaderRecheckActive=false, FlsRbPageSize=8, FlsRbErasedValue=255
        FeeRbSector_0 (FeeRbSector): FlsRbSectorSize=32768
        FeeRbSector_1 (FeeRbSector): FlsRbSectorSize=32768

/*----------------------------------------------------------------------------*/
/*
 * File: ARCMW_CAL60S244AB_EcucPartition_ComCore.ld
 * Generated by: TAN9SGH
 * Version: ETAS Cobra 2.0
 * on: 2022/12/29 14:29
*/
/*----------------------------------------------------------------------------*/
/* -------------------------------------------------------------------------- */
/* Sections of CODE                                                          */
/* -------------------------------------------------------------------------- */
SECTIONS
{

    .EcucPartition_ComCore_CALLOUT_CODE ALIGN(4):
    {
        __EcucPartition_ComCore_CALLOUT_CODE_START = .;

        *(.EcucPartition_ComCore_ASW_CALLOUT_CODE)

        __EcucPartition_ComCore_CALLOUT_CODE_END = .;
    } > Memlay_CODE_EcucPartition_ComCore

    .EcucPartition_ComCore_CODE ALIGN(4):
    {
        __EcucPartition_ComCore_CODE_START = .;

        *(.EcucPartition_ComCore_ASW_CODE)
        *(.EcucPartition_ComCore_RTE_CODE)

        __EcucPartition_ComCore_CODE_END = .;
    } > Memlay_CODE_EcucPartition_ComCore

    .EcucPartition_ComCore_CODE_FAST ALIGN(4):
    {
        __EcucPartition_ComCore_CODE_FAST_START = .;

        *(.EcucPartition_ComCore_ASW_CODE_FAST)

        __EcucPartition_ComCore_CODE_FAST_END = .;
    } > Memlay_CODE_EcucPartition_ComCore

    .EcucPartition_ComCore_CODE_SLOW ALIGN(4):
    {
        __EcucPartition_ComCore_CODE_SLOW_START = .;

        *(.EcucPartition_ComCore_ASW_CODE_SLOW)

        __EcucPartition_ComCore_CODE_SLOW_END = .;
    } > Memlay_CODE_EcucPartition_ComCore

    .EcucPartition_ComCore_VECTORS ALIGN(4):
    {
        __EcucPartition_ComCore_VECTORS_START = .;

        *(.EcucPartition_ComCore_ASW_VECTORS)

        __EcucPartition_ComCore_VECTORS_END = .;
    } > Memlay_CODE_EcucPartition_ComCore

}

/* -------------------------------------------------------------------------- */
/* Sections of CLEARED                                                          */
/* -------------------------------------------------------------------------- */
SECTIONS
{

    .EcucPartition_ComCore_INTERNAL_VAR_CLEARED ALIGN(4):
    {
        __EcucPartition_ComCore_INTERNAL_VAR_CLEARED_START = .;

        *(.EcucPartition_ComCore_ASW_INTERNAL_VAR_CLEARED_16)
        *(.EcucPartition_ComCore_ASW_INTERNAL_VAR_CLEARED_32)
        *(.EcucPartition_ComCore_ASW_INTERNAL_VAR_CLEARED_8)
        *(.EcucPartition_ComCore_ASW_INTERNAL_VAR_CLEARED_BOOLEAN)
        *(.EcucPartition_ComCore_ASW_INTERNAL_VAR_CLEARED_UNSPECIFIED)

        __EcucPartition_ComCore_INTERNAL_VAR_CLEARED_END = .;
    } > Memlay_VAR_EcucPartition_ComCore

    .EcucPartition_ComCore_INTERNAL_VAR_NO_INIT ALIGN(4):
    {
        __EcucPartition_ComCore_INTERNAL_VAR_NO_INIT_START = .;

        *(.EcucPartition_ComCore_ASW_INTERNAL_VAR_NO_INIT_16)
        *(.EcucPartition_ComCore_ASW_INTERNAL_VAR_NO_INIT_32)
        *(.EcucPartition_ComCore_ASW_INTERNAL_VAR_NO_INIT_8)
        *(.EcucPartition_ComCore_ASW_INTERNAL_VAR_NO_INIT_BOOLEAN)
        *(.EcucPartition_ComCore_ASW_INTERNAL_VAR_NO_INIT_UNSPECIFIED)

        __EcucPartition_ComCore_INTERNAL_VAR_NO_INIT_END = .;
    } > Memlay_VAR_EcucPartition_ComCore

    .EcucPartition_ComCore_INTERNAL_VAR_POWER_ON_CLEARED ALIGN(4):
    {
        __EcucPartition_ComCore_INTERNAL_VAR_POWER_ON_CLEARED_START = .;

        *(.EcucPartition_ComCore_ASW_INTERNAL_VAR_POWER_ON_CLEARED_16)
        *(.EcucPartition_ComCore_ASW_INTERNAL_VAR_POWER_ON_CLEARED_32)
        *(.EcucPartition_ComCore_ASW_INTERNAL_VAR_POWER_ON_CLEARED_8)
        *(.EcucPartition_ComCore_ASW_INTERNAL_VAR_POWER_ON_CLEARED_BOOLEAN)
        *(.EcucPartition_ComCore_ASW_INTERNAL_VAR_POWER_ON_CLEARED_UNSPECIFIED)

        __EcucPartition_ComCore_INTERNAL_VAR_POWER_ON_CLEARED_END = .;
    } > Memlay_VAR_EcucPartition_ComCore

    .EcucPartition_ComCore_POSTBUILD_VAR_NO_INIT ALIGN(4):
    {
        __EcucPartition_ComCore_POSTBUILD_VAR_NO_INIT_START = .;

        *(.EcucPartition_ComCore_ASW_POSTBUILD_VAR_NO_INIT_16)
        *(.EcucPartition_ComCore_ASW_POSTBUILD_VAR_NO_INIT_32)
        *(.EcucPartition_ComCore_ASW_POSTBUILD_VAR_NO_INIT_8)
        *(.EcucPartition_ComCore_ASW_POSTBUILD_VAR_NO_INIT_BOOLEAN)
        *(.EcucPartition_ComCore_ASW_POSTBUILD_VAR_NO_INIT_UNSPECIFIED)

        __EcucPartition_ComCore_POSTBUILD_VAR_NO_INIT_END = .;
    } > Memlay_VAR_EcucPartition_ComCore

    .EcucPartition_ComCore_RESET_SAFE_RAM0 ALIGN(4):
    {
        __EcucPartition_ComCore_RESET_SAFE_RAM0_START = .;

        *(.EcucPartition_ComCore_ASW_RESET_SAFE_RAM0_16)
        *(.EcucPartition_ComCore_ASW_RESET_SAFE_RAM0_32)
        *(.EcucPartition_ComCore_ASW_RESET_SAFE_RAM0_8)
        *(.EcucPartition_ComCore_ASW_RESET_SAFE_RAM0_BOOLEAN)
        *(.EcucPartition_ComCore_ASW_RESET_SAFE_RAM0_UNSPECIFIED)

        __EcucPartition_ComCore_RESET_SAFE_RAM0_END = .;
    } > Memlay_VAR_EcucPartition_ComCore

    .EcucPartition_ComCore_SAVED_ZONE ALIGN(4):
    {
        __EcucPartition_ComCore_SAVED_ZONE_START = .;

        *(.EcucPartition_ComCore_ASW_SAVED_ZONE_16)
        *(.EcucPartition_ComCore_ASW_SAVED_ZONE_32)
        *(.EcucPartition_ComCore_ASW_SAVED_ZONE_8)
        *(.EcucPartition_ComCore_ASW_SAVED_ZONE_BOOLEAN)
        *(.EcucPartition_ComCore_ASW_SAVED_ZONE_UNSPECIFIED)

        __EcucPartition_ComCore_SAVED_ZONE_END = .;
    } > Memlay_VAR_EcucPartition_ComCore

    .EcucPartition_ComCore_SHAREDMEMORY ALIGN(4):
    {
        __EcucPartition_ComCore_SHAREDMEMORY_START = .;

        *(.EcucPartition_ComCore_ASW_SHAREDMEMORY_16)
        *(.EcucPartition_ComCore_ASW_SHAREDMEMORY_32)
        *(.EcucPartition_ComCore_ASW_SHAREDMEMORY_8)
        *(.EcucPartition_ComCore_ASW_SHAREDMEMORY_BOOLEAN)
        *(.EcucPartition_ComCore_ASW_SHAREDMEMORY_UNSPECIFIED)

        __EcucPartition_ComCore_SHAREDMEMORY_END = .;
    } > Memlay_VAR_EcucPartition_ComCore

    .EcucPartition_ComCore_VAR_CLEARED ALIGN(4):
    {
        __EcucPartition_ComCore_VAR_CLEARED_START = .;

        *(.EcucPartition_ComCore_ASW_VAR_CLEARED_16)
        *(.EcucPartition_ComCore_ASW_VAR_CLEARED_32)
        *(.EcucPartition_ComCore_ASW_VAR_CLEARED_8)
        *(.EcucPartition_ComCore_ASW_VAR_CLEARED_BOOLEAN)
        *(.EcucPartition_ComCore_ASW_VAR_CLEARED_UNSPECIFIED)
        *(.EcucPartition_ComCore_RTE_VAR_CLEARED_16)
        *(.EcucPartition_ComCore_RTE_VAR_CLEARED_8)
        *(.EcucPartition_ComCore_RTE_VAR_CLEARED_BOOLEAN)

        __EcucPartition_ComCore_VAR_CLEARED_END = .;
    } > Memlay_VAR_EcucPartition_ComCore

    .EcucPartition_ComCore_VAR_CLEARED_POSTBUILD ALIGN(4):
    {
        __EcucPartition_ComCore_VAR_CLEARED_POSTBUILD_START = .;

        *(.EcucPartition_ComCore_ASW_VAR_CLEARED_POSTBUILD_16)
        *(.EcucPartition_ComCore_ASW_VAR_CLEARED_POSTBUILD_32)
        *(.EcucPartition_ComCore_ASW_VAR_CLEARED_POSTBUILD_8)
        *(.EcucPartition_ComCore_ASW_VAR_CLEARED_POSTBUILD_BOOLEAN)
        *(.EcucPartition_ComCore_ASW_VAR_CLEARED_POSTBUILD_UNSPECIFIED)

        __EcucPartition_ComCore_VAR_CLEARED_POSTBUILD_END = .;
    } > Memlay_VAR_EcucPartition_ComCore

    .EcucPartition_ComCore_VAR_FAST_CLEARED ALIGN(4):
    {
        __EcucPartition_ComCore_VAR_FAST_CLEARED_START = .;

        *(.EcucPartition_ComCore_ASW_VAR_FAST_CLEARED_16)
        *(.EcucPartition_ComCore_ASW_VAR_FAST_CLEARED_32)
        *(.EcucPartition_ComCore_ASW_VAR_FAST_CLEARED_8)
        *(.EcucPartition_ComCore_ASW_VAR_FAST_CLEARED_BOOLEAN)
        *(.EcucPartition_ComCore_ASW_VAR_FAST_CLEARED_UNSPECIFIED)

        __EcucPartition_ComCore_VAR_FAST_CLEARED_END = .;
    } > Memlay_VAR_EcucPartition_ComCore

    .EcucPartition_ComCore_VAR_FAST_NO_INIT ALIGN(4):
    {
        __EcucPartition_ComCore_VAR_FAST_NO_INIT_START = .;

        *(.EcucPartition_ComCore_ASW_VAR_FAST_NO_INIT_16)
        *(.EcucPartition_ComCore_ASW_VAR_FAST_NO_INIT_32)
        *(.EcucPartition_ComCore_ASW_VAR_FAST_NO_INIT_8)
        *(.EcucPartition_ComCore_ASW_VAR_FAST_NO_INIT_BOOLEAN)
        *(.EcucPartition_ComCore_ASW_VAR_FAST_NO_INIT_UNSPECIFIED)

        __EcucPartition_ComCore_VAR_FAST_NO_INIT_END = .;
    } > Memlay_VAR_EcucPartition_ComCore

    .EcucPartition_ComCore_VAR_FAST_POWER_ON_CLEARED ALIGN(4):
    {
        __EcucPartition_ComCore_VAR_FAST_POWER_ON_CLEARED_START = .;

        *(.EcucPartition_ComCore_ASW_VAR_FAST_POWER_ON_CLEARED_16)
        *(.EcucPartition_ComCore_ASW_VAR_FAST_POWER_ON_CLEARED_32)
        *(.EcucPartition_ComCore_ASW_VAR_FAST_POWER_ON_CLEARED_8)
        *(.EcucPartition_ComCore_ASW_VAR_FAST_POWER_ON_CLEARED_BOOLEAN)
        *(.EcucPartition_ComCore_ASW_VAR_FAST_POWER_ON_CLEARED_UNSPECIFIED)

        __EcucPartition_ComCore_VAR_FAST_POWER_ON_CLEARED_END = .;
    } > Memlay_VAR_EcucPartition_ComCore

    .EcucPartition_ComCore_VAR_NO_INIT ALIGN(4):
    {
        __EcucPartition_ComCore_VAR_NO_INIT_START = .;

        *(.EcucPartition_ComCore_ASW_VAR_NO_INIT_16)
        *(.EcucPartition_ComCore_ASW_VAR_NO_INIT_32)
        *(.EcucPartition_ComCore_ASW_VAR_NO_INIT_8)
        *(.EcucPartition_ComCore_ASW_VAR_NO_INIT_BOOLEAN)
        *(.EcucPartition_ComCore_ASW_VAR_NO_INIT_UNSPECIFIED)

        __EcucPartition_ComCore_VAR_NO_INIT_END = .;
    } > Memlay_VAR_EcucPartition_ComCore

    .EcucPartition_ComCore_VAR_POWER_ON_CLEARED ALIGN(4):
    {
        __EcucPartition_ComCore_VAR_POWER_ON_CLEARED_START = .;

        *(.EcucPartition_ComCore_ASW_VAR_POWER_ON_CLEARED_16)
        *(.EcucPartition_ComCore_ASW_VAR_POWER_ON_CLEARED_32)
        *(.EcucPartition_ComCore_ASW_VAR_POWER_ON_CLEARED_8)
        *(.EcucPartition_ComCore_ASW_VAR_POWER_ON_CLEARED_BOOLEAN)
        *(.EcucPartition_ComCore_ASW_VAR_POWER_ON_CLEARED_UNSPECIFIED)

        __EcucPartition_ComCore_VAR_POWER_ON_CLEARED_END = .;
    } > Memlay_VAR_EcucPartition_ComCore

    .EcucPartition_ComCore_VAR_SAVED_ZONE ALIGN(4):
    {
        __EcucPartition_ComCore_VAR_SAVED_ZONE_START = .;

        *(.EcucPartition_ComCore_ASW_VAR_SAVED_ZONE_16)
        *(.EcucPartition_ComCore_ASW_VAR_SAVED_ZONE_32)
        *(.EcucPartition_ComCore_ASW_VAR_SAVED_ZONE_8)
        *(.EcucPartition_ComCore_ASW_VAR_SAVED_ZONE_BOOLEAN)
        *(.EcucPartition_ComCore_ASW_VAR_SAVED_ZONE_UNSPECIFIED)

        __EcucPartition_ComCore_VAR_SAVED_ZONE_END = .;
    } > Memlay_VAR_EcucPartition_ComCore

    .EcucPartition_ComCore_VAR_SLOW_CLEARED ALIGN(4):
    {
        __EcucPartition_ComCore_VAR_SLOW_CLEARED_START = .;

        *(.EcucPartition_ComCore_ASW_VAR_SLOW_CLEARED_16)
        *(.EcucPartition_ComCore_ASW_VAR_SLOW_CLEARED_32)
        *(.EcucPartition_ComCore_ASW_VAR_SLOW_CLEARED_8)
        *(.EcucPartition_ComCore_ASW_VAR_SLOW_CLEARED_BOOLEAN)
        *(.EcucPartition_ComCore_ASW_VAR_SLOW_CLEARED_UNSPECIFIED)

        __EcucPartition_ComCore_VAR_SLOW_CLEARED_END = .;
    } > Memlay_VAR_EcucPartition_ComCore

    .EcucPartition_ComCore_VAR_SLOW_NO_INIT ALIGN(4):
    {
        __EcucPartition_ComCore_VAR_SLOW_NO_INIT_START = .;

        *(.EcucPartition_ComCore_ASW_VAR_SLOW_NO_INIT_16)
        *(.EcucPartition_ComCore_ASW_VAR_SLOW_NO_INIT_32)
        *(.EcucPartition_ComCore_ASW_VAR_SLOW_NO_INIT_8)
        *(.EcucPartition_ComCore_ASW_VAR_SLOW_NO_INIT_BOOLEAN)
        *(.EcucPartition_ComCore_ASW_VAR_SLOW_NO_INIT_UNSPECIFIED)

        __EcucPartition_ComCore_VAR_SLOW_NO_INIT_END = .;
    } > Memlay_VAR_EcucPartition_ComCore

    .EcucPartition_ComCore_VAR_SLOW_POWER_ON_CLEARED ALIGN(4):
    {
        __EcucPartition_ComCore_VAR_SLOW_POWER_ON_CLEARED_START = .;

        *(.EcucPartition_ComCore_ASW_VAR_SLOW_POWER_ON_CLEARED_16)
        *(.EcucPartition_ComCore_ASW_VAR_SLOW_POWER_ON_CLEARED_32)
        *(.EcucPartition_ComCore_ASW_VAR_SLOW_POWER_ON_CLEARED_8)
        *(.EcucPartition_ComCore_ASW_VAR_SLOW_POWER_ON_CLEARED_BOOLEAN)
        *(.EcucPartition_ComCore_ASW_VAR_SLOW_POWER_ON_CLEARED_UNSPECIFIED)

        __EcucPartition_ComCore_VAR_SLOW_POWER_ON_CLEARED_END = .;
    } > Memlay_VAR_EcucPartition_ComCore

    .EcucPartition_ComCore_VAR_TRACE ALIGN(4):
    {
        __EcucPartition_ComCore_VAR_TRACE_START = .;

        *(.EcucPartition_ComCore_ASW_VAR_TRACE_16)
        *(.EcucPartition_ComCore_ASW_VAR_TRACE_32)
        *(.EcucPartition_ComCore_ASW_VAR_TRACE_8)
        *(.EcucPartition_ComCore_ASW_VAR_TRACE_BOOLEAN)
        *(.EcucPartition_ComCore_ASW_VAR_TRACE_UNSPECIFIED)

        __EcucPartition_ComCore_VAR_TRACE_END = .;
    } > Memlay_VAR_EcucPartition_ComCore

}

/* -------------------------------------------------------------------------- */
/* Sections of CONST                                                          */
/* -------------------------------------------------------------------------- */
SECTIONS
{
    GROUP SIZE(SIZEOF(Memlay_CALIB_EcucPartition_ComCore)) : 
    {
        .EcucPartition_ComCore_CALIB ALIGN(4):
        {
            __EcucPartition_ComCore_CALIB_START = .;

            *(.EcucPartition_ComCore_ASW_CALIB_16)
            *(.EcucPartition_ComCore_ASW_CALIB_32)
            *(.EcucPartition_ComCore_ASW_CALIB_8)
            *(.EcucPartition_ComCore_ASW_CALIB_BOOLEAN)
            *(.EcucPartition_ComCore_ASW_CALIB_UNSPECIFIED)

            __EcucPartition_ComCore_CALIB_END = .;
        }

        .EcucPartition_ComCore_CALIB_FAST ALIGN(4):
        {
            __EcucPartition_ComCore_CALIB_FAST_START = .;

            *(.EcucPartition_ComCore_ASW_CALIB_FAST_16)
            *(.EcucPartition_ComCore_ASW_CALIB_FAST_32)
            *(.EcucPartition_ComCore_ASW_CALIB_FAST_8)
            *(.EcucPartition_ComCore_ASW_CALIB_FAST_BOOLEAN)
            *(.EcucPartition_ComCore_ASW_CALIB_FAST_UNSPECIFIED)

            __EcucPartition_ComCore_CALIB_FAST_END = .;
        }

        .EcucPartition_ComCore_CALIB_SLOW ALIGN(4):
        {
            __EcucPartition_ComCore_CALIB_SLOW_START = .;

            *(.EcucPartition_ComCore_ASW_CALIB_SLOW_16)
            *(.EcucPartition_ComCore_ASW_CALIB_SLOW_32)
            *(.EcucPartition_ComCore_ASW_CALIB_SLOW_8)
            *(.EcucPartition_ComCore_ASW_CALIB_SLOW_BOOLEAN)
            *(.EcucPartition_ComCore_ASW_CALIB_SLOW_UNSPECIFIED)

            __EcucPartition_ComCore_CALIB_SLOW_END = .;
        }

        .EcucPartition_ComCore_CALPRM ALIGN(4):
        {
            __EcucPartition_ComCore_CALPRM_START = .;

            *(.EcucPartition_ComCore_ASW_CALPRM_16)
            *(.EcucPartition_ComCore_ASW_CALPRM_32)
            *(.EcucPartition_ComCore_ASW_CALPRM_8)
            *(.EcucPartition_ComCore_ASW_CALPRM_BOOLEAN)
            *(.EcucPartition_ComCore_ASW_CALPRM_UNSPECIFIED)

            __EcucPartition_ComCore_CALPRM_END = .;
        }
    } = FILL(0x00) > Memlay_CALIB_EcucPartition_ComCore

    .EcucPartition_ComCore_CONFIG_DATA ALIGN(4):
    {
        __EcucPartition_ComCore_CONFIG_DATA_START = .;

        *(.EcucPartition_ComCore_ASW_CONFIG_DATA_16)
        *(.EcucPartition_ComCore_ASW_CONFIG_DATA_32)
        *(.EcucPartition_ComCore_ASW_CONFIG_DATA_8)
        *(.EcucPartition_ComCore_ASW_CONFIG_DATA_BOOLEAN)
        *(.EcucPartition_ComCore_ASW_CONFIG_DATA_UNSPECIFIED)

        __EcucPartition_ComCore_CONFIG_DATA_END = .;
    } > Memlay_CONST_EcucPartition_ComCore

    .EcucPartition_ComCore_CONFIG_DATA_FAST ALIGN(4):
    {
        __EcucPartition_ComCore_CONFIG_DATA_FAST_START = .;

        *(.EcucPartition_ComCore_ASW_CONFIG_DATA_FAST_16)
        *(.EcucPartition_ComCore_ASW_CONFIG_DATA_FAST_32)
        *(.EcucPartition_ComCore_ASW_CONFIG_DATA_FAST_8)
        *(.EcucPartition_ComCore_ASW_CONFIG_DATA_FAST_BOOLEAN)
        *(.EcucPartition_ComCore_ASW_CONFIG_DATA_FAST_UNSPECIFIED)

        __EcucPartition_ComCore_CONFIG_DATA_FAST_END = .;
    } > Memlay_CONST_EcucPartition_ComCore

    .EcucPartition_ComCore_CONFIG_DATA_POSTBUILD ALIGN(4):
    {
        __EcucPartition_ComCore_CONFIG_DATA_POSTBUILD_START = .;

        *(.EcucPartition_ComCore_ASW_CONFIG_DATA_POSTBUILD_16)
        *(.EcucPartition_ComCore_ASW_CONFIG_DATA_POSTBUILD_32)
        *(.EcucPartition_ComCore_ASW_CONFIG_DATA_POSTBUILD_8)
        *(.EcucPartition_ComCore_ASW_CONFIG_DATA_POSTBUILD_BOOLEAN)
        *(.EcucPartition_ComCore_ASW_CONFIG_DATA_POSTBUILD_UNSPECIFIED)

        __EcucPartition_ComCore_CONFIG_DATA_POSTBUILD_END = .;
    } > Memlay_CONST_EcucPartition_ComCore

    .EcucPartition_ComCore_CONFIG_DATA_POSTBUILD_HEADER ALIGN(4):
    {
        __EcucPartition_ComCore_CONFIG_DATA_POSTBUILD_HEADER_START = .;

        *(.EcucPartition_ComCore_ASW_CONFIG_DATA_POSTBUILD_HEADER_16)
        *(.EcucPartition_ComCore_ASW_CONFIG_DATA_POSTBUILD_HEADER_32)
        *(.EcucPartition_ComCore_ASW_CONFIG_DATA_POSTBUILD_HEADER_8)
        *(.EcucPartition_ComCore_ASW_CONFIG_DATA_POSTBUILD_HEADER_BOOLEAN)
        *(.EcucPartition_ComCore_ASW_CONFIG_DATA_POSTBUILD_HEADER_UNSPECIFIED)

        __EcucPartition_ComCore_CONFIG_DATA_POSTBUILD_HEADER_END = .;
    } > Memlay_CONST_EcucPartition_ComCore

    .EcucPartition_ComCore_CONFIG_DATA_SLOW ALIGN(4):
    {
        __EcucPartition_ComCore_CONFIG_DATA_SLOW_START = .;

        *(.EcucPartition_ComCore_ASW_CONFIG_DATA_SLOW_16)
        *(.EcucPartition_ComCore_ASW_CONFIG_DATA_SLOW_32)
        *(.EcucPartition_ComCore_ASW_CONFIG_DATA_SLOW_8)
        *(.EcucPartition_ComCore_ASW_CONFIG_DATA_SLOW_BOOLEAN)
        *(.EcucPartition_ComCore_ASW_CONFIG_DATA_SLOW_UNSPECIFIED)

        __EcucPartition_ComCore_CONFIG_DATA_SLOW_END = .;
    } > Memlay_CONST_EcucPartition_ComCore

    .EcucPartition_ComCore_CONST ALIGN(4):
    {
        __EcucPartition_ComCore_CONST_START = .;

        *(.EcucPartition_ComCore_ASW_CONST_16)
        *(.EcucPartition_ComCore_ASW_CONST_32)
        *(.EcucPartition_ComCore_ASW_CONST_8)
        *(.EcucPartition_ComCore_ASW_CONST_BOOLEAN)
        *(.EcucPartition_ComCore_ASW_CONST_UNSPECIFIED)
        *(.EcucPartition_ComCore_RTE_CONST_UNSPECIFIED)

        __EcucPartition_ComCore_CONST_END = .;
    } > Memlay_CONST_EcucPartition_ComCore

    .EcucPartition_ComCore_CONST_FAST ALIGN(4):
    {
        __EcucPartition_ComCore_CONST_FAST_START = .;

        *(.EcucPartition_ComCore_ASW_CONST_FAST_16)
        *(.EcucPartition_ComCore_ASW_CONST_FAST_32)
        *(.EcucPartition_ComCore_ASW_CONST_FAST_8)
        *(.EcucPartition_ComCore_ASW_CONST_FAST_BOOLEAN)
        *(.EcucPartition_ComCore_ASW_CONST_FAST_UNSPECIFIED)

        __EcucPartition_ComCore_CONST_FAST_END = .;
    } > Memlay_CONST_EcucPartition_ComCore

    .EcucPartition_ComCore_CONST_SAVED_RECOVERY_ZONE ALIGN(4):
    {
        __EcucPartition_ComCore_CONST_SAVED_RECOVERY_ZONE_START = .;

        *(.EcucPartition_ComCore_ASW_CONST_SAVED_RECOVERY_ZONE_16)
        *(.EcucPartition_ComCore_ASW_CONST_SAVED_RECOVERY_ZONE_32)
        *(.EcucPartition_ComCore_ASW_CONST_SAVED_RECOVERY_ZONE_8)
        *(.EcucPartition_ComCore_ASW_CONST_SAVED_RECOVERY_ZONE_BOOLEAN)
        *(.EcucPartition_ComCore_ASW_CONST_SAVED_RECOVERY_ZONE_UNSPECIFIED)

        __EcucPartition_ComCore_CONST_SAVED_RECOVERY_ZONE_END = .;
    } > Memlay_CONST_EcucPartition_ComCore

    .EcucPartition_ComCore_CONST_SLOW ALIGN(4):
    {
        __EcucPartition_ComCore_CONST_SLOW_START = .;

        *(.EcucPartition_ComCore_ASW_CONST_SLOW_16)
        *(.EcucPartition_ComCore_ASW_CONST_SLOW_32)
        *(.EcucPartition_ComCore_ASW_CONST_SLOW_8)
        *(.EcucPartition_ComCore_ASW_CONST_SLOW_BOOLEAN)
        *(.EcucPartition_ComCore_ASW_CONST_SLOW_UNSPECIFIED)

        __EcucPartition_ComCore_CONST_SLOW_END = .;
    } > Memlay_CONST_EcucPartition_ComCore

    .EcucPartition_ComCore_POSTBUILD_CONST ALIGN(4):
    {
        __EcucPartition_ComCore_POSTBUILD_CONST_START = .;

        *(.EcucPartition_ComCore_ASW_POSTBUILD_CONST_16)
        *(.EcucPartition_ComCore_ASW_POSTBUILD_CONST_32)
        *(.EcucPartition_ComCore_ASW_POSTBUILD_CONST_8)
        *(.EcucPartition_ComCore_ASW_POSTBUILD_CONST_BOOLEAN)
        *(.EcucPartition_ComCore_ASW_POSTBUILD_CONST_UNSPECIFIED)

        __EcucPartition_ComCore_POSTBUILD_CONST_END = .;
    } > Memlay_CONST_EcucPartition_ComCore

}

/* -------------------------------------------------------------------------- */
/* Sections of INIT                                                          */
/* -------------------------------------------------------------------------- */
SECTIONS
{

    .EcucPartition_ComCore_HSM_SHARED_VAR ALIGN(4):
    {
        __EcucPartition_ComCore_HSM_SHARED_VAR_START = .;

        *(.EcucPartition_ComCore_ASW_HSM_SHARED_VAR_16)
        *(.EcucPartition_ComCore_ASW_HSM_SHARED_VAR_32)
        *(.EcucPartition_ComCore_ASW_HSM_SHARED_VAR_8)
        *(.EcucPartition_ComCore_ASW_HSM_SHARED_VAR_BOOLEAN)
        *(.EcucPartition_ComCore_ASW_HSM_SHARED_VAR_UNSPECIFIED)

        __EcucPartition_ComCore_HSM_SHARED_VAR_END = .;
    } > Memlay_VAR_EcucPartition_ComCore

    .EcucPartition_ComCore_INTERNAL_VAR_INIT ALIGN(4):
    {
        __EcucPartition_ComCore_INTERNAL_VAR_INIT_START = .;

        *(.EcucPartition_ComCore_ASW_INTERNAL_VAR_INIT_16)
        *(.EcucPartition_ComCore_ASW_INTERNAL_VAR_INIT_32)
        *(.EcucPartition_ComCore_ASW_INTERNAL_VAR_INIT_8)
        *(.EcucPartition_ComCore_ASW_INTERNAL_VAR_INIT_BOOLEAN)
        *(.EcucPartition_ComCore_ASW_INTERNAL_VAR_INIT_UNSPECIFIED)

        __EcucPartition_ComCore_INTERNAL_VAR_INIT_END = .;
    } > Memlay_VAR_EcucPartition_ComCore

    .EcucPartition_ComCore_INTERNAL_VAR_POWER_ON_INIT ALIGN(4):
    {
        __EcucPartition_ComCore_INTERNAL_VAR_POWER_ON_INIT_START = .;

        *(.EcucPartition_ComCore_ASW_INTERNAL_VAR_POWER_ON_INIT_16)
        *(.EcucPartition_ComCore_ASW_INTERNAL_VAR_POWER_ON_INIT_32)
        *(.EcucPartition_ComCore_ASW_INTERNAL_VAR_POWER_ON_INIT_8)
        *(.EcucPartition_ComCore_ASW_INTERNAL_VAR_POWER_ON_INIT_BOOLEAN)
        *(.EcucPartition_ComCore_ASW_INTERNAL_VAR_POWER_ON_INIT_UNSPECIFIED)

        __EcucPartition_ComCore_INTERNAL_VAR_POWER_ON_INIT_END = .;
    } > Memlay_VAR_EcucPartition_ComCore

    .EcucPartition_ComCore_VAR_FAST_INIT ALIGN(4):
    {
        __EcucPartition_ComCore_VAR_FAST_INIT_START = .;

        *(.EcucPartition_ComCore_ASW_VAR_FAST_INIT_16)
        *(.EcucPartition_ComCore_ASW_VAR_FAST_INIT_32)
        *(.EcucPartition_ComCore_ASW_VAR_FAST_INIT_8)
        *(.EcucPartition_ComCore_ASW_VAR_FAST_INIT_BOOLEAN)
        *(.EcucPartition_ComCore_ASW_VAR_FAST_INIT_UNSPECIFIED)

        __EcucPartition_ComCore_VAR_FAST_INIT_END = .;
    } > Memlay_VAR_EcucPartition_ComCore

    .EcucPartition_ComCore_VAR_FAST_POWER_ON_INIT ALIGN(4):
    {
        __EcucPartition_ComCore_VAR_FAST_POWER_ON_INIT_START = .;

        *(.EcucPartition_ComCore_ASW_VAR_FAST_POWER_ON_INIT_16)
        *(.EcucPartition_ComCore_ASW_VAR_FAST_POWER_ON_INIT_32)
        *(.EcucPartition_ComCore_ASW_VAR_FAST_POWER_ON_INIT_8)
        *(.EcucPartition_ComCore_ASW_VAR_FAST_POWER_ON_INIT_BOOLEAN)
        *(.EcucPartition_ComCore_ASW_VAR_FAST_POWER_ON_INIT_UNSPECIFIED)

        __EcucPartition_ComCore_VAR_FAST_POWER_ON_INIT_END = .;
    } > Memlay_VAR_EcucPartition_ComCore

    .EcucPartition_ComCore_VAR_INIT ALIGN(4):
    {
        __EcucPartition_ComCore_VAR_INIT_START = .;

        *(.EcucPartition_ComCore_ASW_VAR_INIT_16)
        *(.EcucPartition_ComCore_ASW_VAR_INIT_32)
        *(.EcucPartition_ComCore_ASW_VAR_INIT_8)
        *(.EcucPartition_ComCore_ASW_VAR_INIT_BOOLEAN)
        *(.EcucPartition_ComCore_ASW_VAR_INIT_UNSPECIFIED)

        __EcucPartition_ComCore_VAR_INIT_END = .;
    } > Memlay_VAR_EcucPartition_ComCore

    .EcucPartition_ComCore_VAR_POWER_ON_INIT ALIGN(4):
    {
        __EcucPartition_ComCore_VAR_POWER_ON_INIT_START = .;

        *(.EcucPartition_ComCore_ASW_VAR_POWER_ON_INIT_16)
        *(.EcucPartition_ComCore_ASW_VAR_POWER_ON_INIT_32)
        *(.EcucPartition_ComCore_ASW_VAR_POWER_ON_INIT_8)
        *(.EcucPartition_ComCore_ASW_VAR_POWER_ON_INIT_BOOLEAN)
        *(.EcucPartition_ComCore_ASW_VAR_POWER_ON_INIT_UNSPECIFIED)

        __EcucPartition_ComCore_VAR_POWER_ON_INIT_END = .;
    } > Memlay_VAR_EcucPartition_ComCore

    .EcucPartition_ComCore_VAR_SLOW_INIT ALIGN(4):
    {
        __EcucPartition_ComCore_VAR_SLOW_INIT_START = .;

        *(.EcucPartition_ComCore_ASW_VAR_SLOW_INIT_16)
        *(.EcucPartition_ComCore_ASW_VAR_SLOW_INIT_32)
        *(.EcucPartition_ComCore_ASW_VAR_SLOW_INIT_8)
        *(.EcucPartition_ComCore_ASW_VAR_SLOW_INIT_BOOLEAN)
        *(.EcucPartition_ComCore_ASW_VAR_SLOW_INIT_UNSPECIFIED)

        __EcucPartition_ComCore_VAR_SLOW_INIT_END = .;
    } > Memlay_VAR_EcucPartition_ComCore

    .EcucPartition_ComCore_VAR_SLOW_POWER_ON_INIT ALIGN(4):
    {
        __EcucPartition_ComCore_VAR_SLOW_POWER_ON_INIT_START = .;

        *(.EcucPartition_ComCore_ASW_VAR_SLOW_POWER_ON_INIT_16)
        *(.EcucPartition_ComCore_ASW_VAR_SLOW_POWER_ON_INIT_32)
        *(.EcucPartition_ComCore_ASW_VAR_SLOW_POWER_ON_INIT_8)
        *(.EcucPartition_ComCore_ASW_VAR_SLOW_POWER_ON_INIT_BOOLEAN)
        *(.EcucPartition_ComCore_ASW_VAR_SLOW_POWER_ON_INIT_UNSPECIFIED)

        __EcucPartition_ComCore_VAR_SLOW_POWER_ON_INIT_END = .;
    } > Memlay_VAR_EcucPartition_ComCore

}

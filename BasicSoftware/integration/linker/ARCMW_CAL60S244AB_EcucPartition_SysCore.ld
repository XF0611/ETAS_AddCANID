/*----------------------------------------------------------------------------*/
/*
 * File: ARCMW_CAL60S244AB_EcucPartition_SysCore.ld
 * Generated by: TAN9SGH
 * Version: ETAS Cobra 2.0
 * on: 2022/12/29 14:29
*/
/*----------------------------------------------------------------------------*/
/* -------------------------------------------------------------------------- */
/* Sections of CODE                                                          */
/* -------------------------------------------------------------------------- */
SECTIONS
{

    .EcucPartition_SysCore_CALLOUT_CODE ALIGN(4):
    {
        __EcucPartition_SysCore_CALLOUT_CODE_START = .;

        *(.EcucPartition_SysCore_ASW_CALLOUT_CODE)

        __EcucPartition_SysCore_CALLOUT_CODE_END = .;
    } > Memlay_CODE_EcucPartition_SysCore

    .EcucPartition_SysCore_CODE ALIGN(4):
    {
        __EcucPartition_SysCore_CODE_START = .;

        *(.EcucPartition_SysCore_ASW_CODE)
        *(.EcucPartition_SysCore_BSW_CODE)
        *(.EcucPartition_SysCore_BSW_CODE)
        *(.EcucPartition_SysCore_RTE_CODE)

        __EcucPartition_SysCore_CODE_END = .;
    } > Memlay_CODE_EcucPartition_SysCore

    .EcucPartition_SysCore_CODE_FAST ALIGN(4):
    {
        __EcucPartition_SysCore_CODE_FAST_START = .;

        *(.EcucPartition_SysCore_ASW_CODE_FAST)
        *(.EcucPartition_SysCore_BSW_CODE_FAST)

        __EcucPartition_SysCore_CODE_FAST_END = .;
    } > Memlay_CODE_EcucPartition_SysCore

    .EcucPartition_SysCore_CODE_SLOW ALIGN(4):
    {
        __EcucPartition_SysCore_CODE_SLOW_START = .;

        *(.EcucPartition_SysCore_ASW_CODE_SLOW)

        __EcucPartition_SysCore_CODE_SLOW_END = .;
    } > Memlay_CODE_EcucPartition_SysCore

    .EcucPartition_SysCore_SPRAM_CODE ALIGN(4):
    {
        __EcucPartition_SysCore_SPRAM_CODE_START = .;

        *(.EcucPartition_SysCore_BSW_SPRAM_CODE)

        __EcucPartition_SysCore_SPRAM_CODE_END = .;
    } > Memlay_CODE_EcucPartition_SysCore

    .EcucPartition_SysCore_VECTORS ALIGN(4):
    {
        __EcucPartition_SysCore_VECTORS_START = .;

        *(.EcucPartition_SysCore_ASW_VECTORS)

        __EcucPartition_SysCore_VECTORS_END = .;
    } > Memlay_CODE_EcucPartition_SysCore

}

/* -------------------------------------------------------------------------- */
/* Sections of CLEARED                                                          */
/* -------------------------------------------------------------------------- */
SECTIONS
{

    .EcucPartition_SysCore_CORE1_VAR_CLEARED ALIGN(4):
    {
        __EcucPartition_SysCore_CORE1_VAR_CLEARED_START = .;

        *(.EcucPartition_SysCore_BSW_CORE1_VAR_CLEARED_16)
        *(.EcucPartition_SysCore_BSW_CORE1_VAR_CLEARED_32)
        *(.EcucPartition_SysCore_BSW_CORE1_VAR_CLEARED_64)
        *(.EcucPartition_SysCore_BSW_CORE1_VAR_CLEARED_8)
        *(.EcucPartition_SysCore_BSW_CORE1_VAR_CLEARED_UNSPECIFIED)

        __EcucPartition_SysCore_CORE1_VAR_CLEARED_END = .;
    } > Memlay_VAR_EcucPartition_SysCore

    .EcucPartition_SysCore_CORE2_VAR_CLEARED ALIGN(4):
    {
        __EcucPartition_SysCore_CORE2_VAR_CLEARED_START = .;

        *(.EcucPartition_SysCore_BSW_CORE2_VAR_CLEARED_16)
        *(.EcucPartition_SysCore_BSW_CORE2_VAR_CLEARED_32)
        *(.EcucPartition_SysCore_BSW_CORE2_VAR_CLEARED_64)
        *(.EcucPartition_SysCore_BSW_CORE2_VAR_CLEARED_8)
        *(.EcucPartition_SysCore_BSW_CORE2_VAR_CLEARED_UNSPECIFIED)

        __EcucPartition_SysCore_CORE2_VAR_CLEARED_END = .;
    } > Memlay_VAR_EcucPartition_SysCore

    .EcucPartition_SysCore_CORE3_VAR_CLEARED ALIGN(4):
    {
        __EcucPartition_SysCore_CORE3_VAR_CLEARED_START = .;

        *(.EcucPartition_SysCore_BSW_CORE3_VAR_CLEARED_16)
        *(.EcucPartition_SysCore_BSW_CORE3_VAR_CLEARED_32)
        *(.EcucPartition_SysCore_BSW_CORE3_VAR_CLEARED_64)
        *(.EcucPartition_SysCore_BSW_CORE3_VAR_CLEARED_8)
        *(.EcucPartition_SysCore_BSW_CORE3_VAR_CLEARED_UNSPECIFIED)

        __EcucPartition_SysCore_CORE3_VAR_CLEARED_END = .;
    } > Memlay_VAR_EcucPartition_SysCore

    .EcucPartition_SysCore_CORE4_VAR_CLEARED ALIGN(4):
    {
        __EcucPartition_SysCore_CORE4_VAR_CLEARED_START = .;

        *(.EcucPartition_SysCore_BSW_CORE4_VAR_CLEARED_16)
        *(.EcucPartition_SysCore_BSW_CORE4_VAR_CLEARED_32)
        *(.EcucPartition_SysCore_BSW_CORE4_VAR_CLEARED_64)
        *(.EcucPartition_SysCore_BSW_CORE4_VAR_CLEARED_8)
        *(.EcucPartition_SysCore_BSW_CORE4_VAR_CLEARED_UNSPECIFIED)

        __EcucPartition_SysCore_CORE4_VAR_CLEARED_END = .;
    } > Memlay_VAR_EcucPartition_SysCore

    .EcucPartition_SysCore_CORE5_VAR_CLEARED ALIGN(4):
    {
        __EcucPartition_SysCore_CORE5_VAR_CLEARED_START = .;

        *(.EcucPartition_SysCore_BSW_CORE5_VAR_CLEARED_16)
        *(.EcucPartition_SysCore_BSW_CORE5_VAR_CLEARED_32)
        *(.EcucPartition_SysCore_BSW_CORE5_VAR_CLEARED_64)
        *(.EcucPartition_SysCore_BSW_CORE5_VAR_CLEARED_8)
        *(.EcucPartition_SysCore_BSW_CORE5_VAR_CLEARED_UNSPECIFIED)

        __EcucPartition_SysCore_CORE5_VAR_CLEARED_END = .;
    } > Memlay_VAR_EcucPartition_SysCore

    .EcucPartition_SysCore_CORE6_VAR_CLEARED ALIGN(4):
    {
        __EcucPartition_SysCore_CORE6_VAR_CLEARED_START = .;

        *(.EcucPartition_SysCore_BSW_CORE6_VAR_CLEARED_16)
        *(.EcucPartition_SysCore_BSW_CORE6_VAR_CLEARED_32)
        *(.EcucPartition_SysCore_BSW_CORE6_VAR_CLEARED_64)
        *(.EcucPartition_SysCore_BSW_CORE6_VAR_CLEARED_8)
        *(.EcucPartition_SysCore_BSW_CORE6_VAR_CLEARED_UNSPECIFIED)

        __EcucPartition_SysCore_CORE6_VAR_CLEARED_END = .;
    } > Memlay_VAR_EcucPartition_SysCore

    .EcucPartition_SysCore_INTERNAL_VAR_CLEARED ALIGN(4):
    {
        __EcucPartition_SysCore_INTERNAL_VAR_CLEARED_START = .;

        *(.EcucPartition_SysCore_ASW_INTERNAL_VAR_CLEARED_16)
        *(.EcucPartition_SysCore_ASW_INTERNAL_VAR_CLEARED_32)
        *(.EcucPartition_SysCore_ASW_INTERNAL_VAR_CLEARED_8)
        *(.EcucPartition_SysCore_ASW_INTERNAL_VAR_CLEARED_BOOLEAN)
        *(.EcucPartition_SysCore_ASW_INTERNAL_VAR_CLEARED_UNSPECIFIED)

        __EcucPartition_SysCore_INTERNAL_VAR_CLEARED_END = .;
    } > Memlay_VAR_EcucPartition_SysCore

    /*Those session should not be added into clear and copy tables*/
    .EcucPartition_SysCore_INTERNAL_VAR_NO_INIT ALIGN(4):
    {
        __EcucPartition_SysCore_INTERNAL_VAR_NO_INIT_START = .;

        *(.EcucPartition_SysCore_ASW_INTERNAL_VAR_NO_INIT_16)
        *(.EcucPartition_SysCore_ASW_INTERNAL_VAR_NO_INIT_32)
        *(.EcucPartition_SysCore_ASW_INTERNAL_VAR_NO_INIT_8)
        *(.EcucPartition_SysCore_ASW_INTERNAL_VAR_NO_INIT_BOOLEAN)
        *(.EcucPartition_SysCore_ASW_INTERNAL_VAR_NO_INIT_UNSPECIFIED)

        __EcucPartition_SysCore_INTERNAL_VAR_NO_INIT_END = .;
    } > Memlay_VAR_EcucPartition_SysCore

    .EcucPartition_SysCore_INTERNAL_VAR_POWER_ON_CLEARED ALIGN(4):
    {
        __EcucPartition_SysCore_INTERNAL_VAR_POWER_ON_CLEARED_START = .;

        *(.EcucPartition_SysCore_ASW_INTERNAL_VAR_POWER_ON_CLEARED_16)
        *(.EcucPartition_SysCore_ASW_INTERNAL_VAR_POWER_ON_CLEARED_32)
        *(.EcucPartition_SysCore_ASW_INTERNAL_VAR_POWER_ON_CLEARED_8)
        *(.EcucPartition_SysCore_ASW_INTERNAL_VAR_POWER_ON_CLEARED_BOOLEAN)
        *(.EcucPartition_SysCore_ASW_INTERNAL_VAR_POWER_ON_CLEARED_UNSPECIFIED)

        __EcucPartition_SysCore_INTERNAL_VAR_POWER_ON_CLEARED_END = .;
    } > Memlay_VAR_EcucPartition_SysCore

    .EcucPartition_SysCore_POSTBUILD_VAR_NO_INIT ALIGN(4):
    {
        __EcucPartition_SysCore_POSTBUILD_VAR_NO_INIT_START = .;

        *(.EcucPartition_SysCore_ASW_POSTBUILD_VAR_NO_INIT_16)
        *(.EcucPartition_SysCore_ASW_POSTBUILD_VAR_NO_INIT_32)
        *(.EcucPartition_SysCore_ASW_POSTBUILD_VAR_NO_INIT_8)
        *(.EcucPartition_SysCore_ASW_POSTBUILD_VAR_NO_INIT_BOOLEAN)
        *(.EcucPartition_SysCore_ASW_POSTBUILD_VAR_NO_INIT_UNSPECIFIED)

        __EcucPartition_SysCore_POSTBUILD_VAR_NO_INIT_END = .;
    } > Memlay_VAR_EcucPartition_SysCore

    .EcucPartition_SysCore_RAM0_CLEARED ALIGN(4):
    {
        __EcucPartition_SysCore_RAM0_CLEARED_START = .;

        *(.EcucPartition_SysCore_BSW_RAM0_CLEARED_16)
        *(.EcucPartition_SysCore_BSW_RAM0_CLEARED_32)
        *(.EcucPartition_SysCore_BSW_RAM0_CLEARED_8)
        *(.EcucPartition_SysCore_BSW_RAM0_CLEARED_UNSPECIFIED)

        __EcucPartition_SysCore_RAM0_CLEARED_END = .;
    } > Memlay_VAR_EcucPartition_SysCore

    .EcucPartition_SysCore_RESET_SAFE_RAM0 ALIGN(4):
    {
        __EcucPartition_SysCore_RESET_SAFE_RAM0_START = .;

        *(.EcucPartition_SysCore_ASW_RESET_SAFE_RAM0_16)
        *(.EcucPartition_SysCore_ASW_RESET_SAFE_RAM0_32)
        *(.EcucPartition_SysCore_ASW_RESET_SAFE_RAM0_8)
        *(.EcucPartition_SysCore_ASW_RESET_SAFE_RAM0_BOOLEAN)
        *(.EcucPartition_SysCore_ASW_RESET_SAFE_RAM0_UNSPECIFIED)
        *(.EcucPartition_SysCore_BSW_RESET_SAFE_RAM0_32)
        *(.EcucPartition_SysCore_BSW_RESET_SAFE_RAM0_UNSPECIFIED)

        __EcucPartition_SysCore_RESET_SAFE_RAM0_END = .;
    } > Memlay_VAR_EcucPartition_SysCore

    .EcucPartition_SysCore_SAVED_ZONE ALIGN(4):
    {
        __EcucPartition_SysCore_SAVED_ZONE_START = .;

        *(.EcucPartition_SysCore_ASW_SAVED_ZONE_16)
        *(.EcucPartition_SysCore_ASW_SAVED_ZONE_32)
        *(.EcucPartition_SysCore_ASW_SAVED_ZONE_8)
        *(.EcucPartition_SysCore_ASW_SAVED_ZONE_BOOLEAN)
        *(.EcucPartition_SysCore_ASW_SAVED_ZONE_UNSPECIFIED)
        *(.EcucPartition_SysCore_BSW_SAVED_ZONE_16)
        *(.EcucPartition_SysCore_BSW_SAVED_ZONE_32)
        *(.EcucPartition_SysCore_BSW_SAVED_ZONE_8)
        *(.EcucPartition_SysCore_BSW_SAVED_ZONE_UNSPECIFIED)

        __EcucPartition_SysCore_SAVED_ZONE_END = .;
    } > Memlay_VAR_EcucPartition_SysCore

    .EcucPartition_SysCore_SHAREDMEMORY ALIGN(4):
    {
        __EcucPartition_SysCore_SHAREDMEMORY_START = .;

        *(.EcucPartition_SysCore_ASW_SHAREDMEMORY_16)
        *(.EcucPartition_SysCore_ASW_SHAREDMEMORY_32)
        *(.EcucPartition_SysCore_ASW_SHAREDMEMORY_8)
        *(.EcucPartition_SysCore_ASW_SHAREDMEMORY_BOOLEAN)
        *(.EcucPartition_SysCore_ASW_SHAREDMEMORY_UNSPECIFIED)

        __EcucPartition_SysCore_SHAREDMEMORY_END = .;
    } > Memlay_VAR_EcucPartition_SysCore

    .EcucPartition_SysCore_VAR_CLEARED ALIGN(4):
    {
        __EcucPartition_SysCore_VAR_CLEARED_START = .;

        *(.EcucPartition_SysCore_ASW_VAR_CLEARED_16)
        *(.EcucPartition_SysCore_ASW_VAR_CLEARED_32)
        *(.EcucPartition_SysCore_ASW_VAR_CLEARED_8)
        *(.EcucPartition_SysCore_ASW_VAR_CLEARED_BOOLEAN)
        *(.EcucPartition_SysCore_ASW_VAR_CLEARED_UNSPECIFIED)
        *(.EcucPartition_SysCore_BSW_VAR_CLEARED_16)
        *(.EcucPartition_SysCore_BSW_VAR_CLEARED_32)
        *(.EcucPartition_SysCore_BSW_VAR_CLEARED_8)
        *(.EcucPartition_SysCore_BSW_VAR_CLEARED_BOOLEAN)
        *(.EcucPartition_SysCore_BSW_VAR_CLEARED_SECURED_32)
        *(.EcucPartition_SysCore_BSW_VAR_CLEARED_SECURED_8)
        *(.EcucPartition_SysCore_BSW_VAR_CLEARED_SECURED_CACHE_LINE_ALIGNED_UNSPECIFIED)
        *(.EcucPartition_SysCore_BSW_VAR_CLEARED_SECURED_UNSPECIFIED)
        *(.EcucPartition_SysCore_BSW_VAR_CLEARED_UNSPECIFIED)
        *(.EcucPartition_SysCore_RTE_VAR_CLEARED_32)
        *(.EcucPartition_SysCore_RTE_VAR_CLEARED_8)
        *(.EcucPartition_SysCore_RTE_VAR_CLEARED_BOOLEAN)

        __EcucPartition_SysCore_VAR_CLEARED_END = .;
    } > Memlay_VAR_EcucPartition_SysCore

    .EcucPartition_SysCore_VAR_CLEARED_POSTBUILD ALIGN(4):
    {
        __EcucPartition_SysCore_VAR_CLEARED_POSTBUILD_START = .;

        *(.EcucPartition_SysCore_ASW_VAR_CLEARED_POSTBUILD_16)
        *(.EcucPartition_SysCore_ASW_VAR_CLEARED_POSTBUILD_32)
        *(.EcucPartition_SysCore_ASW_VAR_CLEARED_POSTBUILD_8)
        *(.EcucPartition_SysCore_ASW_VAR_CLEARED_POSTBUILD_BOOLEAN)
        *(.EcucPartition_SysCore_ASW_VAR_CLEARED_POSTBUILD_UNSPECIFIED)
        *(.EcucPartition_SysCore_BSW_VAR_CLEARED_POSTBUILD_16)
        *(.EcucPartition_SysCore_BSW_VAR_CLEARED_POSTBUILD_32)
        *(.EcucPartition_SysCore_BSW_VAR_CLEARED_POSTBUILD_8)
        *(.EcucPartition_SysCore_BSW_VAR_CLEARED_POSTBUILD_BOOLEAN)
        *(.EcucPartition_SysCore_BSW_VAR_CLEARED_POSTBUILD_UNSPECIFIED)

        __EcucPartition_SysCore_VAR_CLEARED_POSTBUILD_END = .;
    } > Memlay_VAR_EcucPartition_SysCore

    .EcucPartition_SysCore_VAR_ED_POWER_ON_CLEARED ALIGN(4):
    {
        __EcucPartition_SysCore_VAR_ED_POWER_ON_CLEARED_START = .;

        *(.EcucPartition_SysCore_BSW_VAR_ED_POWER_ON_CLEARED_32)

        __EcucPartition_SysCore_VAR_ED_POWER_ON_CLEARED_END = .;
    } > Memlay_VAR_EcucPartition_SysCore

    .EcucPartition_SysCore_VAR_FAST_CLEARED ALIGN(4):
    {
        __EcucPartition_SysCore_VAR_FAST_CLEARED_START = .;

        *(.EcucPartition_SysCore_ASW_VAR_FAST_CLEARED_16)
        *(.EcucPartition_SysCore_ASW_VAR_FAST_CLEARED_32)
        *(.EcucPartition_SysCore_ASW_VAR_FAST_CLEARED_8)
        *(.EcucPartition_SysCore_ASW_VAR_FAST_CLEARED_BOOLEAN)
        *(.EcucPartition_SysCore_ASW_VAR_FAST_CLEARED_UNSPECIFIED)
        *(.EcucPartition_SysCore_BSW_VAR_FAST_CLEARED_16)
        *(.EcucPartition_SysCore_BSW_VAR_FAST_CLEARED_8)
        *(.EcucPartition_SysCore_BSW_VAR_FAST_CLEARED_UNSPECIFIED)

        __EcucPartition_SysCore_VAR_FAST_CLEARED_END = .;
    } > Memlay_VAR_EcucPartition_SysCore

    /*Those session should not be added into clear and copy tables*/
    .EcucPartition_SysCore_VAR_FAST_NO_INIT ALIGN(4):
    {
        __EcucPartition_SysCore_VAR_FAST_NO_INIT_START = .;

        *(.EcucPartition_SysCore_ASW_VAR_FAST_NO_INIT_16)
        *(.EcucPartition_SysCore_ASW_VAR_FAST_NO_INIT_32)
        *(.EcucPartition_SysCore_ASW_VAR_FAST_NO_INIT_8)
        *(.EcucPartition_SysCore_ASW_VAR_FAST_NO_INIT_BOOLEAN)
        *(.EcucPartition_SysCore_ASW_VAR_FAST_NO_INIT_UNSPECIFIED)

        __EcucPartition_SysCore_VAR_FAST_NO_INIT_END = .;
    } > Memlay_VAR_EcucPartition_SysCore

    .EcucPartition_SysCore_VAR_FAST_POWER_ON_CLEARED ALIGN(4):
    {
        __EcucPartition_SysCore_VAR_FAST_POWER_ON_CLEARED_START = .;

        *(.EcucPartition_SysCore_ASW_VAR_FAST_POWER_ON_CLEARED_16)
        *(.EcucPartition_SysCore_ASW_VAR_FAST_POWER_ON_CLEARED_32)
        *(.EcucPartition_SysCore_ASW_VAR_FAST_POWER_ON_CLEARED_8)
        *(.EcucPartition_SysCore_ASW_VAR_FAST_POWER_ON_CLEARED_BOOLEAN)
        *(.EcucPartition_SysCore_ASW_VAR_FAST_POWER_ON_CLEARED_UNSPECIFIED)

        __EcucPartition_SysCore_VAR_FAST_POWER_ON_CLEARED_END = .;
    } > Memlay_VAR_EcucPartition_SysCore

    /*Those session should not be added into clear and copy tables*/
    .EcucPartition_SysCore_VAR_NO_INIT ALIGN(4):
    {
        __EcucPartition_SysCore_VAR_NO_INIT_START = .;

        *(.EcucPartition_SysCore_ASW_VAR_NO_INIT_16)
        *(.EcucPartition_SysCore_ASW_VAR_NO_INIT_32)
        *(.EcucPartition_SysCore_ASW_VAR_NO_INIT_8)
        *(.EcucPartition_SysCore_ASW_VAR_NO_INIT_BOOLEAN)
        *(.EcucPartition_SysCore_ASW_VAR_NO_INIT_UNSPECIFIED)

        __EcucPartition_SysCore_VAR_NO_INIT_END = .;
    } > Memlay_VAR_EcucPartition_SysCore

    .EcucPartition_SysCore_VAR_POWER_ON_CLEARED ALIGN(4):
    {
        __EcucPartition_SysCore_VAR_POWER_ON_CLEARED_START = .;

        *(.EcucPartition_SysCore_ASW_VAR_POWER_ON_CLEARED_16)
        *(.EcucPartition_SysCore_ASW_VAR_POWER_ON_CLEARED_32)
        *(.EcucPartition_SysCore_ASW_VAR_POWER_ON_CLEARED_8)
        *(.EcucPartition_SysCore_ASW_VAR_POWER_ON_CLEARED_BOOLEAN)
        *(.EcucPartition_SysCore_ASW_VAR_POWER_ON_CLEARED_UNSPECIFIED)

        __EcucPartition_SysCore_VAR_POWER_ON_CLEARED_END = .;
    } > Memlay_VAR_EcucPartition_SysCore

    .EcucPartition_SysCore_VAR_SAVED_ZONE ALIGN(4):
    {
        __EcucPartition_SysCore_VAR_SAVED_ZONE_START = .;

        *(.EcucPartition_SysCore_ASW_VAR_SAVED_ZONE_16)
        *(.EcucPartition_SysCore_ASW_VAR_SAVED_ZONE_32)
        *(.EcucPartition_SysCore_ASW_VAR_SAVED_ZONE_8)
        *(.EcucPartition_SysCore_ASW_VAR_SAVED_ZONE_BOOLEAN)
        *(.EcucPartition_SysCore_ASW_VAR_SAVED_ZONE_UNSPECIFIED)
        *(.EcucPartition_SysCore_BSW_VAR_SAVED_ZONE0_UNSPECIFIED)
        *(.EcucPartition_SysCore_BSW_VAR_SAVED_ZONE_UNSPECIFIED)

        __EcucPartition_SysCore_VAR_SAVED_ZONE_END = .;
    } > Memlay_VAR_EcucPartition_SysCore

    .EcucPartition_SysCore_VAR_SLOW_CLEARED ALIGN(4):
    {
        __EcucPartition_SysCore_VAR_SLOW_CLEARED_START = .;

        *(.EcucPartition_SysCore_ASW_VAR_SLOW_CLEARED_16)
        *(.EcucPartition_SysCore_ASW_VAR_SLOW_CLEARED_32)
        *(.EcucPartition_SysCore_ASW_VAR_SLOW_CLEARED_8)
        *(.EcucPartition_SysCore_ASW_VAR_SLOW_CLEARED_BOOLEAN)
        *(.EcucPartition_SysCore_ASW_VAR_SLOW_CLEARED_UNSPECIFIED)

        __EcucPartition_SysCore_VAR_SLOW_CLEARED_END = .;
    } > Memlay_VAR_EcucPartition_SysCore

    /*Those session should not be added into clear and copy tables*/
    .EcucPartition_SysCore_VAR_SLOW_NO_INIT ALIGN(4):
    {
        __EcucPartition_SysCore_VAR_SLOW_NO_INIT_START = .;

        *(.EcucPartition_SysCore_ASW_VAR_SLOW_NO_INIT_16)
        *(.EcucPartition_SysCore_ASW_VAR_SLOW_NO_INIT_32)
        *(.EcucPartition_SysCore_ASW_VAR_SLOW_NO_INIT_8)
        *(.EcucPartition_SysCore_ASW_VAR_SLOW_NO_INIT_BOOLEAN)
        *(.EcucPartition_SysCore_ASW_VAR_SLOW_NO_INIT_UNSPECIFIED)

        __EcucPartition_SysCore_VAR_SLOW_NO_INIT_END = .;
    } > Memlay_VAR_EcucPartition_SysCore

    .EcucPartition_SysCore_VAR_SLOW_POWER_ON_CLEARED ALIGN(4):
    {
        __EcucPartition_SysCore_VAR_SLOW_POWER_ON_CLEARED_START = .;

        *(.EcucPartition_SysCore_ASW_VAR_SLOW_POWER_ON_CLEARED_16)
        *(.EcucPartition_SysCore_ASW_VAR_SLOW_POWER_ON_CLEARED_32)
        *(.EcucPartition_SysCore_ASW_VAR_SLOW_POWER_ON_CLEARED_8)
        *(.EcucPartition_SysCore_ASW_VAR_SLOW_POWER_ON_CLEARED_BOOLEAN)
        *(.EcucPartition_SysCore_ASW_VAR_SLOW_POWER_ON_CLEARED_UNSPECIFIED)

        __EcucPartition_SysCore_VAR_SLOW_POWER_ON_CLEARED_END = .;
    } > Memlay_VAR_EcucPartition_SysCore

    .EcucPartition_SysCore_VAR_TRACE ALIGN(4):
    {
        __EcucPartition_SysCore_VAR_TRACE_START = .;

        *(.EcucPartition_SysCore_ASW_VAR_TRACE_16)
        *(.EcucPartition_SysCore_ASW_VAR_TRACE_32)
        *(.EcucPartition_SysCore_ASW_VAR_TRACE_8)
        *(.EcucPartition_SysCore_ASW_VAR_TRACE_BOOLEAN)
        *(.EcucPartition_SysCore_ASW_VAR_TRACE_UNSPECIFIED)

        __EcucPartition_SysCore_VAR_TRACE_END = .;
    } > Memlay_VAR_EcucPartition_SysCore

}

/* -------------------------------------------------------------------------- */
/* Sections of INIT (store in PF load on ram)                                 */
/* -------------------------------------------------------------------------- */
SECTIONS
{

    .EcucPartition_SysCore_HSM_SHARED_VAR ALIGN(4):
    {
        __EcucPartition_SysCore_HSM_SHARED_VAR_START = .;

        *(.EcucPartition_SysCore_ASW_HSM_SHARED_VAR_16)
        *(.EcucPartition_SysCore_ASW_HSM_SHARED_VAR_32)
        *(.EcucPartition_SysCore_ASW_HSM_SHARED_VAR_8)
        *(.EcucPartition_SysCore_ASW_HSM_SHARED_VAR_BOOLEAN)
        *(.EcucPartition_SysCore_ASW_HSM_SHARED_VAR_UNSPECIFIED)

        __EcucPartition_SysCore_HSM_SHARED_VAR_END = .;
    } > Memlay_VAR_EcucPartition_SysCore

    .EcucPartition_SysCore_INTERNAL_VAR_INIT ALIGN(4):
    {
        __EcucPartition_SysCore_INTERNAL_VAR_INIT_START = .;

        *(.EcucPartition_SysCore_ASW_INTERNAL_VAR_INIT_16)
        *(.EcucPartition_SysCore_ASW_INTERNAL_VAR_INIT_32)
        *(.EcucPartition_SysCore_ASW_INTERNAL_VAR_INIT_8)
        *(.EcucPartition_SysCore_ASW_INTERNAL_VAR_INIT_BOOLEAN)
        *(.EcucPartition_SysCore_ASW_INTERNAL_VAR_INIT_UNSPECIFIED)

        __EcucPartition_SysCore_INTERNAL_VAR_INIT_END = .;
    } > Memlay_VAR_EcucPartition_SysCore

    .EcucPartition_SysCore_INTERNAL_VAR_POWER_ON_INIT ALIGN(4):
    {
        __EcucPartition_SysCore_INTERNAL_VAR_POWER_ON_INIT_START = .;

        *(.EcucPartition_SysCore_ASW_INTERNAL_VAR_POWER_ON_INIT_16)
        *(.EcucPartition_SysCore_ASW_INTERNAL_VAR_POWER_ON_INIT_32)
        *(.EcucPartition_SysCore_ASW_INTERNAL_VAR_POWER_ON_INIT_8)
        *(.EcucPartition_SysCore_ASW_INTERNAL_VAR_POWER_ON_INIT_BOOLEAN)
        *(.EcucPartition_SysCore_ASW_INTERNAL_VAR_POWER_ON_INIT_UNSPECIFIED)

        __EcucPartition_SysCore_INTERNAL_VAR_POWER_ON_INIT_END = .;
    } > Memlay_VAR_EcucPartition_SysCore   

    .EcucPartition_SysCore_RAM0_INIT ALIGN(4):
    {
        __EcucPartition_SysCore_RAM0_INIT_START = .;

        *(.EcucPartition_SysCore_BSW_RAM0_INIT_16)
        *(.EcucPartition_SysCore_BSW_RAM0_INIT_32)
        *(.EcucPartition_SysCore_BSW_RAM0_INIT_8)
        *(.EcucPartition_SysCore_BSW_RAM0_INIT_UNSPECIFIED)

        __EcucPartition_SysCore_RAM0_INIT_END = .;
    } > Memlay_VAR_EcucPartition_SysCore

    .EcucPartition_SysCore_VAR_FAST_INIT ALIGN(4):
    {
        __EcucPartition_SysCore_VAR_FAST_INIT_START = .;

        *(.EcucPartition_SysCore_ASW_VAR_FAST_INIT_16)
        *(.EcucPartition_SysCore_ASW_VAR_FAST_INIT_32)
        *(.EcucPartition_SysCore_ASW_VAR_FAST_INIT_8)
        *(.EcucPartition_SysCore_ASW_VAR_FAST_INIT_BOOLEAN)
        *(.EcucPartition_SysCore_ASW_VAR_FAST_INIT_UNSPECIFIED)
        *(.EcucPartition_SysCore_BSW_VAR_FAST_INIT_8)

        __EcucPartition_SysCore_VAR_FAST_INIT_END = .;
    } > Memlay_VAR_EcucPartition_SysCore

    .EcucPartition_SysCore_VAR_FAST_POWER_ON_INIT ALIGN(4):
    {
        __EcucPartition_SysCore_VAR_FAST_POWER_ON_INIT_START = .;

        *(.EcucPartition_SysCore_ASW_VAR_FAST_POWER_ON_INIT_16)
        *(.EcucPartition_SysCore_ASW_VAR_FAST_POWER_ON_INIT_32)
        *(.EcucPartition_SysCore_ASW_VAR_FAST_POWER_ON_INIT_8)
        *(.EcucPartition_SysCore_ASW_VAR_FAST_POWER_ON_INIT_BOOLEAN)
        *(.EcucPartition_SysCore_ASW_VAR_FAST_POWER_ON_INIT_UNSPECIFIED)

        __EcucPartition_SysCore_VAR_FAST_POWER_ON_INIT_END = .;
    } > Memlay_VAR_EcucPartition_SysCore

    .EcucPartition_SysCore_VAR_INIT ALIGN(4):
    {
        __EcucPartition_SysCore_VAR_INIT_START = .;

        *(.EcucPartition_SysCore_ASW_VAR_INIT_16)
        *(.EcucPartition_SysCore_ASW_VAR_INIT_32)
        *(.EcucPartition_SysCore_ASW_VAR_INIT_8)
        *(.EcucPartition_SysCore_ASW_VAR_INIT_BOOLEAN)
        *(.EcucPartition_SysCore_ASW_VAR_INIT_UNSPECIFIED)
        *(.EcucPartition_SysCore_BSW_VAR_INIT_16)
        *(.EcucPartition_SysCore_BSW_VAR_INIT_32)
        *(.EcucPartition_SysCore_BSW_VAR_INIT_8)
        *(.EcucPartition_SysCore_BSW_VAR_INIT_BOOLEAN)
        *(.EcucPartition_SysCore_BSW_VAR_INIT_UNSPECIFIED)
        *(.EcucPartition_SysCore_RTE_VAR_INIT_8)

        __EcucPartition_SysCore_VAR_INIT_END = .;
    } > Memlay_VAR_EcucPartition_SysCore

    .EcucPartition_SysCore_VAR_POWER_ON_INIT ALIGN(4):
    {
        __EcucPartition_SysCore_VAR_POWER_ON_INIT_START = .;

        *(.EcucPartition_SysCore_ASW_VAR_POWER_ON_INIT_16)
        *(.EcucPartition_SysCore_ASW_VAR_POWER_ON_INIT_32)
        *(.EcucPartition_SysCore_ASW_VAR_POWER_ON_INIT_8)
        *(.EcucPartition_SysCore_ASW_VAR_POWER_ON_INIT_BOOLEAN)
        *(.EcucPartition_SysCore_ASW_VAR_POWER_ON_INIT_UNSPECIFIED)

        __EcucPartition_SysCore_VAR_POWER_ON_INIT_END = .;
    } > Memlay_VAR_EcucPartition_SysCore

    .EcucPartition_SysCore_VAR_SLOW_INIT ALIGN(4):
    {
        __EcucPartition_SysCore_VAR_SLOW_INIT_START = .;

        *(.EcucPartition_SysCore_ASW_VAR_SLOW_INIT_16)
        *(.EcucPartition_SysCore_ASW_VAR_SLOW_INIT_32)
        *(.EcucPartition_SysCore_ASW_VAR_SLOW_INIT_8)
        *(.EcucPartition_SysCore_ASW_VAR_SLOW_INIT_BOOLEAN)
        *(.EcucPartition_SysCore_ASW_VAR_SLOW_INIT_UNSPECIFIED)

        __EcucPartition_SysCore_VAR_SLOW_INIT_END = .;
    } > Memlay_VAR_EcucPartition_SysCore

    .EcucPartition_SysCore_VAR_SLOW_POWER_ON_INIT ALIGN(4):
    {
        __EcucPartition_SysCore_VAR_SLOW_POWER_ON_INIT_START = .;

        *(.EcucPartition_SysCore_ASW_VAR_SLOW_POWER_ON_INIT_16)
        *(.EcucPartition_SysCore_ASW_VAR_SLOW_POWER_ON_INIT_32)
        *(.EcucPartition_SysCore_ASW_VAR_SLOW_POWER_ON_INIT_8)
        *(.EcucPartition_SysCore_ASW_VAR_SLOW_POWER_ON_INIT_BOOLEAN)
        *(.EcucPartition_SysCore_ASW_VAR_SLOW_POWER_ON_INIT_UNSPECIFIED)

        __EcucPartition_SysCore_VAR_SLOW_POWER_ON_INIT_END = .;
    } > Memlay_VAR_EcucPartition_SysCore

}

/* -------------------------------------------------------------------------- */
/* Sections of CONST                                                          */
/* -------------------------------------------------------------------------- */
SECTIONS
{
    GROUP SIZE(SIZEOF(Memlay_CALIB_EcucPartition_SysCore)) : 
    {
        .EcucPartition_SysCore_CALIB ALIGN(4):
        {
            __EcucPartition_SysCore_CALIB_START = .;

            *(.EcucPartition_SysCore_ASW_CALIB_16)
            *(.EcucPartition_SysCore_ASW_CALIB_32)
            *(.EcucPartition_SysCore_ASW_CALIB_8)
            *(.EcucPartition_SysCore_ASW_CALIB_BOOLEAN)
            *(.EcucPartition_SysCore_ASW_CALIB_UNSPECIFIED)

            __EcucPartition_SysCore_CALIB_END = .;
        }

        .EcucPartition_SysCore_CALIB_FAST ALIGN(4):
        {
            __EcucPartition_SysCore_CALIB_FAST_START = .;

            *(.EcucPartition_SysCore_ASW_CALIB_FAST_16)
            *(.EcucPartition_SysCore_ASW_CALIB_FAST_32)
            *(.EcucPartition_SysCore_ASW_CALIB_FAST_8)
            *(.EcucPartition_SysCore_ASW_CALIB_FAST_BOOLEAN)
            *(.EcucPartition_SysCore_ASW_CALIB_FAST_UNSPECIFIED)

            __EcucPartition_SysCore_CALIB_FAST_END = .;
        }

        .EcucPartition_SysCore_CALIB_SLOW ALIGN(4):
        {
            __EcucPartition_SysCore_CALIB_SLOW_START = .;

            *(.EcucPartition_SysCore_ASW_CALIB_SLOW_16)
            *(.EcucPartition_SysCore_ASW_CALIB_SLOW_32)
            *(.EcucPartition_SysCore_ASW_CALIB_SLOW_8)
            *(.EcucPartition_SysCore_ASW_CALIB_SLOW_BOOLEAN)
            *(.EcucPartition_SysCore_ASW_CALIB_SLOW_UNSPECIFIED)

            __EcucPartition_SysCore_CALIB_SLOW_END = .;
        }

        .EcucPartition_SysCore_CALPRM ALIGN(4):
        {
            __EcucPartition_SysCore_CALPRM_START = .;

            *(.EcucPartition_SysCore_ASW_CALPRM_16)
            *(.EcucPartition_SysCore_ASW_CALPRM_32)
            *(.EcucPartition_SysCore_ASW_CALPRM_8)
            *(.EcucPartition_SysCore_ASW_CALPRM_BOOLEAN)
            *(.EcucPartition_SysCore_ASW_CALPRM_UNSPECIFIED)

            __EcucPartition_SysCore_CALPRM_END = .;
        }
    } = FILL(0x00) > Memlay_CALIB_EcucPartition_SysCore

    .EcucPartition_SysCore_CONFIG_DATA ALIGN(4):
    {
        __EcucPartition_SysCore_CONFIG_DATA_START = .;

        *(.EcucPartition_SysCore_ASW_CONFIG_DATA_16)
        *(.EcucPartition_SysCore_ASW_CONFIG_DATA_32)
        *(.EcucPartition_SysCore_ASW_CONFIG_DATA_8)
        *(.EcucPartition_SysCore_ASW_CONFIG_DATA_BOOLEAN)
        *(.EcucPartition_SysCore_ASW_CONFIG_DATA_UNSPECIFIED)
        *(.EcucPartition_SysCore_BSW_CONFIG_DATA_16)
        *(.EcucPartition_SysCore_BSW_CONFIG_DATA_32)
        *(.EcucPartition_SysCore_BSW_CONFIG_DATA_8)
        *(.EcucPartition_SysCore_BSW_CONFIG_DATA_UNSPECIFIED)

        __EcucPartition_SysCore_CONFIG_DATA_END = .;
    } > Memlay_CONST_EcucPartition_SysCore

    .EcucPartition_SysCore_CONFIG_DATA_FAST ALIGN(4):
    {
        __EcucPartition_SysCore_CONFIG_DATA_FAST_START = .;

        *(.EcucPartition_SysCore_ASW_CONFIG_DATA_FAST_16)
        *(.EcucPartition_SysCore_ASW_CONFIG_DATA_FAST_32)
        *(.EcucPartition_SysCore_ASW_CONFIG_DATA_FAST_8)
        *(.EcucPartition_SysCore_ASW_CONFIG_DATA_FAST_BOOLEAN)
        *(.EcucPartition_SysCore_ASW_CONFIG_DATA_FAST_UNSPECIFIED)

        __EcucPartition_SysCore_CONFIG_DATA_FAST_END = .;
    } > Memlay_CONST_EcucPartition_SysCore

    .EcucPartition_SysCore_CONFIG_DATA_POSTBUILD ALIGN(4):
    {
        __EcucPartition_SysCore_CONFIG_DATA_POSTBUILD_START = .;

        *(.EcucPartition_SysCore_ASW_CONFIG_DATA_POSTBUILD_16)
        *(.EcucPartition_SysCore_ASW_CONFIG_DATA_POSTBUILD_32)
        *(.EcucPartition_SysCore_ASW_CONFIG_DATA_POSTBUILD_8)
        *(.EcucPartition_SysCore_ASW_CONFIG_DATA_POSTBUILD_BOOLEAN)
        *(.EcucPartition_SysCore_ASW_CONFIG_DATA_POSTBUILD_UNSPECIFIED)
        *(.EcucPartition_SysCore_BSW_CONFIG_DATA_POSTBUILD_16)
        *(.EcucPartition_SysCore_BSW_CONFIG_DATA_POSTBUILD_32)
        *(.EcucPartition_SysCore_BSW_CONFIG_DATA_POSTBUILD_8)
        *(.EcucPartition_SysCore_BSW_CONFIG_DATA_POSTBUILD_UNSPECIFIED)

        __EcucPartition_SysCore_CONFIG_DATA_POSTBUILD_END = .;
    } > Memlay_CONST_EcucPartition_SysCore

    .EcucPartition_SysCore_CONFIG_DATA_POSTBUILD_HEADER ALIGN(4):
    {
        __EcucPartition_SysCore_CONFIG_DATA_POSTBUILD_HEADER_START = .;

        *(.EcucPartition_SysCore_ASW_CONFIG_DATA_POSTBUILD_HEADER_16)
        *(.EcucPartition_SysCore_ASW_CONFIG_DATA_POSTBUILD_HEADER_32)
        *(.EcucPartition_SysCore_ASW_CONFIG_DATA_POSTBUILD_HEADER_8)
        *(.EcucPartition_SysCore_ASW_CONFIG_DATA_POSTBUILD_HEADER_BOOLEAN)
        *(.EcucPartition_SysCore_ASW_CONFIG_DATA_POSTBUILD_HEADER_UNSPECIFIED)

        __EcucPartition_SysCore_CONFIG_DATA_POSTBUILD_HEADER_END = .;
    } > Memlay_CONST_EcucPartition_SysCore

    .EcucPartition_SysCore_CONFIG_DATA_SLOW ALIGN(4):
    {
        __EcucPartition_SysCore_CONFIG_DATA_SLOW_START = .;

        *(.EcucPartition_SysCore_ASW_CONFIG_DATA_SLOW_16)
        *(.EcucPartition_SysCore_ASW_CONFIG_DATA_SLOW_32)
        *(.EcucPartition_SysCore_ASW_CONFIG_DATA_SLOW_8)
        *(.EcucPartition_SysCore_ASW_CONFIG_DATA_SLOW_BOOLEAN)
        *(.EcucPartition_SysCore_ASW_CONFIG_DATA_SLOW_UNSPECIFIED)

        __EcucPartition_SysCore_CONFIG_DATA_SLOW_END = .;
    } > Memlay_CONST_EcucPartition_SysCore

    .EcucPartition_SysCore_CONST ALIGN(4):
    {
        __EcucPartition_SysCore_CONST_START = .;

        *(.EcucPartition_SysCore_ASW_CONST_16)
        *(.EcucPartition_SysCore_ASW_CONST_32)
        *(.EcucPartition_SysCore_ASW_CONST_8)
        *(.EcucPartition_SysCore_ASW_CONST_BOOLEAN)
        *(.EcucPartition_SysCore_ASW_CONST_UNSPECIFIED)
        *(.EcucPartition_SysCore_BSW_CONST_16)
        *(.EcucPartition_SysCore_BSW_CONST_16)
        *(.EcucPartition_SysCore_BSW_CONST_32)
        *(.EcucPartition_SysCore_BSW_CONST_32)
        *(.EcucPartition_SysCore_BSW_CONST_8)
        *(.EcucPartition_SysCore_BSW_CONST_8)
        *(.EcucPartition_SysCore_BSW_CONST_BOOLEAN)
        *(.EcucPartition_SysCore_BSW_CONST_UNSPECIFIED)
        *(.EcucPartition_SysCore_BSW_CONST_UNSPECIFIED)
        *(.EcucPartition_SysCore_RTE_CONST_UNSPECIFIED)

        __EcucPartition_SysCore_CONST_END = .;
    } > Memlay_CONST_EcucPartition_SysCore

    .EcucPartition_SysCore_CONST_FAST ALIGN(4):
    {
        __EcucPartition_SysCore_CONST_FAST_START = .;

        *(.EcucPartition_SysCore_ASW_CONST_FAST_16)
        *(.EcucPartition_SysCore_ASW_CONST_FAST_32)
        *(.EcucPartition_SysCore_ASW_CONST_FAST_8)
        *(.EcucPartition_SysCore_ASW_CONST_FAST_BOOLEAN)
        *(.EcucPartition_SysCore_ASW_CONST_FAST_UNSPECIFIED)

        __EcucPartition_SysCore_CONST_FAST_END = .;
    } > Memlay_CONST_EcucPartition_SysCore

    .EcucPartition_SysCore_CONST_SAVED_RECOVERY_ZONE ALIGN(4):
    {
        __EcucPartition_SysCore_CONST_SAVED_RECOVERY_ZONE_START = .;

        *(.EcucPartition_SysCore_ASW_CONST_SAVED_RECOVERY_ZONE_16)
        *(.EcucPartition_SysCore_ASW_CONST_SAVED_RECOVERY_ZONE_32)
        *(.EcucPartition_SysCore_ASW_CONST_SAVED_RECOVERY_ZONE_8)
        *(.EcucPartition_SysCore_ASW_CONST_SAVED_RECOVERY_ZONE_BOOLEAN)
        *(.EcucPartition_SysCore_ASW_CONST_SAVED_RECOVERY_ZONE_UNSPECIFIED)
        *(.EcucPartition_SysCore_BSW_CONST_SAVED_RECOVERY_ZONE_16)
        *(.EcucPartition_SysCore_BSW_CONST_SAVED_RECOVERY_ZONE_32)
        *(.EcucPartition_SysCore_BSW_CONST_SAVED_RECOVERY_ZONE_8)
        *(.EcucPartition_SysCore_BSW_CONST_SAVED_RECOVERY_ZONE_UNSPECIFIED)

        __EcucPartition_SysCore_CONST_SAVED_RECOVERY_ZONE_END = .;
    } > Memlay_CONST_EcucPartition_SysCore

    .EcucPartition_SysCore_CONST_SLOW ALIGN(4):
    {
        __EcucPartition_SysCore_CONST_SLOW_START = .;

        *(.EcucPartition_SysCore_ASW_CONST_SLOW_16)
        *(.EcucPartition_SysCore_ASW_CONST_SLOW_32)
        *(.EcucPartition_SysCore_ASW_CONST_SLOW_8)
        *(.EcucPartition_SysCore_ASW_CONST_SLOW_BOOLEAN)
        *(.EcucPartition_SysCore_ASW_CONST_SLOW_UNSPECIFIED)

        __EcucPartition_SysCore_CONST_SLOW_END = .;
    } > Memlay_CONST_EcucPartition_SysCore

    .EcucPartition_SysCore_POSTBUILD_CONST ALIGN(4):
    {
        __EcucPartition_SysCore_POSTBUILD_CONST_START = .;

        *(.EcucPartition_SysCore_ASW_POSTBUILD_CONST_16)
        *(.EcucPartition_SysCore_ASW_POSTBUILD_CONST_32)
        *(.EcucPartition_SysCore_ASW_POSTBUILD_CONST_8)
        *(.EcucPartition_SysCore_ASW_POSTBUILD_CONST_BOOLEAN)
        *(.EcucPartition_SysCore_ASW_POSTBUILD_CONST_UNSPECIFIED)

        __EcucPartition_SysCore_POSTBUILD_CONST_END = .;
    } > Memlay_CONST_EcucPartition_SysCore

}

/*----------------------------------------------------------------------------*/
/*
 * File: ARCMW_CAL60S244AB_shared.ld
 * Generated by: TAN9SGH
 * Version: ETAS Cobra 2.0
 * on: 2022/12/29 14:29
*/
/*----------------------------------------------------------------------------*/
/* -------------------------------------------------------------------------- */
/* Sections of CODE                                                          */
/* -------------------------------------------------------------------------- */
SECTIONS
{

    .shared_CODE ALIGN(4):
    {
        __shared_CODE_START = .;

        *(.shared_RTE_CODE)

        __shared_CODE_END = .;
    } > Memlay_CODE_shared

}

/* -------------------------------------------------------------------------- */
/* Sections of CLEARED                                                          */
/* -------------------------------------------------------------------------- */
SECTIONS
{

    .shared_VAR_CLEARED ALIGN(4):
    {
        __shared_VAR_CLEARED_START = .;

        *(.shared_RTE_VAR_CLEARED_16)
        *(.shared_RTE_VAR_CLEARED_32)
        *(.shared_RTE_VAR_CLEARED_8)
        *(.shared_RTE_VAR_CLEARED_BOOLEAN)

        __shared_VAR_CLEARED_END = .;
    } > Memlay_VAR_shared

}

/* -------------------------------------------------------------------------- */
/* Sections of INIT                                                          */
/* -------------------------------------------------------------------------- */
SECTIONS
{

    .shared_VAR_INIT ALIGN(4):
    {
        __shared_VAR_INIT_START = .;

        *(.shared_RTE_VAR_INIT_8)
        *(.shared_RTE_VAR_INIT_UNSPECIFIED)

        __shared_VAR_INIT_END = .;
    } > Memlay_VAR_shared

}

/* -------------------------------------------------------------------------- */
/* Sections of CONST                                                          */
/* -------------------------------------------------------------------------- */
SECTIONS
{

    .shared_CALPRM ALIGN(4):
    {
        __shared_CALPRM_START = .;

        *(.shared_RTE_CALPRM_32)

        __shared_CALPRM_END = .;
    } > Memlay_CALIB_shared

    .shared_CONST ALIGN(4):
    {
        __shared_CONST_START = .;

        *(.shared_RTE_CONST_32)
        *(.shared_RTE_CONST_8)
        *(.shared_RTE_CONST_BOOLEAN)
        *(.shared_RTE_CONST_UNSPECIFIED)

        __shared_CONST_END = .;
    } > Memlay_CONST_shared

}

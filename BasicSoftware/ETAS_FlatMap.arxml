AUTOSAR XML (schema 00047)
package /ETAS_FlatView
  flat map ETAS_FlatMap
    147 x flat instance descriptor:
      ArTypedPIM_1: sw-refresh-timing={cse-code=1000, cse-code-factor=1}, upstream-reference=RootSwCompositionPrototype_0.CPT_Composition_AppCluster.CPT_CalUT.ArTypedPIM_1, ecu-extract-reference=CPT_ETAS_FlatView.CPT_CalUT.ArTypedPIM_1
      CPT_BswM: upstream-reference=RootSwCompositionPrototype_0.CPT_Composition_SysCluster.CPT_BswM, ecu-extract-reference=CPT_ETAS_FlatView.CPT_BswM
      CPT_CalUT: upstream-reference=RootSwCompositionPrototype_0.CPT_Composition_AppCluster.CPT_CalUT, ecu-extract-reference=CPT_ETAS_FlatView.CPT_CalUT
      CPT_ComM: upstream-reference=RootSwCompositionPrototype_0.CPT_Composition_SysCluster.CPT_ComM, ecu-extract-reference=CPT_ETAS_FlatView.CPT_ComM
      CPT_Dcm: upstream-reference=RootSwCompositionPrototype_0.CPT_Composition_SysCluster.CPT_Dcm, ecu-extract-reference=CPT_ETAS_FlatView.CPT_Dcm
      CPT_Dem: upstream-reference=RootSwCompositionPrototype_0.CPT_Composition_SysCluster.CPT_Dem, ecu-extract-reference=CPT_ETAS_FlatView.CPT_Dem
      CPT_Det: upstream-reference=RootSwCompositionPrototype_0.CPT_Composition_SysCluster.CPT_Det, ecu-extract-reference=CPT_ETAS_FlatView.CPT_Det
      CPT_DiagUT: upstream-reference=RootSwCompositionPrototype_0.CPT_Composition_SysCluster.CPT_DiagUT, ecu-extract-reference=CPT_ETAS_FlatView.CPT_DiagUT
      CPT_EcuM: upstream-reference=RootSwCompositionPrototype_0.CPT_Composition_SysCluster.CPT_EcuM, ecu-extract-reference=CPT_ETAS_FlatView.CPT_EcuM
      CPT_ExeMgrUT: upstream-reference=RootSwCompositionPrototype_0.CPT_Composition_SysCluster.CPT_ExeMgrUT, ecu-extract-reference=CPT_ETAS_FlatView.CPT_ExeMgrUT
      CPT_FiM: upstream-reference=RootSwCompositionPrototype_0.CPT_Composition_SysCluster.CPT_FiM, ecu-extract-reference=CPT_ETAS_FlatView.CPT_FiM
      CPT_INP_SWC: upstream-reference=RootSwCompositionPrototype_0.CPT_Composition_ComCluster.CPT_INP_SWC, ecu-extract-reference=CPT_ETAS_FlatView.CPT_INP_SWC
      CPT_NmUT: upstream-reference=RootSwCompositionPrototype_0.CPT_Composition_SysCluster.CPT_NmUT, ecu-extract-reference=CPT_ETAS_FlatView.CPT_NmUT
      CPT_NvBlock: upstream-reference=RootSwCompositionPrototype_0.CPT_Composition_SysCluster.CPT_NvBlock, ecu-extract-reference=CPT_ETAS_FlatView.CPT_NvBlock
      CPT_NvM: upstream-reference=RootSwCompositionPrototype_0.CPT_Composition_SysCluster.CPT_NvM, ecu-extract-reference=CPT_ETAS_FlatView.CPT_NvM
      CPT_NvMUT: upstream-reference=RootSwCompositionPrototype_0.CPT_Composition_SysCluster.CPT_NvMUT, ecu-extract-reference=CPT_ETAS_FlatView.CPT_NvMUT
      CPT_OUTP_SWC: upstream-reference=RootSwCompositionPrototype_0.CPT_Composition_ComCluster.CPT_OUTP_SWC, ecu-extract-reference=CPT_ETAS_FlatView.CPT_OUTP_SWC
      CPT_ParameterSWC: upstream-reference=RootSwCompositionPrototype_0.CPT_Composition_AppCluster.CPT_ParameterSWC, ecu-extract-reference=CPT_ETAS_FlatView.CPT_ParameterSWC
      CPT_Rtm: upstream-reference=RootSwCompositionPrototype_0.CPT_Composition_SysCluster.CPT_Rtm, ecu-extract-reference=CPT_ETAS_FlatView.CPT_Rtm
      CPT_StackM: upstream-reference=RootSwCompositionPrototype_0.CPT_Composition_SysCluster.CPT_StackM, ecu-extract-reference=CPT_ETAS_FlatView.CPT_StackM
      CPT_TstM: upstream-reference=RootSwCompositionPrototype_0.CPT_Composition_SysCluster.CPT_TstM, ecu-extract-reference=CPT_ETAS_FlatView.CPT_TstM
      CPT_WdgM: upstream-reference=RootSwCompositionPrototype_0.CPT_Composition_SysCluster.CPT_WdgM, ecu-extract-reference=CPT_ETAS_FlatView.CPT_WdgM
      CPT_WdgMUT: upstream-reference=RootSwCompositionPrototype_0.CPT_Composition_SysCluster.CPT_WdgMUT, ecu-extract-reference=CPT_ETAS_FlatView.CPT_WdgMUT
      CPT_rba_DiagLib: upstream-reference=RootSwCompositionPrototype_0.CPT_Composition_SysCluster.CPT_rba_DiagLib, ecu-extract-reference=CPT_ETAS_FlatView.CPT_rba_DiagLib
      CyclicNvBlock: upstream-reference=RootSwCompositionPrototype_0.CPT_Composition_SysCluster.CPT_NvMUT.PRP_CyclicNvBlock.CyclicNvBlock, ecu-extract-reference=CPT_ETAS_FlatView.CPT_NvMUT.PRP_CyclicNvBlock.CyclicNvBlock
      Data: upstream-reference=RootSwCompositionPrototype_0.CPT_Composition_SysCluster.CPT_Dcm.P_DataServices_DID_0x0100_New_Data_Object.Data, ecu-extract-reference=CPT_ETAS_FlatView.CPT_Dcm.P_DataServices_DID_0x0100_New_Data_Object.Data
      Data_0: upstream-reference=RootSwCompositionPrototype_0.CPT_Composition_SysCluster.CPT_Dcm.P_DataServices_DID_0xF110_New_Data_Object.Data, ecu-extract-reference=CPT_ETAS_FlatView.CPT_Dcm.P_DataServices_DID_0xF110_New_Data_Object.Data
      Data_1: upstream-reference=RootSwCompositionPrototype_0.CPT_Composition_SysCluster.CPT_Dcm.P_DataServices_DID_0xF115_New_Data_Object.Data, ecu-extract-reference=CPT_ETAS_FlatView.CPT_Dcm.P_DataServices_DID_0xF115_New_Data_Object.Data
      Data_10: upstream-reference=RootSwCompositionPrototype_0.CPT_Composition_SysCluster.CPT_Dcm.P_DataServices_DID_0xF1A9_New_Data_Object.Data, ecu-extract-reference=CPT_ETAS_FlatView.CPT_Dcm.P_DataServices_DID_0xF1A9_New_Data_Object.Data
      Data_11: upstream-reference=RootSwCompositionPrototype_0.CPT_Composition_SysCluster.CPT_Dcm.P_DataServices_DID_0xF1AA_New_Data_Object.Data, ecu-extract-reference=CPT_ETAS_FlatView.CPT_Dcm.P_DataServices_DID_0xF1AA_New_Data_Object.Data
      Data_12: sw-refresh-timing={cse-code=4, cse-code-factor=1}, upstream-reference=RootSwCompositionPrototype_0.CPT_Composition_SysCluster.CPT_DiagUT.P_DataServices_DID_0x0100_New_Data_Object.Data, ecu-extract-reference=CPT_ETAS_FlatView.CPT_DiagUT.P_DataServices_DID_0x0100_New_Data_Object.Data
      Data_13: sw-refresh-timing={cse-code=4, cse-code-factor=1}, upstream-reference=RootSwCompositionPrototype_0.CPT_Composition_SysCluster.CPT_DiagUT.P_DataServices_DID_0x010B_Day.Data, ecu-extract-reference=CPT_ETAS_FlatView.CPT_DiagUT.P_DataServices_DID_0x010B_Day.Data
      Data_14: sw-refresh-timing={cse-code=4, cse-code-factor=1}, upstream-reference=RootSwCompositionPrototype_0.CPT_Composition_SysCluster.CPT_DiagUT.P_DataServices_DID_0x010B_Hour.Data, ecu-extract-reference=CPT_ETAS_FlatView.CPT_DiagUT.P_DataServices_DID_0x010B_Hour.Data
      Data_15: sw-refresh-timing={cse-code=4, cse-code-factor=1}, upstream-reference=RootSwCompositionPrototype_0.CPT_Composition_SysCluster.CPT_DiagUT.P_DataServices_DID_0x010B_Minute.Data, ecu-extract-reference=CPT_ETAS_FlatView.CPT_DiagUT.P_DataServices_DID_0x010B_Minute.Data
      Data_16: sw-refresh-timing={cse-code=4, cse-code-factor=1}, upstream-reference=RootSwCompositionPrototype_0.CPT_Composition_SysCluster.CPT_DiagUT.P_DataServices_DID_0x010B_Month.Data, ecu-extract-reference=CPT_ETAS_FlatView.CPT_DiagUT.P_DataServices_DID_0x010B_Month.Data
      Data_17: sw-refresh-timing={cse-code=4, cse-code-factor=1}, upstream-reference=RootSwCompositionPrototype_0.CPT_Composition_SysCluster.CPT_DiagUT.P_DataServices_DID_0x010B_Second.Data, ecu-extract-reference=CPT_ETAS_FlatView.CPT_DiagUT.P_DataServices_DID_0x010B_Second.Data
      Data_18: sw-refresh-timing={cse-code=4, cse-code-factor=1}, upstream-reference=RootSwCompositionPrototype_0.CPT_Composition_SysCluster.CPT_DiagUT.P_DataServices_DID_0x010B_Year.Data, ecu-extract-reference=CPT_ETAS_FlatView.CPT_DiagUT.P_DataServices_DID_0x010B_Year.Data
      Data_19: sw-refresh-timing={cse-code=4, cse-code-factor=1}, upstream-reference=RootSwCompositionPrototype_0.CPT_Composition_SysCluster.CPT_DiagUT.P_DataServices_DID_0x0112_New_Data_Object.Data, ecu-extract-reference=CPT_ETAS_FlatView.CPT_DiagUT.P_DataServices_DID_0x0112_New_Data_Object.Data
      Data_2: upstream-reference=RootSwCompositionPrototype_0.CPT_Composition_SysCluster.CPT_Dcm.P_DataServices_DID_0xF121_New_Data_Object.Data, ecu-extract-reference=CPT_ETAS_FlatView.CPT_Dcm.P_DataServices_DID_0xF121_New_Data_Object.Data
      Data_20: sw-refresh-timing={cse-code=4, cse-code-factor=1}, upstream-reference=RootSwCompositionPrototype_0.CPT_Composition_SysCluster.CPT_DiagUT.P_DataServices_DID_0xB950_New_Data_Object.Data, ecu-extract-reference=CPT_ETAS_FlatView.CPT_DiagUT.P_DataServices_DID_0xB950_New_Data_Object.Data
      Data_21: sw-refresh-timing={cse-code=4, cse-code-factor=1}, upstream-reference=RootSwCompositionPrototype_0.CPT_Composition_SysCluster.CPT_DiagUT.P_DataServices_DID_0xD001_New_Data_Object.Data, ecu-extract-reference=CPT_ETAS_FlatView.CPT_DiagUT.P_DataServices_DID_0xD001_New_Data_Object.Data
      Data_22: sw-refresh-timing={cse-code=4, cse-code-factor=1}, upstream-reference=RootSwCompositionPrototype_0.CPT_Composition_SysCluster.CPT_DiagUT.P_DataServices_DID_0xD901_New_Data_Object.Data, ecu-extract-reference=CPT_ETAS_FlatView.CPT_DiagUT.P_DataServices_DID_0xD901_New_Data_Object.Data
      Data_23: sw-refresh-timing={cse-code=4, cse-code-factor=1}, upstream-reference=RootSwCompositionPrototype_0.CPT_Composition_SysCluster.CPT_DiagUT.P_DataServices_DID_0xE101_New_Data_Object.Data, ecu-extract-reference=CPT_ETAS_FlatView.CPT_DiagUT.P_DataServices_DID_0xE101_New_Data_Object.Data
      Data_24: sw-refresh-timing={cse-code=4, cse-code-factor=1}, upstream-reference=RootSwCompositionPrototype_0.CPT_Composition_SysCluster.CPT_DiagUT.P_DataServices_DID_0xE900_New_Data_Object.Data, ecu-extract-reference=CPT_ETAS_FlatView.CPT_DiagUT.P_DataServices_DID_0xE900_New_Data_Object.Data
      Data_25: sw-refresh-timing={cse-code=4, cse-code-factor=1}, upstream-reference=RootSwCompositionPrototype_0.CPT_Composition_SysCluster.CPT_DiagUT.P_DataServices_DID_0xF100_New_Data_Object.Data, ecu-extract-reference=CPT_ETAS_FlatView.CPT_DiagUT.P_DataServices_DID_0xF100_New_Data_Object.Data
      Data_26: sw-refresh-timing={cse-code=4, cse-code-factor=1}, upstream-reference=RootSwCompositionPrototype_0.CPT_Composition_SysCluster.CPT_DiagUT.P_DataServices_DID_0xF100_New_Data_Object_1.Data, ecu-extract-reference=CPT_ETAS_FlatView.CPT_DiagUT.P_DataServices_DID_0xF100_New_Data_Object_1.Data
      Data_27: sw-refresh-timing={cse-code=4, cse-code-factor=1}, upstream-reference=RootSwCompositionPrototype_0.CPT_Composition_SysCluster.CPT_DiagUT.P_DataServices_DID_0xF110_New_Data_Object.Data, ecu-extract-reference=CPT_ETAS_FlatView.CPT_DiagUT.P_DataServices_DID_0xF110_New_Data_Object.Data
      Data_28: sw-refresh-timing={cse-code=4, cse-code-factor=1}, upstream-reference=RootSwCompositionPrototype_0.CPT_Composition_SysCluster.CPT_DiagUT.P_DataServices_DID_0xF111_New_Data_Object.Data, ecu-extract-reference=CPT_ETAS_FlatView.CPT_DiagUT.P_DataServices_DID_0xF111_New_Data_Object.Data
      Data_29: sw-refresh-timing={cse-code=4, cse-code-factor=1}, upstream-reference=RootSwCompositionPrototype_0.CPT_Composition_SysCluster.CPT_DiagUT.P_DataServices_DID_0xF112_New_Data_Object.Data, ecu-extract-reference=CPT_ETAS_FlatView.CPT_DiagUT.P_DataServices_DID_0xF112_New_Data_Object.Data
      Data_3: upstream-reference=RootSwCompositionPrototype_0.CPT_Composition_SysCluster.CPT_Dcm.P_DataServices_DID_0xF187_New_Data_Object.Data, ecu-extract-reference=CPT_ETAS_FlatView.CPT_Dcm.P_DataServices_DID_0xF187_New_Data_Object.Data
      Data_30: sw-refresh-timing={cse-code=4, cse-code-factor=1}, upstream-reference=RootSwCompositionPrototype_0.CPT_Composition_SysCluster.CPT_DiagUT.P_DataServices_DID_0xF113_New_Data_Object.Data, ecu-extract-reference=CPT_ETAS_FlatView.CPT_DiagUT.P_DataServices_DID_0xF113_New_Data_Object.Data
      Data_31: sw-refresh-timing={cse-code=4, cse-code-factor=1}, upstream-reference=RootSwCompositionPrototype_0.CPT_Composition_SysCluster.CPT_DiagUT.P_DataServices_DID_0xF114_New_Data_Object.Data, ecu-extract-reference=CPT_ETAS_FlatView.CPT_DiagUT.P_DataServices_DID_0xF114_New_Data_Object.Data
      Data_32: sw-refresh-timing={cse-code=4, cse-code-factor=1}, upstream-reference=RootSwCompositionPrototype_0.CPT_Composition_SysCluster.CPT_DiagUT.P_DataServices_DID_0xF115_New_Data_Object.Data, ecu-extract-reference=CPT_ETAS_FlatView.CPT_DiagUT.P_DataServices_DID_0xF115_New_Data_Object.Data
      Data_33: sw-refresh-timing={cse-code=4, cse-code-factor=1}, upstream-reference=RootSwCompositionPrototype_0.CPT_Composition_SysCluster.CPT_DiagUT.P_DataServices_DID_0xF116_New_Data_Object.Data, ecu-extract-reference=CPT_ETAS_FlatView.CPT_DiagUT.P_DataServices_DID_0xF116_New_Data_Object.Data
      Data_34: sw-refresh-timing={cse-code=4, cse-code-factor=1}, upstream-reference=RootSwCompositionPrototype_0.CPT_Composition_SysCluster.CPT_DiagUT.P_DataServices_DID_0xF117_New_Data_Object.Data, ecu-extract-reference=CPT_ETAS_FlatView.CPT_DiagUT.P_DataServices_DID_0xF117_New_Data_Object.Data
      Data_35: sw-refresh-timing={cse-code=4, cse-code-factor=1}, upstream-reference=RootSwCompositionPrototype_0.CPT_Composition_SysCluster.CPT_DiagUT.P_DataServices_DID_0xF118_New_Data_Object.Data, ecu-extract-reference=CPT_ETAS_FlatView.CPT_DiagUT.P_DataServices_DID_0xF118_New_Data_Object.Data
      Data_36: sw-refresh-timing={cse-code=4, cse-code-factor=1}, upstream-reference=RootSwCompositionPrototype_0.CPT_Composition_SysCluster.CPT_DiagUT.P_DataServices_DID_0xF119_New_Data_Object.Data, ecu-extract-reference=CPT_ETAS_FlatView.CPT_DiagUT.P_DataServices_DID_0xF119_New_Data_Object.Data
      Data_37: sw-refresh-timing={cse-code=4, cse-code-factor=1}, upstream-reference=RootSwCompositionPrototype_0.CPT_Composition_SysCluster.CPT_DiagUT.P_DataServices_DID_0xF11A_New_Data_Object.Data, ecu-extract-reference=CPT_ETAS_FlatView.CPT_DiagUT.P_DataServices_DID_0xF11A_New_Data_Object.Data
      Data_38: sw-refresh-timing={cse-code=4, cse-code-factor=1}, upstream-reference=RootSwCompositionPrototype_0.CPT_Composition_SysCluster.CPT_DiagUT.P_DataServices_DID_0xF11B_New_Data_Object.Data, ecu-extract-reference=CPT_ETAS_FlatView.CPT_DiagUT.P_DataServices_DID_0xF11B_New_Data_Object.Data
      Data_39: sw-refresh-timing={cse-code=4, cse-code-factor=1}, upstream-reference=RootSwCompositionPrototype_0.CPT_Composition_SysCluster.CPT_DiagUT.P_DataServices_DID_0xF11C_New_Data_Object.Data, ecu-extract-reference=CPT_ETAS_FlatView.CPT_DiagUT.P_DataServices_DID_0xF11C_New_Data_Object.Data
      Data_4: upstream-reference=RootSwCompositionPrototype_0.CPT_Composition_SysCluster.CPT_Dcm.P_DataServices_DID_0xF18B_New_Data_Object.Data, ecu-extract-reference=CPT_ETAS_FlatView.CPT_Dcm.P_DataServices_DID_0xF18B_New_Data_Object.Data
      Data_40: sw-refresh-timing={cse-code=4, cse-code-factor=1}, upstream-reference=RootSwCompositionPrototype_0.CPT_Composition_SysCluster.CPT_DiagUT.P_DataServices_DID_0xF11D_New_Data_Object.Data, ecu-extract-reference=CPT_ETAS_FlatView.CPT_DiagUT.P_DataServices_DID_0xF11D_New_Data_Object.Data
      Data_41: sw-refresh-timing={cse-code=4, cse-code-factor=1}, upstream-reference=RootSwCompositionPrototype_0.CPT_Composition_SysCluster.CPT_DiagUT.P_DataServices_DID_0xF11E_New_Data_Object.Data, ecu-extract-reference=CPT_ETAS_FlatView.CPT_DiagUT.P_DataServices_DID_0xF11E_New_Data_Object.Data
      Data_42: sw-refresh-timing={cse-code=4, cse-code-factor=1}, upstream-reference=RootSwCompositionPrototype_0.CPT_Composition_SysCluster.CPT_DiagUT.P_DataServices_DID_0xF11F_New_Data_Object.Data, ecu-extract-reference=CPT_ETAS_FlatView.CPT_DiagUT.P_DataServices_DID_0xF11F_New_Data_Object.Data
      Data_43: sw-refresh-timing={cse-code=4, cse-code-factor=1}, upstream-reference=RootSwCompositionPrototype_0.CPT_Composition_SysCluster.CPT_DiagUT.P_DataServices_DID_0xF120_New_Data_Object.Data, ecu-extract-reference=CPT_ETAS_FlatView.CPT_DiagUT.P_DataServices_DID_0xF120_New_Data_Object.Data
      Data_44: sw-refresh-timing={cse-code=4, cse-code-factor=1}, upstream-reference=RootSwCompositionPrototype_0.CPT_Composition_SysCluster.CPT_DiagUT.P_DataServices_DID_0xF121_New_Data_Object.Data, ecu-extract-reference=CPT_ETAS_FlatView.CPT_DiagUT.P_DataServices_DID_0xF121_New_Data_Object.Data
      Data_45: sw-refresh-timing={cse-code=4, cse-code-factor=1}, upstream-reference=RootSwCompositionPrototype_0.CPT_Composition_SysCluster.CPT_DiagUT.P_DataServices_DID_0xF122_New_Data_Object.Data, ecu-extract-reference=CPT_ETAS_FlatView.CPT_DiagUT.P_DataServices_DID_0xF122_New_Data_Object.Data
      Data_46: sw-refresh-timing={cse-code=4, cse-code-factor=1}, upstream-reference=RootSwCompositionPrototype_0.CPT_Composition_SysCluster.CPT_DiagUT.P_DataServices_DID_0xF122_New_Data_Object_2.Data, ecu-extract-reference=CPT_ETAS_FlatView.CPT_DiagUT.P_DataServices_DID_0xF122_New_Data_Object_2.Data
      Data_47: sw-refresh-timing={cse-code=4, cse-code-factor=1}, upstream-reference=RootSwCompositionPrototype_0.CPT_Composition_SysCluster.CPT_DiagUT.P_DataServices_DID_0xF187_New_Data_Object.Data, ecu-extract-reference=CPT_ETAS_FlatView.CPT_DiagUT.P_DataServices_DID_0xF187_New_Data_Object.Data
      Data_48: sw-refresh-timing={cse-code=4, cse-code-factor=1}, upstream-reference=RootSwCompositionPrototype_0.CPT_Composition_SysCluster.CPT_DiagUT.P_DataServices_DID_0xF18A_New_Data_Object.Data, ecu-extract-reference=CPT_ETAS_FlatView.CPT_DiagUT.P_DataServices_DID_0xF18A_New_Data_Object.Data
      Data_49: sw-refresh-timing={cse-code=4, cse-code-factor=1}, upstream-reference=RootSwCompositionPrototype_0.CPT_Composition_SysCluster.CPT_DiagUT.P_DataServices_DID_0xF18B_New_Data_Object.Data, ecu-extract-reference=CPT_ETAS_FlatView.CPT_DiagUT.P_DataServices_DID_0xF18B_New_Data_Object.Data
      Data_5: upstream-reference=RootSwCompositionPrototype_0.CPT_Composition_SysCluster.CPT_Dcm.P_DataServices_DID_0xF18C_New_Data_Object.Data, ecu-extract-reference=CPT_ETAS_FlatView.CPT_Dcm.P_DataServices_DID_0xF18C_New_Data_Object.Data
      Data_50: sw-refresh-timing={cse-code=4, cse-code-factor=1}, upstream-reference=RootSwCompositionPrototype_0.CPT_Composition_SysCluster.CPT_DiagUT.P_DataServices_DID_0xF18C_New_Data_Object.Data, ecu-extract-reference=CPT_ETAS_FlatView.CPT_DiagUT.P_DataServices_DID_0xF18C_New_Data_Object.Data
      Data_51: sw-refresh-timing={cse-code=4, cse-code-factor=1}, upstream-reference=RootSwCompositionPrototype_0.CPT_Composition_SysCluster.CPT_DiagUT.P_DataServices_DID_0xF190_New_Data_Object.Data, ecu-extract-reference=CPT_ETAS_FlatView.CPT_DiagUT.P_DataServices_DID_0xF190_New_Data_Object.Data
      Data_52: sw-refresh-timing={cse-code=4, cse-code-factor=1}, upstream-reference=RootSwCompositionPrototype_0.CPT_Composition_SysCluster.CPT_DiagUT.P_DataServices_DID_0xF192_New_Data_Object.Data, ecu-extract-reference=CPT_ETAS_FlatView.CPT_DiagUT.P_DataServices_DID_0xF192_New_Data_Object.Data
      Data_53: sw-refresh-timing={cse-code=4, cse-code-factor=1}, upstream-reference=RootSwCompositionPrototype_0.CPT_Composition_SysCluster.CPT_DiagUT.P_DataServices_DID_0xF192_New_Data_Object_3.Data, ecu-extract-reference=CPT_ETAS_FlatView.CPT_DiagUT.P_DataServices_DID_0xF192_New_Data_Object_3.Data
      Data_54: sw-refresh-timing={cse-code=4, cse-code-factor=1}, upstream-reference=RootSwCompositionPrototype_0.CPT_Composition_SysCluster.CPT_DiagUT.P_DataServices_DID_0xF194_New_Data_Object.Data, ecu-extract-reference=CPT_ETAS_FlatView.CPT_DiagUT.P_DataServices_DID_0xF194_New_Data_Object.Data
      Data_55: sw-refresh-timing={cse-code=4, cse-code-factor=1}, upstream-reference=RootSwCompositionPrototype_0.CPT_Composition_SysCluster.CPT_DiagUT.P_DataServices_DID_0xF194_New_Data_Object_4.Data, ecu-extract-reference=CPT_ETAS_FlatView.CPT_DiagUT.P_DataServices_DID_0xF194_New_Data_Object_4.Data
      Data_56: sw-refresh-timing={cse-code=4, cse-code-factor=1}, upstream-reference=RootSwCompositionPrototype_0.CPT_Composition_SysCluster.CPT_DiagUT.P_DataServices_DID_0xF198_New_Data_Object.Data, ecu-extract-reference=CPT_ETAS_FlatView.CPT_DiagUT.P_DataServices_DID_0xF198_New_Data_Object.Data
      Data_57: sw-refresh-timing={cse-code=4, cse-code-factor=1}, upstream-reference=RootSwCompositionPrototype_0.CPT_Composition_SysCluster.CPT_DiagUT.P_DataServices_DID_0xF198_New_Data_Object_5.Data, ecu-extract-reference=CPT_ETAS_FlatView.CPT_DiagUT.P_DataServices_DID_0xF198_New_Data_Object_5.Data
      Data_58: sw-refresh-timing={cse-code=4, cse-code-factor=1}, upstream-reference=RootSwCompositionPrototype_0.CPT_Composition_SysCluster.CPT_DiagUT.P_DataServices_DID_0xF1A0_New_Data_Object.Data, ecu-extract-reference=CPT_ETAS_FlatView.CPT_DiagUT.P_DataServices_DID_0xF1A0_New_Data_Object.Data
      Data_59: sw-refresh-timing={cse-code=4, cse-code-factor=1}, upstream-reference=RootSwCompositionPrototype_0.CPT_Composition_SysCluster.CPT_DiagUT.P_DataServices_DID_0xF1A1_New_Data_Object.Data, ecu-extract-reference=CPT_ETAS_FlatView.CPT_DiagUT.P_DataServices_DID_0xF1A1_New_Data_Object.Data
      Data_6: upstream-reference=RootSwCompositionPrototype_0.CPT_Composition_SysCluster.CPT_Dcm.P_DataServices_DID_0xF190_New_Data_Object.Data, ecu-extract-reference=CPT_ETAS_FlatView.CPT_Dcm.P_DataServices_DID_0xF190_New_Data_Object.Data
      Data_60: sw-refresh-timing={cse-code=4, cse-code-factor=1}, upstream-reference=RootSwCompositionPrototype_0.CPT_Composition_SysCluster.CPT_DiagUT.P_DataServices_DID_0xF1A2_New_Data_Object.Data, ecu-extract-reference=CPT_ETAS_FlatView.CPT_DiagUT.P_DataServices_DID_0xF1A2_New_Data_Object.Data
      Data_61: sw-refresh-timing={cse-code=4, cse-code-factor=1}, upstream-reference=RootSwCompositionPrototype_0.CPT_Composition_SysCluster.CPT_DiagUT.P_DataServices_DID_0xF1A5_New_Data_Object.Data, ecu-extract-reference=CPT_ETAS_FlatView.CPT_DiagUT.P_DataServices_DID_0xF1A5_New_Data_Object.Data
      Data_62: sw-refresh-timing={cse-code=4, cse-code-factor=1}, upstream-reference=RootSwCompositionPrototype_0.CPT_Composition_SysCluster.CPT_DiagUT.P_DataServices_DID_0xF1A8_New_Data_Object.Data, ecu-extract-reference=CPT_ETAS_FlatView.CPT_DiagUT.P_DataServices_DID_0xF1A8_New_Data_Object.Data
      Data_63: sw-refresh-timing={cse-code=4, cse-code-factor=1}, upstream-reference=RootSwCompositionPrototype_0.CPT_Composition_SysCluster.CPT_DiagUT.P_DataServices_DID_0xF1A9_New_Data_Object.Data, ecu-extract-reference=CPT_ETAS_FlatView.CPT_DiagUT.P_DataServices_DID_0xF1A9_New_Data_Object.Data
      Data_64: sw-refresh-timing={cse-code=4, cse-code-factor=1}, upstream-reference=RootSwCompositionPrototype_0.CPT_Composition_SysCluster.CPT_DiagUT.P_DataServices_DID_0xF1AA_New_Data_Object.Data, ecu-extract-reference=CPT_ETAS_FlatView.CPT_DiagUT.P_DataServices_DID_0xF1AA_New_Data_Object.Data
      Data_7: upstream-reference=RootSwCompositionPrototype_0.CPT_Composition_SysCluster.CPT_Dcm.P_DataServices_DID_0xF198_New_Data_Object.Data, ecu-extract-reference=CPT_ETAS_FlatView.CPT_Dcm.P_DataServices_DID_0xF198_New_Data_Object.Data
      Data_8: upstream-reference=RootSwCompositionPrototype_0.CPT_Composition_SysCluster.CPT_Dcm.P_DataServices_DID_0xF198_New_Data_Object_5.Data, ecu-extract-reference=CPT_ETAS_FlatView.CPT_Dcm.P_DataServices_DID_0xF198_New_Data_Object_5.Data
      Data_9: upstream-reference=RootSwCompositionPrototype_0.CPT_Composition_SysCluster.CPT_Dcm.P_DataServices_DID_0xF1A8_New_Data_Object.Data, ecu-extract-reference=CPT_ETAS_FlatView.CPT_Dcm.P_DataServices_DID_0xF1A8_New_Data_Object.Data
      ETAS01_Sig{00..08}_ComRx_0x81: sw-refresh-timing={cse-code=4, cse-code-factor=1}, upstream-reference=RootSwCompositionPrototype_0.CPT_Composition_ComCluster.CPT_INP_SWC.RP_ETAS01_Sig{00..08}_ComRx_0x81.ETAS01_Sig{00..08}_ComRx_0x81, ecu-extract-reference=CPT_ETAS_FlatView.CPT_INP_SWC.RP_ETAS01_Sig{00..08}_ComRx_0x81.ETAS01_Sig{00..08}_ComRx_0x81
      ETAS02_Sig09_ComRx_0x261: sw-refresh-timing={cse-code=4, cse-code-factor=1}, upstream-reference=RootSwCompositionPrototype_0.CPT_Composition_ComCluster.CPT_INP_SWC.RP_ETAS02_Sig09_ComRx_0x261.ETAS02_Sig09_ComRx_0x261, ecu-extract-reference=CPT_ETAS_FlatView.CPT_INP_SWC.RP_ETAS02_Sig09_ComRx_0x261.ETAS02_Sig09_ComRx_0x261
      ETAS03_Sig{10..19}_ComTx_0x55: sw-refresh-timing={cse-code=4, cse-code-factor=1}, upstream-reference=RootSwCompositionPrototype_0.CPT_Composition_ComCluster.CPT_OUTP_SWC.PP_ETAS03_Sig{10..19}_ComTx_0x55.ETAS03_Sig{10..19}_ComTx_0x55, ecu-extract-reference=CPT_ETAS_FlatView.CPT_OUTP_SWC.PP_ETAS03_Sig{10..19}_ComTx_0x55.ETAS03_Sig{10..19}_ComTx_0x55
      ETAS04_Sig20_ComTx_0x98: sw-refresh-timing={cse-code=4, cse-code-factor=1}, upstream-reference=RootSwCompositionPrototype_0.CPT_Composition_ComCluster.CPT_OUTP_SWC.PP_ETAS04_Sig20_ComTx_0x98.ETAS04_Sig20_ComTx_0x98, ecu-extract-reference=CPT_ETAS_FlatView.CPT_OUTP_SWC.PP_ETAS04_Sig20_ComTx_0x98.ETAS04_Sig20_ComTx_0x98
      ETAS04_Sig{22..25}_ComTx_0x98: sw-refresh-timing={cse-code=4, cse-code-factor=1}, upstream-reference=RootSwCompositionPrototype_0.CPT_Composition_ComCluster.CPT_OUTP_SWC.PP_ETAS04_Sig{22..25}_ComTx_0x98.ETAS04_Sig{22..25}_ComTx_0x98, ecu-extract-reference=CPT_ETAS_FlatView.CPT_OUTP_SWC.PP_ETAS04_Sig{22..25}_ComTx_0x98.ETAS04_Sig{22..25}_ComTx_0x98
      ExeMgr_StartupSource: sw-refresh-timing={cse-code=1000, cse-code-factor=1}, upstream-reference=RootSwCompositionPrototype_0.CPT_Composition_SysCluster.CPT_ExeMgrUT.ExeMgr_StartupSource, ecu-extract-reference=CPT_ETAS_FlatView.CPT_ExeMgrUT.ExeMgr_StartupSource
      IOControlRequest_DID_0xD901_New_Data_Object: upstream-reference=RootSwCompositionPrototype_0.CPT_Composition_SysCluster.CPT_Dcm.IOControlRequest_DID_0xD901_New_Data_Object.IOControlRequest_DID_0xD901_New_Data_Object, ecu-extract-reference=CPT_ETAS_FlatView.CPT_Dcm.IOControlRequest_DID_0xD901_New_Data_Object.IOControlRequest_DID_0xD901_New_Data_Object
      IOControlRequest_DID_0xE900_New_Data_Object: upstream-reference=RootSwCompositionPrototype_0.CPT_Composition_SysCluster.CPT_Dcm.IOControlRequest_DID_0xE900_New_Data_Object.IOControlRequest_DID_0xE900_New_Data_Object, ecu-extract-reference=CPT_ETAS_FlatView.CPT_Dcm.IOControlRequest_DID_0xE900_New_Data_Object.IOControlRequest_DID_0xE900_New_Data_Object
      IOOperationResponse: sw-refresh-timing={cse-code=4, cse-code-factor=1}, upstream-reference=RootSwCompositionPrototype_0.CPT_Composition_SysCluster.CPT_DiagUT.IOControlResponse_DID_0xD901_New_Data_Object.IOOperationResponse, ecu-extract-reference=CPT_ETAS_FlatView.CPT_DiagUT.IOControlResponse_DID_0xD901_New_Data_Object.IOOperationResponse
      IOOperationResponse_0: sw-refresh-timing={cse-code=4, cse-code-factor=1}, upstream-reference=RootSwCompositionPrototype_0.CPT_Composition_SysCluster.CPT_DiagUT.IOControlResponse_DID_0xE900_New_Data_Object.IOOperationResponse, ecu-extract-reference=CPT_ETAS_FlatView.CPT_DiagUT.IOControlResponse_DID_0xE900_New_Data_Object.IOOperationResponse
      ImmediateNvBlock: upstream-reference=RootSwCompositionPrototype_0.CPT_Composition_SysCluster.CPT_NvMUT.PRP_ImmediateNvBlock.ImmediateNvBlock, ecu-extract-reference=CPT_ETAS_FlatView.CPT_NvMUT.PRP_ImmediateNvBlock.ImmediateNvBlock
      MDGP_APPMode: role=CURRENT_MODE, upstream-reference=RootSwCompositionPrototype_0.CPT_Composition_SysCluster.CPT_ExeMgrUT.PP_BswM_APPMode.MDGP_APPMode, ecu-extract-reference=CPT_ETAS_FlatView.CPT_ExeMgrUT.PP_BswM_APPMode.MDGP_APPMode
      MDGP_DcmCommunicationControl_Can_Network_ETAS_Channel_Can_Network_ETAS:
        role=CURRENT_MODE
        upstream-reference=RootSwCompositionPrototype_0.CPT_Composition_SysCluster.CPT_Dcm.Pp_DcmCommunicationControl_Can_Network_ETAS_Channel_Can_Network_ETAS.MDGP_DcmCommunicationControl_Can_Network_ETAS_Channel_Can_Network_ETAS
        ecu-extract-reference=CPT_ETAS_FlatView.CPT_Dcm.Pp_DcmCommunicationControl_Can_Network_ETAS_Channel_Can_Network_ETAS.MDGP_DcmCommunicationControl_Can_Network_ETAS_Channel_Can_Network_ETAS
      MDGP_DcmControlDTCSetting: role=CURRENT_MODE, upstream-reference=RootSwCompositionPrototype_0.CPT_Composition_SysCluster.CPT_Dcm.Pp_DcmControlDTCSetting.MDGP_DcmControlDTCSetting, ecu-extract-reference=CPT_ETAS_FlatView.CPT_Dcm.Pp_DcmControlDTCSetting.MDGP_DcmControlDTCSetting
      MDGP_DcmDiagnosticSessionControl: role=CURRENT_MODE, upstream-reference=RootSwCompositionPrototype_0.CPT_Composition_SysCluster.CPT_Dcm.Pp_DcmDiagnosticSessionControl.MDGP_DcmDiagnosticSessionControl, ecu-extract-reference=CPT_ETAS_FlatView.CPT_Dcm.Pp_DcmDiagnosticSessionControl.MDGP_DcmDiagnosticSessionControl
      MDGP_DcmEcuReset: role=CURRENT_MODE, upstream-reference=RootSwCompositionPrototype_0.CPT_Composition_SysCluster.CPT_Dcm.Pp_DcmEcuReset.MDGP_DcmEcuReset, ecu-extract-reference=CPT_ETAS_FlatView.CPT_Dcm.Pp_DcmEcuReset.MDGP_DcmEcuReset
      NM_Tx_Sig_NM_Tx_0x600: sw-refresh-timing={cse-code=4, cse-code-factor=1}, upstream-reference=RootSwCompositionPrototype_0.CPT_Composition_SysCluster.CPT_NmUT.PP_NM_Tx_Sig_NM_Tx_0x600.NM_Tx_Sig_NM_Tx_0x600, ecu-extract-reference=CPT_ETAS_FlatView.CPT_NmUT.PP_NM_Tx_Sig_NM_Tx_0x600.NM_Tx_Sig_NM_Tx_0x600
      ShutDownNvBlock: upstream-reference=RootSwCompositionPrototype_0.CPT_Composition_SysCluster.CPT_NvMUT.PRP_ShutdownNvBlock.ShutDownNvBlock, ecu-extract-reference=CPT_ETAS_FlatView.CPT_NvMUT.PRP_ShutdownNvBlock.ShutDownNvBlock
      SpeedLimitLower: sw-refresh-timing={cse-code=1000, cse-code-factor=1}, upstream-reference=RootSwCompositionPrototype_0.CPT_Composition_AppCluster.CPT_CalUT.SpeedLimitLower, ecu-extract-reference=CPT_ETAS_FlatView.CPT_CalUT.SpeedLimitLower
      SpeedLimitUpper: sw-refresh-timing={cse-code=1000, cse-code-factor=1}, upstream-reference=RootSwCompositionPrototype_0.CPT_Composition_AppCluster.CPT_CalUT.SpeedLimitUpper, ecu-extract-reference=CPT_ETAS_FlatView.CPT_CalUT.SpeedLimitUpper
      Unconnected_uint8: sw-refresh-timing={cse-code=4, cse-code-factor=1}, upstream-reference=RootSwCompositionPrototype_0.CPT_Composition_SysCluster.CPT_NmUT.PP_NmState.uint8, ecu-extract-reference=CPT_ETAS_FlatView.CPT_NmUT.PP_NmState.uint8
      currentMode: role=CURRENT_MODE, upstream-reference=RootSwCompositionPrototype_0.CPT_Composition_SysCluster.CPT_ComM.UM_ComMUser_Can_Network_ETAS_Channel_Can_Network_ETAS.currentMode, ecu-extract-reference=CPT_ETAS_FlatView.CPT_ComM.UM_ComMUser_Can_Network_ETAS_Channel_Can_Network_ETAS.currentMode
      currentMode_0: role=CURRENT_MODE, upstream-reference=RootSwCompositionPrototype_0.CPT_Composition_SysCluster.CPT_WdgM.globalMode.currentMode, ecu-extract-reference=CPT_ETAS_FlatView.CPT_WdgM.globalMode.currentMode
      currentMode_1: role=CURRENT_MODE, upstream-reference=RootSwCompositionPrototype_0.CPT_Composition_SysCluster.CPT_WdgM.mode_WdgM_SE1.currentMode, ecu-extract-reference=CPT_ETAS_FlatView.CPT_WdgM.mode_WdgM_SE1.currentMode
      sharedCURVE: sw-refresh-timing={cse-code=1000, cse-code-factor=1}, upstream-reference=RootSwCompositionPrototype_0.CPT_Composition_AppCluster.CPT_CalUT.sharedCURVE, ecu-extract-reference=CPT_ETAS_FlatView.CPT_CalUT.sharedCURVE
      sharedMAP: sw-refresh-timing={cse-code=1000, cse-code-factor=1}, upstream-reference=RootSwCompositionPrototype_0.CPT_Composition_AppCluster.CPT_CalUT.sharedMAP, ecu-extract-reference=CPT_ETAS_FlatView.CPT_CalUT.sharedMAP
      speedMax: upstream-reference=RootSwCompositionPrototype_0.CPT_Composition_AppCluster.CPT_ParameterSWC.PP_SpeedLimit.speedMax, ecu-extract-reference=CPT_ETAS_FlatView.CPT_ParameterSWC.PP_SpeedLimit.speedMax
      speedMin: upstream-reference=RootSwCompositionPrototype_0.CPT_Composition_AppCluster.CPT_ParameterSWC.PP_SpeedLimit.speedMin, ecu-extract-reference=CPT_ETAS_FlatView.CPT_ParameterSWC.PP_SpeedLimit.speedMin
      ETAS06_Sig{34..41}_ComRx_0x456: sw-refresh-timing={cse-code=4, cse-code-factor=1}, upstream-reference=RootSwCompositionPrototype_0.CPT_Composition_ComCluster.CPT_INP_SWC.RP_ETAS06_Sig{34..41}_ComRx_0x456.ETAS06_Sig{34..41}_ComRx_0x456, ecu-extract-reference=CPT_ETAS_FlatView.CPT_INP_SWC.RP_ETAS06_Sig{34..41}_ComRx_0x456.ETAS06_Sig{34..41}_ComRx_0x456

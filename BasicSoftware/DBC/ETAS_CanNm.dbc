VERSION ""

NS_ :

BS_:

BU_: ETAS
VAL_TABLE_ NRF_DCLINKCURRENT_SAMPLING 1 "Trouble" 0 "NoTrouble" ;
VAL_TABLE_ LI_DCLINK_UNDERVOLTAGE 1 "Trouble" 0 "NoTrouble" ;
VAL_TABLE_ LI_INV_OVERTEMP 1 "Trouble" 0 "NoTrouble" ;
VAL_TABLE_ LI_MOTORTEMP_OVERTEMP 1 "Trouble" 0 "NoTrouble" ;
VAL_TABLE_ LI_OVERSPEED 1 "Trouble" 0 "NoTrouble" ;
VAL_TABLE_ LI_DCLINK_OVERVOLTAGE 1 "Trouble" 0 "NoTrouble" ;
VAL_TABLE_ RF_MOTORTEMP_OVERTEMP 1 "Trouble" 0 "NoTrouble" ;
VAL_TABLE_ RF_OVERSPEED 1 "Trouble" 0 "NoTrouble" ;
VAL_TABLE_ RF_CAN_BUSOFF 1 "Trouble" 0 "NoTrouble" ;
VAL_TABLE_ RF_MSGMISSING 1 "Trouble" 0 "NoTrouble" ;
VAL_TABLE_ RF_HW_OVERCURRENT 1 "Trouble" 0 "NoTrouble" ;
VAL_TABLE_ RF_PHASE_A_OVERCURRENT 1 "Trouble" 0 "NoTrouble" ;
VAL_TABLE_ RF_PHASE_B_OVERCURRENT 1 "Trouble" 0 "NoTrouble" ;
VAL_TABLE_ RF_PHASE_C_OVERCURRENT 1 "Trouble" 0 "NoTrouble" ;
VAL_TABLE_ RF_POWER12V_SUPPLY 1 "Trouble" 0 "NoTrouble" ;
VAL_TABLE_ RF_DCLINK_OVERCURRENT 1 "Trouble" 0 "NoTrouble" ;
VAL_TABLE_ RF_DCLINK_OVERVOLTAGE 1 "Trouble" 0 "NoTrouble" ;
VAL_TABLE_ RF_CONTROLTORQUE_IMP 1 "Trouble" 0 "NoTrouble" ;
VAL_TABLE_ RF_INVTEMP_OVERTEMP 1 "Trouble" 0 "NoTrouble" ;
VAL_TABLE_ RF_DCLINK_UNDERVOLTAGE 1 "Trouble" 0 "NoTrouble" ;
VAL_TABLE_ RF_INTERNAL 1 "Trouble" 0 "NoTrouble" ;
VAL_TABLE_ RF_UNBANLANCEDCURRENT 1 "Trouble" 0 "NoTrouble" ;
VAL_TABLE_ NRF_DCLINKVOLTAGE_SAMPLING 1 "Trouble" 0 "NoTrouble" ;
VAL_TABLE_ NRF_INVTEMP_SAMPLING 1 "Trouble" 0 "NoTrouble" ;
VAL_TABLE_ NRF_COMMUNICATE_IMP 1 "Trouble" 0 "NoTrouble" ;
VAL_TABLE_ NRF_SYSTEM_IMP 1 "Trouble" 0 "NoTrouble" ;
VAL_TABLE_ NRF_GATEDESAT 1 "Trouble" 0 "NoTrouble" ;
VAL_TABLE_ NRF_ANALOG5V_SUPPLY 1 "Trouble" 0 "NoTrouble" ;
VAL_TABLE_ NRF_RDC 1 "Trouble" 0 "NoTrouble" ;
VAL_TABLE_ NRF_PHASE_A_SAMPLING 1 "Trouble" 0 "NoTrouble" ;
VAL_TABLE_ NRF_PHASE_B_SAMPLING 1 "Trouble" 0 "NoTrouble" ;
VAL_TABLE_ NRF_PHASE_C_SAMPLING 1 "Trouble" 0 "NoTrouble" ;
VAL_TABLE_ NRF_MOTORTEMP_SAMPLING 1 "Trouble" 0 "NoTrouble" ;
VAL_TABLE_ MCU_Ready 1 "forbidding getting torquecommand" 0 "allow mcu to get torque command" ;
VAL_TABLE_ MCU_HighVolAllowed 1 "forbidding to turn on HV" 0 "allowing to turn on HV" ;
VAL_TABLE_ MCU_Status 3 "recoverable fault" 2 "recoverable fault" 1 "warning (derating" 0 "normal" ;
VAL_TABLE_ MCU_ActDischStatus 3 "failed" 2 "OK" 1 "selfchecking" 0 "default" ;
VAL_TABLE_ MCU_SelfCheck 3 "failed" 2 "OK" 1 "selfchecking" 0 "default" ;
VAL_TABLE_ MCU_ShutDownAllowed 1 "allowing" 0 "forbidding" ;
VAL_TABLE_ HCU_Poweroff 1 "Sleep" 0 "normal" ;
VAL_TABLE_ HCU_ActiveDischarge 1 "allowing" 0 "forbidding" ;
VAL_TABLE_ HCU_McuModeCmd 3 "reserved" 2 "speed mode" 1 "torque mode" 0 "default" ;
VAL_TABLE_ HCU_ready 1 "allowing" 0 "forbidding" ;
VAL_TABLE_ HCU_Shift 3 "P" 2 "D" 1 "R" 0 "N" ;

BO_ 3221225472 VECTOR__INDEPENDENT_SIG_MSG: 0 Vector__XXX
 SG_ New_Signal_3 : 0|8@1+ (1,0) [0|0] "" Vector__XXX

BO_ 1655 NM_Rx_0x677: 8 Vector__XXX
 SG_ NM_Rx_Sig : 23|8@0+ (1,0) [0|255] ""  ETAS

BO_ 1536 NM_Tx_0x600: 8 ETAS
 SG_ NM_Tx_Sig : 23|8@0+ (1,0) [0|255] "" Vector__XXX

CM_ BO_ 3221225472 "This is a message for not used signals, created by Vector CANdb++ DBC OLE DB Provider.";
BA_DEF_ BO_  "GenMsgILSupport" ENUM  "No","Yes";
BA_DEF_  "NmBaseAddress" HEX 1024 1087;
BA_DEF_  "BusType" STRING ;
BA_DEF_ BU_  "NmStationAddress" HEX 0 0;
BA_DEF_  "GenNWMApBusSleep" STRING ;
BA_DEF_  "GenNWMApCanNormal" STRING ;
BA_DEF_  "GenNWMApCanOff" STRING ;
BA_DEF_  "GenNWMApCanOn" STRING ;
BA_DEF_  "GenNWMApCanSleep" STRING ;
BA_DEF_  "GenNWMApCanWakeUp" STRING ;
BA_DEF_  "GenNWMGotoMode_Awake" STRING ;
BA_DEF_  "GenNWMGotoMode_BusSleep" STRING ;
BA_DEF_  "GenNWMTalkNM" STRING ;
BA_DEF_ BO_  "NmMessage" ENUM  "No","Yes";
BA_DEF_ BO_  "GenMsgCycleTime" INT 2 50000;
BA_DEF_ BO_  "GenMsgDelayTime" INT 1 1000;
BA_DEF_ BO_  "GenMsgNrOfRepetitions" INT 1 999999;
BA_DEF_  "GenEnvVarEndingDsp" STRING ;
BA_DEF_  "GenEnvVarEndingSnd" STRING ;
BA_DEF_  "GenEnvVarPrefix" STRING ;
BA_DEF_DEF_  "GenMsgILSupport" "Yes";
BA_DEF_DEF_  "NmBaseAddress" 1024;
BA_DEF_DEF_  "BusType" "CAN";
BA_DEF_DEF_  "NmStationAddress" 0;
BA_DEF_DEF_  "GenNWMApBusSleep" "apBusSleep()";
BA_DEF_DEF_  "GenNWMApCanNormal" "apCanNormal()";
BA_DEF_DEF_  "GenNWMApCanOff" "apCanOff()";
BA_DEF_DEF_  "GenNWMApCanOn" "apCanOn()";
BA_DEF_DEF_  "GenNWMApCanSleep" "apCanSleep()";
BA_DEF_DEF_  "GenNWMApCanWakeUp" "apCanWakeUp()";
BA_DEF_DEF_  "GenNWMGotoMode_Awake" "GotoMode_Awake()";
BA_DEF_DEF_  "GenNWMGotoMode_BusSleep" "GotoMode_BusSleep()";
BA_DEF_DEF_  "GenNWMTalkNM" "TalkNM()";
BA_DEF_DEF_  "NmMessage" "No";
BA_DEF_DEF_  "GenMsgCycleTime" 100;
BA_DEF_DEF_  "GenMsgDelayTime" 1;
BA_DEF_DEF_  "GenMsgNrOfRepetitions" 1;
BA_DEF_DEF_  "GenEnvVarEndingDsp" "Dsp_";
BA_DEF_DEF_  "GenEnvVarEndingSnd" "_";
BA_DEF_DEF_  "GenEnvVarPrefix" "Env";
BA_ "NmStationAddress" BU_ ETAS 248;
BA_ "NmMessage" BO_ 1655 1;
BA_ "NmMessage" BO_ 1536 1;

VERSION ""

NS_ :

BS_:

BU_: ETAS Tester

BO_ 819 XcpTx_0x333: 8 ETAS
 SG_ XcpTx_Sig : 7|8@0- (1,0) [0|255] ""  Tester

BO_ 818 XcpRx_0x332: 8 Tester
 SG_ XcpRx_Sig : 7|8@0- (1,0) [0|255] ""  ETAS

BA_DEF_  "BusType" STRING ;
BA_DEF_ BO_  "XcpReq" ENUM  "No","Yes";
BA_DEF_ BO_  "XcpResp" ENUM  "No","Yes";
BA_DEF_DEF_  "BusType" "CAN";
BA_DEF_DEF_  "XcpReq" "No";
BA_DEF_DEF_  "XcpResp" "No";
BA_ "XcpResp" BO_ 819 1;
BA_ "XcpReq" BO_ 818 1;

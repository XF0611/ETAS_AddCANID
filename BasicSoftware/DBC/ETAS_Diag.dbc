VERSION ""

NS_ :

BS_:

BU_: ETAS

BO_ 2015 UdsRxFnc: 8 Vector__XXX
 SG_ UdsRxFnc_Sig : 7|64@0+ (1,0) [0|255] ""  ETAS

BO_ 1856 UdsRxPhy: 8 Vector__XXX
 SG_ UdsRxPhy_Sig : 7|64@0+ (1,0) [0|255] ""  ETAS

BO_ 1864 UdsTxPhy: 8 ETAS
 SG_ UdsTxPhy_Sig : 7|64@0+ (1,0) [0|255] "" Vector__XXX

BA_DEF_ BO_  "DiagRequest" ENUM  "No","Yes";
BA_DEF_ BO_  "DiagResponse" ENUM  "No","Yes";
BA_DEF_DEF_  "DiagRequest" "No";
BA_DEF_DEF_  "DiagResponse" "No";
BA_ "DiagRequest" BO_ 2015 1;
BA_ "DiagRequest" BO_ 1856 1;
BA_ "DiagResponse" BO_ 1864 1;

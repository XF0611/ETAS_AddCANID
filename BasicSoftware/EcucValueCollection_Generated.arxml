AUTOSAR XML (schema 00047)
package /ETAS_BIP/EcucModuleConfigurationValuess
  ecuc value collection EcucValueCollection: ecu-extract=EXTR_ETAS
    ecuc-values:
      Rte
      BswM
      Os
      EcuC
      Bfx
      EcuM
      ComStack
      Crc
      Xcp
      Standard
      Rtm
      FiM
      Fls
      Mfl
      StackM
      NvM
      Fee
      Dem
      Det
      rba_MemLib
      CanTp
      CanNm
      CanSM
      MemIf
      Nm
      Com
      ComM
      Dcm
      CanIf
      PduR
      rba_ArxmlGen
      Linker
      Mcu
      Platform
      WdgM
      Wdg
      WdgIf
      ExtWdg
      Can

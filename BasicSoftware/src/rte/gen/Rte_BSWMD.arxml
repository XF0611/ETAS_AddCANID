[part 2 of 2: packages /AUTOSAR_Rte/BswModuleEntrys to /AUTOSAR_Rte/SwBaseTypes]
AUTOSAR XML (schema 00047)
package /AUTOSAR_Rte/BswModuleEntrys
  533 x bsw module entry:
    RE_StoreAtShutdown_NvBlock: call-type=REGULAR
    RE_StoreCyclic_NvBlock: call-type=REGULAR
    RE_StoreImmediate_NvBlock: call-type=REGULAR
    Rte_ActivateRE: call-type=REGULAR
    Rte_CData_CalUT_SpeedLimitLower: call-type=REGULAR
    Rte_CData_CalUT_SpeedLimitUpper: call-type=REGULAR
    Rte_CData_CalUT_sharedCURVE: call-type=REGULAR
    Rte_CData_CalUT_sharedMAP: call-type=REGULAR
    Rte_Call_Dcm_RoutineServices_Routine_Control_203_Start: call-type=REGULAR
    Rte_Call_Dcm_RoutineServices_Routine_Control_ABFF_RequestResults: call-type=REGULAR
    Rte_Call_Dcm_RoutineServices_Routine_Control_ABFF_Start: call-type=REGULAR
    Rte_Call_Dcm_RoutineServices_X_Routine_Control_ABFE_Start: call-type=REGULAR
    Rte_Call_Dcm_SecurityAccess_UnlockedL1_CompareKey: call-type=REGULAR
    Rte_Call_Dcm_SecurityAccess_UnlockedL1_GetSeed: call-type=REGULAR
    Rte_Call_Dcm_SecurityAccess_Unlocked_L3_CompareKey: call-type=REGULAR
    Rte_Call_Dcm_SecurityAccess_Unlocked_L3_GetSeed: call-type=REGULAR
    Rte_Call_Dem_CBClrEvt_DTC_0x000001_Event_ClearEventAllowed: call-type=REGULAR
    Rte_Call_Dem_CBClrEvt_DTC_0x0d0400_CAN_Network_ETAS_BusOff_Event_ClearEventAllowed: call-type=REGULAR
    Rte_Call_Dem_CBClrEvt_DTC_0xc07388_Event_ClearEventAllowed: call-type=REGULAR
    Rte_Call_Dem_CBClrEvt_DTC_0xc12687_Event_ClearEventAllowed: call-type=REGULAR
    Rte_Call_Dem_CBClrEvt_DTC_0xc14587_Event_ClearEventAllowed: call-type=REGULAR
    Rte_Call_Dem_CBClrEvt_DTC_0xc22a87_Event_ClearEventAllowed: call-type=REGULAR
    Rte_Call_Dem_CBClrEvt_DTC_0xc41487_Event_ClearEventAllowed: call-type=REGULAR
    Rte_Call_Dem_CBClrEvt_DTC_0xd56217_Event_ClearEventAllowed: call-type=REGULAR
    Rte_Call_Dem_CBClrEvt_DTC_0xd56316_Event_ClearEventAllowed: call-type=REGULAR
    Rte_Call_Dem_CBClrEvt_DTC_0xe00141_Event_ClearEventAllowed: call-type=REGULAR
    Rte_Call_Dem_CBClrEvt_DTC_0xe00142_Event_ClearEventAllowed: call-type=REGULAR
    Rte_Call_Dem_CBClrEvt_DTC_0xe26200_Event_ClearEventAllowed: call-type=REGULAR
    Rte_Call_DiagUT_ControlEventAvailable_EventParameter_DTC_0x000001_Event_SetEventAvailable: call-type=REGULAR
    Rte_Call_DiagUT_ControlEventAvailable_EventParameter_DTC_0xc07388_Event_SetEventAvailable: call-type=REGULAR
    Rte_Call_DiagUT_ControlEventAvailable_EventParameter_DTC_0xc12687_Event_SetEventAvailable: call-type=REGULAR
    Rte_Call_DiagUT_ControlEventAvailable_EventParameter_DTC_0xc14587_Event_SetEventAvailable: call-type=REGULAR
    Rte_Call_DiagUT_ControlEventAvailable_EventParameter_DTC_0xc22a87_Event_SetEventAvailable: call-type=REGULAR
    Rte_Call_DiagUT_ControlEventAvailable_EventParameter_DTC_0xc41487_Event_SetEventAvailable: call-type=REGULAR
    Rte_Call_DiagUT_ControlEventAvailable_EventParameter_DTC_0xd56217_Event_SetEventAvailable: call-type=REGULAR
    Rte_Call_DiagUT_ControlEventAvailable_EventParameter_DTC_0xd56316_Event_SetEventAvailable: call-type=REGULAR
    Rte_Call_DiagUT_ControlEventAvailable_EventParameter_DTC_0xe00141_Event_SetEventAvailable: call-type=REGULAR
    Rte_Call_DiagUT_ControlEventAvailable_EventParameter_DTC_0xe00142_Event_SetEventAvailable: call-type=REGULAR
    Rte_Call_DiagUT_ControlEventAvailable_EventParameter_DTC_0xe26200_Event_SetEventAvailable: call-type=REGULAR
    Rte_Call_DiagUT_DCMServices_GetActiveProtocol: call-type=REGULAR
    Rte_Call_DiagUT_DCMServices_GetSecurityLevel: call-type=REGULAR
    Rte_Call_DiagUT_DCMServices_GetSesCtrlType: call-type=REGULAR
    Rte_Call_DiagUT_DCMServices_ResetToDefaultSession: call-type=REGULAR
    Rte_Call_DiagUT_DCMServices_SetActiveDiagnostic: call-type=REGULAR
    Rte_Call_DiagUT_EventStatus_EventParameter_DTC_0x000001_Event_SetWIRStatus: call-type=REGULAR
    Rte_Call_DiagUT_EventStatus_EventParameter_DTC_0xc07388_Event_SetWIRStatus: call-type=REGULAR
    Rte_Call_DiagUT_EventStatus_EventParameter_DTC_0xc12687_Event_SetWIRStatus: call-type=REGULAR
    Rte_Call_DiagUT_EventStatus_EventParameter_DTC_0xc14587_Event_SetWIRStatus: call-type=REGULAR
    Rte_Call_DiagUT_EventStatus_EventParameter_DTC_0xc22a87_Event_SetWIRStatus: call-type=REGULAR
    Rte_Call_DiagUT_EventStatus_EventParameter_DTC_0xc41487_Event_SetWIRStatus: call-type=REGULAR
    Rte_Call_DiagUT_EventStatus_EventParameter_DTC_0xd56217_Event_SetWIRStatus: call-type=REGULAR
    Rte_Call_DiagUT_EventStatus_EventParameter_DTC_0xd56316_Event_SetWIRStatus: call-type=REGULAR
    Rte_Call_DiagUT_EventStatus_EventParameter_DTC_0xe00141_Event_SetWIRStatus: call-type=REGULAR
    Rte_Call_DiagUT_EventStatus_EventParameter_DTC_0xe00142_Event_SetWIRStatus: call-type=REGULAR
    Rte_Call_DiagUT_EventStatus_EventParameter_DTC_0xe26200_Event_SetWIRStatus: call-type=REGULAR
    Rte_Call_DiagUT_Event_EventParameter_DTC_0x000001_Event_ClearPrestoredFreezeFrame: call-type=REGULAR
    Rte_Call_DiagUT_Event_EventParameter_DTC_0x000001_Event_PrestoreFreezeFrame: call-type=REGULAR
    Rte_Call_DiagUT_Event_EventParameter_DTC_0x000001_Event_ResetEventDebounceStatus: call-type=REGULAR
    Rte_Call_DiagUT_Event_EventParameter_DTC_0x000001_Event_ResetEventStatus: call-type=REGULAR
    Rte_Call_DiagUT_Event_EventParameter_DTC_0x000001_Event_SetEventStatus: call-type=REGULAR
    Rte_Call_DiagUT_Event_EventParameter_DTC_0x000001_Event_SetEventStatusWithEnvdata: call-type=REGULAR
    Rte_Call_DiagUT_Event_EventParameter_DTC_0xc07388_Event_ClearPrestoredFreezeFrame: call-type=REGULAR
    Rte_Call_DiagUT_Event_EventParameter_DTC_0xc07388_Event_PrestoreFreezeFrame: call-type=REGULAR
    Rte_Call_DiagUT_Event_EventParameter_DTC_0xc07388_Event_ResetEventDebounceStatus: call-type=REGULAR
    Rte_Call_DiagUT_Event_EventParameter_DTC_0xc07388_Event_ResetEventStatus: call-type=REGULAR
    Rte_Call_DiagUT_Event_EventParameter_DTC_0xc07388_Event_SetEventStatus: call-type=REGULAR
    Rte_Call_DiagUT_Event_EventParameter_DTC_0xc07388_Event_SetEventStatusWithEnvdata: call-type=REGULAR
    Rte_Call_DiagUT_Event_EventParameter_DTC_0xc12687_Event_ClearPrestoredFreezeFrame: call-type=REGULAR
    Rte_Call_DiagUT_Event_EventParameter_DTC_0xc12687_Event_PrestoreFreezeFrame: call-type=REGULAR
    Rte_Call_DiagUT_Event_EventParameter_DTC_0xc12687_Event_ResetEventDebounceStatus: call-type=REGULAR
    Rte_Call_DiagUT_Event_EventParameter_DTC_0xc12687_Event_ResetEventStatus: call-type=REGULAR
    Rte_Call_DiagUT_Event_EventParameter_DTC_0xc12687_Event_SetEventStatus: call-type=REGULAR
    Rte_Call_DiagUT_Event_EventParameter_DTC_0xc12687_Event_SetEventStatusWithEnvdata: call-type=REGULAR
    Rte_Call_DiagUT_Event_EventParameter_DTC_0xc14587_Event_ClearPrestoredFreezeFrame: call-type=REGULAR
    Rte_Call_DiagUT_Event_EventParameter_DTC_0xc14587_Event_PrestoreFreezeFrame: call-type=REGULAR
    Rte_Call_DiagUT_Event_EventParameter_DTC_0xc14587_Event_ResetEventDebounceStatus: call-type=REGULAR
    Rte_Call_DiagUT_Event_EventParameter_DTC_0xc14587_Event_ResetEventStatus: call-type=REGULAR
    Rte_Call_DiagUT_Event_EventParameter_DTC_0xc14587_Event_SetEventStatus: call-type=REGULAR
    Rte_Call_DiagUT_Event_EventParameter_DTC_0xc14587_Event_SetEventStatusWithEnvdata: call-type=REGULAR
    Rte_Call_DiagUT_Event_EventParameter_DTC_0xc22a87_Event_ClearPrestoredFreezeFrame: call-type=REGULAR
    Rte_Call_DiagUT_Event_EventParameter_DTC_0xc22a87_Event_PrestoreFreezeFrame: call-type=REGULAR
    Rte_Call_DiagUT_Event_EventParameter_DTC_0xc22a87_Event_ResetEventDebounceStatus: call-type=REGULAR
    Rte_Call_DiagUT_Event_EventParameter_DTC_0xc22a87_Event_ResetEventStatus: call-type=REGULAR
    Rte_Call_DiagUT_Event_EventParameter_DTC_0xc22a87_Event_SetEventStatus: call-type=REGULAR
    Rte_Call_DiagUT_Event_EventParameter_DTC_0xc22a87_Event_SetEventStatusWithEnvdata: call-type=REGULAR
    Rte_Call_DiagUT_Event_EventParameter_DTC_0xc41487_Event_ClearPrestoredFreezeFrame: call-type=REGULAR
    Rte_Call_DiagUT_Event_EventParameter_DTC_0xc41487_Event_PrestoreFreezeFrame: call-type=REGULAR
    Rte_Call_DiagUT_Event_EventParameter_DTC_0xc41487_Event_ResetEventDebounceStatus: call-type=REGULAR
    Rte_Call_DiagUT_Event_EventParameter_DTC_0xc41487_Event_ResetEventStatus: call-type=REGULAR
    Rte_Call_DiagUT_Event_EventParameter_DTC_0xc41487_Event_SetEventStatus: call-type=REGULAR
    Rte_Call_DiagUT_Event_EventParameter_DTC_0xc41487_Event_SetEventStatusWithEnvdata: call-type=REGULAR
    Rte_Call_DiagUT_Event_EventParameter_DTC_0xd56217_Event_ClearPrestoredFreezeFrame: call-type=REGULAR
    Rte_Call_DiagUT_Event_EventParameter_DTC_0xd56217_Event_PrestoreFreezeFrame: call-type=REGULAR
    Rte_Call_DiagUT_Event_EventParameter_DTC_0xd56217_Event_ResetEventDebounceStatus: call-type=REGULAR
    Rte_Call_DiagUT_Event_EventParameter_DTC_0xd56217_Event_ResetEventStatus: call-type=REGULAR
    Rte_Call_DiagUT_Event_EventParameter_DTC_0xd56217_Event_SetEventStatus: call-type=REGULAR
    Rte_Call_DiagUT_Event_EventParameter_DTC_0xd56217_Event_SetEventStatusWithEnvdata: call-type=REGULAR
    Rte_Call_DiagUT_Event_EventParameter_DTC_0xd56316_Event_ClearPrestoredFreezeFrame: call-type=REGULAR
    Rte_Call_DiagUT_Event_EventParameter_DTC_0xd56316_Event_PrestoreFreezeFrame: call-type=REGULAR
    Rte_Call_DiagUT_Event_EventParameter_DTC_0xd56316_Event_ResetEventDebounceStatus: call-type=REGULAR
    Rte_Call_DiagUT_Event_EventParameter_DTC_0xd56316_Event_ResetEventStatus: call-type=REGULAR
    Rte_Call_DiagUT_Event_EventParameter_DTC_0xd56316_Event_SetEventStatus: call-type=REGULAR
    Rte_Call_DiagUT_Event_EventParameter_DTC_0xd56316_Event_SetEventStatusWithEnvdata: call-type=REGULAR
    Rte_Call_DiagUT_Event_EventParameter_DTC_0xe00141_Event_ClearPrestoredFreezeFrame: call-type=REGULAR
    Rte_Call_DiagUT_Event_EventParameter_DTC_0xe00141_Event_PrestoreFreezeFrame: call-type=REGULAR
    Rte_Call_DiagUT_Event_EventParameter_DTC_0xe00141_Event_ResetEventDebounceStatus: call-type=REGULAR
    Rte_Call_DiagUT_Event_EventParameter_DTC_0xe00141_Event_ResetEventStatus: call-type=REGULAR
    Rte_Call_DiagUT_Event_EventParameter_DTC_0xe00141_Event_SetEventStatus: call-type=REGULAR
    Rte_Call_DiagUT_Event_EventParameter_DTC_0xe00141_Event_SetEventStatusWithEnvdata: call-type=REGULAR
    Rte_Call_DiagUT_Event_EventParameter_DTC_0xe00142_Event_ClearPrestoredFreezeFrame: call-type=REGULAR
    Rte_Call_DiagUT_Event_EventParameter_DTC_0xe00142_Event_PrestoreFreezeFrame: call-type=REGULAR
    Rte_Call_DiagUT_Event_EventParameter_DTC_0xe00142_Event_ResetEventDebounceStatus: call-type=REGULAR
    Rte_Call_DiagUT_Event_EventParameter_DTC_0xe00142_Event_ResetEventStatus: call-type=REGULAR
    Rte_Call_DiagUT_Event_EventParameter_DTC_0xe00142_Event_SetEventStatus: call-type=REGULAR
    Rte_Call_DiagUT_Event_EventParameter_DTC_0xe00142_Event_SetEventStatusWithEnvdata: call-type=REGULAR
    Rte_Call_DiagUT_Event_EventParameter_DTC_0xe26200_Event_ClearPrestoredFreezeFrame: call-type=REGULAR
    Rte_Call_DiagUT_Event_EventParameter_DTC_0xe26200_Event_PrestoreFreezeFrame: call-type=REGULAR
    Rte_Call_DiagUT_Event_EventParameter_DTC_0xe26200_Event_ResetEventDebounceStatus: call-type=REGULAR
    Rte_Call_DiagUT_Event_EventParameter_DTC_0xe26200_Event_ResetEventStatus: call-type=REGULAR
    Rte_Call_DiagUT_Event_EventParameter_DTC_0xe26200_Event_SetEventStatus: call-type=REGULAR
    Rte_Call_DiagUT_Event_EventParameter_DTC_0xe26200_Event_SetEventStatusWithEnvdata: call-type=REGULAR
    Rte_Call_DiagUT_EvtInfo_EventParameter_DTC_0x000001_Event_GetDTCOfEvent: call-type=REGULAR
    Rte_Call_DiagUT_EvtInfo_EventParameter_DTC_0x000001_Event_GetDebouncingOfEvent: call-type=REGULAR
    Rte_Call_DiagUT_EvtInfo_EventParameter_DTC_0x000001_Event_GetEventExtendedDataRecord: call-type=REGULAR
    Rte_Call_DiagUT_EvtInfo_EventParameter_DTC_0x000001_Event_GetEventExtendedDataRecordEx: call-type=REGULAR
    Rte_Call_DiagUT_EvtInfo_EventParameter_DTC_0x000001_Event_GetEventFailed: call-type=REGULAR
    Rte_Call_DiagUT_EvtInfo_EventParameter_DTC_0x000001_Event_GetEventFreezeFrameData: call-type=REGULAR
    Rte_Call_DiagUT_EvtInfo_EventParameter_DTC_0x000001_Event_GetEventFreezeFrameDataEx: call-type=REGULAR
    Rte_Call_DiagUT_EvtInfo_EventParameter_DTC_0x000001_Event_GetEventStatus: call-type=REGULAR
    Rte_Call_DiagUT_EvtInfo_EventParameter_DTC_0x000001_Event_GetEventTested: call-type=REGULAR
    Rte_Call_DiagUT_EvtInfo_EventParameter_DTC_0x000001_Event_GetFaultDetectionCounter: call-type=REGULAR
    Rte_Call_DiagUT_EvtInfo_EventParameter_DTC_0x0d0400_CAN_Network_ETAS_BusOff_Event_GetDTCOfEvent: call-type=REGULAR
    Rte_Call_DiagUT_EvtInfo_EventParameter_DTC_0x0d0400_CAN_Network_ETAS_BusOff_Event_GetDebouncingOfEvent: call-type=REGULAR
    Rte_Call_DiagUT_EvtInfo_EventParameter_DTC_0x0d0400_CAN_Network_ETAS_BusOff_Event_GetEventExtendedDataRecord: call-type=REGULAR
    Rte_Call_DiagUT_EvtInfo_EventParameter_DTC_0x0d0400_CAN_Network_ETAS_BusOff_Event_GetEventExtendedDataRecordEx: call-type=REGULAR
    Rte_Call_DiagUT_EvtInfo_EventParameter_DTC_0x0d0400_CAN_Network_ETAS_BusOff_Event_GetEventFailed: call-type=REGULAR
    Rte_Call_DiagUT_EvtInfo_EventParameter_DTC_0x0d0400_CAN_Network_ETAS_BusOff_Event_GetEventFreezeFrameData: call-type=REGULAR
    Rte_Call_DiagUT_EvtInfo_EventParameter_DTC_0x0d0400_CAN_Network_ETAS_BusOff_Event_GetEventFreezeFrameDataEx: call-type=REGULAR
    Rte_Call_DiagUT_EvtInfo_EventParameter_DTC_0x0d0400_CAN_Network_ETAS_BusOff_Event_GetEventStatus: call-type=REGULAR
    Rte_Call_DiagUT_EvtInfo_EventParameter_DTC_0x0d0400_CAN_Network_ETAS_BusOff_Event_GetEventTested: call-type=REGULAR
    Rte_Call_DiagUT_EvtInfo_EventParameter_DTC_0x0d0400_CAN_Network_ETAS_BusOff_Event_GetFaultDetectionCounter: call-type=REGULAR
    Rte_Call_DiagUT_EvtInfo_EventParameter_DTC_0xc07388_Event_GetDTCOfEvent: call-type=REGULAR
    Rte_Call_DiagUT_EvtInfo_EventParameter_DTC_0xc07388_Event_GetDebouncingOfEvent: call-type=REGULAR
    Rte_Call_DiagUT_EvtInfo_EventParameter_DTC_0xc07388_Event_GetEventExtendedDataRecord: call-type=REGULAR
    Rte_Call_DiagUT_EvtInfo_EventParameter_DTC_0xc07388_Event_GetEventExtendedDataRecordEx: call-type=REGULAR
    Rte_Call_DiagUT_EvtInfo_EventParameter_DTC_0xc07388_Event_GetEventFailed: call-type=REGULAR
    Rte_Call_DiagUT_EvtInfo_EventParameter_DTC_0xc07388_Event_GetEventFreezeFrameData: call-type=REGULAR
    Rte_Call_DiagUT_EvtInfo_EventParameter_DTC_0xc07388_Event_GetEventFreezeFrameDataEx: call-type=REGULAR
    Rte_Call_DiagUT_EvtInfo_EventParameter_DTC_0xc07388_Event_GetEventStatus: call-type=REGULAR
    Rte_Call_DiagUT_EvtInfo_EventParameter_DTC_0xc07388_Event_GetEventTested: call-type=REGULAR
    Rte_Call_DiagUT_EvtInfo_EventParameter_DTC_0xc07388_Event_GetFaultDetectionCounter: call-type=REGULAR
    Rte_Call_DiagUT_EvtInfo_EventParameter_DTC_0xc12687_Event_GetDTCOfEvent: call-type=REGULAR
    Rte_Call_DiagUT_EvtInfo_EventParameter_DTC_0xc12687_Event_GetDebouncingOfEvent: call-type=REGULAR
    Rte_Call_DiagUT_EvtInfo_EventParameter_DTC_0xc12687_Event_GetEventExtendedDataRecord: call-type=REGULAR
    Rte_Call_DiagUT_EvtInfo_EventParameter_DTC_0xc12687_Event_GetEventExtendedDataRecordEx: call-type=REGULAR
    Rte_Call_DiagUT_EvtInfo_EventParameter_DTC_0xc12687_Event_GetEventFailed: call-type=REGULAR
    Rte_Call_DiagUT_EvtInfo_EventParameter_DTC_0xc12687_Event_GetEventFreezeFrameData: call-type=REGULAR
    Rte_Call_DiagUT_EvtInfo_EventParameter_DTC_0xc12687_Event_GetEventFreezeFrameDataEx: call-type=REGULAR
    Rte_Call_DiagUT_EvtInfo_EventParameter_DTC_0xc12687_Event_GetEventStatus: call-type=REGULAR
    Rte_Call_DiagUT_EvtInfo_EventParameter_DTC_0xc12687_Event_GetEventTested: call-type=REGULAR
    Rte_Call_DiagUT_EvtInfo_EventParameter_DTC_0xc12687_Event_GetFaultDetectionCounter: call-type=REGULAR
    Rte_Call_DiagUT_EvtInfo_EventParameter_DTC_0xc14587_Event_GetDTCOfEvent: call-type=REGULAR
    Rte_Call_DiagUT_EvtInfo_EventParameter_DTC_0xc14587_Event_GetDebouncingOfEvent: call-type=REGULAR
    Rte_Call_DiagUT_EvtInfo_EventParameter_DTC_0xc14587_Event_GetEventExtendedDataRecord: call-type=REGULAR
    Rte_Call_DiagUT_EvtInfo_EventParameter_DTC_0xc14587_Event_GetEventExtendedDataRecordEx: call-type=REGULAR
    Rte_Call_DiagUT_EvtInfo_EventParameter_DTC_0xc14587_Event_GetEventFailed: call-type=REGULAR
    Rte_Call_DiagUT_EvtInfo_EventParameter_DTC_0xc14587_Event_GetEventFreezeFrameData: call-type=REGULAR
    Rte_Call_DiagUT_EvtInfo_EventParameter_DTC_0xc14587_Event_GetEventFreezeFrameDataEx: call-type=REGULAR
    Rte_Call_DiagUT_EvtInfo_EventParameter_DTC_0xc14587_Event_GetEventStatus: call-type=REGULAR
    Rte_Call_DiagUT_EvtInfo_EventParameter_DTC_0xc14587_Event_GetEventTested: call-type=REGULAR
    Rte_Call_DiagUT_EvtInfo_EventParameter_DTC_0xc14587_Event_GetFaultDetectionCounter: call-type=REGULAR
    Rte_Call_DiagUT_EvtInfo_EventParameter_DTC_0xc22a87_Event_GetDTCOfEvent: call-type=REGULAR
    Rte_Call_DiagUT_EvtInfo_EventParameter_DTC_0xc22a87_Event_GetDebouncingOfEvent: call-type=REGULAR
    Rte_Call_DiagUT_EvtInfo_EventParameter_DTC_0xc22a87_Event_GetEventExtendedDataRecord: call-type=REGULAR
    Rte_Call_DiagUT_EvtInfo_EventParameter_DTC_0xc22a87_Event_GetEventExtendedDataRecordEx: call-type=REGULAR
    Rte_Call_DiagUT_EvtInfo_EventParameter_DTC_0xc22a87_Event_GetEventFailed: call-type=REGULAR
    Rte_Call_DiagUT_EvtInfo_EventParameter_DTC_0xc22a87_Event_GetEventFreezeFrameData: call-type=REGULAR
    Rte_Call_DiagUT_EvtInfo_EventParameter_DTC_0xc22a87_Event_GetEventFreezeFrameDataEx: call-type=REGULAR
    Rte_Call_DiagUT_EvtInfo_EventParameter_DTC_0xc22a87_Event_GetEventStatus: call-type=REGULAR
    Rte_Call_DiagUT_EvtInfo_EventParameter_DTC_0xc22a87_Event_GetEventTested: call-type=REGULAR
    Rte_Call_DiagUT_EvtInfo_EventParameter_DTC_0xc22a87_Event_GetFaultDetectionCounter: call-type=REGULAR
    Rte_Call_DiagUT_EvtInfo_EventParameter_DTC_0xc41487_Event_GetDTCOfEvent: call-type=REGULAR
    Rte_Call_DiagUT_EvtInfo_EventParameter_DTC_0xc41487_Event_GetDebouncingOfEvent: call-type=REGULAR
    Rte_Call_DiagUT_EvtInfo_EventParameter_DTC_0xc41487_Event_GetEventExtendedDataRecord: call-type=REGULAR
    Rte_Call_DiagUT_EvtInfo_EventParameter_DTC_0xc41487_Event_GetEventExtendedDataRecordEx: call-type=REGULAR
    Rte_Call_DiagUT_EvtInfo_EventParameter_DTC_0xc41487_Event_GetEventFailed: call-type=REGULAR
    Rte_Call_DiagUT_EvtInfo_EventParameter_DTC_0xc41487_Event_GetEventFreezeFrameData: call-type=REGULAR
    Rte_Call_DiagUT_EvtInfo_EventParameter_DTC_0xc41487_Event_GetEventFreezeFrameDataEx: call-type=REGULAR
    Rte_Call_DiagUT_EvtInfo_EventParameter_DTC_0xc41487_Event_GetEventStatus: call-type=REGULAR
    Rte_Call_DiagUT_EvtInfo_EventParameter_DTC_0xc41487_Event_GetEventTested: call-type=REGULAR
    Rte_Call_DiagUT_EvtInfo_EventParameter_DTC_0xc41487_Event_GetFaultDetectionCounter: call-type=REGULAR
    Rte_Call_DiagUT_EvtInfo_EventParameter_DTC_0xd56217_Event_GetDTCOfEvent: call-type=REGULAR
    Rte_Call_DiagUT_EvtInfo_EventParameter_DTC_0xd56217_Event_GetDebouncingOfEvent: call-type=REGULAR
    Rte_Call_DiagUT_EvtInfo_EventParameter_DTC_0xd56217_Event_GetEventExtendedDataRecord: call-type=REGULAR
    Rte_Call_DiagUT_EvtInfo_EventParameter_DTC_0xd56217_Event_GetEventExtendedDataRecordEx: call-type=REGULAR
    Rte_Call_DiagUT_EvtInfo_EventParameter_DTC_0xd56217_Event_GetEventFailed: call-type=REGULAR
    Rte_Call_DiagUT_EvtInfo_EventParameter_DTC_0xd56217_Event_GetEventFreezeFrameData: call-type=REGULAR
    Rte_Call_DiagUT_EvtInfo_EventParameter_DTC_0xd56217_Event_GetEventFreezeFrameDataEx: call-type=REGULAR
    Rte_Call_DiagUT_EvtInfo_EventParameter_DTC_0xd56217_Event_GetEventStatus: call-type=REGULAR
    Rte_Call_DiagUT_EvtInfo_EventParameter_DTC_0xd56217_Event_GetEventTested: call-type=REGULAR
    Rte_Call_DiagUT_EvtInfo_EventParameter_DTC_0xd56217_Event_GetFaultDetectionCounter: call-type=REGULAR
    Rte_Call_DiagUT_EvtInfo_EventParameter_DTC_0xd56316_Event_GetDTCOfEvent: call-type=REGULAR
    Rte_Call_DiagUT_EvtInfo_EventParameter_DTC_0xd56316_Event_GetDebouncingOfEvent: call-type=REGULAR
    Rte_Call_DiagUT_EvtInfo_EventParameter_DTC_0xd56316_Event_GetEventExtendedDataRecord: call-type=REGULAR
    Rte_Call_DiagUT_EvtInfo_EventParameter_DTC_0xd56316_Event_GetEventExtendedDataRecordEx: call-type=REGULAR
    Rte_Call_DiagUT_EvtInfo_EventParameter_DTC_0xd56316_Event_GetEventFailed: call-type=REGULAR
    Rte_Call_DiagUT_EvtInfo_EventParameter_DTC_0xd56316_Event_GetEventFreezeFrameData: call-type=REGULAR
    Rte_Call_DiagUT_EvtInfo_EventParameter_DTC_0xd56316_Event_GetEventFreezeFrameDataEx: call-type=REGULAR
    Rte_Call_DiagUT_EvtInfo_EventParameter_DTC_0xd56316_Event_GetEventStatus: call-type=REGULAR
    Rte_Call_DiagUT_EvtInfo_EventParameter_DTC_0xd56316_Event_GetEventTested: call-type=REGULAR
    Rte_Call_DiagUT_EvtInfo_EventParameter_DTC_0xd56316_Event_GetFaultDetectionCounter: call-type=REGULAR
    Rte_Call_DiagUT_EvtInfo_EventParameter_DTC_0xe00141_Event_GetDTCOfEvent: call-type=REGULAR
    Rte_Call_DiagUT_EvtInfo_EventParameter_DTC_0xe00141_Event_GetDebouncingOfEvent: call-type=REGULAR
    Rte_Call_DiagUT_EvtInfo_EventParameter_DTC_0xe00141_Event_GetEventExtendedDataRecord: call-type=REGULAR
    Rte_Call_DiagUT_EvtInfo_EventParameter_DTC_0xe00141_Event_GetEventExtendedDataRecordEx: call-type=REGULAR
    Rte_Call_DiagUT_EvtInfo_EventParameter_DTC_0xe00141_Event_GetEventFailed: call-type=REGULAR
    Rte_Call_DiagUT_EvtInfo_EventParameter_DTC_0xe00141_Event_GetEventFreezeFrameData: call-type=REGULAR
    Rte_Call_DiagUT_EvtInfo_EventParameter_DTC_0xe00141_Event_GetEventFreezeFrameDataEx: call-type=REGULAR
    Rte_Call_DiagUT_EvtInfo_EventParameter_DTC_0xe00141_Event_GetEventStatus: call-type=REGULAR
    Rte_Call_DiagUT_EvtInfo_EventParameter_DTC_0xe00141_Event_GetEventTested: call-type=REGULAR
    Rte_Call_DiagUT_EvtInfo_EventParameter_DTC_0xe00141_Event_GetFaultDetectionCounter: call-type=REGULAR
    Rte_Call_DiagUT_EvtInfo_EventParameter_DTC_0xe00142_Event_GetDTCOfEvent: call-type=REGULAR
    Rte_Call_DiagUT_EvtInfo_EventParameter_DTC_0xe00142_Event_GetDebouncingOfEvent: call-type=REGULAR
    Rte_Call_DiagUT_EvtInfo_EventParameter_DTC_0xe00142_Event_GetEventExtendedDataRecord: call-type=REGULAR
    Rte_Call_DiagUT_EvtInfo_EventParameter_DTC_0xe00142_Event_GetEventExtendedDataRecordEx: call-type=REGULAR
    Rte_Call_DiagUT_EvtInfo_EventParameter_DTC_0xe00142_Event_GetEventFailed: call-type=REGULAR
    Rte_Call_DiagUT_EvtInfo_EventParameter_DTC_0xe00142_Event_GetEventFreezeFrameData: call-type=REGULAR
    Rte_Call_DiagUT_EvtInfo_EventParameter_DTC_0xe00142_Event_GetEventFreezeFrameDataEx: call-type=REGULAR
    Rte_Call_DiagUT_EvtInfo_EventParameter_DTC_0xe00142_Event_GetEventStatus: call-type=REGULAR
    Rte_Call_DiagUT_EvtInfo_EventParameter_DTC_0xe00142_Event_GetEventTested: call-type=REGULAR
    Rte_Call_DiagUT_EvtInfo_EventParameter_DTC_0xe00142_Event_GetFaultDetectionCounter: call-type=REGULAR
    Rte_Call_DiagUT_EvtInfo_EventParameter_DTC_0xe26200_Event_GetDTCOfEvent: call-type=REGULAR
    Rte_Call_DiagUT_EvtInfo_EventParameter_DTC_0xe26200_Event_GetDebouncingOfEvent: call-type=REGULAR
    Rte_Call_DiagUT_EvtInfo_EventParameter_DTC_0xe26200_Event_GetEventExtendedDataRecord: call-type=REGULAR
    Rte_Call_DiagUT_EvtInfo_EventParameter_DTC_0xe26200_Event_GetEventExtendedDataRecordEx: call-type=REGULAR
    Rte_Call_DiagUT_EvtInfo_EventParameter_DTC_0xe26200_Event_GetEventFailed: call-type=REGULAR
    Rte_Call_DiagUT_EvtInfo_EventParameter_DTC_0xe26200_Event_GetEventFreezeFrameData: call-type=REGULAR
    Rte_Call_DiagUT_EvtInfo_EventParameter_DTC_0xe26200_Event_GetEventFreezeFrameDataEx: call-type=REGULAR
    Rte_Call_DiagUT_EvtInfo_EventParameter_DTC_0xe26200_Event_GetEventStatus: call-type=REGULAR
    Rte_Call_DiagUT_EvtInfo_EventParameter_DTC_0xe26200_Event_GetEventTested: call-type=REGULAR
    Rte_Call_DiagUT_EvtInfo_EventParameter_DTC_0xe26200_Event_GetFaultDetectionCounter: call-type=REGULAR
    Rte_Call_DiagUT_GeneralEvtInfo_GetDTCOfEvent: call-type=REGULAR
    Rte_Call_DiagUT_GeneralEvtInfo_GetDebouncingOfEvent: call-type=REGULAR
    Rte_Call_DiagUT_GeneralEvtInfo_GetEventExtendedDataRecord: call-type=REGULAR
    Rte_Call_DiagUT_GeneralEvtInfo_GetEventExtendedDataRecordEx: call-type=REGULAR
    Rte_Call_DiagUT_GeneralEvtInfo_GetEventFailed: call-type=REGULAR
    Rte_Call_DiagUT_GeneralEvtInfo_GetEventFreezeFrameData: call-type=REGULAR
    Rte_Call_DiagUT_GeneralEvtInfo_GetEventFreezeFrameDataEx: call-type=REGULAR
    Rte_Call_DiagUT_GeneralEvtInfo_GetEventIdCausingLastDetError: call-type=REGULAR
    Rte_Call_DiagUT_GeneralEvtInfo_GetEventStatus: call-type=REGULAR
    Rte_Call_DiagUT_GeneralEvtInfo_GetEventTested: call-type=REGULAR
    Rte_Call_DiagUT_GeneralEvtInfo_GetFaultDetectionCounter: call-type=REGULAR
    Rte_Call_DiagUT_OpCycle_DemOpCycle_DEM_POWER_GetCycleQualified: call-type=REGULAR
    Rte_Call_DiagUT_OpCycle_DemOpCycle_DEM_POWER_GetOperationCycleState: call-type=REGULAR
    Rte_Call_DiagUT_OpCycle_DemOpCycle_DEM_POWER_SetCycleQualified: call-type=REGULAR
    Rte_Call_DiagUT_OpCycle_DemOpCycle_DEM_POWER_SetOperationCycleState: call-type=REGULAR
    Rte_Call_DiagUT_StorageCond_DemStorageCondition_0_GetStorageCondition: call-type=REGULAR
    Rte_Call_DiagUT_StorageCond_DemStorageCondition_0_SetStorageCondition: call-type=REGULAR
    Rte_Call_ExeMgrUT_RP_EcuM_SelectResetTarget_GetLastShutdownTarget: call-type=REGULAR
    Rte_Call_ExeMgrUT_RP_EcuM_SelectResetTarget_GetShutdownCause: call-type=REGULAR
    Rte_Call_ExeMgrUT_RP_EcuM_SelectResetTarget_GetShutdownTarget: call-type=REGULAR
    Rte_Call_ExeMgrUT_RP_EcuM_SelectResetTarget_SelectShutdownCause: call-type=REGULAR
    Rte_Call_ExeMgrUT_RP_EcuM_SelectResetTarget_SelectShutdownTarget: call-type=REGULAR
    Rte_Call_NmUT_UR_ComMUser_Can_Network_ETAS_Channel_GetCurrentComMode: call-type=REGULAR
    Rte_Call_NmUT_UR_ComMUser_Can_Network_ETAS_Channel_GetMaxComMode: call-type=REGULAR
    Rte_Call_NmUT_UR_ComMUser_Can_Network_ETAS_Channel_GetRequestedComMode: call-type=REGULAR
    Rte_Call_NmUT_UR_ComMUser_Can_Network_ETAS_Channel_RequestComMode: call-type=REGULAR
    Rte_Call_NmUT_modeLimitation_LimitECUToNoComMode: call-type=REGULAR
    Rte_Call_NmUT_modeLimitation_ReadInhibitCounter: call-type=REGULAR
    Rte_Call_NmUT_modeLimitation_ResetInhibitCounter: call-type=REGULAR
    Rte_Call_NmUT_modeLimitation_SetECUGroupClassification: call-type=REGULAR
    Rte_Call_NvMUT_RP_RequestReset_RequestReset: call-type=REGULAR
    Rte_Call_NvMUT_RP_ResetInfo_GetLastResetInfo: call-type=REGULAR
    Rte_Call_NvMUT_RP_Startup_Source_GetLastStartupSource: call-type=REGULAR
    Rte_Call_TstM_GetStackInfo_GetStackInfo: call-type=REGULAR
    Rte_Call_WdgMUT_RP_AliveSupervision_ASW_10ms_CheckpointReached: call-type=REGULAR
    Rte_Call_WdgMUT_RP_Deadline_Start_ASW_10ms_CheckpointReached: call-type=REGULAR
    Rte_Call_WdgMUT_RP_Deadline_Stop_ASW_10ms_CheckpointReached: call-type=REGULAR
    Rte_Call_WdgMUT_RP_PFM_CP0_ASW_10ms_CheckpointReached: call-type=REGULAR
    Rte_Call_WdgMUT_RP_PFM_CP1_ASW_10ms_CheckpointReached: call-type=REGULAR
    Rte_Call_WdgMUT_RP_WdgM_GlobalSupervision_GetFirstExpiredSEID: call-type=REGULAR
    Rte_Call_WdgMUT_RP_WdgM_GlobalSupervision_GetGlobalStatus: call-type=REGULAR
    Rte_Call_WdgMUT_RP_WdgM_GlobalSupervision_GetMode: call-type=REGULAR
    Rte_Call_WdgMUT_RP_WdgM_GlobalSupervision_PerformReset: call-type=REGULAR
    Rte_Call_WdgMUT_RP_WdgM_GlobalSupervision_SetMode: call-type=REGULAR
    Rte_Call_WdgMUT_RP_WdgM_LocalSupervisionStatus_GetLocalStatus: call-type=REGULAR
    Rte_DecrementWaitingCount: call-type=REGULAR
    Rte_Enter_ExeMgrUT_ExeMgr_TriggerBswBg_EXCLUSIVE_AREA: call-type=REGULAR
    Rte_Exit_ExeMgrUT_ExeMgr_TriggerBswBg_EXCLUSIVE_AREA: call-type=REGULAR
    Rte_GetCurrentTaskIndex: call-type=REGULAR
    Rte_ImplCall_NvBlock_RP_StoreAtShutdownBlock_JobFinished: call-type=REGULAR
    Rte_ImplCall_NvBlock_RP_StoreCyclicBlock_JobFinished: call-type=REGULAR
    Rte_ImplCall_NvBlock_RP_StoreImmediateBlock_JobFinished: call-type=REGULAR
    Rte_ImplWrite_OUTP_SWC_PP_ETAS03_Sig{10..19}_ComTx_0x55_ETAS03_Sig{10..19}_ComTx_0x55: call-type=REGULAR
    Rte_IrTrigger_ExeMgrUT_RE_ExeMgr_GetWakeupSource_ITP_GetWakeupSource: call-type=REGULAR
    Rte_IrTrigger_ExeMgrUT_RE_ExeMgr_ValidateWakeup_ITP_ValidateWakeupSource: call-type=REGULAR
    Rte_MSACbk_SW_11: call-type=REGULAR
    Rte_MSACbk_SW_12: call-type=REGULAR
    Rte_MainFunction: call-type=REGULAR
    Rte_Mode_BswM_RP_BswM_MRP_SWC_AppMode_MDGP_APPMode: call-type=REGULAR
    Rte_Mode_DiagUT_RR_DcmCommunicationControl_ComMChannel_Can_Network_ETAS_Channel_MDGP_DcmCommunicationControl_Can_Network_ETAS_Channel_Can_Network_ETAS: call-type=REGULAR
    Rte_Mode_DiagUT_RR_DcmControlDTCSetting_MDGP_DcmControlDTCSetting: call-type=REGULAR
    Rte_Mode_DiagUT_RR_DcmDiagnosticSessionControl_MDGP_DcmDiagnosticSessionControl: call-type=REGULAR
    Rte_Mode_DiagUT_RR_DcmEcuReset_MDGP_DcmEcuReset: call-type=REGULAR
    Rte_Mode_ExeMgrUT_PP_BswM_APPMode_MDGP_APPMode: call-type=REGULAR
    Rte_Mode_WdgMUT_RP_WdgM_GlobalMode_currentMode: call-type=REGULAR
    Rte_Mode_WdgMUT_RP_WdgM_WdgM_SE1_Mode_currentMode: call-type=REGULAR
    Rte_Prm_CalUT_RP_SpeedLimit_speedMax: call-type=REGULAR
    Rte_Prm_CalUT_RP_SpeedLimit_speedMin: call-type=REGULAR
    Rte_ReadQueue: call-type=REGULAR
    Rte_Read_Dcm_IOControlResponse_DID_0xD901_New_Data_Object_IOOperationResponse: call-type=REGULAR
    Rte_Read_Dcm_IOControlResponse_DID_0xE900_New_Data_Object_IOOperationResponse: call-type=REGULAR
    Rte_Read_Dcm_R_DataServices_DID_0x0100_New_Data_Object_Data: call-type=REGULAR
    Rte_Read_Dcm_R_DataServices_DID_0x010B_Day_Data: call-type=REGULAR
    Rte_Read_Dcm_R_DataServices_DID_0x010B_Hour_Data: call-type=REGULAR
    Rte_Read_Dcm_R_DataServices_DID_0x010B_Minute_Data: call-type=REGULAR
    Rte_Read_Dcm_R_DataServices_DID_0x010B_Month_Data: call-type=REGULAR
    Rte_Read_Dcm_R_DataServices_DID_0x010B_Second_Data: call-type=REGULAR
    Rte_Read_Dcm_R_DataServices_DID_0x010B_Year_Data: call-type=REGULAR
    Rte_Read_Dcm_R_DataServices_DID_0x0112_New_Data_Object_Data: call-type=REGULAR
    Rte_Read_Dcm_R_DataServices_DID_0xB950_New_Data_Object_Data: call-type=REGULAR
    Rte_Read_Dcm_R_DataServices_DID_0xD001_New_Data_Object_Data: call-type=REGULAR
    Rte_Read_Dcm_R_DataServices_DID_0xD901_New_Data_Object_Data: call-type=REGULAR
    Rte_Read_Dcm_R_DataServices_DID_0xE101_New_Data_Object_Data: call-type=REGULAR
    Rte_Read_Dcm_R_DataServices_DID_0xE900_New_Data_Object_Data: call-type=REGULAR
    Rte_Read_Dcm_R_DataServices_DID_0xF100_New_Data_Object_1_Data: call-type=REGULAR
    Rte_Read_Dcm_R_DataServices_DID_0xF100_New_Data_Object_Data: call-type=REGULAR
    Rte_Read_Dcm_R_DataServices_DID_0xF{110..119}_New_Data_Object_Data: call-type=REGULAR
    Rte_Read_Dcm_R_DataServices_DID_0xF11A_New_Data_Object_Data: call-type=REGULAR
    Rte_Read_Dcm_R_DataServices_DID_0xF11B_New_Data_Object_Data: call-type=REGULAR
    Rte_Read_Dcm_R_DataServices_DID_0xF11C_New_Data_Object_Data: call-type=REGULAR
    Rte_Read_Dcm_R_DataServices_DID_0xF11D_New_Data_Object_Data: call-type=REGULAR
    Rte_Read_Dcm_R_DataServices_DID_0xF11E_New_Data_Object_Data: call-type=REGULAR
    Rte_Read_Dcm_R_DataServices_DID_0xF11F_New_Data_Object_Data: call-type=REGULAR
    Rte_Read_Dcm_R_DataServices_DID_0xF120_New_Data_Object_Data: call-type=REGULAR
    Rte_Read_Dcm_R_DataServices_DID_0xF121_New_Data_Object_Data: call-type=REGULAR
    Rte_Read_Dcm_R_DataServices_DID_0xF122_New_Data_Object_2_Data: call-type=REGULAR
    Rte_Read_Dcm_R_DataServices_DID_0xF122_New_Data_Object_Data: call-type=REGULAR
    Rte_Read_Dcm_R_DataServices_DID_0xF187_New_Data_Object_Data: call-type=REGULAR
    Rte_Read_Dcm_R_DataServices_DID_0xF18A_New_Data_Object_Data: call-type=REGULAR
    Rte_Read_Dcm_R_DataServices_DID_0xF18B_New_Data_Object_Data: call-type=REGULAR
    Rte_Read_Dcm_R_DataServices_DID_0xF18C_New_Data_Object_Data: call-type=REGULAR
    Rte_Read_Dcm_R_DataServices_DID_0xF190_New_Data_Object_Data: call-type=REGULAR
    Rte_Read_Dcm_R_DataServices_DID_0xF192_New_Data_Object_3_Data: call-type=REGULAR
    Rte_Read_Dcm_R_DataServices_DID_0xF192_New_Data_Object_Data: call-type=REGULAR
    Rte_Read_Dcm_R_DataServices_DID_0xF194_New_Data_Object_4_Data: call-type=REGULAR
    Rte_Read_Dcm_R_DataServices_DID_0xF194_New_Data_Object_Data: call-type=REGULAR
    Rte_Read_Dcm_R_DataServices_DID_0xF198_New_Data_Object_5_Data: call-type=REGULAR
    Rte_Read_Dcm_R_DataServices_DID_0xF198_New_Data_Object_Data: call-type=REGULAR
    Rte_Read_Dcm_R_DataServices_DID_0xF1A{0..2}_New_Data_Object_Data: call-type=REGULAR
    Rte_Read_Dcm_R_DataServices_DID_0xF1A5_New_Data_Object_Data: call-type=REGULAR
    Rte_Read_Dcm_R_DataServices_DID_0xF1A8_New_Data_Object_Data: call-type=REGULAR
    Rte_Read_Dcm_R_DataServices_DID_0xF1A9_New_Data_Object_Data: call-type=REGULAR
    Rte_Read_Dcm_R_DataServices_DID_0xF1AA_New_Data_Object_Data: call-type=REGULAR
    Rte_Read_DiagUT_IOControlRequest_DID_0xD901_New_Data_Object_IOControlRequest_DID_0xD901_New_Data_Object: call-type=REGULAR
    Rte_Read_DiagUT_IOControlRequest_DID_0xE900_New_Data_Object_IOControlRequest_DID_0xE900_New_Data_Object: call-type=REGULAR
    Rte_Read_DiagUT_R_DataServices_DID_0x0100_New_Data_Object_Data: call-type=REGULAR
    Rte_Read_DiagUT_R_DataServices_DID_0xF110_New_Data_Object_Data: call-type=REGULAR
    Rte_Read_DiagUT_R_DataServices_DID_0xF115_New_Data_Object_Data: call-type=REGULAR
    Rte_Read_DiagUT_R_DataServices_DID_0xF121_New_Data_Object_Data: call-type=REGULAR
    Rte_Read_DiagUT_R_DataServices_DID_0xF187_New_Data_Object_Data: call-type=REGULAR
    Rte_Read_DiagUT_R_DataServices_DID_0xF18B_New_Data_Object_Data: call-type=REGULAR
    Rte_Read_DiagUT_R_DataServices_DID_0xF18C_New_Data_Object_Data: call-type=REGULAR
    Rte_Read_DiagUT_R_DataServices_DID_0xF190_New_Data_Object_Data: call-type=REGULAR
    Rte_Read_DiagUT_R_DataServices_DID_0xF198_New_Data_Object_5_Data: call-type=REGULAR
    Rte_Read_DiagUT_R_DataServices_DID_0xF198_New_Data_Object_Data: call-type=REGULAR
    Rte_Read_DiagUT_R_DataServices_DID_0xF1A8_New_Data_Object_Data: call-type=REGULAR
    Rte_Read_DiagUT_R_DataServices_DID_0xF1A9_New_Data_Object_Data: call-type=REGULAR
    Rte_Read_DiagUT_R_DataServices_DID_0xF1AA_New_Data_Object_Data: call-type=REGULAR
    Rte_Read_INP_SWC_RP_ETAS01_Sig{00..08}_ComRx_0x81_ETAS01_Sig{00..08}_ComRx_0x81: call-type=REGULAR
    Rte_Read_INP_SWC_RP_ETAS02_Sig09_ComRx_0x261_ETAS02_Sig09_ComRx_0x261: call-type=REGULAR
    Rte_Read_INP_SWC_RP_ETAS06_Sig{34..41}_ComRx_0x456_ETAS06_Sig{34..41}_ComRx_0x456: call-type=REGULAR
    Rte_Read_NvMUT_PRP_CyclicNvBlock_CyclicNvBlock: call-type=REGULAR
    Rte_Read_NvMUT_PRP_ImmediateNvBlock_ImmediateNvBlock: call-type=REGULAR
    Rte_Read_NvMUT_PRP_ShutdownNvBlock_ShutDownNvBlock: call-type=REGULAR
    Rte_SetEvent: call-type=REGULAR
    Rte_Start: call-type=REGULAR
    Rte_StartHook_Return: call-type=CALLBACK
    Rte_StartHook_Start: call-type=CALLBACK
    Rte_Stop: call-type=REGULAR
    Rte_StopHook_Return: call-type=CALLBACK
    Rte_StopHook_Start: call-type=CALLBACK
    Rte_SwitchAck_WdgM_globalMode_currentMode: call-type=REGULAR
    Rte_SwitchAck_WdgM_mode_WdgM_SE1_currentMode: call-type=REGULAR
    Rte_Switch_ComM_UM_ComMUser_Can_Network_ETAS_Channel_Can_Network_ETAS_currentMode: call-type=REGULAR
    Rte_Switch_Dcm_Pp_DcmCommunicationControl_Can_Network_ETAS_Channel_Can_Network_ETAS_MDGP_DcmCommunicationControl_Can_Network_ETAS_Channel_Can_Network_ETAS: call-type=REGULAR
    Rte_Switch_Dcm_Pp_DcmControlDTCSetting_MDGP_DcmControlDTCSetting: call-type=REGULAR
    Rte_Switch_Dcm_Pp_DcmDiagnosticSessionControl_MDGP_DcmDiagnosticSessionControl: call-type=REGULAR
    Rte_Switch_Dcm_Pp_DcmEcuReset_MDGP_DcmEcuReset: call-type=REGULAR
    Rte_Switch_ExeMgrUT_PP_BswM_APPMode_MDGP_APPMode: call-type=REGULAR
    Rte_Switch_WdgM_globalMode_currentMode: call-type=REGULAR
    Rte_Switch_WdgM_mode_WdgM_SE1_currentMode: call-type=REGULAR
    Rte_Task_Activate: call-type=CALLBACK
    Rte_WaitWithTimeout: call-type=REGULAR
    Rte_WriteQueue: call-type=REGULAR
    Rte_Write_Dcm_IOControlRequest_DID_0xD901_New_Data_Object_IOControlRequest_DID_0xD901_New_Data_Object: call-type=REGULAR
    Rte_Write_Dcm_IOControlRequest_DID_0xE900_New_Data_Object_IOControlRequest_DID_0xE900_New_Data_Object: call-type=REGULAR
    Rte_Write_Dcm_P_DataServices_DID_0x0100_New_Data_Object_Data: call-type=REGULAR
    Rte_Write_Dcm_P_DataServices_DID_0xF110_New_Data_Object_Data: call-type=REGULAR
    Rte_Write_Dcm_P_DataServices_DID_0xF115_New_Data_Object_Data: call-type=REGULAR
    Rte_Write_Dcm_P_DataServices_DID_0xF121_New_Data_Object_Data: call-type=REGULAR
    Rte_Write_Dcm_P_DataServices_DID_0xF187_New_Data_Object_Data: call-type=REGULAR
    Rte_Write_Dcm_P_DataServices_DID_0xF18B_New_Data_Object_Data: call-type=REGULAR
    Rte_Write_Dcm_P_DataServices_DID_0xF18C_New_Data_Object_Data: call-type=REGULAR
    Rte_Write_Dcm_P_DataServices_DID_0xF190_New_Data_Object_Data: call-type=REGULAR
    Rte_Write_Dcm_P_DataServices_DID_0xF198_New_Data_Object_5_Data: call-type=REGULAR
    Rte_Write_Dcm_P_DataServices_DID_0xF198_New_Data_Object_Data: call-type=REGULAR
    Rte_Write_Dcm_P_DataServices_DID_0xF1A8_New_Data_Object_Data: call-type=REGULAR
    Rte_Write_Dcm_P_DataServices_DID_0xF1A9_New_Data_Object_Data: call-type=REGULAR
    Rte_Write_Dcm_P_DataServices_DID_0xF1AA_New_Data_Object_Data: call-type=REGULAR
    Rte_Write_DiagUT_IOControlResponse_DID_0xD901_New_Data_Object_IOOperationResponse: call-type=REGULAR
    Rte_Write_DiagUT_IOControlResponse_DID_0xE900_New_Data_Object_IOOperationResponse: call-type=REGULAR
    Rte_Write_DiagUT_P_DataServices_DID_0x0100_New_Data_Object_Data: call-type=REGULAR
    Rte_Write_DiagUT_P_DataServices_DID_0x010B_Day_Data: call-type=REGULAR
    Rte_Write_DiagUT_P_DataServices_DID_0x010B_Hour_Data: call-type=REGULAR
    Rte_Write_DiagUT_P_DataServices_DID_0x010B_Minute_Data: call-type=REGULAR
    Rte_Write_DiagUT_P_DataServices_DID_0x010B_Month_Data: call-type=REGULAR
    Rte_Write_DiagUT_P_DataServices_DID_0x010B_Second_Data: call-type=REGULAR
    Rte_Write_DiagUT_P_DataServices_DID_0x010B_Year_Data: call-type=REGULAR
    Rte_Write_DiagUT_P_DataServices_DID_0x0112_New_Data_Object_Data: call-type=REGULAR
    Rte_Write_DiagUT_P_DataServices_DID_0xB950_New_Data_Object_Data: call-type=REGULAR
    Rte_Write_DiagUT_P_DataServices_DID_0xD001_New_Data_Object_Data: call-type=REGULAR
    Rte_Write_DiagUT_P_DataServices_DID_0xD901_New_Data_Object_Data: call-type=REGULAR
    Rte_Write_DiagUT_P_DataServices_DID_0xE101_New_Data_Object_Data: call-type=REGULAR
    Rte_Write_DiagUT_P_DataServices_DID_0xE900_New_Data_Object_Data: call-type=REGULAR
    Rte_Write_DiagUT_P_DataServices_DID_0xF100_New_Data_Object_1_Data: call-type=REGULAR
    Rte_Write_DiagUT_P_DataServices_DID_0xF100_New_Data_Object_Data: call-type=REGULAR
    Rte_Write_DiagUT_P_DataServices_DID_0xF{110..119}_New_Data_Object_Data: call-type=REGULAR
    Rte_Write_DiagUT_P_DataServices_DID_0xF11A_New_Data_Object_Data: call-type=REGULAR
    Rte_Write_DiagUT_P_DataServices_DID_0xF11B_New_Data_Object_Data: call-type=REGULAR
    Rte_Write_DiagUT_P_DataServices_DID_0xF11C_New_Data_Object_Data: call-type=REGULAR
    Rte_Write_DiagUT_P_DataServices_DID_0xF11D_New_Data_Object_Data: call-type=REGULAR
    Rte_Write_DiagUT_P_DataServices_DID_0xF11E_New_Data_Object_Data: call-type=REGULAR
    Rte_Write_DiagUT_P_DataServices_DID_0xF11F_New_Data_Object_Data: call-type=REGULAR
    Rte_Write_DiagUT_P_DataServices_DID_0xF120_New_Data_Object_Data: call-type=REGULAR
    Rte_Write_DiagUT_P_DataServices_DID_0xF121_New_Data_Object_Data: call-type=REGULAR
    Rte_Write_DiagUT_P_DataServices_DID_0xF122_New_Data_Object_2_Data: call-type=REGULAR
    Rte_Write_DiagUT_P_DataServices_DID_0xF122_New_Data_Object_Data: call-type=REGULAR
    Rte_Write_DiagUT_P_DataServices_DID_0xF187_New_Data_Object_Data: call-type=REGULAR
    Rte_Write_DiagUT_P_DataServices_DID_0xF18A_New_Data_Object_Data: call-type=REGULAR
    Rte_Write_DiagUT_P_DataServices_DID_0xF18B_New_Data_Object_Data: call-type=REGULAR
    Rte_Write_DiagUT_P_DataServices_DID_0xF18C_New_Data_Object_Data: call-type=REGULAR
    Rte_Write_DiagUT_P_DataServices_DID_0xF190_New_Data_Object_Data: call-type=REGULAR
    Rte_Write_DiagUT_P_DataServices_DID_0xF192_New_Data_Object_3_Data: call-type=REGULAR
    Rte_Write_DiagUT_P_DataServices_DID_0xF192_New_Data_Object_Data: call-type=REGULAR
    Rte_Write_DiagUT_P_DataServices_DID_0xF194_New_Data_Object_4_Data: call-type=REGULAR
    Rte_Write_DiagUT_P_DataServices_DID_0xF194_New_Data_Object_Data: call-type=REGULAR
    Rte_Write_DiagUT_P_DataServices_DID_0xF198_New_Data_Object_5_Data: call-type=REGULAR
    Rte_Write_DiagUT_P_DataServices_DID_0xF198_New_Data_Object_Data: call-type=REGULAR
    Rte_Write_DiagUT_P_DataServices_DID_0xF1A{0..2}_New_Data_Object_Data: call-type=REGULAR
    Rte_Write_DiagUT_P_DataServices_DID_0xF1A5_New_Data_Object_Data: call-type=REGULAR
    Rte_Write_DiagUT_P_DataServices_DID_0xF1A8_New_Data_Object_Data: call-type=REGULAR
    Rte_Write_DiagUT_P_DataServices_DID_0xF1A9_New_Data_Object_Data: call-type=REGULAR
    Rte_Write_DiagUT_P_DataServices_DID_0xF1AA_New_Data_Object_Data: call-type=REGULAR
    Rte_Write_NmUT_PP_NM_Tx_Sig_NM_Tx_0x600_NM_Tx_Sig_NM_Tx_0x600: call-type=REGULAR
    Rte_Write_NmUT_PP_NmState_uint8: call-type=REGULAR
    Rte_Write_NvMUT_PRP_CyclicNvBlock_CyclicNvBlock: call-type=REGULAR
    Rte_Write_NvMUT_PRP_ImmediateNvBlock_ImmediateNvBlock: call-type=REGULAR
    Rte_Write_NvMUT_PRP_ShutdownNvBlock_ShutDownNvBlock: call-type=REGULAR
    Rte_Write_OUTP_SWC_PP_ETAS04_Sig{20..25}_ComTx_0x98_ETAS04_Sig{20..25}_ComTx_0x98: call-type=REGULAR
    Rte_Write_OUTP_SWC_PP_ETAS05_Sig{26..33}_ComTx_0x123_ETAS05_Sig{26..33}_ComTx_0x123: call-type=REGULAR
    Rte_memcpy: call-type=REGULAR
    SchM_Deinit: call-type=REGULAR
    SchM_IModeInit: call-type=REGULAR
    SchM_Init: call-type=REGULAR
    SchM_Mode_BswM_MDGR_BswM_MRP_BSWM_MDG: call-type=REGULAR
    SchM_Mode_BswM_MDGR_BswM_MRP_DCM_DiagnosticSessionControl: call-type=REGULAR
    SchM_Mode_BswM_MDGR_BswM_MRP_DCM_ModeNotification_EcuReset: call-type=REGULAR
    SchM_Mode_Dcm_R_DcmCommunicationControl_Can_Network_ETAS_Channel_Can_Network_ETAS: call-type=REGULAR
    SchM_Mode_WdgM_Current_WdgMSupervisionCycle: call-type=REGULAR
    SchM_Switch_BswM_MDGP_AUTOSAR_BswM_ModeDeclarationGroups_MDG_ECUM_STATE: call-type=REGULAR
    SchM_Switch_Dcm_DcmCommunicationControl_Can_Network_ETAS_Channel_Can_Network_ETAS: call-type=REGULAR
    SchM_Switch_Dcm_DcmControlDTCSetting: call-type=REGULAR
    SchM_Switch_Dcm_DcmDiagnosticSessionControl: call-type=REGULAR
    SchM_Switch_Dcm_DcmEcuReset: call-type=REGULAR
package /AUTOSAR_Rte/BswImplementations
  bsw implementation Rte: programming-language=C, sw-version=0.0.0, used-code-generator=ETAS RTEGen, ar-release-version=4.0.0, behavior=RteInternalBehavior
    generated-artifacts:
      107 x dependency on artifact:
        Com_h: artifact-descriptor={short-label=Com_h, category=SWHDR, domain=AUTOSAR}
        Ioc_h: artifact-descriptor={short-label=Ioc_h, category=SWHDR, domain=AUTOSAR}
        NvM_h: artifact-descriptor={short-label=NvM_h, category=SWHDR, domain=AUTOSAR}
        Os_h: artifact-descriptor={short-label=Os_h, category=SWHDR, domain=AUTOSAR}
        OsTask_AppCore_ASW_10ms_h: artifact-descriptor={short-label=OsTask_AppCore_ASW_10ms_h, category=SWHDR, domain=AUTOSAR}
        OsTask_ComCore_ASW_10ms_h: artifact-descriptor={short-label=OsTask_ComCore_ASW_10ms_h, category=SWHDR, domain=AUTOSAR}
        OsTask_SysCore_ASW_100ms_h: artifact-descriptor={short-label=OsTask_SysCore_ASW_100ms_h, category=SWHDR, domain=AUTOSAR}
        OsTask_SysCore_ASW_10ms_h: artifact-descriptor={short-label=OsTask_SysCore_ASW_10ms_h, category=SWHDR, domain=AUTOSAR}
        OsTask_SysCore_ASW_50ms_h: artifact-descriptor={short-label=OsTask_SysCore_ASW_50ms_h, category=SWHDR, domain=AUTOSAR}
        OsTask_SysCore_BSW_10ms_h: artifact-descriptor={short-label=OsTask_SysCore_BSW_10ms_h, category=SWHDR, domain=AUTOSAR}
        OsTask_SysCore_BSW_1ms_h: artifact-descriptor={short-label=OsTask_SysCore_BSW_1ms_h, category=SWHDR, domain=AUTOSAR}
        OsTask_SysCore_BSW_SwcRequest_h: artifact-descriptor={short-label=OsTask_SysCore_BSW_SwcRequest_h, category=SWHDR, domain=AUTOSAR}
        OsTask_SysCore_BswBg_100ms_h: artifact-descriptor={short-label=OsTask_SysCore_BswBg_100ms_h, category=SWHDR, domain=AUTOSAR}
        OsTask_SysCore_DRE_h: artifact-descriptor={short-label=OsTask_SysCore_DRE_h, category=SWHDR, domain=AUTOSAR}
        OsTask_SysCore_Startup_h: artifact-descriptor={short-label=OsTask_SysCore_Startup_h, category=SWHDR, domain=AUTOSAR}
        Rte_c: artifact-descriptor={short-label=Rte_c, category=SWSRC, domain=AUTOSAR}
        Rte_h: artifact-descriptor={short-label=Rte_h, category=SWHDR, domain=AUTOSAR}
        Rte_BswM_h: artifact-descriptor={short-label=Rte_BswM_h, category=SWHDR, domain=AUTOSAR}
        Rte_BswM_Type_h: artifact-descriptor={short-label=Rte_BswM_Type_h, category=SWHDR, domain=AUTOSAR}
        Rte_CalUT_h: artifact-descriptor={short-label=Rte_CalUT_h, category=SWHDR, domain=AUTOSAR}
        Rte_CalUT_Type_h: artifact-descriptor={short-label=Rte_CalUT_Type_h, category=SWHDR, domain=AUTOSAR}
        Rte_Cbk_h: artifact-descriptor={short-label=Rte_Cbk_h, category=SWHDR, domain=AUTOSAR}
        Rte_Cfg_h: artifact-descriptor={short-label=Rte_Cfg_h, category=SWHDR, domain=AUTOSAR}
        Rte_ComM_h: artifact-descriptor={short-label=Rte_ComM_h, category=SWHDR, domain=AUTOSAR}
        Rte_ComM_Type_h: artifact-descriptor={short-label=Rte_ComM_Type_h, category=SWHDR, domain=AUTOSAR}
        Rte_Const_h: artifact-descriptor={short-label=Rte_Const_h, category=SWHDR, domain=AUTOSAR}
        Rte_DataHandleType_h: artifact-descriptor={short-label=Rte_DataHandleType_h, category=SWHDR, domain=AUTOSAR}
        Rte_Dcm_h: artifact-descriptor={short-label=Rte_Dcm_h, category=SWHDR, domain=AUTOSAR}
        Rte_Dcm_Type_h: artifact-descriptor={short-label=Rte_Dcm_Type_h, category=SWHDR, domain=AUTOSAR}
        Rte_Dem_h: artifact-descriptor={short-label=Rte_Dem_h, category=SWHDR, domain=AUTOSAR}
        Rte_Dem_Type_h: artifact-descriptor={short-label=Rte_Dem_Type_h, category=SWHDR, domain=AUTOSAR}
        Rte_Det_h: artifact-descriptor={short-label=Rte_Det_h, category=SWHDR, domain=AUTOSAR}
        Rte_Det_Type_h: artifact-descriptor={short-label=Rte_Det_Type_h, category=SWHDR, domain=AUTOSAR}
        Rte_DiagUT_h: artifact-descriptor={short-label=Rte_DiagUT_h, category=SWHDR, domain=AUTOSAR}
        Rte_DiagUT_Type_h: artifact-descriptor={short-label=Rte_DiagUT_Type_h, category=SWHDR, domain=AUTOSAR}
        Rte_EcuM_h: artifact-descriptor={short-label=Rte_EcuM_h, category=SWHDR, domain=AUTOSAR}
        Rte_EcuM_Type_h: artifact-descriptor={short-label=Rte_EcuM_Type_h, category=SWHDR, domain=AUTOSAR}
        Rte_ExeMgrUT_h: artifact-descriptor={short-label=Rte_ExeMgrUT_h, category=SWHDR, domain=AUTOSAR}
        Rte_ExeMgrUT_Type_h: artifact-descriptor={short-label=Rte_ExeMgrUT_Type_h, category=SWHDR, domain=AUTOSAR}
        Rte_FiM_h: artifact-descriptor={short-label=Rte_FiM_h, category=SWHDR, domain=AUTOSAR}
        Rte_FiM_Type_h: artifact-descriptor={short-label=Rte_FiM_Type_h, category=SWHDR, domain=AUTOSAR}
        Rte_Hook_h: artifact-descriptor={short-label=Rte_Hook_h, category=SWHDR, domain=AUTOSAR}
        Rte_INP_SWC_h: artifact-descriptor={short-label=Rte_INP_SWC_h, category=SWHDR, domain=AUTOSAR}
        Rte_INP_SWC_Type_h: artifact-descriptor={short-label=Rte_INP_SWC_Type_h, category=SWHDR, domain=AUTOSAR}
        Rte_Intl_h: artifact-descriptor={short-label=Rte_Intl_h, category=SWHDR, domain=AUTOSAR}
        Rte_Lib_c: artifact-descriptor={short-label=Rte_Lib_c, category=SWSRC, domain=AUTOSAR}
        Rte_Main_h: artifact-descriptor={short-label=Rte_Main_h, category=SWHDR, domain=AUTOSAR}
        Rte_NmUT_h: artifact-descriptor={short-label=Rte_NmUT_h, category=SWHDR, domain=AUTOSAR}
        Rte_NmUT_Type_h: artifact-descriptor={short-label=Rte_NmUT_Type_h, category=SWHDR, domain=AUTOSAR}
        Rte_NvM_h: artifact-descriptor={short-label=Rte_NvM_h, category=SWHDR, domain=AUTOSAR}
        Rte_NvMUT_h: artifact-descriptor={short-label=Rte_NvMUT_h, category=SWHDR, domain=AUTOSAR}
        Rte_NvMUT_Type_h: artifact-descriptor={short-label=Rte_NvMUT_Type_h, category=SWHDR, domain=AUTOSAR}
        Rte_NvM_Type_h: artifact-descriptor={short-label=Rte_NvM_Type_h, category=SWHDR, domain=AUTOSAR}
        Rte_OUTP_SWC_h: artifact-descriptor={short-label=Rte_OUTP_SWC_h, category=SWHDR, domain=AUTOSAR}
        Rte_OUTP_SWC_Type_h: artifact-descriptor={short-label=Rte_OUTP_SWC_Type_h, category=SWHDR, domain=AUTOSAR}
        Rte_Rtm_h: artifact-descriptor={short-label=Rte_Rtm_h, category=SWHDR, domain=AUTOSAR}
        Rte_Rtm_Type_h: artifact-descriptor={short-label=Rte_Rtm_Type_h, category=SWHDR, domain=AUTOSAR}
        Rte_StackM_h: artifact-descriptor={short-label=Rte_StackM_h, category=SWHDR, domain=AUTOSAR}
        Rte_StackM_Type_h: artifact-descriptor={short-label=Rte_StackM_Type_h, category=SWHDR, domain=AUTOSAR}
        Rte_TstM_h: artifact-descriptor={short-label=Rte_TstM_h, category=SWHDR, domain=AUTOSAR}
        Rte_TstM_Type_h: artifact-descriptor={short-label=Rte_TstM_Type_h, category=SWHDR, domain=AUTOSAR}
        Rte_Type_h: artifact-descriptor={short-label=Rte_Type_h, category=SWHDR, domain=AUTOSAR}
        Rte_WdgM_h: artifact-descriptor={short-label=Rte_WdgM_h, category=SWHDR, domain=AUTOSAR}
        Rte_WdgMUT_h: artifact-descriptor={short-label=Rte_WdgMUT_h, category=SWHDR, domain=AUTOSAR}
        Rte_WdgMUT_Type_h: artifact-descriptor={short-label=Rte_WdgMUT_Type_h, category=SWHDR, domain=AUTOSAR}
        Rte_WdgM_Type_h: artifact-descriptor={short-label=Rte_WdgM_Type_h, category=SWHDR, domain=AUTOSAR}
        Rte_rba_DiagLib_h: artifact-descriptor={short-label=Rte_rba_DiagLib_h, category=SWHDR, domain=AUTOSAR}
        Rte_rba_DiagLib_Type_h: artifact-descriptor={short-label=Rte_rba_DiagLib_Type_h, category=SWHDR, domain=AUTOSAR}
        SchM_BswM_h: artifact-descriptor={short-label=SchM_BswM_h, category=SWHDR, domain=AUTOSAR}
        SchM_BswM_Type_h: artifact-descriptor={short-label=SchM_BswM_Type_h, category=SWHDR, domain=AUTOSAR}
        SchM_Can_h: artifact-descriptor={short-label=SchM_Can_h, category=SWHDR, domain=AUTOSAR}
        SchM_CanIf_h: artifact-descriptor={short-label=SchM_CanIf_h, category=SWHDR, domain=AUTOSAR}
        SchM_CanIf_Type_h: artifact-descriptor={short-label=SchM_CanIf_Type_h, category=SWHDR, domain=AUTOSAR}
        SchM_CanNm_h: artifact-descriptor={short-label=SchM_CanNm_h, category=SWHDR, domain=AUTOSAR}
        SchM_CanNm_Type_h: artifact-descriptor={short-label=SchM_CanNm_Type_h, category=SWHDR, domain=AUTOSAR}
        SchM_CanSM_h: artifact-descriptor={short-label=SchM_CanSM_h, category=SWHDR, domain=AUTOSAR}
        SchM_CanSM_Type_h: artifact-descriptor={short-label=SchM_CanSM_Type_h, category=SWHDR, domain=AUTOSAR}
        SchM_CanTp_h: artifact-descriptor={short-label=SchM_CanTp_h, category=SWHDR, domain=AUTOSAR}
        SchM_CanTp_Type_h: artifact-descriptor={short-label=SchM_CanTp_Type_h, category=SWHDR, domain=AUTOSAR}
        SchM_Can_Type_h: artifact-descriptor={short-label=SchM_Can_Type_h, category=SWHDR, domain=AUTOSAR}
        SchM_Com_h: artifact-descriptor={short-label=SchM_Com_h, category=SWHDR, domain=AUTOSAR}
        SchM_ComM_h: artifact-descriptor={short-label=SchM_ComM_h, category=SWHDR, domain=AUTOSAR}
        SchM_ComM_Type_h: artifact-descriptor={short-label=SchM_ComM_Type_h, category=SWHDR, domain=AUTOSAR}
        SchM_Com_Type_h: artifact-descriptor={short-label=SchM_Com_Type_h, category=SWHDR, domain=AUTOSAR}
        SchM_Dcm_h: artifact-descriptor={short-label=SchM_Dcm_h, category=SWHDR, domain=AUTOSAR}
        SchM_Dcm_Type_h: artifact-descriptor={short-label=SchM_Dcm_Type_h, category=SWHDR, domain=AUTOSAR}
        SchM_Dem_h: artifact-descriptor={short-label=SchM_Dem_h, category=SWHDR, domain=AUTOSAR}
        SchM_Dem_Type_h: artifact-descriptor={short-label=SchM_Dem_Type_h, category=SWHDR, domain=AUTOSAR}
        SchM_EcuM_h: artifact-descriptor={short-label=SchM_EcuM_h, category=SWHDR, domain=AUTOSAR}
        SchM_EcuM_Type_h: artifact-descriptor={short-label=SchM_EcuM_Type_h, category=SWHDR, domain=AUTOSAR}
        SchM_FiM_h: artifact-descriptor={short-label=SchM_FiM_h, category=SWHDR, domain=AUTOSAR}
        SchM_FiM_Type_h: artifact-descriptor={short-label=SchM_FiM_Type_h, category=SWHDR, domain=AUTOSAR}
        SchM_NvM_h: artifact-descriptor={short-label=SchM_NvM_h, category=SWHDR, domain=AUTOSAR}
        SchM_NvM_Type_h: artifact-descriptor={short-label=SchM_NvM_Type_h, category=SWHDR, domain=AUTOSAR}
        SchM_PduR_h: artifact-descriptor={short-label=SchM_PduR_h, category=SWHDR, domain=AUTOSAR}
        SchM_PduR_Type_h: artifact-descriptor={short-label=SchM_PduR_Type_h, category=SWHDR, domain=AUTOSAR}
        SchM_Rtm_h: artifact-descriptor={short-label=SchM_Rtm_h, category=SWHDR, domain=AUTOSAR}
        SchM_Rtm_Type_h: artifact-descriptor={short-label=SchM_Rtm_Type_h, category=SWHDR, domain=AUTOSAR}
        SchM_StackM_h: artifact-descriptor={short-label=SchM_StackM_h, category=SWHDR, domain=AUTOSAR}
        SchM_StackM_Type_h: artifact-descriptor={short-label=SchM_StackM_Type_h, category=SWHDR, domain=AUTOSAR}
        SchM_TstM_h: artifact-descriptor={short-label=SchM_TstM_h, category=SWHDR, domain=AUTOSAR}
        SchM_TstM_Type_h: artifact-descriptor={short-label=SchM_TstM_Type_h, category=SWHDR, domain=AUTOSAR}
        SchM_WdgM_h: artifact-descriptor={short-label=SchM_WdgM_h, category=SWHDR, domain=AUTOSAR}
        SchM_WdgM_Type_h: artifact-descriptor={short-label=SchM_WdgM_Type_h, category=SWHDR, domain=AUTOSAR}
        SchM_Xcp_h: artifact-descriptor={short-label=SchM_Xcp_h, category=SWHDR, domain=AUTOSAR}
        SchM_Xcp_Type_h: artifact-descriptor={short-label=SchM_Xcp_Type_h, category=SWHDR, domain=AUTOSAR}
        iocNeeds_h: artifact-descriptor={short-label=iocNeeds_h, category=SWHDR, domain=AUTOSAR}
    resource consumption ResConsumption
      85 x memory section:
        CALPRM_32: alignment=32, sw-addrmethod=CALPRM
        RTE_BSWM_CODE: executable-entity=[Rte_Mode_BswM_RP_BswM_MRP_SWC_AppMode_MDGP_APPMode, SchM_Mode_BswM_MDGR_BswM_MRP_BSWM_MDG, SchM_Mode_BswM_MDGR_BswM_MRP_DCM_DiagnosticSessionControl, SchM_Mode_BswM_MDGR_BswM_MRP_DCM_ModeNotification_EcuReset, SchM_Switch_BswM_MDGP_AUTOSAR_BswM_ModeDeclarationGroups_MDG_ECUM_STATE], prefix=RTE_BSWM, sw-addrmethod=CODE, symbol=CODE
        RTE_CALUT_CODE: executable-entity=[Rte_CData_CalUT_SpeedLimitLower, Rte_CData_CalUT_SpeedLimitUpper, Rte_CData_CalUT_sharedCURVE, Rte_CData_CalUT_sharedMAP, Rte_Prm_CalUT_RP_SpeedLimit_speedMax, Rte_Prm_CalUT_RP_SpeedLimit_speedMin], prefix=RTE_CALUT, sw-addrmethod=CODE, symbol=CODE
        RTE_COMM_CODE: executable-entity=Rte_Switch_ComM_UM_ComMUser_Can_Network_ETAS_Channel_Can_Network_ETAS_currentMode, prefix=RTE_COMM, sw-addrmethod=CODE, symbol=CODE
        RTE_DCM_CODE:
          executable-entity=[Rte_Call_Dcm_RoutineServices_Routine_Control_203_Start, Rte_Call_Dcm_RoutineServices_Routine_Control_ABFF_RequestResults, Rte_Call_Dcm_RoutineServices_Routine_Control_ABFF_Start, Rte_Call_Dcm_RoutineServices_X_Routine_Control_ABFE_Start, Rte_Call_Dcm_SecurityAccess_UnlockedL1_CompareKey, Rte_Call_Dcm_SecurityAccess_UnlockedL1_GetSeed, Rte_Call_Dcm_SecurityAccess_Unlocked_L3_CompareKey, Rte_Call_Dcm_SecurityAccess_Unlocked_L3_GetSeed, Rte_Read_Dcm_IOControlResponse_DID_0xD901_New_Data_Object_IOOperationResponse, Rte_Read_Dcm_IOControlResponse_DID_0xE900_New_Data_Object_IOOperationResponse, Rte_Read_Dcm_R_DataServices_DID_0x0100_New_Data_Object_Data, Rte_Read_Dcm_R_DataServices_DID_0x010B_Day_Data, Rte_Read_Dcm_R_DataServices_DID_0x010B_Hour_Data, Rte_Read_Dcm_R_DataServices_DID_0x010B_Minute_Data, Rte_Read_Dcm_R_DataServices_DID_0x010B_Month_Data, Rte_Read_Dcm_R_DataServices_DID_0x010B_Second_Data, Rte_Read_Dcm_R_DataServices_DID_0x010B_Year_Data, Rte_Read_Dcm_R_DataServices_DID_0x0112_New_Data_Object_Data, Rte_Read_Dcm_R_DataServices_DID_0xB950_New_Data_Object_Data, Rte_Read_Dcm_R_DataServices_DID_0xD001_New_Data_Object_Data, Rte_Read_Dcm_R_DataServices_DID_0xD901_New_Data_Object_Data, Rte_Read_Dcm_R_DataServices_DID_0xE101_New_Data_Object_Data, Rte_Read_Dcm_R_DataServices_DID_0xE900_New_Data_Object_Data, Rte_Read_Dcm_R_DataServices_DID_0xF100_New_Data_Object_1_Data, Rte_Read_Dcm_R_DataServices_DID_0xF100_New_Data_Object_Data, Rte_Read_Dcm_R_DataServices_DID_0xF110_New_Data_Object_Data, Rte_Read_Dcm_R_DataServices_DID_0xF111_New_Data_Object_Data, Rte_Read_Dcm_R_DataServices_DID_0xF112_New_Data_Object_Data, Rte_Read_Dcm_R_DataServices_DID_0xF113_New_Data_Object_Data, Rte_Read_Dcm_R_DataServices_DID_0xF114_New_Data_Object_Data, Rte_Read_Dcm_R_DataServices_DID_0xF115_New_Data_Object_Data, Rte_Read_Dcm_R_DataServices_DID_0xF116_New_Data_Object_Data, Rte_Read_Dcm_R_DataServices_DID_0xF117_New_Data_Object_Data, Rte_Read_Dcm_R_DataServices_DID_0xF118_New_Data_Object_Data, Rte_Read_Dcm_R_DataServices_DID_0xF119_New_Data_Object_Data, Rte_Read_Dcm_R_DataServices_DID_0xF11A_New_Data_Object_Data, Rte_Read_Dcm_R_DataServices_DID_0xF11B_New_Data_Object_Data, Rte_Read_Dcm_R_DataServices_DID_0xF11C_New_Data_Object_Data, Rte_Read_Dcm_R_DataServices_DID_0xF11D_New_Data_Object_Data, Rte_Read_Dcm_R_DataServices_DID_0xF11E_New_Data_Object_Data, Rte_Read_Dcm_R_DataServices_DID_0xF11F_New_Data_Object_Data, Rte_Read_Dcm_R_DataServices_DID_0xF120_New_Data_Object_Data, Rte_Read_Dcm_R_DataServices_DID_0xF121_New_Data_Object_Data, Rte_Read_Dcm_R_DataServices_DID_0xF122_New_Data_Object_2_Data, Rte_Read_Dcm_R_DataServices_DID_0xF122_New_Data_Object_Data, Rte_Read_Dcm_R_DataServices_DID_0xF187_New_Data_Object_Data, Rte_Read_Dcm_R_DataServices_DID_0xF18A_New_Data_Object_Data, Rte_Read_Dcm_R_DataServices_DID_0xF18B_New_Data_Object_Data, Rte_Read_Dcm_R_DataServices_DID_0xF18C_New_Data_Object_Data, Rte_Read_Dcm_R_DataServices_DID_0xF190_New_Data_Object_Data, Rte_Read_Dcm_R_DataServices_DID_0xF192_New_Data_Object_3_Data, Rte_Read_Dcm_R_DataServices_DID_0xF192_New_Data_Object_Data, Rte_Read_Dcm_R_DataServices_DID_0xF194_New_Data_Object_4_Data, Rte_Read_Dcm_R_DataServices_DID_0xF194_New_Data_Object_Data, Rte_Read_Dcm_R_DataServices_DID_0xF198_New_Data_Object_5_Data, Rte_Read_Dcm_R_DataServices_DID_0xF198_New_Data_Object_Data, Rte_Read_Dcm_R_DataServices_DID_0xF1A0_New_Data_Object_Data, Rte_Read_Dcm_R_DataServices_DID_0xF1A1_New_Data_Object_Data, Rte_Read_Dcm_R_DataServices_DID_0xF1A2_New_Data_Object_Data, Rte_Read_Dcm_R_DataServices_DID_0xF1A5_New_Data_Object_Data, Rte_Read_Dcm_R_DataServices_DID_0xF1A8_New_Data_Object_Data, Rte_Read_Dcm_R_DataServices_DID_0xF1A9_New_Data_Object_Data, Rte_Read_Dcm_R_DataServices_DID_0xF1AA_New_Data_Object_Data, Rte_Switch_Dcm_Pp_DcmCommunicationControl_Can_Network_ETAS_Channel_Can_Network_ETAS_MDGP_DcmCommunicationControl_Can_Network_ETAS_Channel_Can_Network_ETAS, Rte_Switch_Dcm_Pp_DcmControlDTCSetting_MDGP_DcmControlDTCSetting, Rte_Switch_Dcm_Pp_DcmDiagnosticSessionControl_MDGP_DcmDiagnosticSessionControl, Rte_Switch_Dcm_Pp_DcmEcuReset_MDGP_DcmEcuReset, Rte_Write_Dcm_IOControlRequest_DID_0xD901_New_Data_Object_IOControlRequest_DID_0xD901_New_Data_Object, Rte_Write_Dcm_IOControlRequest_DID_0xE900_New_Data_Object_IOControlRequest_DID_0xE900_New_Data_Object, Rte_Write_Dcm_P_DataServices_DID_0x0100_New_Data_Object_Data, Rte_Write_Dcm_P_DataServices_DID_0xF110_New_Data_Object_Data, Rte_Write_Dcm_P_DataServices_DID_0xF115_New_Data_Object_Data, Rte_Write_Dcm_P_DataServices_DID_0xF121_New_Data_Object_Data, Rte_Write_Dcm_P_DataServices_DID_0xF187_New_Data_Object_Data, Rte_Write_Dcm_P_DataServices_DID_0xF18B_New_Data_Object_Data, Rte_Write_Dcm_P_DataServices_DID_0xF18C_New_Data_Object_Data, Rte_Write_Dcm_P_DataServices_DID_0xF190_New_Data_Object_Data, Rte_Write_Dcm_P_DataServices_DID_0xF198_New_Data_Object_5_Data, Rte_Write_Dcm_P_DataServices_DID_0xF198_New_Data_Object_Data, Rte_Write_Dcm_P_DataServices_DID_0xF1A8_New_Data_Object_Data, Rte_Write_Dcm_P_DataServices_DID_0xF1A9_New_Data_Object_Data, Rte_Write_Dcm_P_DataServices_DID_0xF1AA_New_Data_Object_Data, SchM_Mode_Dcm_R_DcmCommunicationControl_Can_Network_ETAS_Channel_Can_Network_ETAS, SchM_Switch_Dcm_DcmCommunicationControl_Can_Network_ETAS_Channel_Can_Network_ETAS, SchM_Switch_Dcm_DcmControlDTCSetting, SchM_Switch_Dcm_DcmDiagnosticSessionControl, SchM_Switch_Dcm_DcmEcuReset]
          prefix=RTE_DCM
          sw-addrmethod=CODE
          symbol=CODE
        RTE_DEM_CODE:
          executable-entity=[Rte_Call_Dem_CBClrEvt_DTC_0x000001_Event_ClearEventAllowed, Rte_Call_Dem_CBClrEvt_DTC_0x0d0400_CAN_Network_ETAS_BusOff_Event_ClearEventAllowed, Rte_Call_Dem_CBClrEvt_DTC_0xc07388_Event_ClearEventAllowed, Rte_Call_Dem_CBClrEvt_DTC_0xc12687_Event_ClearEventAllowed, Rte_Call_Dem_CBClrEvt_DTC_0xc14587_Event_ClearEventAllowed, Rte_Call_Dem_CBClrEvt_DTC_0xc22a87_Event_ClearEventAllowed, Rte_Call_Dem_CBClrEvt_DTC_0xc41487_Event_ClearEventAllowed, Rte_Call_Dem_CBClrEvt_DTC_0xd56217_Event_ClearEventAllowed, Rte_Call_Dem_CBClrEvt_DTC_0xd56316_Event_ClearEventAllowed, Rte_Call_Dem_CBClrEvt_DTC_0xe00141_Event_ClearEventAllowed, Rte_Call_Dem_CBClrEvt_DTC_0xe00142_Event_ClearEventAllowed, Rte_Call_Dem_CBClrEvt_DTC_0xe26200_Event_ClearEventAllowed]
          prefix=RTE_DEM
          sw-addrmethod=CODE
          symbol=CODE
        RTE_DIAGUT_CODE:
          executable-entity=[Rte_Call_DiagUT_ControlEventAvailable_EventParameter_DTC_0x000001_Event_SetEventAvailable, Rte_Call_DiagUT_ControlEventAvailable_EventParameter_DTC_0xc07388_Event_SetEventAvailable, Rte_Call_DiagUT_ControlEventAvailable_EventParameter_DTC_0xc12687_Event_SetEventAvailable, Rte_Call_DiagUT_ControlEventAvailable_EventParameter_DTC_0xc14587_Event_SetEventAvailable, Rte_Call_DiagUT_ControlEventAvailable_EventParameter_DTC_0xc22a87_Event_SetEventAvailable, Rte_Call_DiagUT_ControlEventAvailable_EventParameter_DTC_0xc41487_Event_SetEventAvailable, Rte_Call_DiagUT_ControlEventAvailable_EventParameter_DTC_0xd56217_Event_SetEventAvailable, Rte_Call_DiagUT_ControlEventAvailable_EventParameter_DTC_0xd56316_Event_SetEventAvailable, Rte_Call_DiagUT_ControlEventAvailable_EventParameter_DTC_0xe00141_Event_SetEventAvailable, Rte_Call_DiagUT_ControlEventAvailable_EventParameter_DTC_0xe00142_Event_SetEventAvailable, Rte_Call_DiagUT_ControlEventAvailable_EventParameter_DTC_0xe26200_Event_SetEventAvailable, Rte_Call_DiagUT_DCMServices_GetActiveProtocol, Rte_Call_DiagUT_DCMServices_GetSecurityLevel, Rte_Call_DiagUT_DCMServices_GetSesCtrlType, Rte_Call_DiagUT_DCMServices_ResetToDefaultSession, Rte_Call_DiagUT_DCMServices_SetActiveDiagnostic, Rte_Call_DiagUT_EventStatus_EventParameter_DTC_0x000001_Event_SetWIRStatus, Rte_Call_DiagUT_EventStatus_EventParameter_DTC_0xc07388_Event_SetWIRStatus, Rte_Call_DiagUT_EventStatus_EventParameter_DTC_0xc12687_Event_SetWIRStatus, Rte_Call_DiagUT_EventStatus_EventParameter_DTC_0xc14587_Event_SetWIRStatus, Rte_Call_DiagUT_EventStatus_EventParameter_DTC_0xc22a87_Event_SetWIRStatus, Rte_Call_DiagUT_EventStatus_EventParameter_DTC_0xc41487_Event_SetWIRStatus, Rte_Call_DiagUT_EventStatus_EventParameter_DTC_0xd56217_Event_SetWIRStatus, Rte_Call_DiagUT_EventStatus_EventParameter_DTC_0xd56316_Event_SetWIRStatus, Rte_Call_DiagUT_EventStatus_EventParameter_DTC_0xe00141_Event_SetWIRStatus, Rte_Call_DiagUT_EventStatus_EventParameter_DTC_0xe00142_Event_SetWIRStatus, Rte_Call_DiagUT_EventStatus_EventParameter_DTC_0xe26200_Event_SetWIRStatus, Rte_Call_DiagUT_Event_EventParameter_DTC_0x000001_Event_ClearPrestoredFreezeFrame, Rte_Call_DiagUT_Event_EventParameter_DTC_0x000001_Event_PrestoreFreezeFrame, Rte_Call_DiagUT_Event_EventParameter_DTC_0x000001_Event_ResetEventDebounceStatus, Rte_Call_DiagUT_Event_EventParameter_DTC_0x000001_Event_ResetEventStatus, Rte_Call_DiagUT_Event_EventParameter_DTC_0x000001_Event_SetEventStatus, Rte_Call_DiagUT_Event_EventParameter_DTC_0x000001_Event_SetEventStatusWithEnvdata, Rte_Call_DiagUT_Event_EventParameter_DTC_0xc07388_Event_ClearPrestoredFreezeFrame, Rte_Call_DiagUT_Event_EventParameter_DTC_0xc07388_Event_PrestoreFreezeFrame, Rte_Call_DiagUT_Event_EventParameter_DTC_0xc07388_Event_ResetEventDebounceStatus, Rte_Call_DiagUT_Event_EventParameter_DTC_0xc07388_Event_ResetEventStatus, Rte_Call_DiagUT_Event_EventParameter_DTC_0xc07388_Event_SetEventStatus, Rte_Call_DiagUT_Event_EventParameter_DTC_0xc07388_Event_SetEventStatusWithEnvdata, Rte_Call_DiagUT_Event_EventParameter_DTC_0xc12687_Event_ClearPrestoredFreezeFrame, Rte_Call_DiagUT_Event_EventParameter_DTC_0xc12687_Event_PrestoreFreezeFrame, Rte_Call_DiagUT_Event_EventParameter_DTC_0xc12687_Event_ResetEventDebounceStatus, Rte_Call_DiagUT_Event_EventParameter_DTC_0xc12687_Event_ResetEventStatus, Rte_Call_DiagUT_Event_EventParameter_DTC_0xc12687_Event_SetEventStatus, Rte_Call_DiagUT_Event_EventParameter_DTC_0xc12687_Event_SetEventStatusWithEnvdata, Rte_Call_DiagUT_Event_EventParameter_DTC_0xc14587_Event_ClearPrestoredFreezeFrame, Rte_Call_DiagUT_Event_EventParameter_DTC_0xc14587_Event_PrestoreFreezeFrame, Rte_Call_DiagUT_Event_EventParameter_DTC_0xc14587_Event_ResetEventDebounceStatus, Rte_Call_DiagUT_Event_EventParameter_DTC_0xc14587_Event_ResetEventStatus, Rte_Call_DiagUT_Event_EventParameter_DTC_0xc14587_Event_SetEventStatus, Rte_Call_DiagUT_Event_EventParameter_DTC_0xc14587_Event_SetEventStatusWithEnvdata, Rte_Call_DiagUT_Event_EventParameter_DTC_0xc22a87_Event_ClearPrestoredFreezeFrame, Rte_Call_DiagUT_Event_EventParameter_DTC_0xc22a87_Event_PrestoreFreezeFrame, Rte_Call_DiagUT_Event_EventParameter_DTC_0xc22a87_Event_ResetEventDebounceStatus, Rte_Call_DiagUT_Event_EventParameter_DTC_0xc22a87_Event_ResetEventStatus, Rte_Call_DiagUT_Event_EventParameter_DTC_0xc22a87_Event_SetEventStatus, Rte_Call_DiagUT_Event_EventParameter_DTC_0xc22a87_Event_SetEventStatusWithEnvdata, Rte_Call_DiagUT_Event_EventParameter_DTC_0xc41487_Event_ClearPrestoredFreezeFrame, Rte_Call_DiagUT_Event_EventParameter_DTC_0xc41487_Event_PrestoreFreezeFrame, Rte_Call_DiagUT_Event_EventParameter_DTC_0xc41487_Event_ResetEventDebounceStatus, Rte_Call_DiagUT_Event_EventParameter_DTC_0xc41487_Event_ResetEventStatus, Rte_Call_DiagUT_Event_EventParameter_DTC_0xc41487_Event_SetEventStatus, Rte_Call_DiagUT_Event_EventParameter_DTC_0xc41487_Event_SetEventStatusWithEnvdata, Rte_Call_DiagUT_Event_EventParameter_DTC_0xd56217_Event_ClearPrestoredFreezeFrame, Rte_Call_DiagUT_Event_EventParameter_DTC_0xd56217_Event_PrestoreFreezeFrame, Rte_Call_DiagUT_Event_EventParameter_DTC_0xd56217_Event_ResetEventDebounceStatus, Rte_Call_DiagUT_Event_EventParameter_DTC_0xd56217_Event_ResetEventStatus, Rte_Call_DiagUT_Event_EventParameter_DTC_0xd56217_Event_SetEventStatus, Rte_Call_DiagUT_Event_EventParameter_DTC_0xd56217_Event_SetEventStatusWithEnvdata, Rte_Call_DiagUT_Event_EventParameter_DTC_0xd56316_Event_ClearPrestoredFreezeFrame, Rte_Call_DiagUT_Event_EventParameter_DTC_0xd56316_Event_PrestoreFreezeFrame, Rte_Call_DiagUT_Event_EventParameter_DTC_0xd56316_Event_ResetEventDebounceStatus, Rte_Call_DiagUT_Event_EventParameter_DTC_0xd56316_Event_ResetEventStatus, Rte_Call_DiagUT_Event_EventParameter_DTC_0xd56316_Event_SetEventStatus, Rte_Call_DiagUT_Event_EventParameter_DTC_0xd56316_Event_SetEventStatusWithEnvdata, Rte_Call_DiagUT_Event_EventParameter_DTC_0xe00141_Event_ClearPrestoredFreezeFrame, Rte_Call_DiagUT_Event_EventParameter_DTC_0xe00141_Event_PrestoreFreezeFrame, Rte_Call_DiagUT_Event_EventParameter_DTC_0xe00141_Event_ResetEventDebounceStatus, Rte_Call_DiagUT_Event_EventParameter_DTC_0xe00141_Event_ResetEventStatus, Rte_Call_DiagUT_Event_EventParameter_DTC_0xe00141_Event_SetEventStatus, Rte_Call_DiagUT_Event_EventParameter_DTC_0xe00141_Event_SetEventStatusWithEnvdata, Rte_Call_DiagUT_Event_EventParameter_DTC_0xe00142_Event_ClearPrestoredFreezeFrame, Rte_Call_DiagUT_Event_EventParameter_DTC_0xe00142_Event_PrestoreFreezeFrame, Rte_Call_DiagUT_Event_EventParameter_DTC_0xe00142_Event_ResetEventDebounceStatus, Rte_Call_DiagUT_Event_EventParameter_DTC_0xe00142_Event_ResetEventStatus, Rte_Call_DiagUT_Event_EventParameter_DTC_0xe00142_Event_SetEventStatus, Rte_Call_DiagUT_Event_EventParameter_DTC_0xe00142_Event_SetEventStatusWithEnvdata, Rte_Call_DiagUT_Event_EventParameter_DTC_0xe26200_Event_ClearPrestoredFreezeFrame, Rte_Call_DiagUT_Event_EventParameter_DTC_0xe26200_Event_PrestoreFreezeFrame, Rte_Call_DiagUT_Event_EventParameter_DTC_0xe26200_Event_ResetEventDebounceStatus, Rte_Call_DiagUT_Event_EventParameter_DTC_0xe26200_Event_ResetEventStatus, Rte_Call_DiagUT_Event_EventParameter_DTC_0xe26200_Event_SetEventStatus, Rte_Call_DiagUT_Event_EventParameter_DTC_0xe26200_Event_SetEventStatusWithEnvdata, Rte_Call_DiagUT_EvtInfo_EventParameter_DTC_0x000001_Event_GetDTCOfEvent, Rte_Call_DiagUT_EvtInfo_EventParameter_DTC_0x000001_Event_GetDebouncingOfEvent, Rte_Call_DiagUT_EvtInfo_EventParameter_DTC_0x000001_Event_GetEventExtendedDataRecord, Rte_Call_DiagUT_EvtInfo_EventParameter_DTC_0x000001_Event_GetEventExtendedDataRecordEx, Rte_Call_DiagUT_EvtInfo_EventParameter_DTC_0x000001_Event_GetEventFailed, Rte_Call_DiagUT_EvtInfo_EventParameter_DTC_0x000001_Event_GetEventFreezeFrameData, Rte_Call_DiagUT_EvtInfo_EventParameter_DTC_0x000001_Event_GetEventFreezeFrameDataEx, Rte_Call_DiagUT_EvtInfo_EventParameter_DTC_0x000001_Event_GetEventStatus, Rte_Call_DiagUT_EvtInfo_EventParameter_DTC_0x000001_Event_GetEventTested, Rte_Call_DiagUT_EvtInfo_EventParameter_DTC_0x000001_Event_GetFaultDetectionCounter, Rte_Call_DiagUT_EvtInfo_EventParameter_DTC_0x0d0400_CAN_Network_ETAS_BusOff_Event_GetDTCOfEvent, Rte_Call_DiagUT_EvtInfo_EventParameter_DTC_0x0d0400_CAN_Network_ETAS_BusOff_Event_GetDebouncingOfEvent, Rte_Call_DiagUT_EvtInfo_EventParameter_DTC_0x0d0400_CAN_Network_ETAS_BusOff_Event_GetEventExtendedDataRecord, Rte_Call_DiagUT_EvtInfo_EventParameter_DTC_0x0d0400_CAN_Network_ETAS_BusOff_Event_GetEventExtendedDataRecordEx, Rte_Call_DiagUT_EvtInfo_EventParameter_DTC_0x0d0400_CAN_Network_ETAS_BusOff_Event_GetEventFailed, Rte_Call_DiagUT_EvtInfo_EventParameter_DTC_0x0d0400_CAN_Network_ETAS_BusOff_Event_GetEventFreezeFrameData, Rte_Call_DiagUT_EvtInfo_EventParameter_DTC_0x0d0400_CAN_Network_ETAS_BusOff_Event_GetEventFreezeFrameDataEx, Rte_Call_DiagUT_EvtInfo_EventParameter_DTC_0x0d0400_CAN_Network_ETAS_BusOff_Event_GetEventStatus, Rte_Call_DiagUT_EvtInfo_EventParameter_DTC_0x0d0400_CAN_Network_ETAS_BusOff_Event_GetEventTested, Rte_Call_DiagUT_EvtInfo_EventParameter_DTC_0x0d0400_CAN_Network_ETAS_BusOff_Event_GetFaultDetectionCounter, Rte_Call_DiagUT_EvtInfo_EventParameter_DTC_0xc07388_Event_GetDTCOfEvent, Rte_Call_DiagUT_EvtInfo_EventParameter_DTC_0xc07388_Event_GetDebouncingOfEvent, Rte_Call_DiagUT_EvtInfo_EventParameter_DTC_0xc07388_Event_GetEventExtendedDataRecord, Rte_Call_DiagUT_EvtInfo_EventParameter_DTC_0xc07388_Event_GetEventExtendedDataRecordEx, Rte_Call_DiagUT_EvtInfo_EventParameter_DTC_0xc07388_Event_GetEventFailed, Rte_Call_DiagUT_EvtInfo_EventParameter_DTC_0xc07388_Event_GetEventFreezeFrameData, Rte_Call_DiagUT_EvtInfo_EventParameter_DTC_0xc07388_Event_GetEventFreezeFrameDataEx, Rte_Call_DiagUT_EvtInfo_EventParameter_DTC_0xc07388_Event_GetEventStatus, Rte_Call_DiagUT_EvtInfo_EventParameter_DTC_0xc07388_Event_GetEventTested, Rte_Call_DiagUT_EvtInfo_EventParameter_DTC_0xc07388_Event_GetFaultDetectionCounter, Rte_Call_DiagUT_EvtInfo_EventParameter_DTC_0xc12687_Event_GetDTCOfEvent, Rte_Call_DiagUT_EvtInfo_EventParameter_DTC_0xc12687_Event_GetDebouncingOfEvent, Rte_Call_DiagUT_EvtInfo_EventParameter_DTC_0xc12687_Event_GetEventExtendedDataRecord, Rte_Call_DiagUT_EvtInfo_EventParameter_DTC_0xc12687_Event_GetEventExtendedDataRecordEx, Rte_Call_DiagUT_EvtInfo_EventParameter_DTC_0xc12687_Event_GetEventFailed, Rte_Call_DiagUT_EvtInfo_EventParameter_DTC_0xc12687_Event_GetEventFreezeFrameData, Rte_Call_DiagUT_EvtInfo_EventParameter_DTC_0xc12687_Event_GetEventFreezeFrameDataEx, Rte_Call_DiagUT_EvtInfo_EventParameter_DTC_0xc12687_Event_GetEventStatus, Rte_Call_DiagUT_EvtInfo_EventParameter_DTC_0xc12687_Event_GetEventTested, Rte_Call_DiagUT_EvtInfo_EventParameter_DTC_0xc12687_Event_GetFaultDetectionCounter, Rte_Call_DiagUT_EvtInfo_EventParameter_DTC_0xc14587_Event_GetDTCOfEvent, Rte_Call_DiagUT_EvtInfo_EventParameter_DTC_0xc14587_Event_GetDebouncingOfEvent, Rte_Call_DiagUT_EvtInfo_EventParameter_DTC_0xc14587_Event_GetEventExtendedDataRecord, Rte_Call_DiagUT_EvtInfo_EventParameter_DTC_0xc14587_Event_GetEventExtendedDataRecordEx, Rte_Call_DiagUT_EvtInfo_EventParameter_DTC_0xc14587_Event_GetEventFailed, Rte_Call_DiagUT_EvtInfo_EventParameter_DTC_0xc14587_Event_GetEventFreezeFrameData, Rte_Call_DiagUT_EvtInfo_EventParameter_DTC_0xc14587_Event_GetEventFreezeFrameDataEx, Rte_Call_DiagUT_EvtInfo_EventParameter_DTC_0xc14587_Event_GetEventStatus, Rte_Call_DiagUT_EvtInfo_EventParameter_DTC_0xc14587_Event_GetEventTested, Rte_Call_DiagUT_EvtInfo_EventParameter_DTC_0xc14587_Event_GetFaultDetectionCounter, Rte_Call_DiagUT_EvtInfo_EventParameter_DTC_0xc22a87_Event_GetDTCOfEvent, Rte_Call_DiagUT_EvtInfo_EventParameter_DTC_0xc22a87_Event_GetDebouncingOfEvent, Rte_Call_DiagUT_EvtInfo_EventParameter_DTC_0xc22a87_Event_GetEventExtendedDataRecord, Rte_Call_DiagUT_EvtInfo_EventParameter_DTC_0xc22a87_Event_GetEventExtendedDataRecordEx, Rte_Call_DiagUT_EvtInfo_EventParameter_DTC_0xc22a87_Event_GetEventFailed, Rte_Call_DiagUT_EvtInfo_EventParameter_DTC_0xc22a87_Event_GetEventFreezeFrameData, Rte_Call_DiagUT_EvtInfo_EventParameter_DTC_0xc22a87_Event_GetEventFreezeFrameDataEx, Rte_Call_DiagUT_EvtInfo_EventParameter_DTC_0xc22a87_Event_GetEventStatus, Rte_Call_DiagUT_EvtInfo_EventParameter_DTC_0xc22a87_Event_GetEventTested, Rte_Call_DiagUT_EvtInfo_EventParameter_DTC_0xc22a87_Event_GetFaultDetectionCounter, Rte_Call_DiagUT_EvtInfo_EventParameter_DTC_0xc41487_Event_GetDTCOfEvent, Rte_Call_DiagUT_EvtInfo_EventParameter_DTC_0xc41487_Event_GetDebouncingOfEvent, Rte_Call_DiagUT_EvtInfo_EventParameter_DTC_0xc41487_Event_GetEventExtendedDataRecord, Rte_Call_DiagUT_EvtInfo_EventParameter_DTC_0xc41487_Event_GetEventExtendedDataRecordEx, Rte_Call_DiagUT_EvtInfo_EventParameter_DTC_0xc41487_Event_GetEventFailed, Rte_Call_DiagUT_EvtInfo_EventParameter_DTC_0xc41487_Event_GetEventFreezeFrameData, Rte_Call_DiagUT_EvtInfo_EventParameter_DTC_0xc41487_Event_GetEventFreezeFrameDataEx, Rte_Call_DiagUT_EvtInfo_EventParameter_DTC_0xc41487_Event_GetEventStatus, Rte_Call_DiagUT_EvtInfo_EventParameter_DTC_0xc41487_Event_GetEventTested, Rte_Call_DiagUT_EvtInfo_EventParameter_DTC_0xc41487_Event_GetFaultDetectionCounter, Rte_Call_DiagUT_EvtInfo_EventParameter_DTC_0xd56217_Event_GetDTCOfEvent, Rte_Call_DiagUT_EvtInfo_EventParameter_DTC_0xd56217_Event_GetDebouncingOfEvent, Rte_Call_DiagUT_EvtInfo_EventParameter_DTC_0xd56217_Event_GetEventExtendedDataRecord, Rte_Call_DiagUT_EvtInfo_EventParameter_DTC_0xd56217_Event_GetEventExtendedDataRecordEx, Rte_Call_DiagUT_EvtInfo_EventParameter_DTC_0xd56217_Event_GetEventFailed, Rte_Call_DiagUT_EvtInfo_EventParameter_DTC_0xd56217_Event_GetEventFreezeFrameData, Rte_Call_DiagUT_EvtInfo_EventParameter_DTC_0xd56217_Event_GetEventFreezeFrameDataEx, Rte_Call_DiagUT_EvtInfo_EventParameter_DTC_0xd56217_Event_GetEventStatus, Rte_Call_DiagUT_EvtInfo_EventParameter_DTC_0xd56217_Event_GetEventTested, Rte_Call_DiagUT_EvtInfo_EventParameter_DTC_0xd56217_Event_GetFaultDetectionCounter, Rte_Call_DiagUT_EvtInfo_EventParameter_DTC_0xd56316_Event_GetDTCOfEvent, Rte_Call_DiagUT_EvtInfo_EventParameter_DTC_0xd56316_Event_GetDebouncingOfEvent, Rte_Call_DiagUT_EvtInfo_EventParameter_DTC_0xd56316_Event_GetEventExtendedDataRecord, Rte_Call_DiagUT_EvtInfo_EventParameter_DTC_0xd56316_Event_GetEventExtendedDataRecordEx, Rte_Call_DiagUT_EvtInfo_EventParameter_DTC_0xd56316_Event_GetEventFailed, Rte_Call_DiagUT_EvtInfo_EventParameter_DTC_0xd56316_Event_GetEventFreezeFrameData, Rte_Call_DiagUT_EvtInfo_EventParameter_DTC_0xd56316_Event_GetEventFreezeFrameDataEx, Rte_Call_DiagUT_EvtInfo_EventParameter_DTC_0xd56316_Event_GetEventStatus, Rte_Call_DiagUT_EvtInfo_EventParameter_DTC_0xd56316_Event_GetEventTested, Rte_Call_DiagUT_EvtInfo_EventParameter_DTC_0xd56316_Event_GetFaultDetectionCounter, Rte_Call_DiagUT_EvtInfo_EventParameter_DTC_0xe00141_Event_GetDTCOfEvent, Rte_Call_DiagUT_EvtInfo_EventParameter_DTC_0xe00141_Event_GetDebouncingOfEvent, Rte_Call_DiagUT_EvtInfo_EventParameter_DTC_0xe00141_Event_GetEventExtendedDataRecord, Rte_Call_DiagUT_EvtInfo_EventParameter_DTC_0xe00141_Event_GetEventExtendedDataRecordEx, Rte_Call_DiagUT_EvtInfo_EventParameter_DTC_0xe00141_Event_GetEventFailed, Rte_Call_DiagUT_EvtInfo_EventParameter_DTC_0xe00141_Event_GetEventFreezeFrameData, Rte_Call_DiagUT_EvtInfo_EventParameter_DTC_0xe00141_Event_GetEventFreezeFrameDataEx, Rte_Call_DiagUT_EvtInfo_EventParameter_DTC_0xe00141_Event_GetEventStatus, Rte_Call_DiagUT_EvtInfo_EventParameter_DTC_0xe00141_Event_GetEventTested, Rte_Call_DiagUT_EvtInfo_EventParameter_DTC_0xe00141_Event_GetFaultDetectionCounter, Rte_Call_DiagUT_EvtInfo_EventParameter_DTC_0xe00142_Event_GetDTCOfEvent, Rte_Call_DiagUT_EvtInfo_EventParameter_DTC_0xe00142_Event_GetDebouncingOfEvent, Rte_Call_DiagUT_EvtInfo_EventParameter_DTC_0xe00142_Event_GetEventExtendedDataRecord, Rte_Call_DiagUT_EvtInfo_EventParameter_DTC_0xe00142_Event_GetEventExtendedDataRecordEx, Rte_Call_DiagUT_EvtInfo_EventParameter_DTC_0xe00142_Event_GetEventFailed, Rte_Call_DiagUT_EvtInfo_EventParameter_DTC_0xe00142_Event_GetEventFreezeFrameData, Rte_Call_DiagUT_EvtInfo_EventParameter_DTC_0xe00142_Event_GetEventFreezeFrameDataEx, Rte_Call_DiagUT_EvtInfo_EventParameter_DTC_0xe00142_Event_GetEventStatus, Rte_Call_DiagUT_EvtInfo_EventParameter_DTC_0xe00142_Event_GetEventTested, Rte_Call_DiagUT_EvtInfo_EventParameter_DTC_0xe00142_Event_GetFaultDetectionCounter, Rte_Call_DiagUT_EvtInfo_EventParameter_DTC_0xe26200_Event_GetDTCOfEvent, Rte_Call_DiagUT_EvtInfo_EventParameter_DTC_0xe26200_Event_GetDebouncingOfEvent, Rte_Call_DiagUT_EvtInfo_EventParameter_DTC_0xe26200_Event_GetEventExtendedDataRecord, Rte_Call_DiagUT_EvtInfo_EventParameter_DTC_0xe26200_Event_GetEventExtendedDataRecordEx, Rte_Call_DiagUT_EvtInfo_EventParameter_DTC_0xe26200_Event_GetEventFailed, Rte_Call_DiagUT_EvtInfo_EventParameter_DTC_0xe26200_Event_GetEventFreezeFrameData, Rte_Call_DiagUT_EvtInfo_EventParameter_DTC_0xe26200_Event_GetEventFreezeFrameDataEx, Rte_Call_DiagUT_EvtInfo_EventParameter_DTC_0xe26200_Event_GetEventStatus, Rte_Call_DiagUT_EvtInfo_EventParameter_DTC_0xe26200_Event_GetEventTested, Rte_Call_DiagUT_EvtInfo_EventParameter_DTC_0xe26200_Event_GetFaultDetectionCounter, Rte_Call_DiagUT_GeneralEvtInfo_GetDTCOfEvent, Rte_Call_DiagUT_GeneralEvtInfo_GetDebouncingOfEvent, Rte_Call_DiagUT_GeneralEvtInfo_GetEventExtendedDataRecord, Rte_Call_DiagUT_GeneralEvtInfo_GetEventExtendedDataRecordEx, Rte_Call_DiagUT_GeneralEvtInfo_GetEventFailed, Rte_Call_DiagUT_GeneralEvtInfo_GetEventFreezeFrameData, Rte_Call_DiagUT_GeneralEvtInfo_GetEventFreezeFrameDataEx, Rte_Call_DiagUT_GeneralEvtInfo_GetEventIdCausingLastDetError, Rte_Call_DiagUT_GeneralEvtInfo_GetEventStatus, Rte_Call_DiagUT_GeneralEvtInfo_GetEventTested, Rte_Call_DiagUT_GeneralEvtInfo_GetFaultDetectionCounter, Rte_Call_DiagUT_OpCycle_DemOpCycle_DEM_POWER_GetCycleQualified, Rte_Call_DiagUT_OpCycle_DemOpCycle_DEM_POWER_GetOperationCycleState, Rte_Call_DiagUT_OpCycle_DemOpCycle_DEM_POWER_SetCycleQualified, Rte_Call_DiagUT_OpCycle_DemOpCycle_DEM_POWER_SetOperationCycleState, Rte_Call_DiagUT_StorageCond_DemStorageCondition_0_GetStorageCondition, Rte_Call_DiagUT_StorageCond_DemStorageCondition_0_SetStorageCondition, Rte_Mode_DiagUT_RR_DcmCommunicationControl_ComMChannel_Can_Network_ETAS_Channel_MDGP_DcmCommunicationControl_Can_Network_ETAS_Channel_Can_Network_ETAS, Rte_Mode_DiagUT_RR_DcmControlDTCSetting_MDGP_DcmControlDTCSetting, Rte_Mode_DiagUT_RR_DcmDiagnosticSessionControl_MDGP_DcmDiagnosticSessionControl, Rte_Mode_DiagUT_RR_DcmEcuReset_MDGP_DcmEcuReset, Rte_Read_DiagUT_IOControlRequest_DID_0xD901_New_Data_Object_IOControlRequest_DID_0xD901_New_Data_Object, Rte_Read_DiagUT_IOControlRequest_DID_0xE900_New_Data_Object_IOControlRequest_DID_0xE900_New_Data_Object, Rte_Read_DiagUT_R_DataServices_DID_0x0100_New_Data_Object_Data, Rte_Read_DiagUT_R_DataServices_DID_0xF110_New_Data_Object_Data, Rte_Read_DiagUT_R_DataServices_DID_0xF115_New_Data_Object_Data, Rte_Read_DiagUT_R_DataServices_DID_0xF121_New_Data_Object_Data, Rte_Read_DiagUT_R_DataServices_DID_0xF187_New_Data_Object_Data, Rte_Read_DiagUT_R_DataServices_DID_0xF18B_New_Data_Object_Data, Rte_Read_DiagUT_R_DataServices_DID_0xF18C_New_Data_Object_Data, Rte_Read_DiagUT_R_DataServices_DID_0xF190_New_Data_Object_Data, Rte_Read_DiagUT_R_DataServices_DID_0xF198_New_Data_Object_5_Data, Rte_Read_DiagUT_R_DataServices_DID_0xF198_New_Data_Object_Data, Rte_Read_DiagUT_R_DataServices_DID_0xF1A8_New_Data_Object_Data, Rte_Read_DiagUT_R_DataServices_DID_0xF1A9_New_Data_Object_Data, Rte_Read_DiagUT_R_DataServices_DID_0xF1AA_New_Data_Object_Data, Rte_Write_DiagUT_IOControlResponse_DID_0xD901_New_Data_Object_IOOperationResponse, Rte_Write_DiagUT_IOControlResponse_DID_0xE900_New_Data_Object_IOOperationResponse, Rte_Write_DiagUT_P_DataServices_DID_0x0100_New_Data_Object_Data, Rte_Write_DiagUT_P_DataServices_DID_0x010B_Day_Data, Rte_Write_DiagUT_P_DataServices_DID_0x010B_Hour_Data, Rte_Write_DiagUT_P_DataServices_DID_0x010B_Minute_Data, Rte_Write_DiagUT_P_DataServices_DID_0x010B_Month_Data, Rte_Write_DiagUT_P_DataServices_DID_0x010B_Second_Data, Rte_Write_DiagUT_P_DataServices_DID_0x010B_Year_Data, Rte_Write_DiagUT_P_DataServices_DID_0x0112_New_Data_Object_Data, Rte_Write_DiagUT_P_DataServices_DID_0xB950_New_Data_Object_Data, Rte_Write_DiagUT_P_DataServices_DID_0xD001_New_Data_Object_Data, Rte_Write_DiagUT_P_DataServices_DID_0xD901_New_Data_Object_Data, Rte_Write_DiagUT_P_DataServices_DID_0xE101_New_Data_Object_Data, Rte_Write_DiagUT_P_DataServices_DID_0xE900_New_Data_Object_Data, Rte_Write_DiagUT_P_DataServices_DID_0xF100_New_Data_Object_1_Data, Rte_Write_DiagUT_P_DataServices_DID_0xF100_New_Data_Object_Data, Rte_Write_DiagUT_P_DataServices_DID_0xF110_New_Data_Object_Data, Rte_Write_DiagUT_P_DataServices_DID_0xF111_New_Data_Object_Data, Rte_Write_DiagUT_P_DataServices_DID_0xF112_New_Data_Object_Data, Rte_Write_DiagUT_P_DataServices_DID_0xF113_New_Data_Object_Data, Rte_Write_DiagUT_P_DataServices_DID_0xF114_New_Data_Object_Data, Rte_Write_DiagUT_P_DataServices_DID_0xF115_New_Data_Object_Data, Rte_Write_DiagUT_P_DataServices_DID_0xF116_New_Data_Object_Data, Rte_Write_DiagUT_P_DataServices_DID_0xF117_New_Data_Object_Data, Rte_Write_DiagUT_P_DataServices_DID_0xF118_New_Data_Object_Data, Rte_Write_DiagUT_P_DataServices_DID_0xF119_New_Data_Object_Data, Rte_Write_DiagUT_P_DataServices_DID_0xF11A_New_Data_Object_Data, Rte_Write_DiagUT_P_DataServices_DID_0xF11B_New_Data_Object_Data, Rte_Write_DiagUT_P_DataServices_DID_0xF11C_New_Data_Object_Data, Rte_Write_DiagUT_P_DataServices_DID_0xF11D_New_Data_Object_Data, Rte_Write_DiagUT_P_DataServices_DID_0xF11E_New_Data_Object_Data, Rte_Write_DiagUT_P_DataServices_DID_0xF11F_New_Data_Object_Data, Rte_Write_DiagUT_P_DataServices_DID_0xF120_New_Data_Object_Data, Rte_Write_DiagUT_P_DataServices_DID_0xF121_New_Data_Object_Data, Rte_Write_DiagUT_P_DataServices_DID_0xF122_New_Data_Object_2_Data, Rte_Write_DiagUT_P_DataServices_DID_0xF122_New_Data_Object_Data, Rte_Write_DiagUT_P_DataServices_DID_0xF187_New_Data_Object_Data, Rte_Write_DiagUT_P_DataServices_DID_0xF18A_New_Data_Object_Data, Rte_Write_DiagUT_P_DataServices_DID_0xF18B_New_Data_Object_Data, Rte_Write_DiagUT_P_DataServices_DID_0xF18C_New_Data_Object_Data, Rte_Write_DiagUT_P_DataServices_DID_0xF190_New_Data_Object_Data, Rte_Write_DiagUT_P_DataServices_DID_0xF192_New_Data_Object_3_Data, Rte_Write_DiagUT_P_DataServices_DID_0xF192_New_Data_Object_Data, Rte_Write_DiagUT_P_DataServices_DID_0xF194_New_Data_Object_4_Data, Rte_Write_DiagUT_P_DataServices_DID_0xF194_New_Data_Object_Data, Rte_Write_DiagUT_P_DataServices_DID_0xF198_New_Data_Object_5_Data, Rte_Write_DiagUT_P_DataServices_DID_0xF198_New_Data_Object_Data, Rte_Write_DiagUT_P_DataServices_DID_0xF1A0_New_Data_Object_Data, Rte_Write_DiagUT_P_DataServices_DID_0xF1A1_New_Data_Object_Data, Rte_Write_DiagUT_P_DataServices_DID_0xF1A2_New_Data_Object_Data, Rte_Write_DiagUT_P_DataServices_DID_0xF1A5_New_Data_Object_Data, Rte_Write_DiagUT_P_DataServices_DID_0xF1A8_New_Data_Object_Data, Rte_Write_DiagUT_P_DataServices_DID_0xF1A9_New_Data_Object_Data, Rte_Write_DiagUT_P_DataServices_DID_0xF1AA_New_Data_Object_Data]
          prefix=RTE_DIAGUT
          sw-addrmethod=CODE
          symbol=CODE
        RTE_EXT_CODE: executable-entity=[Rte_ActivateRE, Rte_MSACbk_SW_11, Rte_MSACbk_SW_12, Rte_SetEvent, Rte_WriteQueue], prefix=RTE_EXT, sw-addrmethod=CODE, symbol=CODE
        RTE_EXEMGRUT_CODE:
          executable-entity=[Rte_Call_ExeMgrUT_RP_EcuM_SelectResetTarget_GetLastShutdownTarget, Rte_Call_ExeMgrUT_RP_EcuM_SelectResetTarget_GetShutdownCause, Rte_Call_ExeMgrUT_RP_EcuM_SelectResetTarget_GetShutdownTarget, Rte_Call_ExeMgrUT_RP_EcuM_SelectResetTarget_SelectShutdownCause, Rte_Call_ExeMgrUT_RP_EcuM_SelectResetTarget_SelectShutdownTarget, Rte_Enter_ExeMgrUT_ExeMgr_TriggerBswBg_EXCLUSIVE_AREA, Rte_Exit_ExeMgrUT_ExeMgr_TriggerBswBg_EXCLUSIVE_AREA, Rte_IrTrigger_ExeMgrUT_RE_ExeMgr_GetWakeupSource_ITP_GetWakeupSource, Rte_IrTrigger_ExeMgrUT_RE_ExeMgr_ValidateWakeup_ITP_ValidateWakeupSource, Rte_Mode_ExeMgrUT_PP_BswM_APPMode_MDGP_APPMode, Rte_Switch_ExeMgrUT_PP_BswM_APPMode_MDGP_APPMode]
          prefix=RTE_EXEMGRUT
          sw-addrmethod=CODE
          symbol=CODE
        RTE_INP_SWC_CODE:
          executable-entity=[Rte_Read_INP_SWC_RP_ETAS01_Sig00_ComRx_0x81_ETAS01_Sig00_ComRx_0x81, Rte_Read_INP_SWC_RP_ETAS01_Sig01_ComRx_0x81_ETAS01_Sig01_ComRx_0x81, Rte_Read_INP_SWC_RP_ETAS01_Sig02_ComRx_0x81_ETAS01_Sig02_ComRx_0x81, Rte_Read_INP_SWC_RP_ETAS01_Sig03_ComRx_0x81_ETAS01_Sig03_ComRx_0x81, Rte_Read_INP_SWC_RP_ETAS01_Sig04_ComRx_0x81_ETAS01_Sig04_ComRx_0x81, Rte_Read_INP_SWC_RP_ETAS01_Sig05_ComRx_0x81_ETAS01_Sig05_ComRx_0x81, Rte_Read_INP_SWC_RP_ETAS01_Sig06_ComRx_0x81_ETAS01_Sig06_ComRx_0x81, Rte_Read_INP_SWC_RP_ETAS01_Sig07_ComRx_0x81_ETAS01_Sig07_ComRx_0x81, Rte_Read_INP_SWC_RP_ETAS01_Sig08_ComRx_0x81_ETAS01_Sig08_ComRx_0x81, Rte_Read_INP_SWC_RP_ETAS02_Sig09_ComRx_0x261_ETAS02_Sig09_ComRx_0x261, Rte_Read_INP_SWC_RP_ETAS06_Sig34_ComRx_0x456_ETAS06_Sig34_ComRx_0x456, Rte_Read_INP_SWC_RP_ETAS06_Sig35_ComRx_0x456_ETAS06_Sig35_ComRx_0x456, Rte_Read_INP_SWC_RP_ETAS06_Sig36_ComRx_0x456_ETAS06_Sig36_ComRx_0x456, Rte_Read_INP_SWC_RP_ETAS06_Sig37_ComRx_0x456_ETAS06_Sig37_ComRx_0x456, Rte_Read_INP_SWC_RP_ETAS06_Sig38_ComRx_0x456_ETAS06_Sig38_ComRx_0x456, Rte_Read_INP_SWC_RP_ETAS06_Sig39_ComRx_0x456_ETAS06_Sig39_ComRx_0x456, Rte_Read_INP_SWC_RP_ETAS06_Sig40_ComRx_0x456_ETAS06_Sig40_ComRx_0x456, Rte_Read_INP_SWC_RP_ETAS06_Sig41_ComRx_0x456_ETAS06_Sig41_ComRx_0x456]
          prefix=RTE_INP_SWC
          sw-addrmethod=CODE
          symbol=CODE
        RTE_LIB_CODE: executable-entity=[Rte_GetCurrentTaskIndex, Rte_memcpy], prefix=RTE_LIB, sw-addrmethod=CODE, symbol=CODE
        RTE_MAIN_CODE: executable-entity=[Rte_MainFunction, Rte_Start, Rte_Stop, SchM_Deinit, SchM_Init], prefix=RTE_MAIN, sw-addrmethod=CODE, symbol=CODE
        RTE_NVM_NVBLOCK_NVBLOCKDESCRIPTOR_STOREATSHUTDOWNBLOCK_CODE: executable-entity=Rte_GetMirror_CPT_NvBlock_NvBlockDescriptor_StoreAtShutdownBlock, prefix=RTE_NVM_NVBLOCK_NVBLOCKDESCRIPTOR_STOREATSHUTDOWNBLOCK, sw-addrmethod=CODE, symbol=CODE
        RTE_NVM_NVBLOCK_NVBLOCKDESCRIPTOR_STORECYCLICBLOCK_CODE: executable-entity=Rte_GetMirror_CPT_NvBlock_NvBlockDescriptor_StoreCyclicBlock, prefix=RTE_NVM_NVBLOCK_NVBLOCKDESCRIPTOR_STORECYCLICBLOCK, sw-addrmethod=CODE, symbol=CODE
        RTE_NVM_NVBLOCK_NVBLOCKDESCRIPTOR_STOREIMMEDIATEBLOCK_CODE: executable-entity=Rte_GetMirror_CPT_NvBlock_NvBlockDescriptor_StoreImmediateBlock, prefix=RTE_NVM_NVBLOCK_NVBLOCKDESCRIPTOR_STOREIMMEDIATEBLOCK, sw-addrmethod=CODE, symbol=CODE
        RTE_NMUT_CODE:
          executable-entity=[Rte_Call_NmUT_UR_ComMUser_Can_Network_ETAS_Channel_GetCurrentComMode, Rte_Call_NmUT_UR_ComMUser_Can_Network_ETAS_Channel_GetMaxComMode, Rte_Call_NmUT_UR_ComMUser_Can_Network_ETAS_Channel_GetRequestedComMode, Rte_Call_NmUT_UR_ComMUser_Can_Network_ETAS_Channel_RequestComMode, Rte_Call_NmUT_modeLimitation_LimitECUToNoComMode, Rte_Call_NmUT_modeLimitation_ReadInhibitCounter, Rte_Call_NmUT_modeLimitation_ResetInhibitCounter, Rte_Call_NmUT_modeLimitation_SetECUGroupClassification, Rte_Write_NmUT_PP_NM_Tx_Sig_NM_Tx_0x600_NM_Tx_Sig_NM_Tx_0x600, Rte_Write_NmUT_PP_NmState_uint8]
          prefix=RTE_NMUT
          sw-addrmethod=CODE
          symbol=CODE
        RTE_NVBLOCK_CODE: executable-entity=[Rte_ImplCall_NvBlock_RP_StoreAtShutdownBlock_JobFinished, Rte_ImplCall_NvBlock_RP_StoreCyclicBlock_JobFinished, Rte_ImplCall_NvBlock_RP_StoreImmediateBlock_JobFinished], prefix=RTE_NVBLOCK, sw-addrmethod=CODE, symbol=CODE
        RTE_NVBLOCK_NVBLOCKDESCRIPTOR_STOREATSHUTDOWNBLOCK_CODE: executable-entity=[RE_StoreAtShutdown_NvBlock, Rte_NvMNotifyInitBlock_CPT_NvBlock_NvBlockDescriptor_StoreAtShutdownBlock, Rte_NvMNotifyJobFinished_CPT_NvBlock_NvBlockDescriptor_StoreAtShutdownBlock, Rte_SetMirror_CPT_NvBlock_NvBlockDescriptor_StoreAtShutdownBlock], prefix=RTE_NVBLOCK_NVBLOCKDESCRIPTOR_STOREATSHUTDOWNBLOCK, sw-addrmethod=CODE, symbol=CODE
        RTE_NVBLOCK_NVBLOCKDESCRIPTOR_STORECYCLICBLOCK_CODE: executable-entity=[RE_StoreCyclic_NvBlock, Rte_NvMNotifyInitBlock_CPT_NvBlock_NvBlockDescriptor_StoreCyclicBlock, Rte_NvMNotifyJobFinished_CPT_NvBlock_NvBlockDescriptor_StoreCyclicBlock, Rte_SetMirror_CPT_NvBlock_NvBlockDescriptor_StoreCyclicBlock], prefix=RTE_NVBLOCK_NVBLOCKDESCRIPTOR_STORECYCLICBLOCK, sw-addrmethod=CODE, symbol=CODE
        RTE_NVBLOCK_NVBLOCKDESCRIPTOR_STOREIMMEDIATEBLOCK_CODE: executable-entity=[RE_StoreImmediate_NvBlock, Rte_NvMNotifyInitBlock_CPT_NvBlock_NvBlockDescriptor_StoreImmediateBlock, Rte_NvMNotifyJobFinished_CPT_NvBlock_NvBlockDescriptor_StoreImmediateBlock, Rte_SetMirror_CPT_NvBlock_NvBlockDescriptor_StoreImmediateBlock], prefix=RTE_NVBLOCK_NVBLOCKDESCRIPTOR_STOREIMMEDIATEBLOCK, sw-addrmethod=CODE, symbol=CODE
        RTE_NVMUT_CODE:
          executable-entity=[Rte_Call_NvMUT_RP_RequestReset_RequestReset, Rte_Call_NvMUT_RP_ResetInfo_GetLastResetInfo, Rte_Call_NvMUT_RP_Startup_Source_GetLastStartupSource, Rte_Read_NvMUT_PRP_CyclicNvBlock_CyclicNvBlock, Rte_Read_NvMUT_PRP_ImmediateNvBlock_ImmediateNvBlock, Rte_Read_NvMUT_PRP_ShutdownNvBlock_ShutDownNvBlock, Rte_Write_NvMUT_PRP_CyclicNvBlock_CyclicNvBlock, Rte_Write_NvMUT_PRP_ImmediateNvBlock_ImmediateNvBlock, Rte_Write_NvMUT_PRP_ShutdownNvBlock_ShutDownNvBlock]
          prefix=RTE_NVMUT
          sw-addrmethod=CODE
          symbol=CODE
        RTE_OUTP_SWC_CODE:
          executable-entity=[Rte_ImplWrite_OUTP_SWC_PP_ETAS03_Sig10_ComTx_0x55_ETAS03_Sig10_ComTx_0x55, Rte_ImplWrite_OUTP_SWC_PP_ETAS03_Sig11_ComTx_0x55_ETAS03_Sig11_ComTx_0x55, Rte_ImplWrite_OUTP_SWC_PP_ETAS03_Sig12_ComTx_0x55_ETAS03_Sig12_ComTx_0x55, Rte_ImplWrite_OUTP_SWC_PP_ETAS03_Sig13_ComTx_0x55_ETAS03_Sig13_ComTx_0x55, Rte_ImplWrite_OUTP_SWC_PP_ETAS03_Sig14_ComTx_0x55_ETAS03_Sig14_ComTx_0x55, Rte_ImplWrite_OUTP_SWC_PP_ETAS03_Sig15_ComTx_0x55_ETAS03_Sig15_ComTx_0x55, Rte_ImplWrite_OUTP_SWC_PP_ETAS03_Sig16_ComTx_0x55_ETAS03_Sig16_ComTx_0x55, Rte_ImplWrite_OUTP_SWC_PP_ETAS03_Sig17_ComTx_0x55_ETAS03_Sig17_ComTx_0x55, Rte_ImplWrite_OUTP_SWC_PP_ETAS03_Sig18_ComTx_0x55_ETAS03_Sig18_ComTx_0x55, Rte_ImplWrite_OUTP_SWC_PP_ETAS03_Sig19_ComTx_0x55_ETAS03_Sig19_ComTx_0x55, Rte_Write_OUTP_SWC_PP_ETAS04_Sig20_ComTx_0x98_ETAS04_Sig20_ComTx_0x98, Rte_Write_OUTP_SWC_PP_ETAS04_Sig21_ComTx_0x98_ETAS04_Sig21_ComTx_0x98, Rte_Write_OUTP_SWC_PP_ETAS04_Sig22_ComTx_0x98_ETAS04_Sig22_ComTx_0x98, Rte_Write_OUTP_SWC_PP_ETAS04_Sig23_ComTx_0x98_ETAS04_Sig23_ComTx_0x98, Rte_Write_OUTP_SWC_PP_ETAS04_Sig24_ComTx_0x98_ETAS04_Sig24_ComTx_0x98, Rte_Write_OUTP_SWC_PP_ETAS04_Sig25_ComTx_0x98_ETAS04_Sig25_ComTx_0x98, Rte_Write_OUTP_SWC_PP_ETAS05_Sig26_ComTx_0x123_ETAS05_Sig26_ComTx_0x123, Rte_Write_OUTP_SWC_PP_ETAS05_Sig27_ComTx_0x123_ETAS05_Sig27_ComTx_0x123, Rte_Write_OUTP_SWC_PP_ETAS05_Sig28_ComTx_0x123_ETAS05_Sig28_ComTx_0x123, Rte_Write_OUTP_SWC_PP_ETAS05_Sig29_ComTx_0x123_ETAS05_Sig29_ComTx_0x123, Rte_Write_OUTP_SWC_PP_ETAS05_Sig30_ComTx_0x123_ETAS05_Sig30_ComTx_0x123, Rte_Write_OUTP_SWC_PP_ETAS05_Sig31_ComTx_0x123_ETAS05_Sig31_ComTx_0x123, Rte_Write_OUTP_SWC_PP_ETAS05_Sig32_ComTx_0x123_ETAS05_Sig32_ComTx_0x123, Rte_Write_OUTP_SWC_PP_ETAS05_Sig33_ComTx_0x123_ETAS05_Sig33_ComTx_0x123]
          prefix=RTE_OUTP_SWC
          sw-addrmethod=CODE
          symbol=CODE
        RTE_OSTASK_APPCORE_ASW_10MS_CODE: prefix=RTE_OSTASK_APPCORE_ASW_10MS, sw-addrmethod=CODE, symbol=CODE
        RTE_OSTASK_COMCORE_ASW_10MS_CODE: prefix=RTE_OSTASK_COMCORE_ASW_10MS, sw-addrmethod=CODE, symbol=CODE
        RTE_OSTASK_SYSCORE_ASW_100MS_CODE: prefix=RTE_OSTASK_SYSCORE_ASW_100MS, sw-addrmethod=CODE, symbol=CODE
        RTE_OSTASK_SYSCORE_ASW_10MS_CODE: prefix=RTE_OSTASK_SYSCORE_ASW_10MS, sw-addrmethod=CODE, symbol=CODE
        RTE_OSTASK_SYSCORE_ASW_50MS_CODE: prefix=RTE_OSTASK_SYSCORE_ASW_50MS, sw-addrmethod=CODE, symbol=CODE
        RTE_OSTASK_SYSCORE_BSW_10MS_CODE: prefix=RTE_OSTASK_SYSCORE_BSW_10MS, sw-addrmethod=CODE, symbol=CODE
        RTE_OSTASK_SYSCORE_BSW_1MS_CODE: prefix=RTE_OSTASK_SYSCORE_BSW_1MS, sw-addrmethod=CODE, symbol=CODE
        RTE_OSTASK_SYSCORE_BSW_SWCREQUEST_CODE: prefix=RTE_OSTASK_SYSCORE_BSW_SWCREQUEST, sw-addrmethod=CODE, symbol=CODE
        RTE_OSTASK_SYSCORE_BSWBG_100MS_CODE: prefix=RTE_OSTASK_SYSCORE_BSWBG_100MS, sw-addrmethod=CODE, symbol=CODE
        RTE_OSTASK_SYSCORE_DRE_CODE: prefix=RTE_OSTASK_SYSCORE_DRE, sw-addrmethod=CODE, symbol=CODE
        RTE_OSTASK_SYSCORE_STARTUP_CODE: prefix=RTE_OSTASK_SYSCORE_STARTUP, sw-addrmethod=CODE, symbol=CODE
        RTE_SIG_S_ETAS01_SIG{00..08}_COMRX_0X81_CAN_NETWORK_ETAS_CHANNEL_CAN_RX_CODE: executable-entity=Rte_COMCbk_S_ETAS01_Sig{00..08}_ComRx_0x81_Can_Network_ETAS_Channel_CAN_Rx, prefix=RTE_SIG_S_ETAS01_SIG{00..08}_COMRX_0X81_CAN_NETWORK_ETAS_CHANNEL_CAN_RX, sw-addrmethod=CODE, symbol=CODE
        RTE_SIG_S_ETAS02_SIG09_COMRX_0X261_CAN_NETWORK_ETAS_CHANNEL_CAN_RX_CODE: executable-entity=Rte_COMCbk_S_ETAS02_Sig09_ComRx_0x261_Can_Network_ETAS_Channel_CAN_Rx, prefix=RTE_SIG_S_ETAS02_SIG09_COMRX_0X261_CAN_NETWORK_ETAS_CHANNEL_CAN_RX, sw-addrmethod=CODE, symbol=CODE
        RTE_SIG_S_ETAS06_SIG{34..41}_COMRX_0X456_CAN_NETWORK_ETAS_CHANNEL_CAN_RX_CODE: executable-entity=Rte_COMCbk_S_ETAS06_Sig{34..41}_ComRx_0x456_Can_Network_ETAS_Channel_CAN_Rx, prefix=RTE_SIG_S_ETAS06_SIG{34..41}_COMRX_0X456_CAN_NETWORK_ETAS_CHANNEL_CAN_RX, sw-addrmethod=CODE, symbol=CODE
        RTE_SYS_CODE: executable-entity=[Rte_DecrementWaitingCount, Rte_ReadQueue, Rte_WaitWithTimeout, SchM_IModeInit], prefix=RTE_SYS, sw-addrmethod=CODE, symbol=CODE
        RTE_TSTM_CODE: executable-entity=Rte_Call_TstM_GetStackInfo_GetStackInfo, prefix=RTE_TSTM, sw-addrmethod=CODE, symbol=CODE
        RTE_WDGM_CODE: executable-entity=[Rte_SwitchAck_WdgM_globalMode_currentMode, Rte_SwitchAck_WdgM_mode_WdgM_SE1_currentMode, Rte_Switch_WdgM_globalMode_currentMode, Rte_Switch_WdgM_mode_WdgM_SE1_currentMode, SchM_Mode_WdgM_Current_WdgMSupervisionCycle], prefix=RTE_WDGM, sw-addrmethod=CODE, symbol=CODE
        RTE_WDGMUT_CODE:
          executable-entity=[Rte_Call_WdgMUT_RP_AliveSupervision_ASW_10ms_CheckpointReached, Rte_Call_WdgMUT_RP_Deadline_Start_ASW_10ms_CheckpointReached, Rte_Call_WdgMUT_RP_Deadline_Stop_ASW_10ms_CheckpointReached, Rte_Call_WdgMUT_RP_PFM_CP0_ASW_10ms_CheckpointReached, Rte_Call_WdgMUT_RP_PFM_CP1_ASW_10ms_CheckpointReached, Rte_Call_WdgMUT_RP_WdgM_GlobalSupervision_GetFirstExpiredSEID, Rte_Call_WdgMUT_RP_WdgM_GlobalSupervision_GetGlobalStatus, Rte_Call_WdgMUT_RP_WdgM_GlobalSupervision_GetMode, Rte_Call_WdgMUT_RP_WdgM_GlobalSupervision_PerformReset, Rte_Call_WdgMUT_RP_WdgM_GlobalSupervision_SetMode, Rte_Call_WdgMUT_RP_WdgM_LocalSupervisionStatus_GetLocalStatus, Rte_Mode_WdgMUT_RP_WdgM_GlobalMode_currentMode, Rte_Mode_WdgMUT_RP_WdgM_WdgM_SE1_Mode_currentMode]
          prefix=RTE_WDGMUT
          sw-addrmethod=CODE
          symbol=CODE
        CONST_32: alignment=32, sw-addrmethod=CONST
        CONST_8: alignment=8, sw-addrmethod=CONST
        CONST_BOOLEAN: alignment=BOOLEAN, sw-addrmethod=CONST
        CONST_UNSPECIFIED: alignment=UNSPECIFIED, sw-addrmethod=CONST
        EcucPartition_AppCore_CALPRM_32: alignment=32, sw-addrmethod=EcucPartition_AppCore_CALPRM
        EcucPartition_AppCore_CONST_UNSPECIFIED: alignment=UNSPECIFIED, sw-addrmethod=EcucPartition_AppCore_CONST
        EcucPartition_AppCore_VAR_CLEARED_32: alignment=32, sw-addrmethod=EcucPartition_AppCore_VAR_CLEARED
        EcucPartition_ComCore_CONST_UNSPECIFIED: alignment=UNSPECIFIED, sw-addrmethod=EcucPartition_ComCore_CONST
        EcucPartition_ComCore_VAR_CLEARED_16: alignment=16, sw-addrmethod=EcucPartition_ComCore_VAR_CLEARED
        EcucPartition_ComCore_VAR_CLEARED_8: alignment=8, sw-addrmethod=EcucPartition_ComCore_VAR_CLEARED
        EcucPartition_ComCore_VAR_CLEARED_BOOLEAN: alignment=BOOLEAN, sw-addrmethod=EcucPartition_ComCore_VAR_CLEARED
        EcucPartition_SysCore_CONST_UNSPECIFIED: alignment=UNSPECIFIED, sw-addrmethod=EcucPartition_SysCore_CONST
        EcucPartition_SysCore_VAR_CLEARED_32: alignment=32, sw-addrmethod=EcucPartition_SysCore_VAR_CLEARED
        EcucPartition_SysCore_VAR_CLEARED_8: alignment=8, sw-addrmethod=EcucPartition_SysCore_VAR_CLEARED
        EcucPartition_SysCore_VAR_CLEARED_BOOLEAN: alignment=BOOLEAN, sw-addrmethod=EcucPartition_SysCore_VAR_CLEARED
        VAR_CLEARED_16: alignment=16, sw-addrmethod=VAR_CLEARED
        RTE_ECUCPARTITION_COMCORE_VAR_CLEARED_16: alignment=16, prefix=RTE_ECUCPARTITION_COMCORE, sw-addrmethod=VAR_CLEARED, symbol=VAR_CLEARED_16
        RTE_OSAPP_APPCORE_VAR_CLEARED_16: alignment=16, prefix=RTE_OSAPP_APPCORE, sw-addrmethod=VAR_CLEARED, symbol=VAR_CLEARED_16
        RTE_OSAPP_COMCORE_VAR_CLEARED_16: alignment=16, prefix=RTE_OSAPP_COMCORE, sw-addrmethod=VAR_CLEARED, symbol=VAR_CLEARED_16
        RTE_OSAPP_SYSCORE_VAR_CLEARED_16: alignment=16, prefix=RTE_OSAPP_SYSCORE, sw-addrmethod=VAR_CLEARED, symbol=VAR_CLEARED_16
        VAR_CLEARED_32: alignment=32, sw-addrmethod=VAR_CLEARED
        RTE_SYS_VAR_CLEARED_32: alignment=32, prefix=RTE_SYS, sw-addrmethod=VAR_CLEARED, symbol=VAR_CLEARED_32
        VAR_CLEARED_8: alignment=8, sw-addrmethod=VAR_CLEARED
        RTE_AF_CPT_NVBLOCK_DRE_NVBLOCK_STOREATSHUTDOWNNVBLOCK_VAR_CLEARED_8: alignment=8, prefix=RTE_AF_CPT_NVBLOCK_DRE_NVBLOCK_STOREATSHUTDOWNNVBLOCK, sw-addrmethod=VAR_CLEARED, symbol=VAR_CLEARED_8
        RTE_AF_CPT_NVBLOCK_DRE_NVBLOCK_STOREIMMEDIATENVBLOCK_VAR_CLEARED_8: alignment=8, prefix=RTE_AF_CPT_NVBLOCK_DRE_NVBLOCK_STOREIMMEDIATENVBLOCK, sw-addrmethod=VAR_CLEARED, symbol=VAR_CLEARED_8
        RTE_ECUCPARTITION_SYSCORE_VAR_CLEARED_8: alignment=8, prefix=RTE_ECUCPARTITION_SYSCORE, sw-addrmethod=VAR_CLEARED, symbol=VAR_CLEARED_8
        VAR_CLEARED_BOOLEAN: alignment=BOOLEAN, sw-addrmethod=VAR_CLEARED
        VAR_INIT_8: alignment=8, sw-addrmethod=VAR_INIT
        RTE_ECUCPARTITION_SYSCORE_VAR_INIT_8: alignment=8, prefix=RTE_ECUCPARTITION_SYSCORE, sw-addrmethod=VAR_INIT, symbol=VAR_INIT_8
        VAR_INIT_UNSPECIFIED: alignment=UNSPECIFIED, sw-addrmethod=VAR_INIT
      61 x section name prefix:
        RTE_AF_CPT_NVBLOCK_DRE_NVBLOCK_STOREATSHUTDOWNNVBLOCK
        RTE_AF_CPT_NVBLOCK_DRE_NVBLOCK_STOREIMMEDIATENVBLOCK
        RTE_BSWM
        RTE_CALUT
        RTE_COMM
        RTE_DCM
        RTE_DEM
        RTE_DIAGUT
        RTE_ECUCPARTITION_COMCORE
        RTE_ECUCPARTITION_SYSCORE
        RTE_EXEMGRUT
        RTE_EXT
        RTE_INP_SWC
        RTE_LIB
        RTE_MAIN
        RTE_NMUT
        RTE_NVBLOCK
        RTE_NVBLOCK_NVBLOCKDESCRIPTOR_STOREATSHUTDOWNBLOCK
        RTE_NVBLOCK_NVBLOCKDESCRIPTOR_STORECYCLICBLOCK
        RTE_NVBLOCK_NVBLOCKDESCRIPTOR_STOREIMMEDIATEBLOCK
        RTE_NVMUT
        RTE_NVM_NVBLOCK_NVBLOCKDESCRIPTOR_STOREATSHUTDOWNBLOCK
        RTE_NVM_NVBLOCK_NVBLOCKDESCRIPTOR_STORECYCLICBLOCK
        RTE_NVM_NVBLOCK_NVBLOCKDESCRIPTOR_STOREIMMEDIATEBLOCK
        RTE_OSAPP_APPCORE
        RTE_OSAPP_COMCORE
        RTE_OSAPP_SYSCORE
        RTE_OSTASK_APPCORE_ASW_10MS
        RTE_OSTASK_COMCORE_ASW_10MS
        RTE_OSTASK_SYSCORE_ASW_100MS
        RTE_OSTASK_SYSCORE_ASW_10MS
        RTE_OSTASK_SYSCORE_ASW_50MS
        RTE_OSTASK_SYSCORE_BSWBG_100MS
        RTE_OSTASK_SYSCORE_BSW_10MS
        RTE_OSTASK_SYSCORE_BSW_1MS
        RTE_OSTASK_SYSCORE_BSW_SWCREQUEST
        RTE_OSTASK_SYSCORE_DRE
        RTE_OSTASK_SYSCORE_STARTUP
        RTE_OUTP_SWC
        RTE_SIG_S_ETAS01_SIG{00..08}_COMRX_0X81_CAN_NETWORK_ETAS_CHANNEL_CAN_RX
        RTE_SIG_S_ETAS02_SIG09_COMRX_0X261_CAN_NETWORK_ETAS_CHANNEL_CAN_RX
        RTE_SIG_S_ETAS06_SIG{34..41}_COMRX_0X456_CAN_NETWORK_ETAS_CHANNEL_CAN_RX
        RTE_SYS
        RTE_TSTM
        RTE_WDGM
        RTE_WDGMUT
package /AUTOSAR_Rte/CompuMethods
  compu method AUTOSAR_Platform_CompuMethods_boolean: 0=FALSE, 1=TRUE
  compu method CompuMethods_ExeMgr_StartupSourceType: 0=STARTUP_SOURCE_NONE, 1=STARTUP_SOURCE_KL15, 2=STARTUP_SOURCE_SWITCH, 4=STARTUP_SOURCE_SLOWCHARGESWITCH, 8=STARTUP_SOURCE_SLOWCHARGECP, 16=STARTUP_SOURCE_REQ4, 32=STARTUP_SOURCE_APLUS, 64=STARTUP_SOURCE_CCWAKE
  compu method AUTOSAR_PlatformTypes_CompuMethods_boolean: 0=FALSE, 1=TRUE
  compu method AUTOSAR_Dcm_CompuMethods_inputOutputControlParameterType_Values: 255=DCM_IDLE, 3=DCM_SHORT_TERM_ADJUSTMENT, 2=DCM_FREEZE_CURRENT_STATE, 1=DCM_RESET_TO_DEFAULT, 0=DCM_RETURN_CONTROL_TO_ECU
  compu method AUTOSAR_Dcm_CompuMethods_IOOperationResponse_Values: 255=DCM_IDLE, 0=DCM_POSITIVE_RESPONSE, 16=DCM_GENERAL_REJECT, 33=DCM_BUSY_REPEAT_REQUEST, 34=DCM_CONDITIONS_NOT_CORRECT, 38=DCM_FAILURE_PREVENTS_EXECUTION, 49=DCM_REQUEST_OUT_OF_RANGE, 120=DCM_RESPONSE_PENDING
package /AUTOSAR_Rte/ImplementationDataTypes
  117 x impl type:
    Rte_REActCounterType: category=VALUE  # This is an external type, i.e. it is declared in the Rte Library and not in the XML. RTEGen does not have any information about this type apart from its name.
    Rte_DE_boolean: category=STRUCTURE
      element value: implementation-data-type=boolean
    Rte_DE_uint16: category=STRUCTURE
      element value: implementation-data-type=uint16
    Rte_DE_uint8: category=STRUCTURE
      element value: implementation-data-type=uint8
    Rte_TDB_OsTask_ComCore_ASW_10ms: category=STRUCTURE
      10 x element, all with category=TYPE_REFERENCE:
        wbuf0: implementation-data-type=Rte_DE_boolean
        wbuf1: implementation-data-type=Rte_DE_boolean
        wbuf2: implementation-data-type=Rte_DE_uint16
        wbuf3: implementation-data-type=Rte_DE_uint16
        wbuf{4..6}: implementation-data-type=Rte_DE_uint8
        wbuf7: implementation-data-type=Rte_DE_boolean
        wbuf8: implementation-data-type=Rte_DE_boolean
        wbuf9: implementation-data-type=Rte_DE_uint8
    Rte_EcucPartition_ComCore_ISA_Core0_8: category=UNION
      element Rte_OsTask_ComCore_ASW_10ms: implementation-data-type=Rte_TDB_OsTask_ComCore_ASW_10ms
    Rte_EcucPartition_ComCore_ImplicitBufsType: category=STRUCTURE
      element isa_Core0_8: implementation-data-type=Rte_EcucPartition_ComCore_ISA_Core0_8
    Rte_CDS_BswM: category=STRUCTURE
      element Rte_Dummy: implementation-data-type=uint8
    Rte_CDS_CalUT: category=STRUCTURE
      element Pim_ArTypedPIM_1: implementation-data-type=uint32
    Rte_CDS_ComM: category=STRUCTURE
      element Rte_Dummy: implementation-data-type=uint8
    Rte_CDS_Dcm: category=STRUCTURE
      element Rte_Dummy: implementation-data-type=uint8
    Rte_CDS_Dem: category=STRUCTURE
      element Rte_Dummy: implementation-data-type=uint8
    Rte_CDS_Det: category=STRUCTURE
      element Rte_Dummy: implementation-data-type=uint8
    Rte_CDS_DiagUT: category=STRUCTURE
      element Rte_Dummy: implementation-data-type=uint8
    Rte_CDS_EcuM: category=STRUCTURE
      element Rte_Dummy: implementation-data-type=uint8
    ExeMgr_StartupSourceType: compu-method=CompuMethods_ExeMgr_StartupSourceType, implementation-data-type=uint8
    Rte_EnterFP_ExeMgrUT_ExeMgr_TriggerBswBg_EXCLUSIVE_AREA: category=FUNCTION_REFERENCE
    Rte_ExitFP_ExeMgrUT_ExeMgr_TriggerBswBg_EXCLUSIVE_AREA: category=FUNCTION_REFERENCE
    Rte_CDS_ExeMgrUT: category=STRUCTURE
      5 x element, all with category=TYPE_REFERENCE:
        Irv_RE_ExeMgr_EvaluateWakeup_ExeMgr_StartupSource: implementation-data-type=ExeMgr_StartupSourceType
        Irv_RE_ExeMgr_GetWakeupSource_ExeMgr_StartupSource: implementation-data-type=ExeMgr_StartupSourceType
        Irv_RE_ExeMgr_StartupSource_ExeMgr_StartupSource: implementation-data-type=ExeMgr_StartupSourceType
        Entry_ExeMgr_TriggerBswBg_EXCLUSIVE_AREA: implementation-data-type=Rte_EnterFP_ExeMgrUT_ExeMgr_TriggerBswBg_EXCLUSIVE_AREA
        Exit_ExeMgr_TriggerBswBg_EXCLUSIVE_AREA: implementation-data-type=Rte_ExitFP_ExeMgrUT_ExeMgr_TriggerBswBg_EXCLUSIVE_AREA
    Rte_CDS_FiM: category=STRUCTURE
      element Rte_Dummy: implementation-data-type=uint8
    Rte_CDS_INP_SWC: category=STRUCTURE
      element Rte_Dummy: implementation-data-type=uint8
    Rte_CDS_NmUT: category=STRUCTURE
      element Rte_Dummy: implementation-data-type=uint8
    Rte_CDS_NvM: category=STRUCTURE
      element Rte_Dummy: implementation-data-type=uint8
    Rte_CDS_NvMUT: category=STRUCTURE
      element Rte_Dummy: implementation-data-type=uint8
    Rte_CDS_OUTP_SWC: category=STRUCTURE
      10 x element, all with category=TYPE_REFERENCE:
        RE_OUTP_SWC_PP_ETAS03_Sig10_ComTx_0x55_ETAS03_Sig10_ComTx_0x55: implementation-data-type=Rte_DE_boolean
        RE_OUTP_SWC_PP_ETAS03_Sig11_ComTx_0x55_ETAS03_Sig11_ComTx_0x55: implementation-data-type=Rte_DE_uint8
        RE_OUTP_SWC_PP_ETAS03_Sig12_ComTx_0x55_ETAS03_Sig12_ComTx_0x55: implementation-data-type=Rte_DE_uint8
        RE_OUTP_SWC_PP_ETAS03_Sig13_ComTx_0x55_ETAS03_Sig13_ComTx_0x55: implementation-data-type=Rte_DE_uint16
        RE_OUTP_SWC_PP_ETAS03_Sig14_ComTx_0x55_ETAS03_Sig14_ComTx_0x55: implementation-data-type=Rte_DE_boolean
        RE_OUTP_SWC_PP_ETAS03_Sig15_ComTx_0x55_ETAS03_Sig15_ComTx_0x55: implementation-data-type=Rte_DE_uint16
        RE_OUTP_SWC_PP_ETAS03_Sig16_ComTx_0x55_ETAS03_Sig16_ComTx_0x55: implementation-data-type=Rte_DE_boolean
        RE_OUTP_SWC_PP_ETAS03_Sig17_ComTx_0x55_ETAS03_Sig17_ComTx_0x55: implementation-data-type=Rte_DE_uint8
        RE_OUTP_SWC_PP_ETAS03_Sig18_ComTx_0x55_ETAS03_Sig18_ComTx_0x55: implementation-data-type=Rte_DE_boolean
        RE_OUTP_SWC_PP_ETAS03_Sig19_ComTx_0x55_ETAS03_Sig19_ComTx_0x55: implementation-data-type=Rte_DE_uint8
    Rte_CDS_Rtm: category=STRUCTURE
      element Rte_Dummy: implementation-data-type=uint8
    Rte_CDS_StackM: category=STRUCTURE
      element Rte_Dummy: implementation-data-type=uint8
    Rte_CDS_TstM: category=STRUCTURE
      element Rte_Dummy: implementation-data-type=uint8
    Rte_SwitchAckFP_WdgM_WdgM_LocalMode_currentMode: category=FUNCTION_REFERENCE
    Rte_SwitchFP_WdgM_WdgM_LocalMode_currentMode: category=FUNCTION_REFERENCE
    Rte_PDS_WdgM_WdgM_LocalMode_P: category=STRUCTURE
      element SwitchAck_currentMode: implementation-data-type=Rte_SwitchAckFP_WdgM_WdgM_LocalMode_currentMode
      element Switch_currentMode: implementation-data-type=Rte_SwitchFP_WdgM_WdgM_LocalMode_currentMode
    Rte_PDS_WdgM_WdgM_LocalMode_PA: category=ARRAY
      element Rte_PDS_WdgM_WdgM_LocalMode_PAElement: array-size=1, array-size-semantics=FIXED-SIZE, implementation-data-type=Rte_PDS_WdgM_WdgM_LocalMode_P
    Rte_CDS_WdgM: category=STRUCTURE
      element mode_WdgM_SE1: implementation-data-type=Rte_PDS_WdgM_WdgM_LocalMode_PA
    Rte_CDS_WdgMUT: category=STRUCTURE
      element Rte_Dummy: implementation-data-type=uint8
    Rte_CDS_rba_DiagLib: category=STRUCTURE
      element Rte_Dummy: implementation-data-type=uint8
    ComM_InhibitionStatusType: implementation-data-type=uint8
    StackM_StackMeasureType: category=STRUCTURE
      element FreeSpace: implementation-data-type=uint32
      element FreePercent: implementation-data-type=float32
      element CheckWordReached: implementation-data-type=uint8
    Type_ArrayBoolean_96: category=ARRAY
      element Type_ArrayBoolean_96Element: array-size=96, array-size-semantics=FIXED-SIZE, implementation-data-type=boolean
    Type_U8: implementation-data-type=uint8
    Type_ArrayU8_1024: category=ARRAY
      element Type_ArrayU8_1024Element: array-size=1024, array-size-semantics=FIXED-SIZE, implementation-data-type=Type_U8
    Type_ArrayU32_96: category=ARRAY
      element Type_ArrayU32_96Element: array-size=96, array-size-semantics=FIXED-SIZE, implementation-data-type=uint32
    Dcm_ControlMask_32Type: implementation-data-type=uint32
    Dcm_InputOutputControlParameterType: compu-method=AUTOSAR_Dcm_CompuMethods_inputOutputControlParameterType_Values, implementation-data-type=uint8
    Dcm_IOOperationRequest_DID_0xD901_New_Data_ObjectType: category=STRUCTURE
      element inputOutputControlParameter: implementation-data-type=Dcm_InputOutputControlParameterType
      element controlEnableMask: implementation-data-type=Dcm_ControlMask_32Type
    Dcm_DataArrayTypeUint8_DID_0xD901_New_Data_ObjectType: implementation-data-type=uint8
    Dcm_IOControlRequest_DID_0xD901_New_Data_ObjectType: category=STRUCTURE
      element undercontrol: implementation-data-type=Dcm_ControlMask_32Type
      element IOOperationRequest: implementation-data-type=Dcm_IOOperationRequest_DID_0xD901_New_Data_ObjectType
      element controlState: implementation-data-type=Dcm_DataArrayTypeUint8_DID_0xD901_New_Data_ObjectType
    Dcm_IOOperationRequest_DID_0xE900_New_Data_ObjectType: category=STRUCTURE
      element inputOutputControlParameter: implementation-data-type=Dcm_InputOutputControlParameterType
      element controlEnableMask: implementation-data-type=Dcm_ControlMask_32Type
    Dcm_DataArrayTypeUint8_DID_0xE900_New_Data_ObjectType: implementation-data-type=uint8
    Dcm_IOControlRequest_DID_0xE900_New_Data_ObjectType: category=STRUCTURE
      element undercontrol: implementation-data-type=Dcm_ControlMask_32Type
      element IOOperationRequest: implementation-data-type=Dcm_IOOperationRequest_DID_0xE900_New_Data_ObjectType
      element controlState: implementation-data-type=Dcm_DataArrayTypeUint8_DID_0xE900_New_Data_ObjectType
    Dcm_DataArrayTypeUint8_DID_0x0100_New_Data_ObjectType: category=ARRAY
      element Dcm_DataArrayTypeUint8_DID_0x0100_New_Data_ObjectTypeElement: array-size=16, array-size-semantics=FIXED-SIZE, implementation-data-type=uint8
    Dcm_DataArrayTypeUint8_DID_0xF110_New_Data_ObjectType: category=ARRAY
      element Dcm_DataArrayTypeUint8_DID_0xF110_New_Data_ObjectTypeElement: array-size=16, array-size-semantics=FIXED-SIZE, implementation-data-type=uint8
    Dcm_DataArrayTypeUint8_DID_0xF115_New_Data_ObjectType: category=ARRAY
      element Dcm_DataArrayTypeUint8_DID_0xF115_New_Data_ObjectTypeElement: array-size=16, array-size-semantics=FIXED-SIZE, implementation-data-type=uint8
    Dcm_DataArrayTypeUint8_DID_0xF121_New_Data_ObjectType: category=ARRAY
      element Dcm_DataArrayTypeUint8_DID_0xF121_New_Data_ObjectTypeElement: array-size=16, array-size-semantics=FIXED-SIZE, implementation-data-type=uint8
    Dcm_DataArrayTypeUint8_DID_0xF187_New_Data_ObjectType: category=ARRAY
      element Dcm_DataArrayTypeUint8_DID_0xF187_New_Data_ObjectTypeElement: array-size=5, array-size-semantics=FIXED-SIZE, implementation-data-type=uint8
    Dcm_DataArrayTypeUint8_DID_0xF18B_New_Data_ObjectType: category=ARRAY
      element Dcm_DataArrayTypeUint8_DID_0xF18B_New_Data_ObjectTypeElement: array-size=3, array-size-semantics=FIXED-SIZE, implementation-data-type=uint8
    Dcm_DataArrayTypeUint8_DID_0xF18C_New_Data_ObjectType: category=ARRAY
      element Dcm_DataArrayTypeUint8_DID_0xF18C_New_Data_ObjectTypeElement: array-size=16, array-size-semantics=FIXED-SIZE, implementation-data-type=uint8
    Dcm_DataArrayTypeUint8_DID_0xF190_New_Data_ObjectType: category=ARRAY
      element Dcm_DataArrayTypeUint8_DID_0xF190_New_Data_ObjectTypeElement: array-size=17, array-size-semantics=FIXED-SIZE, implementation-data-type=uint8
    Dcm_DataArrayTypeUint8_DID_0xF198_New_Data_ObjectType: category=ARRAY
      element Dcm_DataArrayTypeUint8_DID_0xF198_New_Data_ObjectTypeElement: array-size=5, array-size-semantics=FIXED-SIZE, implementation-data-type=uint8
    Dcm_DataArrayTypeUint8_DID_0xF198_New_Data_Object_5Type: category=ARRAY
      element Dcm_DataArrayTypeUint8_DID_0xF198_New_Data_Object_5TypeElement: array-size=6, array-size-semantics=FIXED-SIZE, implementation-data-type=uint8
    Dcm_DataArrayTypeUint8_DID_0xF1A8_New_Data_ObjectType: category=ARRAY
      element Dcm_DataArrayTypeUint8_DID_0xF1A8_New_Data_ObjectTypeElement: array-size=20, array-size-semantics=FIXED-SIZE, implementation-data-type=uint8
    Dcm_DataArrayTypeUint8_DID_0xF1A9_New_Data_ObjectType: category=ARRAY
      element Dcm_DataArrayTypeUint8_DID_0xF1A9_New_Data_ObjectTypeElement: array-size=5, array-size-semantics=FIXED-SIZE, implementation-data-type=uint8
    Dcm_DataArrayTypeUint8_DID_0xF1AA_New_Data_ObjectType: category=ARRAY
      element Dcm_DataArrayTypeUint8_DID_0xF1AA_New_Data_ObjectTypeElement: array-size=5, array-size-semantics=FIXED-SIZE, implementation-data-type=uint8
    Dcm_IOOperationResponseType: compu-method=AUTOSAR_Dcm_CompuMethods_IOOperationResponse_Values, implementation-data-type=uint8
    Dcm_DataArrayTypeUint8_DID_0xB950_New_Data_ObjectType: category=ARRAY
      element Dcm_DataArrayTypeUint8_DID_0xB950_New_Data_ObjectTypeElement: array-size=8, array-size-semantics=FIXED-SIZE, implementation-data-type=uint8
    Dcm_DataArrayTypeUint8_DID_0xE101_New_Data_ObjectType: category=ARRAY
      element Dcm_DataArrayTypeUint8_DID_0xE101_New_Data_ObjectTypeElement: array-size=3, array-size-semantics=FIXED-SIZE, implementation-data-type=uint8
    Dcm_DataArrayTypeUint8_DID_0xF100_New_Data_ObjectType: category=ARRAY
      element Dcm_DataArrayTypeUint8_DID_0xF100_New_Data_ObjectTypeElement: array-size=5, array-size-semantics=FIXED-SIZE, implementation-data-type=uint8
    Dcm_DataArrayTypeUint8_DID_0xF100_New_Data_Object_1Type: category=ARRAY
      element Dcm_DataArrayTypeUint8_DID_0xF100_New_Data_Object_1TypeElement: array-size=6, array-size-semantics=FIXED-SIZE, implementation-data-type=uint8
    Dcm_DataArrayTypeUint8_DID_0xF111_New_Data_ObjectType: category=ARRAY
      element Dcm_DataArrayTypeUint8_DID_0xF111_New_Data_ObjectTypeElement: array-size=16, array-size-semantics=FIXED-SIZE, implementation-data-type=uint8
    Dcm_DataArrayTypeUint8_DID_0xF112_New_Data_ObjectType: category=ARRAY
      element Dcm_DataArrayTypeUint8_DID_0xF112_New_Data_ObjectTypeElement: array-size=16, array-size-semantics=FIXED-SIZE, implementation-data-type=uint8
    Dcm_DataArrayTypeUint8_DID_0xF113_New_Data_ObjectType: category=ARRAY
      element Dcm_DataArrayTypeUint8_DID_0xF113_New_Data_ObjectTypeElement: array-size=16, array-size-semantics=FIXED-SIZE, implementation-data-type=uint8
    Dcm_DataArrayTypeUint8_DID_0xF114_New_Data_ObjectType: category=ARRAY
      element Dcm_DataArrayTypeUint8_DID_0xF114_New_Data_ObjectTypeElement: array-size=16, array-size-semantics=FIXED-SIZE, implementation-data-type=uint8
    Dcm_DataArrayTypeUint8_DID_0xF116_New_Data_ObjectType: category=ARRAY
      element Dcm_DataArrayTypeUint8_DID_0xF116_New_Data_ObjectTypeElement: array-size=16, array-size-semantics=FIXED-SIZE, implementation-data-type=uint8
    Dcm_DataArrayTypeUint8_DID_0xF117_New_Data_ObjectType: category=ARRAY
      element Dcm_DataArrayTypeUint8_DID_0xF117_New_Data_ObjectTypeElement: array-size=16, array-size-semantics=FIXED-SIZE, implementation-data-type=uint8
    Dcm_DataArrayTypeUint8_DID_0xF118_New_Data_ObjectType: category=ARRAY
      element Dcm_DataArrayTypeUint8_DID_0xF118_New_Data_ObjectTypeElement: array-size=16, array-size-semantics=FIXED-SIZE, implementation-data-type=uint8
    Dcm_DataArrayTypeUint8_DID_0xF119_New_Data_ObjectType: category=ARRAY
      element Dcm_DataArrayTypeUint8_DID_0xF119_New_Data_ObjectTypeElement: array-size=16, array-size-semantics=FIXED-SIZE, implementation-data-type=uint8
    Dcm_DataArrayTypeUint8_DID_0xF11A_New_Data_ObjectType: category=ARRAY
      element Dcm_DataArrayTypeUint8_DID_0xF11A_New_Data_ObjectTypeElement: array-size=16, array-size-semantics=FIXED-SIZE, implementation-data-type=uint8
    Dcm_DataArrayTypeUint8_DID_0xF11B_New_Data_ObjectType: category=ARRAY
      element Dcm_DataArrayTypeUint8_DID_0xF11B_New_Data_ObjectTypeElement: array-size=16, array-size-semantics=FIXED-SIZE, implementation-data-type=uint8
    Dcm_DataArrayTypeUint8_DID_0xF11C_New_Data_ObjectType: category=ARRAY
      element Dcm_DataArrayTypeUint8_DID_0xF11C_New_Data_ObjectTypeElement: array-size=16, array-size-semantics=FIXED-SIZE, implementation-data-type=uint8
    Dcm_DataArrayTypeUint8_DID_0xF11D_New_Data_ObjectType: category=ARRAY
      element Dcm_DataArrayTypeUint8_DID_0xF11D_New_Data_ObjectTypeElement: array-size=16, array-size-semantics=FIXED-SIZE, implementation-data-type=uint8
    Dcm_DataArrayTypeUint8_DID_0xF11E_New_Data_ObjectType: category=ARRAY
      element Dcm_DataArrayTypeUint8_DID_0xF11E_New_Data_ObjectTypeElement: array-size=16, array-size-semantics=FIXED-SIZE, implementation-data-type=uint8
    Dcm_DataArrayTypeUint8_DID_0xF11F_New_Data_ObjectType: category=ARRAY
      element Dcm_DataArrayTypeUint8_DID_0xF11F_New_Data_ObjectTypeElement: array-size=16, array-size-semantics=FIXED-SIZE, implementation-data-type=uint8
    Dcm_DataArrayTypeUint8_DID_0xF120_New_Data_ObjectType: category=ARRAY
      element Dcm_DataArrayTypeUint8_DID_0xF120_New_Data_ObjectTypeElement: array-size=16, array-size-semantics=FIXED-SIZE, implementation-data-type=uint8
    Dcm_DataArrayTypeUint8_DID_0xF122_New_Data_ObjectType: category=ARRAY
      element Dcm_DataArrayTypeUint8_DID_0xF122_New_Data_ObjectTypeElement: array-size=5, array-size-semantics=FIXED-SIZE, implementation-data-type=uint8
    Dcm_DataArrayTypeUint8_DID_0xF122_New_Data_Object_2Type: category=ARRAY
      element Dcm_DataArrayTypeUint8_DID_0xF122_New_Data_Object_2TypeElement: array-size=5, array-size-semantics=FIXED-SIZE, implementation-data-type=uint8
    Dcm_DataArrayTypeUint8_DID_0xF18A_New_Data_ObjectType: category=ARRAY
      element Dcm_DataArrayTypeUint8_DID_0xF18A_New_Data_ObjectTypeElement: array-size=5, array-size-semantics=FIXED-SIZE, implementation-data-type=uint8
    Dcm_DataArrayTypeUint8_DID_0xF192_New_Data_ObjectType: category=ARRAY
      element Dcm_DataArrayTypeUint8_DID_0xF192_New_Data_ObjectTypeElement: array-size=5, array-size-semantics=FIXED-SIZE, implementation-data-type=uint8
    Dcm_DataArrayTypeUint8_DID_0xF192_New_Data_Object_3Type: category=ARRAY
      element Dcm_DataArrayTypeUint8_DID_0xF192_New_Data_Object_3TypeElement: array-size=5, array-size-semantics=FIXED-SIZE, implementation-data-type=uint8
    Dcm_DataArrayTypeUint8_DID_0xF194_New_Data_ObjectType: category=ARRAY
      element Dcm_DataArrayTypeUint8_DID_0xF194_New_Data_ObjectTypeElement: array-size=5, array-size-semantics=FIXED-SIZE, implementation-data-type=uint8
    Dcm_DataArrayTypeUint8_DID_0xF194_New_Data_Object_4Type: category=ARRAY
      element Dcm_DataArrayTypeUint8_DID_0xF194_New_Data_Object_4TypeElement: array-size=5, array-size-semantics=FIXED-SIZE, implementation-data-type=uint8
    Dcm_DataArrayTypeUint8_DID_0xF1A0_New_Data_ObjectType: category=ARRAY
      element Dcm_DataArrayTypeUint8_DID_0xF1A0_New_Data_ObjectTypeElement: array-size=5, array-size-semantics=FIXED-SIZE, implementation-data-type=uint8
    Dcm_DataArrayTypeUint8_DID_0xF1A1_New_Data_ObjectType: category=ARRAY
      element Dcm_DataArrayTypeUint8_DID_0xF1A1_New_Data_ObjectTypeElement: array-size=5, array-size-semantics=FIXED-SIZE, implementation-data-type=uint8
    Dcm_DataArrayTypeUint8_DID_0xF1A2_New_Data_ObjectType: category=ARRAY
      element Dcm_DataArrayTypeUint8_DID_0xF1A2_New_Data_ObjectTypeElement: array-size=8, array-size-semantics=FIXED-SIZE, implementation-data-type=uint8
    Dcm_DataArrayTypeUint8_DID_0xF1A5_New_Data_ObjectType: category=ARRAY
      element Dcm_DataArrayTypeUint8_DID_0xF1A5_New_Data_ObjectTypeElement: array-size=3, array-size-semantics=FIXED-SIZE, implementation-data-type=uint8
    Rte_SelfType_BswM: implementation-data-type=Rte_CDS_BswM
    Rte_SelfType_CalUT: implementation-data-type=Rte_CDS_CalUT
    Rte_SelfType_ComM: implementation-data-type=Rte_CDS_ComM
    Rte_SelfType_Dcm: implementation-data-type=Rte_CDS_Dcm
    Rte_SelfType_Dem: implementation-data-type=Rte_CDS_Dem
    Rte_SelfType_Det: implementation-data-type=Rte_CDS_Det
    Rte_SelfType_DiagUT: implementation-data-type=Rte_CDS_DiagUT
    Rte_SelfType_EcuM: implementation-data-type=Rte_CDS_EcuM
    Rte_SelfType_ExeMgrUT: implementation-data-type=Rte_CDS_ExeMgrUT
    Rte_SelfType_FiM: implementation-data-type=Rte_CDS_FiM
    Rte_SelfType_INP_SWC: implementation-data-type=Rte_CDS_INP_SWC
    Rte_SelfType_NmUT: implementation-data-type=Rte_CDS_NmUT
    Rte_SelfType_NvM: implementation-data-type=Rte_CDS_NvM
    Rte_SelfType_NvMUT: implementation-data-type=Rte_CDS_NvMUT
    Rte_SelfType_OUTP_SWC: implementation-data-type=Rte_CDS_OUTP_SWC
    Rte_SelfType_Rtm: implementation-data-type=Rte_CDS_Rtm
    Rte_SelfType_StackM: implementation-data-type=Rte_CDS_StackM
    Rte_SelfType_TstM: implementation-data-type=Rte_CDS_TstM
    Rte_SelfType_WdgM: implementation-data-type=Rte_CDS_WdgM
    Rte_SelfType_WdgMUT: implementation-data-type=Rte_CDS_WdgMUT
    Rte_SelfType_rba_DiagLib: implementation-data-type=Rte_CDS_rba_DiagLib
    Rte_TaskInfo: category=VALUE  # This is an external type, i.e. it is declared in the Rte Library and not in the XML. RTEGen does not have any information about this type apart from its name.
    IDT_CURVE: category=ARRAY
      element IDT_CURVEElement: array-size=5, array-size-semantics=FIXED-SIZE, implementation-data-type=float32
    IDT_MAP: category=ARRAY
      element IDT_MAPElement: array-size=122, array-size-semantics=FIXED-SIZE, implementation-data-type=float32
package /AUTOSAR_Rte/SwAddrMethods
  14 x sw addr method:
    CALPRM: memory-allocation-keyword-policy=ADDR-METHOD-SHORT-NAME-AND-ALIGNMENT, section-type=CALPRM
    CODE: memory-allocation-keyword-policy=ADDR-METHOD-SHORT-NAME, section-type=CODE
    CODE_FAST: memory-allocation-keyword-policy=ADDR-METHOD-SHORT-NAME, section-type=CODE
    CODE_SLOW: memory-allocation-keyword-policy=ADDR-METHOD-SHORT-NAME, section-type=CODE
    CONST: memory-allocation-keyword-policy=ADDR-METHOD-SHORT-NAME-AND-ALIGNMENT, section-type=CONST
    EcucPartition_AppCore_CALPRM: memory-allocation-keyword-policy=ADDR-METHOD-SHORT-NAME-AND-ALIGNMENT, section-type=CALPRM
    EcucPartition_AppCore_CONST: memory-allocation-keyword-policy=ADDR-METHOD-SHORT-NAME-AND-ALIGNMENT, section-type=CONST
    EcucPartition_AppCore_VAR_CLEARED: memory-allocation-keyword-policy=ADDR-METHOD-SHORT-NAME-AND-ALIGNMENT, section-initialization-policy=CLEARED, section-type=VAR
    EcucPartition_ComCore_CONST: memory-allocation-keyword-policy=ADDR-METHOD-SHORT-NAME-AND-ALIGNMENT, section-type=CONST
    EcucPartition_ComCore_VAR_CLEARED: memory-allocation-keyword-policy=ADDR-METHOD-SHORT-NAME-AND-ALIGNMENT, section-initialization-policy=CLEARED, section-type=VAR
    EcucPartition_SysCore_CONST: memory-allocation-keyword-policy=ADDR-METHOD-SHORT-NAME-AND-ALIGNMENT, section-type=CONST
    EcucPartition_SysCore_VAR_CLEARED: memory-allocation-keyword-policy=ADDR-METHOD-SHORT-NAME-AND-ALIGNMENT, section-initialization-policy=CLEARED, section-type=VAR
    VAR_CLEARED: memory-allocation-keyword-policy=ADDR-METHOD-SHORT-NAME-AND-ALIGNMENT, section-initialization-policy=CLEARED, section-type=VAR
    VAR_INIT: memory-allocation-keyword-policy=ADDR-METHOD-SHORT-NAME-AND-ALIGNMENT, section-initialization-policy=INIT, section-type=VAR
package /AUTOSAR_Rte/SwBaseTypes
  8 x base type, all with category=FIXED_LENGTH:
    AUTOSAR_Platform_BaseTypes_uint32: base-type-size=32, base-type-encoding=NONE, mem-alignment=32, native-declaration=uint32  # unsigned integer 32bit | This standard AUTOSAR type shall be 32 bit unsigned
    AUTOSAR_Platform_BaseTypes_boolean: base-type-size=8, base-type-encoding=BOOLEAN, native-declaration=Boolean  # Boolean | The boolean type shall always be mapped to a platform specific type where pointers can be applied to enable a passing of parameters via API. There are specific BIT types of some HW platforms which are very efficient but where no pointers can point to. This standard AUTOSAR type shall only be used together with the definitions TRUE and FALSE. See PLATFORM027 for implementation and usage.
    AUTOSAR_Platform_BaseTypes_uint16: base-type-size=16, base-type-encoding=NONE, mem-alignment=16, native-declaration=uint16  # unsigned integer 16bit | This standard AUTOSAR type shall be of 16 bit unsigned.
    AUTOSAR_Platform_BaseTypes_uint8: base-type-size=8, base-type-encoding=NONE, mem-alignment=8, native-declaration=uint8  # unsigned integer 8bit | This standard AUTOSAR type shall be of 8 bit unsigned.
    AUTOSAR_PlatformTypes_SwBaseTypes_uint32: base-type-size=32, base-type-encoding=NONE, mem-alignment=32, native-declaration=uint32  # unsigned integer 32bit | This standard AUTOSAR type shall be 32 bit unsigned
    AUTOSAR_Platform_BaseTypes_float32: base-type-size=32, base-type-encoding=IEEE754, mem-alignment=32, native-declaration=float32  # Float | This standard AUTOSAR type shall follow the 32-bit binary interchange format according to IEEE 754-2008 with encoding parameters specified in chapter 3.6, table 3.5, column"binary32".
    AUTOSAR_PlatformTypes_SwBaseTypes_boolean: base-type-size=8, base-type-encoding=BOOLEAN, native-declaration=Boolean  # Boolean | The boolean type shall always be mapped to a platform specific type where pointers can be applied to enable a passing of parameters via API. There are specific BIT types of some HW platforms which are very efficient but where no pointers can point to. This standard AUTOSAR type shall only be used together with the definitions TRUE and FALSE. See PLATFORM027 for implementation and usage.
    AUTOSAR_PlatformTypes_SwBaseTypes_float32: base-type-size=32, base-type-encoding=IEEE754, mem-alignment=32, native-declaration=float32  # Float | This standard AUTOSAR type shall follow the 32-bit binary interchange format according to IEEE 754-2008 with encoding parameters specified in chapter 3.6, table 3.5, column"binary32".

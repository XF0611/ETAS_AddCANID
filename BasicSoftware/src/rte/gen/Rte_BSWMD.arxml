[part 1 of 2: package /AUTOSAR_Rte/BswModuleDescriptions]
AUTOSAR XML (schema 00047)
standard types defined: uint32, boolean, uint16, uint8, Std_ReturnType, float32
package /AUTOSAR_Rte/BswModuleDescriptions
  bsw module description Rte: outgoing-callbacks=[Rte_StartHook_Return, Rte_StartHook_Start, Rte_StopHook_Return, Rte_StopHook_Start, Rte_Task_Activate]
    provided-entrys:
      Rte_ActivateRE
      Rte_CData_CalUT_SpeedLimitLower
      Rte_CData_CalUT_SpeedLimitUpper
      Rte_CData_CalUT_sharedCURVE
      Rte_CData_CalUT_sharedMAP
      Rte_Call_Dcm_RoutineServices_Routine_Control_203_Start
      Rte_Call_Dcm_RoutineServices_Routine_Control_ABFF_RequestResults
      Rte_Call_Dcm_RoutineServices_Routine_Control_ABFF_Start
      Rte_Call_Dcm_RoutineServices_X_Routine_Control_ABFE_Start
      Rte_Call_Dcm_SecurityAccess_UnlockedL1_CompareKey
      Rte_Call_Dcm_SecurityAccess_UnlockedL1_GetSeed
      Rte_Call_Dcm_SecurityAccess_Unlocked_L3_CompareKey
      Rte_Call_Dcm_SecurityAccess_Unlocked_L3_GetSeed
      Rte_Call_Dem_CBClrEvt_DTC_0x000001_Event_ClearEventAllowed
      Rte_Call_Dem_CBClrEvt_DTC_0x0d0400_CAN_Network_ETAS_BusOff_Event_ClearEventAllowed
      Rte_Call_Dem_CBClrEvt_DTC_0xc07388_Event_ClearEventAllowed
      Rte_Call_Dem_CBClrEvt_DTC_0xc12687_Event_ClearEventAllowed
      Rte_Call_Dem_CBClrEvt_DTC_0xc14587_Event_ClearEventAllowed
      Rte_Call_Dem_CBClrEvt_DTC_0xc22a87_Event_ClearEventAllowed
      Rte_Call_Dem_CBClrEvt_DTC_0xc41487_Event_ClearEventAllowed
      Rte_Call_Dem_CBClrEvt_DTC_0xd56217_Event_ClearEventAllowed
      Rte_Call_Dem_CBClrEvt_DTC_0xd56316_Event_ClearEventAllowed
      Rte_Call_Dem_CBClrEvt_DTC_0xe00141_Event_ClearEventAllowed
      Rte_Call_Dem_CBClrEvt_DTC_0xe00142_Event_ClearEventAllowed
      Rte_Call_Dem_CBClrEvt_DTC_0xe26200_Event_ClearEventAllowed
      Rte_Call_DiagUT_ControlEventAvailable_EventParameter_DTC_0x000001_Event_SetEventAvailable
      Rte_Call_DiagUT_ControlEventAvailable_EventParameter_DTC_0xc07388_Event_SetEventAvailable
      Rte_Call_DiagUT_ControlEventAvailable_EventParameter_DTC_0xc12687_Event_SetEventAvailable
      Rte_Call_DiagUT_ControlEventAvailable_EventParameter_DTC_0xc14587_Event_SetEventAvailable
      Rte_Call_DiagUT_ControlEventAvailable_EventParameter_DTC_0xc22a87_Event_SetEventAvailable
      Rte_Call_DiagUT_ControlEventAvailable_EventParameter_DTC_0xc41487_Event_SetEventAvailable
      Rte_Call_DiagUT_ControlEventAvailable_EventParameter_DTC_0xd56217_Event_SetEventAvailable
      Rte_Call_DiagUT_ControlEventAvailable_EventParameter_DTC_0xd56316_Event_SetEventAvailable
      Rte_Call_DiagUT_ControlEventAvailable_EventParameter_DTC_0xe00141_Event_SetEventAvailable
      Rte_Call_DiagUT_ControlEventAvailable_EventParameter_DTC_0xe00142_Event_SetEventAvailable
      Rte_Call_DiagUT_ControlEventAvailable_EventParameter_DTC_0xe26200_Event_SetEventAvailable
      Rte_Call_DiagUT_DCMServices_GetActiveProtocol
      Rte_Call_DiagUT_DCMServices_GetSecurityLevel
      Rte_Call_DiagUT_DCMServices_GetSesCtrlType
      Rte_Call_DiagUT_DCMServices_ResetToDefaultSession
      Rte_Call_DiagUT_DCMServices_SetActiveDiagnostic
      Rte_Call_DiagUT_EventStatus_EventParameter_DTC_0x000001_Event_SetWIRStatus
      Rte_Call_DiagUT_EventStatus_EventParameter_DTC_0xc07388_Event_SetWIRStatus
      Rte_Call_DiagUT_EventStatus_EventParameter_DTC_0xc12687_Event_SetWIRStatus
      Rte_Call_DiagUT_EventStatus_EventParameter_DTC_0xc14587_Event_SetWIRStatus
      Rte_Call_DiagUT_EventStatus_EventParameter_DTC_0xc22a87_Event_SetWIRStatus
      Rte_Call_DiagUT_EventStatus_EventParameter_DTC_0xc41487_Event_SetWIRStatus
      Rte_Call_DiagUT_EventStatus_EventParameter_DTC_0xd56217_Event_SetWIRStatus
      Rte_Call_DiagUT_EventStatus_EventParameter_DTC_0xd56316_Event_SetWIRStatus
      Rte_Call_DiagUT_EventStatus_EventParameter_DTC_0xe00141_Event_SetWIRStatus
      Rte_Call_DiagUT_EventStatus_EventParameter_DTC_0xe00142_Event_SetWIRStatus
      Rte_Call_DiagUT_EventStatus_EventParameter_DTC_0xe26200_Event_SetWIRStatus
      Rte_Call_DiagUT_Event_EventParameter_DTC_0x000001_Event_ClearPrestoredFreezeFrame
      Rte_Call_DiagUT_Event_EventParameter_DTC_0x000001_Event_PrestoreFreezeFrame
      Rte_Call_DiagUT_Event_EventParameter_DTC_0x000001_Event_ResetEventDebounceStatus
      Rte_Call_DiagUT_Event_EventParameter_DTC_0x000001_Event_ResetEventStatus
      Rte_Call_DiagUT_Event_EventParameter_DTC_0x000001_Event_SetEventStatus
      Rte_Call_DiagUT_Event_EventParameter_DTC_0x000001_Event_SetEventStatusWithEnvdata
      Rte_Call_DiagUT_Event_EventParameter_DTC_0xc07388_Event_ClearPrestoredFreezeFrame
      Rte_Call_DiagUT_Event_EventParameter_DTC_0xc07388_Event_PrestoreFreezeFrame
      Rte_Call_DiagUT_Event_EventParameter_DTC_0xc07388_Event_ResetEventDebounceStatus
      Rte_Call_DiagUT_Event_EventParameter_DTC_0xc07388_Event_ResetEventStatus
      Rte_Call_DiagUT_Event_EventParameter_DTC_0xc07388_Event_SetEventStatus
      Rte_Call_DiagUT_Event_EventParameter_DTC_0xc07388_Event_SetEventStatusWithEnvdata
      Rte_Call_DiagUT_Event_EventParameter_DTC_0xc12687_Event_ClearPrestoredFreezeFrame
      Rte_Call_DiagUT_Event_EventParameter_DTC_0xc12687_Event_PrestoreFreezeFrame
      Rte_Call_DiagUT_Event_EventParameter_DTC_0xc12687_Event_ResetEventDebounceStatus
      Rte_Call_DiagUT_Event_EventParameter_DTC_0xc12687_Event_ResetEventStatus
      Rte_Call_DiagUT_Event_EventParameter_DTC_0xc12687_Event_SetEventStatus
      Rte_Call_DiagUT_Event_EventParameter_DTC_0xc12687_Event_SetEventStatusWithEnvdata
      Rte_Call_DiagUT_Event_EventParameter_DTC_0xc14587_Event_ClearPrestoredFreezeFrame
      Rte_Call_DiagUT_Event_EventParameter_DTC_0xc14587_Event_PrestoreFreezeFrame
      Rte_Call_DiagUT_Event_EventParameter_DTC_0xc14587_Event_ResetEventDebounceStatus
      Rte_Call_DiagUT_Event_EventParameter_DTC_0xc14587_Event_ResetEventStatus
      Rte_Call_DiagUT_Event_EventParameter_DTC_0xc14587_Event_SetEventStatus
      Rte_Call_DiagUT_Event_EventParameter_DTC_0xc14587_Event_SetEventStatusWithEnvdata
      Rte_Call_DiagUT_Event_EventParameter_DTC_0xc22a87_Event_ClearPrestoredFreezeFrame
      Rte_Call_DiagUT_Event_EventParameter_DTC_0xc22a87_Event_PrestoreFreezeFrame
      Rte_Call_DiagUT_Event_EventParameter_DTC_0xc22a87_Event_ResetEventDebounceStatus
      Rte_Call_DiagUT_Event_EventParameter_DTC_0xc22a87_Event_ResetEventStatus
      Rte_Call_DiagUT_Event_EventParameter_DTC_0xc22a87_Event_SetEventStatus
      Rte_Call_DiagUT_Event_EventParameter_DTC_0xc22a87_Event_SetEventStatusWithEnvdata
      Rte_Call_DiagUT_Event_EventParameter_DTC_0xc41487_Event_ClearPrestoredFreezeFrame
      Rte_Call_DiagUT_Event_EventParameter_DTC_0xc41487_Event_PrestoreFreezeFrame
      Rte_Call_DiagUT_Event_EventParameter_DTC_0xc41487_Event_ResetEventDebounceStatus
      Rte_Call_DiagUT_Event_EventParameter_DTC_0xc41487_Event_ResetEventStatus
      Rte_Call_DiagUT_Event_EventParameter_DTC_0xc41487_Event_SetEventStatus
      Rte_Call_DiagUT_Event_EventParameter_DTC_0xc41487_Event_SetEventStatusWithEnvdata
      Rte_Call_DiagUT_Event_EventParameter_DTC_0xd56217_Event_ClearPrestoredFreezeFrame
      Rte_Call_DiagUT_Event_EventParameter_DTC_0xd56217_Event_PrestoreFreezeFrame
      Rte_Call_DiagUT_Event_EventParameter_DTC_0xd56217_Event_ResetEventDebounceStatus
      Rte_Call_DiagUT_Event_EventParameter_DTC_0xd56217_Event_ResetEventStatus
      Rte_Call_DiagUT_Event_EventParameter_DTC_0xd56217_Event_SetEventStatus
      Rte_Call_DiagUT_Event_EventParameter_DTC_0xd56217_Event_SetEventStatusWithEnvdata
      Rte_Call_DiagUT_Event_EventParameter_DTC_0xd56316_Event_ClearPrestoredFreezeFrame
      Rte_Call_DiagUT_Event_EventParameter_DTC_0xd56316_Event_PrestoreFreezeFrame
      Rte_Call_DiagUT_Event_EventParameter_DTC_0xd56316_Event_ResetEventDebounceStatus
      Rte_Call_DiagUT_Event_EventParameter_DTC_0xd56316_Event_ResetEventStatus
      Rte_Call_DiagUT_Event_EventParameter_DTC_0xd56316_Event_SetEventStatus
      Rte_Call_DiagUT_Event_EventParameter_DTC_0xd56316_Event_SetEventStatusWithEnvdata
      Rte_Call_DiagUT_Event_EventParameter_DTC_0xe00141_Event_ClearPrestoredFreezeFrame
      Rte_Call_DiagUT_Event_EventParameter_DTC_0xe00141_Event_PrestoreFreezeFrame
      Rte_Call_DiagUT_Event_EventParameter_DTC_0xe00141_Event_ResetEventDebounceStatus
      Rte_Call_DiagUT_Event_EventParameter_DTC_0xe00141_Event_ResetEventStatus
      Rte_Call_DiagUT_Event_EventParameter_DTC_0xe00141_Event_SetEventStatus
      Rte_Call_DiagUT_Event_EventParameter_DTC_0xe00141_Event_SetEventStatusWithEnvdata
      Rte_Call_DiagUT_Event_EventParameter_DTC_0xe00142_Event_ClearPrestoredFreezeFrame
      Rte_Call_DiagUT_Event_EventParameter_DTC_0xe00142_Event_PrestoreFreezeFrame
      Rte_Call_DiagUT_Event_EventParameter_DTC_0xe00142_Event_ResetEventDebounceStatus
      Rte_Call_DiagUT_Event_EventParameter_DTC_0xe00142_Event_ResetEventStatus
      Rte_Call_DiagUT_Event_EventParameter_DTC_0xe00142_Event_SetEventStatus
      Rte_Call_DiagUT_Event_EventParameter_DTC_0xe00142_Event_SetEventStatusWithEnvdata
      Rte_Call_DiagUT_Event_EventParameter_DTC_0xe26200_Event_ClearPrestoredFreezeFrame
      Rte_Call_DiagUT_Event_EventParameter_DTC_0xe26200_Event_PrestoreFreezeFrame
      Rte_Call_DiagUT_Event_EventParameter_DTC_0xe26200_Event_ResetEventDebounceStatus
      Rte_Call_DiagUT_Event_EventParameter_DTC_0xe26200_Event_ResetEventStatus
      Rte_Call_DiagUT_Event_EventParameter_DTC_0xe26200_Event_SetEventStatus
      Rte_Call_DiagUT_Event_EventParameter_DTC_0xe26200_Event_SetEventStatusWithEnvdata
      Rte_Call_DiagUT_EvtInfo_EventParameter_DTC_0x000001_Event_GetDTCOfEvent
      Rte_Call_DiagUT_EvtInfo_EventParameter_DTC_0x000001_Event_GetDebouncingOfEvent
      Rte_Call_DiagUT_EvtInfo_EventParameter_DTC_0x000001_Event_GetEventExtendedDataRecord
      Rte_Call_DiagUT_EvtInfo_EventParameter_DTC_0x000001_Event_GetEventExtendedDataRecordEx
      Rte_Call_DiagUT_EvtInfo_EventParameter_DTC_0x000001_Event_GetEventFailed
      Rte_Call_DiagUT_EvtInfo_EventParameter_DTC_0x000001_Event_GetEventFreezeFrameData
      Rte_Call_DiagUT_EvtInfo_EventParameter_DTC_0x000001_Event_GetEventFreezeFrameDataEx
      Rte_Call_DiagUT_EvtInfo_EventParameter_DTC_0x000001_Event_GetEventStatus
      Rte_Call_DiagUT_EvtInfo_EventParameter_DTC_0x000001_Event_GetEventTested
      Rte_Call_DiagUT_EvtInfo_EventParameter_DTC_0x000001_Event_GetFaultDetectionCounter
      Rte_Call_DiagUT_EvtInfo_EventParameter_DTC_0x0d0400_CAN_Network_ETAS_BusOff_Event_GetDTCOfEvent
      Rte_Call_DiagUT_EvtInfo_EventParameter_DTC_0x0d0400_CAN_Network_ETAS_BusOff_Event_GetDebouncingOfEvent
      Rte_Call_DiagUT_EvtInfo_EventParameter_DTC_0x0d0400_CAN_Network_ETAS_BusOff_Event_GetEventExtendedDataRecord
      Rte_Call_DiagUT_EvtInfo_EventParameter_DTC_0x0d0400_CAN_Network_ETAS_BusOff_Event_GetEventExtendedDataRecordEx
      Rte_Call_DiagUT_EvtInfo_EventParameter_DTC_0x0d0400_CAN_Network_ETAS_BusOff_Event_GetEventFailed
      Rte_Call_DiagUT_EvtInfo_EventParameter_DTC_0x0d0400_CAN_Network_ETAS_BusOff_Event_GetEventFreezeFrameData
      Rte_Call_DiagUT_EvtInfo_EventParameter_DTC_0x0d0400_CAN_Network_ETAS_BusOff_Event_GetEventFreezeFrameDataEx
      Rte_Call_DiagUT_EvtInfo_EventParameter_DTC_0x0d0400_CAN_Network_ETAS_BusOff_Event_GetEventStatus
      Rte_Call_DiagUT_EvtInfo_EventParameter_DTC_0x0d0400_CAN_Network_ETAS_BusOff_Event_GetEventTested
      Rte_Call_DiagUT_EvtInfo_EventParameter_DTC_0x0d0400_CAN_Network_ETAS_BusOff_Event_GetFaultDetectionCounter
      Rte_Call_DiagUT_EvtInfo_EventParameter_DTC_0xc07388_Event_GetDTCOfEvent
      Rte_Call_DiagUT_EvtInfo_EventParameter_DTC_0xc07388_Event_GetDebouncingOfEvent
      Rte_Call_DiagUT_EvtInfo_EventParameter_DTC_0xc07388_Event_GetEventExtendedDataRecord
      Rte_Call_DiagUT_EvtInfo_EventParameter_DTC_0xc07388_Event_GetEventExtendedDataRecordEx
      Rte_Call_DiagUT_EvtInfo_EventParameter_DTC_0xc07388_Event_GetEventFailed
      Rte_Call_DiagUT_EvtInfo_EventParameter_DTC_0xc07388_Event_GetEventFreezeFrameData
      Rte_Call_DiagUT_EvtInfo_EventParameter_DTC_0xc07388_Event_GetEventFreezeFrameDataEx
      Rte_Call_DiagUT_EvtInfo_EventParameter_DTC_0xc07388_Event_GetEventStatus
      Rte_Call_DiagUT_EvtInfo_EventParameter_DTC_0xc07388_Event_GetEventTested
      Rte_Call_DiagUT_EvtInfo_EventParameter_DTC_0xc07388_Event_GetFaultDetectionCounter
      Rte_Call_DiagUT_EvtInfo_EventParameter_DTC_0xc12687_Event_GetDTCOfEvent
      Rte_Call_DiagUT_EvtInfo_EventParameter_DTC_0xc12687_Event_GetDebouncingOfEvent
      Rte_Call_DiagUT_EvtInfo_EventParameter_DTC_0xc12687_Event_GetEventExtendedDataRecord
      Rte_Call_DiagUT_EvtInfo_EventParameter_DTC_0xc12687_Event_GetEventExtendedDataRecordEx
      Rte_Call_DiagUT_EvtInfo_EventParameter_DTC_0xc12687_Event_GetEventFailed
      Rte_Call_DiagUT_EvtInfo_EventParameter_DTC_0xc12687_Event_GetEventFreezeFrameData
      Rte_Call_DiagUT_EvtInfo_EventParameter_DTC_0xc12687_Event_GetEventFreezeFrameDataEx
      Rte_Call_DiagUT_EvtInfo_EventParameter_DTC_0xc12687_Event_GetEventStatus
      Rte_Call_DiagUT_EvtInfo_EventParameter_DTC_0xc12687_Event_GetEventTested
      Rte_Call_DiagUT_EvtInfo_EventParameter_DTC_0xc12687_Event_GetFaultDetectionCounter
      Rte_Call_DiagUT_EvtInfo_EventParameter_DTC_0xc14587_Event_GetDTCOfEvent
      Rte_Call_DiagUT_EvtInfo_EventParameter_DTC_0xc14587_Event_GetDebouncingOfEvent
      Rte_Call_DiagUT_EvtInfo_EventParameter_DTC_0xc14587_Event_GetEventExtendedDataRecord
      Rte_Call_DiagUT_EvtInfo_EventParameter_DTC_0xc14587_Event_GetEventExtendedDataRecordEx
      Rte_Call_DiagUT_EvtInfo_EventParameter_DTC_0xc14587_Event_GetEventFailed
      Rte_Call_DiagUT_EvtInfo_EventParameter_DTC_0xc14587_Event_GetEventFreezeFrameData
      Rte_Call_DiagUT_EvtInfo_EventParameter_DTC_0xc14587_Event_GetEventFreezeFrameDataEx
      Rte_Call_DiagUT_EvtInfo_EventParameter_DTC_0xc14587_Event_GetEventStatus
      Rte_Call_DiagUT_EvtInfo_EventParameter_DTC_0xc14587_Event_GetEventTested
      Rte_Call_DiagUT_EvtInfo_EventParameter_DTC_0xc14587_Event_GetFaultDetectionCounter
      Rte_Call_DiagUT_EvtInfo_EventParameter_DTC_0xc22a87_Event_GetDTCOfEvent
      Rte_Call_DiagUT_EvtInfo_EventParameter_DTC_0xc22a87_Event_GetDebouncingOfEvent
      Rte_Call_DiagUT_EvtInfo_EventParameter_DTC_0xc22a87_Event_GetEventExtendedDataRecord
      Rte_Call_DiagUT_EvtInfo_EventParameter_DTC_0xc22a87_Event_GetEventExtendedDataRecordEx
      Rte_Call_DiagUT_EvtInfo_EventParameter_DTC_0xc22a87_Event_GetEventFailed
      Rte_Call_DiagUT_EvtInfo_EventParameter_DTC_0xc22a87_Event_GetEventFreezeFrameData
      Rte_Call_DiagUT_EvtInfo_EventParameter_DTC_0xc22a87_Event_GetEventFreezeFrameDataEx
      Rte_Call_DiagUT_EvtInfo_EventParameter_DTC_0xc22a87_Event_GetEventStatus
      Rte_Call_DiagUT_EvtInfo_EventParameter_DTC_0xc22a87_Event_GetEventTested
      Rte_Call_DiagUT_EvtInfo_EventParameter_DTC_0xc22a87_Event_GetFaultDetectionCounter
      Rte_Call_DiagUT_EvtInfo_EventParameter_DTC_0xc41487_Event_GetDTCOfEvent
      Rte_Call_DiagUT_EvtInfo_EventParameter_DTC_0xc41487_Event_GetDebouncingOfEvent
      Rte_Call_DiagUT_EvtInfo_EventParameter_DTC_0xc41487_Event_GetEventExtendedDataRecord
      Rte_Call_DiagUT_EvtInfo_EventParameter_DTC_0xc41487_Event_GetEventExtendedDataRecordEx
      Rte_Call_DiagUT_EvtInfo_EventParameter_DTC_0xc41487_Event_GetEventFailed
      Rte_Call_DiagUT_EvtInfo_EventParameter_DTC_0xc41487_Event_GetEventFreezeFrameData
      Rte_Call_DiagUT_EvtInfo_EventParameter_DTC_0xc41487_Event_GetEventFreezeFrameDataEx
      Rte_Call_DiagUT_EvtInfo_EventParameter_DTC_0xc41487_Event_GetEventStatus
      Rte_Call_DiagUT_EvtInfo_EventParameter_DTC_0xc41487_Event_GetEventTested
      Rte_Call_DiagUT_EvtInfo_EventParameter_DTC_0xc41487_Event_GetFaultDetectionCounter
      Rte_Call_DiagUT_EvtInfo_EventParameter_DTC_0xd56217_Event_GetDTCOfEvent
      Rte_Call_DiagUT_EvtInfo_EventParameter_DTC_0xd56217_Event_GetDebouncingOfEvent
      Rte_Call_DiagUT_EvtInfo_EventParameter_DTC_0xd56217_Event_GetEventExtendedDataRecord
      Rte_Call_DiagUT_EvtInfo_EventParameter_DTC_0xd56217_Event_GetEventExtendedDataRecordEx
      Rte_Call_DiagUT_EvtInfo_EventParameter_DTC_0xd56217_Event_GetEventFailed
      Rte_Call_DiagUT_EvtInfo_EventParameter_DTC_0xd56217_Event_GetEventFreezeFrameData
      Rte_Call_DiagUT_EvtInfo_EventParameter_DTC_0xd56217_Event_GetEventFreezeFrameDataEx
      Rte_Call_DiagUT_EvtInfo_EventParameter_DTC_0xd56217_Event_GetEventStatus
      Rte_Call_DiagUT_EvtInfo_EventParameter_DTC_0xd56217_Event_GetEventTested
      Rte_Call_DiagUT_EvtInfo_EventParameter_DTC_0xd56217_Event_GetFaultDetectionCounter
      Rte_Call_DiagUT_EvtInfo_EventParameter_DTC_0xd56316_Event_GetDTCOfEvent
      Rte_Call_DiagUT_EvtInfo_EventParameter_DTC_0xd56316_Event_GetDebouncingOfEvent
      Rte_Call_DiagUT_EvtInfo_EventParameter_DTC_0xd56316_Event_GetEventExtendedDataRecord
      Rte_Call_DiagUT_EvtInfo_EventParameter_DTC_0xd56316_Event_GetEventExtendedDataRecordEx
      Rte_Call_DiagUT_EvtInfo_EventParameter_DTC_0xd56316_Event_GetEventFailed
      Rte_Call_DiagUT_EvtInfo_EventParameter_DTC_0xd56316_Event_GetEventFreezeFrameData
      Rte_Call_DiagUT_EvtInfo_EventParameter_DTC_0xd56316_Event_GetEventFreezeFrameDataEx
      Rte_Call_DiagUT_EvtInfo_EventParameter_DTC_0xd56316_Event_GetEventStatus
      Rte_Call_DiagUT_EvtInfo_EventParameter_DTC_0xd56316_Event_GetEventTested
      Rte_Call_DiagUT_EvtInfo_EventParameter_DTC_0xd56316_Event_GetFaultDetectionCounter
      Rte_Call_DiagUT_EvtInfo_EventParameter_DTC_0xe00141_Event_GetDTCOfEvent
      Rte_Call_DiagUT_EvtInfo_EventParameter_DTC_0xe00141_Event_GetDebouncingOfEvent
      Rte_Call_DiagUT_EvtInfo_EventParameter_DTC_0xe00141_Event_GetEventExtendedDataRecord
      Rte_Call_DiagUT_EvtInfo_EventParameter_DTC_0xe00141_Event_GetEventExtendedDataRecordEx
      Rte_Call_DiagUT_EvtInfo_EventParameter_DTC_0xe00141_Event_GetEventFailed
      Rte_Call_DiagUT_EvtInfo_EventParameter_DTC_0xe00141_Event_GetEventFreezeFrameData
      Rte_Call_DiagUT_EvtInfo_EventParameter_DTC_0xe00141_Event_GetEventFreezeFrameDataEx
      Rte_Call_DiagUT_EvtInfo_EventParameter_DTC_0xe00141_Event_GetEventStatus
      Rte_Call_DiagUT_EvtInfo_EventParameter_DTC_0xe00141_Event_GetEventTested
      Rte_Call_DiagUT_EvtInfo_EventParameter_DTC_0xe00141_Event_GetFaultDetectionCounter
      Rte_Call_DiagUT_EvtInfo_EventParameter_DTC_0xe00142_Event_GetDTCOfEvent
      Rte_Call_DiagUT_EvtInfo_EventParameter_DTC_0xe00142_Event_GetDebouncingOfEvent
      Rte_Call_DiagUT_EvtInfo_EventParameter_DTC_0xe00142_Event_GetEventExtendedDataRecord
      Rte_Call_DiagUT_EvtInfo_EventParameter_DTC_0xe00142_Event_GetEventExtendedDataRecordEx
      Rte_Call_DiagUT_EvtInfo_EventParameter_DTC_0xe00142_Event_GetEventFailed
      Rte_Call_DiagUT_EvtInfo_EventParameter_DTC_0xe00142_Event_GetEventFreezeFrameData
      Rte_Call_DiagUT_EvtInfo_EventParameter_DTC_0xe00142_Event_GetEventFreezeFrameDataEx
      Rte_Call_DiagUT_EvtInfo_EventParameter_DTC_0xe00142_Event_GetEventStatus
      Rte_Call_DiagUT_EvtInfo_EventParameter_DTC_0xe00142_Event_GetEventTested
      Rte_Call_DiagUT_EvtInfo_EventParameter_DTC_0xe00142_Event_GetFaultDetectionCounter
      Rte_Call_DiagUT_EvtInfo_EventParameter_DTC_0xe26200_Event_GetDTCOfEvent
      Rte_Call_DiagUT_EvtInfo_EventParameter_DTC_0xe26200_Event_GetDebouncingOfEvent
      Rte_Call_DiagUT_EvtInfo_EventParameter_DTC_0xe26200_Event_GetEventExtendedDataRecord
      Rte_Call_DiagUT_EvtInfo_EventParameter_DTC_0xe26200_Event_GetEventExtendedDataRecordEx
      Rte_Call_DiagUT_EvtInfo_EventParameter_DTC_0xe26200_Event_GetEventFailed
      Rte_Call_DiagUT_EvtInfo_EventParameter_DTC_0xe26200_Event_GetEventFreezeFrameData
      Rte_Call_DiagUT_EvtInfo_EventParameter_DTC_0xe26200_Event_GetEventFreezeFrameDataEx
      Rte_Call_DiagUT_EvtInfo_EventParameter_DTC_0xe26200_Event_GetEventStatus
      Rte_Call_DiagUT_EvtInfo_EventParameter_DTC_0xe26200_Event_GetEventTested
      Rte_Call_DiagUT_EvtInfo_EventParameter_DTC_0xe26200_Event_GetFaultDetectionCounter
      Rte_Call_DiagUT_GeneralEvtInfo_GetDTCOfEvent
      Rte_Call_DiagUT_GeneralEvtInfo_GetDebouncingOfEvent
      Rte_Call_DiagUT_GeneralEvtInfo_GetEventExtendedDataRecord
      Rte_Call_DiagUT_GeneralEvtInfo_GetEventExtendedDataRecordEx
      Rte_Call_DiagUT_GeneralEvtInfo_GetEventFailed
      Rte_Call_DiagUT_GeneralEvtInfo_GetEventFreezeFrameData
      Rte_Call_DiagUT_GeneralEvtInfo_GetEventFreezeFrameDataEx
      Rte_Call_DiagUT_GeneralEvtInfo_GetEventIdCausingLastDetError
      Rte_Call_DiagUT_GeneralEvtInfo_GetEventStatus
      Rte_Call_DiagUT_GeneralEvtInfo_GetEventTested
      Rte_Call_DiagUT_GeneralEvtInfo_GetFaultDetectionCounter
      Rte_Call_DiagUT_OpCycle_DemOpCycle_DEM_POWER_GetCycleQualified
      Rte_Call_DiagUT_OpCycle_DemOpCycle_DEM_POWER_GetOperationCycleState
      Rte_Call_DiagUT_OpCycle_DemOpCycle_DEM_POWER_SetCycleQualified
      Rte_Call_DiagUT_OpCycle_DemOpCycle_DEM_POWER_SetOperationCycleState
      Rte_Call_DiagUT_StorageCond_DemStorageCondition_0_GetStorageCondition
      Rte_Call_DiagUT_StorageCond_DemStorageCondition_0_SetStorageCondition
      Rte_Call_ExeMgrUT_RP_EcuM_SelectResetTarget_GetLastShutdownTarget
      Rte_Call_ExeMgrUT_RP_EcuM_SelectResetTarget_GetShutdownCause
      Rte_Call_ExeMgrUT_RP_EcuM_SelectResetTarget_GetShutdownTarget
      Rte_Call_ExeMgrUT_RP_EcuM_SelectResetTarget_SelectShutdownCause
      Rte_Call_ExeMgrUT_RP_EcuM_SelectResetTarget_SelectShutdownTarget
      Rte_Call_NmUT_UR_ComMUser_Can_Network_ETAS_Channel_GetCurrentComMode
      Rte_Call_NmUT_UR_ComMUser_Can_Network_ETAS_Channel_GetMaxComMode
      Rte_Call_NmUT_UR_ComMUser_Can_Network_ETAS_Channel_GetRequestedComMode
      Rte_Call_NmUT_UR_ComMUser_Can_Network_ETAS_Channel_RequestComMode
      Rte_Call_NmUT_modeLimitation_LimitECUToNoComMode
      Rte_Call_NmUT_modeLimitation_ReadInhibitCounter
      Rte_Call_NmUT_modeLimitation_ResetInhibitCounter
      Rte_Call_NmUT_modeLimitation_SetECUGroupClassification
      Rte_Call_NvMUT_RP_RequestReset_RequestReset
      Rte_Call_NvMUT_RP_ResetInfo_GetLastResetInfo
      Rte_Call_NvMUT_RP_Startup_Source_GetLastStartupSource
      Rte_Call_TstM_GetStackInfo_GetStackInfo
      Rte_Call_WdgMUT_RP_AliveSupervision_ASW_10ms_CheckpointReached
      Rte_Call_WdgMUT_RP_Deadline_Start_ASW_10ms_CheckpointReached
      Rte_Call_WdgMUT_RP_Deadline_Stop_ASW_10ms_CheckpointReached
      Rte_Call_WdgMUT_RP_PFM_CP0_ASW_10ms_CheckpointReached
      Rte_Call_WdgMUT_RP_PFM_CP1_ASW_10ms_CheckpointReached
      Rte_Call_WdgMUT_RP_WdgM_GlobalSupervision_GetFirstExpiredSEID
      Rte_Call_WdgMUT_RP_WdgM_GlobalSupervision_GetGlobalStatus
      Rte_Call_WdgMUT_RP_WdgM_GlobalSupervision_GetMode
      Rte_Call_WdgMUT_RP_WdgM_GlobalSupervision_PerformReset
      Rte_Call_WdgMUT_RP_WdgM_GlobalSupervision_SetMode
      Rte_Call_WdgMUT_RP_WdgM_LocalSupervisionStatus_GetLocalStatus
      Rte_DecrementWaitingCount
      Rte_Enter_ExeMgrUT_ExeMgr_TriggerBswBg_EXCLUSIVE_AREA
      Rte_Exit_ExeMgrUT_ExeMgr_TriggerBswBg_EXCLUSIVE_AREA
      Rte_GetCurrentTaskIndex
      Rte_ImplCall_NvBlock_RP_StoreAtShutdownBlock_JobFinished
      Rte_ImplCall_NvBlock_RP_StoreCyclicBlock_JobFinished
      Rte_ImplCall_NvBlock_RP_StoreImmediateBlock_JobFinished
      Rte_ImplWrite_OUTP_SWC_PP_ETAS03_Sig{10..19}_ComTx_0x55_ETAS03_Sig{10..19}_ComTx_0x55
      Rte_IrTrigger_ExeMgrUT_RE_ExeMgr_GetWakeupSource_ITP_GetWakeupSource
      Rte_IrTrigger_ExeMgrUT_RE_ExeMgr_ValidateWakeup_ITP_ValidateWakeupSource
      Rte_MSACbk_SW_11
      Rte_MSACbk_SW_12
      Rte_MainFunction
      Rte_Mode_BswM_RP_BswM_MRP_SWC_AppMode_MDGP_APPMode
      Rte_Mode_DiagUT_RR_DcmCommunicationControl_ComMChannel_Can_Network_ETAS_Channel_MDGP_DcmCommunicationControl_Can_Network_ETAS_Channel_Can_Network_ETAS
      Rte_Mode_DiagUT_RR_DcmControlDTCSetting_MDGP_DcmControlDTCSetting
      Rte_Mode_DiagUT_RR_DcmDiagnosticSessionControl_MDGP_DcmDiagnosticSessionControl
      Rte_Mode_DiagUT_RR_DcmEcuReset_MDGP_DcmEcuReset
      Rte_Mode_ExeMgrUT_PP_BswM_APPMode_MDGP_APPMode
      Rte_Mode_WdgMUT_RP_WdgM_GlobalMode_currentMode
      Rte_Mode_WdgMUT_RP_WdgM_WdgM_SE1_Mode_currentMode
      Rte_Prm_CalUT_RP_SpeedLimit_speedMax
      Rte_Prm_CalUT_RP_SpeedLimit_speedMin
      Rte_ReadQueue
      Rte_Read_Dcm_IOControlResponse_DID_0xD901_New_Data_Object_IOOperationResponse
      Rte_Read_Dcm_IOControlResponse_DID_0xE900_New_Data_Object_IOOperationResponse
      Rte_Read_Dcm_R_DataServices_DID_0x0100_New_Data_Object_Data
      Rte_Read_Dcm_R_DataServices_DID_0x010B_Day_Data
      Rte_Read_Dcm_R_DataServices_DID_0x010B_Hour_Data
      Rte_Read_Dcm_R_DataServices_DID_0x010B_Minute_Data
      Rte_Read_Dcm_R_DataServices_DID_0x010B_Month_Data
      Rte_Read_Dcm_R_DataServices_DID_0x010B_Second_Data
      Rte_Read_Dcm_R_DataServices_DID_0x010B_Year_Data
      Rte_Read_Dcm_R_DataServices_DID_0x0112_New_Data_Object_Data
      Rte_Read_Dcm_R_DataServices_DID_0xB950_New_Data_Object_Data
      Rte_Read_Dcm_R_DataServices_DID_0xD001_New_Data_Object_Data
      Rte_Read_Dcm_R_DataServices_DID_0xD901_New_Data_Object_Data
      Rte_Read_Dcm_R_DataServices_DID_0xE101_New_Data_Object_Data
      Rte_Read_Dcm_R_DataServices_DID_0xE900_New_Data_Object_Data
      Rte_Read_Dcm_R_DataServices_DID_0xF100_New_Data_Object_1_Data
      Rte_Read_Dcm_R_DataServices_DID_0xF100_New_Data_Object_Data
      Rte_Read_Dcm_R_DataServices_DID_0xF{110..119}_New_Data_Object_Data
      Rte_Read_Dcm_R_DataServices_DID_0xF11A_New_Data_Object_Data
      Rte_Read_Dcm_R_DataServices_DID_0xF11B_New_Data_Object_Data
      Rte_Read_Dcm_R_DataServices_DID_0xF11C_New_Data_Object_Data
      Rte_Read_Dcm_R_DataServices_DID_0xF11D_New_Data_Object_Data
      Rte_Read_Dcm_R_DataServices_DID_0xF11E_New_Data_Object_Data
      Rte_Read_Dcm_R_DataServices_DID_0xF11F_New_Data_Object_Data
      Rte_Read_Dcm_R_DataServices_DID_0xF120_New_Data_Object_Data
      Rte_Read_Dcm_R_DataServices_DID_0xF121_New_Data_Object_Data
      Rte_Read_Dcm_R_DataServices_DID_0xF122_New_Data_Object_2_Data
      Rte_Read_Dcm_R_DataServices_DID_0xF122_New_Data_Object_Data
      Rte_Read_Dcm_R_DataServices_DID_0xF187_New_Data_Object_Data
      Rte_Read_Dcm_R_DataServices_DID_0xF18A_New_Data_Object_Data
      Rte_Read_Dcm_R_DataServices_DID_0xF18B_New_Data_Object_Data
      Rte_Read_Dcm_R_DataServices_DID_0xF18C_New_Data_Object_Data
      Rte_Read_Dcm_R_DataServices_DID_0xF190_New_Data_Object_Data
      Rte_Read_Dcm_R_DataServices_DID_0xF192_New_Data_Object_3_Data
      Rte_Read_Dcm_R_DataServices_DID_0xF192_New_Data_Object_Data
      Rte_Read_Dcm_R_DataServices_DID_0xF194_New_Data_Object_4_Data
      Rte_Read_Dcm_R_DataServices_DID_0xF194_New_Data_Object_Data
      Rte_Read_Dcm_R_DataServices_DID_0xF198_New_Data_Object_5_Data
      Rte_Read_Dcm_R_DataServices_DID_0xF198_New_Data_Object_Data
      Rte_Read_Dcm_R_DataServices_DID_0xF1A{0..2}_New_Data_Object_Data
      Rte_Read_Dcm_R_DataServices_DID_0xF1A5_New_Data_Object_Data
      Rte_Read_Dcm_R_DataServices_DID_0xF1A8_New_Data_Object_Data
      Rte_Read_Dcm_R_DataServices_DID_0xF1A9_New_Data_Object_Data
      Rte_Read_Dcm_R_DataServices_DID_0xF1AA_New_Data_Object_Data
      Rte_Read_DiagUT_IOControlRequest_DID_0xD901_New_Data_Object_IOControlRequest_DID_0xD901_New_Data_Object
      Rte_Read_DiagUT_IOControlRequest_DID_0xE900_New_Data_Object_IOControlRequest_DID_0xE900_New_Data_Object
      Rte_Read_DiagUT_R_DataServices_DID_0x0100_New_Data_Object_Data
      Rte_Read_DiagUT_R_DataServices_DID_0xF110_New_Data_Object_Data
      Rte_Read_DiagUT_R_DataServices_DID_0xF115_New_Data_Object_Data
      Rte_Read_DiagUT_R_DataServices_DID_0xF121_New_Data_Object_Data
      Rte_Read_DiagUT_R_DataServices_DID_0xF187_New_Data_Object_Data
      Rte_Read_DiagUT_R_DataServices_DID_0xF18B_New_Data_Object_Data
      Rte_Read_DiagUT_R_DataServices_DID_0xF18C_New_Data_Object_Data
      Rte_Read_DiagUT_R_DataServices_DID_0xF190_New_Data_Object_Data
      Rte_Read_DiagUT_R_DataServices_DID_0xF198_New_Data_Object_5_Data
      Rte_Read_DiagUT_R_DataServices_DID_0xF198_New_Data_Object_Data
      Rte_Read_DiagUT_R_DataServices_DID_0xF1A8_New_Data_Object_Data
      Rte_Read_DiagUT_R_DataServices_DID_0xF1A9_New_Data_Object_Data
      Rte_Read_DiagUT_R_DataServices_DID_0xF1AA_New_Data_Object_Data
      Rte_Read_INP_SWC_RP_ETAS01_Sig{00..08}_ComRx_0x81_ETAS01_Sig{00..08}_ComRx_0x81
      Rte_Read_INP_SWC_RP_ETAS02_Sig09_ComRx_0x261_ETAS02_Sig09_ComRx_0x261
      Rte_Read_INP_SWC_RP_ETAS06_Sig{34..41}_ComRx_0x456_ETAS06_Sig{34..41}_ComRx_0x456
      Rte_Read_NvMUT_PRP_CyclicNvBlock_CyclicNvBlock
      Rte_Read_NvMUT_PRP_ImmediateNvBlock_ImmediateNvBlock
      Rte_Read_NvMUT_PRP_ShutdownNvBlock_ShutDownNvBlock
      Rte_SetEvent
      Rte_Start
      Rte_Stop
      Rte_SwitchAck_WdgM_globalMode_currentMode
      Rte_SwitchAck_WdgM_mode_WdgM_SE1_currentMode
      Rte_Switch_ComM_UM_ComMUser_Can_Network_ETAS_Channel_Can_Network_ETAS_currentMode
      Rte_Switch_Dcm_Pp_DcmCommunicationControl_Can_Network_ETAS_Channel_Can_Network_ETAS_MDGP_DcmCommunicationControl_Can_Network_ETAS_Channel_Can_Network_ETAS
      Rte_Switch_Dcm_Pp_DcmControlDTCSetting_MDGP_DcmControlDTCSetting
      Rte_Switch_Dcm_Pp_DcmDiagnosticSessionControl_MDGP_DcmDiagnosticSessionControl
      Rte_Switch_Dcm_Pp_DcmEcuReset_MDGP_DcmEcuReset
      Rte_Switch_ExeMgrUT_PP_BswM_APPMode_MDGP_APPMode
      Rte_Switch_WdgM_globalMode_currentMode
      Rte_Switch_WdgM_mode_WdgM_SE1_currentMode
      Rte_WaitWithTimeout
      Rte_WriteQueue
      Rte_Write_Dcm_IOControlRequest_DID_0xD901_New_Data_Object_IOControlRequest_DID_0xD901_New_Data_Object
      Rte_Write_Dcm_IOControlRequest_DID_0xE900_New_Data_Object_IOControlRequest_DID_0xE900_New_Data_Object
      Rte_Write_Dcm_P_DataServices_DID_0x0100_New_Data_Object_Data
      Rte_Write_Dcm_P_DataServices_DID_0xF110_New_Data_Object_Data
      Rte_Write_Dcm_P_DataServices_DID_0xF115_New_Data_Object_Data
      Rte_Write_Dcm_P_DataServices_DID_0xF121_New_Data_Object_Data
      Rte_Write_Dcm_P_DataServices_DID_0xF187_New_Data_Object_Data
      Rte_Write_Dcm_P_DataServices_DID_0xF18B_New_Data_Object_Data
      Rte_Write_Dcm_P_DataServices_DID_0xF18C_New_Data_Object_Data
      Rte_Write_Dcm_P_DataServices_DID_0xF190_New_Data_Object_Data
      Rte_Write_Dcm_P_DataServices_DID_0xF198_New_Data_Object_5_Data
      Rte_Write_Dcm_P_DataServices_DID_0xF198_New_Data_Object_Data
      Rte_Write_Dcm_P_DataServices_DID_0xF1A8_New_Data_Object_Data
      Rte_Write_Dcm_P_DataServices_DID_0xF1A9_New_Data_Object_Data
      Rte_Write_Dcm_P_DataServices_DID_0xF1AA_New_Data_Object_Data
      Rte_Write_DiagUT_IOControlResponse_DID_0xD901_New_Data_Object_IOOperationResponse
      Rte_Write_DiagUT_IOControlResponse_DID_0xE900_New_Data_Object_IOOperationResponse
      Rte_Write_DiagUT_P_DataServices_DID_0x0100_New_Data_Object_Data
      Rte_Write_DiagUT_P_DataServices_DID_0x010B_Day_Data
      Rte_Write_DiagUT_P_DataServices_DID_0x010B_Hour_Data
      Rte_Write_DiagUT_P_DataServices_DID_0x010B_Minute_Data
      Rte_Write_DiagUT_P_DataServices_DID_0x010B_Month_Data
      Rte_Write_DiagUT_P_DataServices_DID_0x010B_Second_Data
      Rte_Write_DiagUT_P_DataServices_DID_0x010B_Year_Data
      Rte_Write_DiagUT_P_DataServices_DID_0x0112_New_Data_Object_Data
      Rte_Write_DiagUT_P_DataServices_DID_0xB950_New_Data_Object_Data
      Rte_Write_DiagUT_P_DataServices_DID_0xD001_New_Data_Object_Data
      Rte_Write_DiagUT_P_DataServices_DID_0xD901_New_Data_Object_Data
      Rte_Write_DiagUT_P_DataServices_DID_0xE101_New_Data_Object_Data
      Rte_Write_DiagUT_P_DataServices_DID_0xE900_New_Data_Object_Data
      Rte_Write_DiagUT_P_DataServices_DID_0xF100_New_Data_Object_1_Data
      Rte_Write_DiagUT_P_DataServices_DID_0xF100_New_Data_Object_Data
      Rte_Write_DiagUT_P_DataServices_DID_0xF{110..119}_New_Data_Object_Data
      Rte_Write_DiagUT_P_DataServices_DID_0xF11A_New_Data_Object_Data
      Rte_Write_DiagUT_P_DataServices_DID_0xF11B_New_Data_Object_Data
      Rte_Write_DiagUT_P_DataServices_DID_0xF11C_New_Data_Object_Data
      Rte_Write_DiagUT_P_DataServices_DID_0xF11D_New_Data_Object_Data
      Rte_Write_DiagUT_P_DataServices_DID_0xF11E_New_Data_Object_Data
      Rte_Write_DiagUT_P_DataServices_DID_0xF11F_New_Data_Object_Data
      Rte_Write_DiagUT_P_DataServices_DID_0xF120_New_Data_Object_Data
      Rte_Write_DiagUT_P_DataServices_DID_0xF121_New_Data_Object_Data
      Rte_Write_DiagUT_P_DataServices_DID_0xF122_New_Data_Object_2_Data
      Rte_Write_DiagUT_P_DataServices_DID_0xF122_New_Data_Object_Data
      Rte_Write_DiagUT_P_DataServices_DID_0xF187_New_Data_Object_Data
      Rte_Write_DiagUT_P_DataServices_DID_0xF18A_New_Data_Object_Data
      Rte_Write_DiagUT_P_DataServices_DID_0xF18B_New_Data_Object_Data
      Rte_Write_DiagUT_P_DataServices_DID_0xF18C_New_Data_Object_Data
      Rte_Write_DiagUT_P_DataServices_DID_0xF190_New_Data_Object_Data
      Rte_Write_DiagUT_P_DataServices_DID_0xF192_New_Data_Object_3_Data
      Rte_Write_DiagUT_P_DataServices_DID_0xF192_New_Data_Object_Data
      Rte_Write_DiagUT_P_DataServices_DID_0xF194_New_Data_Object_4_Data
      Rte_Write_DiagUT_P_DataServices_DID_0xF194_New_Data_Object_Data
      Rte_Write_DiagUT_P_DataServices_DID_0xF198_New_Data_Object_5_Data
      Rte_Write_DiagUT_P_DataServices_DID_0xF198_New_Data_Object_Data
      Rte_Write_DiagUT_P_DataServices_DID_0xF1A{0..2}_New_Data_Object_Data
      Rte_Write_DiagUT_P_DataServices_DID_0xF1A5_New_Data_Object_Data
      Rte_Write_DiagUT_P_DataServices_DID_0xF1A8_New_Data_Object_Data
      Rte_Write_DiagUT_P_DataServices_DID_0xF1A9_New_Data_Object_Data
      Rte_Write_DiagUT_P_DataServices_DID_0xF1AA_New_Data_Object_Data
      Rte_Write_NmUT_PP_NM_Tx_Sig_NM_Tx_0x600_NM_Tx_Sig_NM_Tx_0x600
      Rte_Write_NmUT_PP_NmState_uint8
      Rte_Write_NvMUT_PRP_CyclicNvBlock_CyclicNvBlock
      Rte_Write_NvMUT_PRP_ImmediateNvBlock_ImmediateNvBlock
      Rte_Write_NvMUT_PRP_ShutdownNvBlock_ShutDownNvBlock
      Rte_Write_OUTP_SWC_PP_ETAS04_Sig{20..25}_ComTx_0x98_ETAS04_Sig{20..25}_ComTx_0x98
      Rte_Write_OUTP_SWC_PP_ETAS05_Sig{26..33}_ComTx_0x123_ETAS05_Sig{26..33}_ComTx_0x123
      Rte_memcpy
      SchM_Deinit
      SchM_IModeInit
      SchM_Init
      SchM_Mode_BswM_MDGR_BswM_MRP_BSWM_MDG
      SchM_Mode_BswM_MDGR_BswM_MRP_DCM_DiagnosticSessionControl
      SchM_Mode_BswM_MDGR_BswM_MRP_DCM_ModeNotification_EcuReset
      SchM_Mode_Dcm_R_DcmCommunicationControl_Can_Network_ETAS_Channel_Can_Network_ETAS
      SchM_Mode_WdgM_Current_WdgMSupervisionCycle
      SchM_Switch_BswM_MDGP_AUTOSAR_BswM_ModeDeclarationGroups_MDG_ECUM_STATE
      SchM_Switch_Dcm_DcmCommunicationControl_Can_Network_ETAS_Channel_Can_Network_ETAS
      SchM_Switch_Dcm_DcmControlDTCSetting
      SchM_Switch_Dcm_DcmDiagnosticSessionControl
      SchM_Switch_Dcm_DcmEcuReset
    bsw module dependency AUTOSAR_Os: target-module-id=1
    bsw module dependency AUTOSAR_Com: target-module-id=50
    bsw module dependency AUTOSAR_NvM: target-module-id=20
    bsw internal behavior RteInternalBehavior
      constant-memorys:
        52 x parameter data prototype:
          Rte_Inst_BswM: type=Rte_CDS_BswM
          Rte_Inst_CalUT: type=Rte_CDS_CalUT
          Rte_Inst_ComM: type=Rte_CDS_ComM
          Rte_Inst_Dcm: type=Rte_CDS_Dcm
          Rte_Inst_Dem: type=Rte_CDS_Dem
          Rte_Inst_Det: type=Rte_CDS_Det
          Rte_Inst_DiagUT: type=Rte_CDS_DiagUT
          Rte_Inst_EcuM: type=Rte_CDS_EcuM
          Rte_Inst_ExeMgrUT: type=Rte_CDS_ExeMgrUT
          Rte_Inst_FiM: type=Rte_CDS_FiM
          Rte_Inst_INP_SWC: type=Rte_CDS_INP_SWC
          Rte_Inst_NmUT: type=Rte_CDS_NmUT
          Rte_Inst_NvM: type=Rte_CDS_NvM
          Rte_Inst_NvMUT: type=Rte_CDS_NvMUT
          Rte_Inst_OUTP_SWC: type=Rte_CDS_OUTP_SWC
          Rte_Inst_Rtm: type=Rte_CDS_Rtm
          Rte_Inst_StackM: type=Rte_CDS_StackM
          Rte_Inst_TstM: type=Rte_CDS_TstM
          Rte_Inst_WdgM: type=Rte_CDS_WdgM
          Rte_Inst_WdgMUT: type=Rte_CDS_WdgMUT
          Rte_Inst_rba_DiagLib: type=Rte_CDS_rba_DiagLib
          Rte_RomBlk_NvBlock_NvBlockDescriptor_StoreAtShutdownBlock_ShutdownRomBlock: type=Type_ArrayBoolean_96
          Rte_RomBlk_NvBlock_NvBlockDescriptor_StoreCyclicBlock_CyclicRomBlock: type=Type_ArrayU8_1024
          Rte_RomBlk_NvBlock_NvBlockDescriptor_StoreImmediateBlock_ImmediateRomBlock: type=Type_ArrayU32_96
          Rte_Self_CPT_BswM: type=Rte_SelfType_BswM
          Rte_Self_CPT_CalUT: type=Rte_SelfType_CalUT
          Rte_Self_CPT_ComM: type=Rte_SelfType_ComM
          Rte_Self_CPT_Dcm: type=Rte_SelfType_Dcm
          Rte_Self_CPT_Dem: type=Rte_SelfType_Dem
          Rte_Self_CPT_Det: type=Rte_SelfType_Det
          Rte_Self_CPT_DiagUT: type=Rte_SelfType_DiagUT
          Rte_Self_CPT_EcuM: type=Rte_SelfType_EcuM
          Rte_Self_CPT_ExeMgrUT: type=Rte_SelfType_ExeMgrUT
          Rte_Self_CPT_FiM: type=Rte_SelfType_FiM
          Rte_Self_CPT_INP_SWC: type=Rte_SelfType_INP_SWC
          Rte_Self_CPT_NmUT: type=Rte_SelfType_NmUT
          Rte_Self_CPT_NvM: type=Rte_SelfType_NvM
          Rte_Self_CPT_NvMUT: type=Rte_SelfType_NvMUT
          Rte_Self_CPT_OUTP_SWC: type=Rte_SelfType_OUTP_SWC
          Rte_Self_CPT_Rtm: type=Rte_SelfType_Rtm
          Rte_Self_CPT_StackM: type=Rte_SelfType_StackM
          Rte_Self_CPT_TstM: type=Rte_SelfType_TstM
          Rte_Self_CPT_WdgM: type=Rte_SelfType_WdgM
          Rte_Self_CPT_WdgMUT: type=Rte_SelfType_WdgMUT
          Rte_Self_CPT_rba_DiagLib: type=Rte_SelfType_rba_DiagLib
          Rte_Tasks: type=Rte_TaskInfo
          SpeedLimitLower: type=uint32
          SpeedLimitUpper: type=uint32
          sharedCURVE: type=IDT_CURVE
          sharedMAP: type=IDT_MAP
          speedMax: type=uint32
          speedMin: type=uint32
      static-memorys:
        116 x data:
          Rte_ActCount_CPT_NvBlock_DRE_NvBlock_StoreAtShutdownNvBlock: type=Rte_REActCounterType
          Rte_ActCount_CPT_NvBlock_DRE_NvBlock_StoreImmediateNvBlock: type=Rte_REActCounterType
          Rte_ArPim_CalUT_ArTypedPIM_1: type=uint32
          Rte_CyclicRamBlock_DirtyFlag: type=boolean
          Rte_EcucPartition_ComCore_ImplicitBufs: type=Rte_EcucPartition_ComCore_ImplicitBufsType
          Rte_FbVar_CPT_WdgM_globalMode_currentMode: type=Std_ReturnType
          Rte_FbVar_CPT_WdgM_mode_WdgM_SE1_currentMode: type=Std_ReturnType
          Rte_ImmediateRamBlock_DirtyFlag: type=boolean
          Rte_Irv_ExeMgrUT_ExeMgr_StartupSource: type=ExeMgr_StartupSourceType
          Rte_ModeCurrent_0: type=uint8
          Rte_ModeCurrent_1: type=uint8
          Rte_ModeCurrent_{10..12}: type=uint8
          Rte_ModeCurrent_{2..9}: type=uint8
          Rte_ModeNext_10: type=uint8
          Rte_ModeNext_5: type=uint8
          Rte_ModeSchMNext_0: type=uint8
          Rte_ModeSchMNext_1: type=uint8
          Rte_ModeSchMNext_5: type=uint8
          Rte_Ms_000000: type=boolean
          Rte_Ms_000001: type=uint16
          Rte_Ms_000002: type=ComM_InhibitionStatusType
          Rte_Ms_000003: type=uint32
          Rte_Ms_000004: type=uint8
          Rte_Ms_000005: type=StackM_StackMeasureType
          Rte_RamBlk_NvBlock_NvBlockDescriptor_StoreAtShutdownBlock_ShutdownRamBlock: type=Type_ArrayBoolean_96
          Rte_RamBlk_NvBlock_NvBlockDescriptor_StoreCyclicBlock_CyclicRamBlock: type=Type_ArrayU8_1024
          Rte_RamBlk_NvBlock_NvBlockDescriptor_StoreImmediateBlock_ImmediateRamBlock: type=Type_ArrayU32_96
          Rte_Rx_000018: type=Dcm_IOControlRequest_DID_0xD901_New_Data_ObjectType
          Rte_Rx_000019: type=Dcm_IOControlRequest_DID_0xE900_New_Data_ObjectType
          Rte_Rx_000020: type=Dcm_DataArrayTypeUint8_DID_0x0100_New_Data_ObjectType
          Rte_Rx_000021: type=Dcm_DataArrayTypeUint8_DID_0xF110_New_Data_ObjectType
          Rte_Rx_000022: type=Dcm_DataArrayTypeUint8_DID_0xF115_New_Data_ObjectType
          Rte_Rx_000023: type=Dcm_DataArrayTypeUint8_DID_0xF121_New_Data_ObjectType
          Rte_Rx_000024: type=Dcm_DataArrayTypeUint8_DID_0xF187_New_Data_ObjectType
          Rte_Rx_000025: type=Dcm_DataArrayTypeUint8_DID_0xF18B_New_Data_ObjectType
          Rte_Rx_000026: type=Dcm_DataArrayTypeUint8_DID_0xF18C_New_Data_ObjectType
          Rte_Rx_000027: type=Dcm_DataArrayTypeUint8_DID_0xF190_New_Data_ObjectType
          Rte_Rx_000028: type=Dcm_DataArrayTypeUint8_DID_0xF198_New_Data_ObjectType
          Rte_Rx_000029: type=Dcm_DataArrayTypeUint8_DID_0xF198_New_Data_Object_5Type
          Rte_Rx_000030: type=Dcm_DataArrayTypeUint8_DID_0xF1A8_New_Data_ObjectType
          Rte_Rx_000031: type=Dcm_DataArrayTypeUint8_DID_0xF1A9_New_Data_ObjectType
          Rte_Rx_000032: type=Dcm_DataArrayTypeUint8_DID_0xF1AA_New_Data_ObjectType
          Rte_Rx_000033: type=Dcm_IOOperationResponseType
          Rte_Rx_000034: type=Dcm_IOOperationResponseType
          Rte_Rx_000035: type=Dcm_DataArrayTypeUint8_DID_0x0100_New_Data_ObjectType
          Rte_Rx_{000036..000042}: type=uint8
          Rte_Rx_000043: type=Dcm_DataArrayTypeUint8_DID_0xB950_New_Data_ObjectType
          Rte_Rx_000044: type=uint8
          Rte_Rx_000045: type=uint8
          Rte_Rx_000046: type=Dcm_DataArrayTypeUint8_DID_0xE101_New_Data_ObjectType
          Rte_Rx_000047: type=uint8
          Rte_Rx_000048: type=Dcm_DataArrayTypeUint8_DID_0xF100_New_Data_ObjectType
          Rte_Rx_000049: type=Dcm_DataArrayTypeUint8_DID_0xF100_New_Data_Object_1Type
          Rte_Rx_000050: type=Dcm_DataArrayTypeUint8_DID_0xF110_New_Data_ObjectType
          Rte_Rx_000051: type=Dcm_DataArrayTypeUint8_DID_0xF111_New_Data_ObjectType
          Rte_Rx_000052: type=Dcm_DataArrayTypeUint8_DID_0xF112_New_Data_ObjectType
          Rte_Rx_000053: type=Dcm_DataArrayTypeUint8_DID_0xF113_New_Data_ObjectType
          Rte_Rx_000054: type=Dcm_DataArrayTypeUint8_DID_0xF114_New_Data_ObjectType
          Rte_Rx_000055: type=Dcm_DataArrayTypeUint8_DID_0xF115_New_Data_ObjectType
          Rte_Rx_000056: type=Dcm_DataArrayTypeUint8_DID_0xF116_New_Data_ObjectType
          Rte_Rx_000057: type=Dcm_DataArrayTypeUint8_DID_0xF117_New_Data_ObjectType
          Rte_Rx_000058: type=Dcm_DataArrayTypeUint8_DID_0xF118_New_Data_ObjectType
          Rte_Rx_000059: type=Dcm_DataArrayTypeUint8_DID_0xF119_New_Data_ObjectType
          Rte_Rx_000060: type=Dcm_DataArrayTypeUint8_DID_0xF11A_New_Data_ObjectType
          Rte_Rx_000061: type=Dcm_DataArrayTypeUint8_DID_0xF11B_New_Data_ObjectType
          Rte_Rx_000062: type=Dcm_DataArrayTypeUint8_DID_0xF11C_New_Data_ObjectType
          Rte_Rx_000063: type=Dcm_DataArrayTypeUint8_DID_0xF11D_New_Data_ObjectType
          Rte_Rx_000064: type=Dcm_DataArrayTypeUint8_DID_0xF11E_New_Data_ObjectType
          Rte_Rx_000065: type=Dcm_DataArrayTypeUint8_DID_0xF11F_New_Data_ObjectType
          Rte_Rx_000066: type=Dcm_DataArrayTypeUint8_DID_0xF120_New_Data_ObjectType
          Rte_Rx_000067: type=Dcm_DataArrayTypeUint8_DID_0xF121_New_Data_ObjectType
          Rte_Rx_000068: type=Dcm_DataArrayTypeUint8_DID_0xF122_New_Data_ObjectType
          Rte_Rx_000069: type=Dcm_DataArrayTypeUint8_DID_0xF122_New_Data_Object_2Type
          Rte_Rx_000070: type=Dcm_DataArrayTypeUint8_DID_0xF187_New_Data_ObjectType
          Rte_Rx_000071: type=Dcm_DataArrayTypeUint8_DID_0xF18A_New_Data_ObjectType
          Rte_Rx_000072: type=Dcm_DataArrayTypeUint8_DID_0xF18B_New_Data_ObjectType
          Rte_Rx_000073: type=Dcm_DataArrayTypeUint8_DID_0xF18C_New_Data_ObjectType
          Rte_Rx_000074: type=Dcm_DataArrayTypeUint8_DID_0xF190_New_Data_ObjectType
          Rte_Rx_000075: type=Dcm_DataArrayTypeUint8_DID_0xF192_New_Data_ObjectType
          Rte_Rx_000076: type=Dcm_DataArrayTypeUint8_DID_0xF192_New_Data_Object_3Type
          Rte_Rx_000077: type=Dcm_DataArrayTypeUint8_DID_0xF194_New_Data_ObjectType
          Rte_Rx_000078: type=Dcm_DataArrayTypeUint8_DID_0xF194_New_Data_Object_4Type
          Rte_Rx_000079: type=Dcm_DataArrayTypeUint8_DID_0xF198_New_Data_ObjectType
          Rte_Rx_000080: type=Dcm_DataArrayTypeUint8_DID_0xF198_New_Data_Object_5Type
          Rte_Rx_000081: type=Dcm_DataArrayTypeUint8_DID_0xF1A0_New_Data_ObjectType
          Rte_Rx_000082: type=Dcm_DataArrayTypeUint8_DID_0xF1A1_New_Data_ObjectType
          Rte_Rx_000083: type=Dcm_DataArrayTypeUint8_DID_0xF1A2_New_Data_ObjectType
          Rte_Rx_000084: type=Dcm_DataArrayTypeUint8_DID_0xF1A5_New_Data_ObjectType
          Rte_Rx_000085: type=Dcm_DataArrayTypeUint8_DID_0xF1A8_New_Data_ObjectType
          Rte_Rx_000086: type=Dcm_DataArrayTypeUint8_DID_0xF1A9_New_Data_ObjectType
          Rte_Rx_000087: type=Dcm_DataArrayTypeUint8_DID_0xF1AA_New_Data_ObjectType
          Rte_Rx_000088: type=boolean
          Rte_Rx_000089: type=boolean
          Rte_Rx_000090: type=uint16
          Rte_Rx_000091: type=uint16
          Rte_Rx_{000092..000094}: type=uint8
          Rte_Rx_000095: type=boolean
          Rte_Rx_000096: type=boolean
          Rte_Rx_000097: type=uint8
      528 x bsw called entity, all with sw-addr-method=CODE:
        RE_StoreAtShutdown_NvBlock: implemented-entry=RE_StoreAtShutdown_NvBlock
        RE_StoreCyclic_NvBlock: implemented-entry=RE_StoreCyclic_NvBlock
        RE_StoreImmediate_NvBlock: implemented-entry=RE_StoreImmediate_NvBlock
        Rte_ActivateRE: implemented-entry=Rte_ActivateRE
        Rte_CData_CalUT_SpeedLimitLower: implemented-entry=Rte_CData_CalUT_SpeedLimitLower
        Rte_CData_CalUT_SpeedLimitUpper: implemented-entry=Rte_CData_CalUT_SpeedLimitUpper
        Rte_CData_CalUT_sharedCURVE: implemented-entry=Rte_CData_CalUT_sharedCURVE
        Rte_CData_CalUT_sharedMAP: implemented-entry=Rte_CData_CalUT_sharedMAP
        Rte_Call_Dcm_RoutineServices_Routine_Control_203_Start: implemented-entry=Rte_Call_Dcm_RoutineServices_Routine_Control_203_Start
        Rte_Call_Dcm_RoutineServices_Routine_Control_ABFF_RequestResults: implemented-entry=Rte_Call_Dcm_RoutineServices_Routine_Control_ABFF_RequestResults
        Rte_Call_Dcm_RoutineServices_Routine_Control_ABFF_Start: implemented-entry=Rte_Call_Dcm_RoutineServices_Routine_Control_ABFF_Start
        Rte_Call_Dcm_RoutineServices_X_Routine_Control_ABFE_Start: implemented-entry=Rte_Call_Dcm_RoutineServices_X_Routine_Control_ABFE_Start
        Rte_Call_Dcm_SecurityAccess_UnlockedL1_CompareKey: implemented-entry=Rte_Call_Dcm_SecurityAccess_UnlockedL1_CompareKey
        Rte_Call_Dcm_SecurityAccess_UnlockedL1_GetSeed: implemented-entry=Rte_Call_Dcm_SecurityAccess_UnlockedL1_GetSeed
        Rte_Call_Dcm_SecurityAccess_Unlocked_L3_CompareKey: implemented-entry=Rte_Call_Dcm_SecurityAccess_Unlocked_L3_CompareKey
        Rte_Call_Dcm_SecurityAccess_Unlocked_L3_GetSeed: implemented-entry=Rte_Call_Dcm_SecurityAccess_Unlocked_L3_GetSeed
        Rte_Call_Dem_CBClrEvt_DTC_0x000001_Event_ClearEventAllowed: implemented-entry=Rte_Call_Dem_CBClrEvt_DTC_0x000001_Event_ClearEventAllowed
        Rte_Call_Dem_CBClrEvt_DTC_0x0d0400_CAN_Network_ETAS_BusOff_Event_ClearEventAllowed: implemented-entry=Rte_Call_Dem_CBClrEvt_DTC_0x0d0400_CAN_Network_ETAS_BusOff_Event_ClearEventAllowed
        Rte_Call_Dem_CBClrEvt_DTC_0xc07388_Event_ClearEventAllowed: implemented-entry=Rte_Call_Dem_CBClrEvt_DTC_0xc07388_Event_ClearEventAllowed
        Rte_Call_Dem_CBClrEvt_DTC_0xc12687_Event_ClearEventAllowed: implemented-entry=Rte_Call_Dem_CBClrEvt_DTC_0xc12687_Event_ClearEventAllowed
        Rte_Call_Dem_CBClrEvt_DTC_0xc14587_Event_ClearEventAllowed: implemented-entry=Rte_Call_Dem_CBClrEvt_DTC_0xc14587_Event_ClearEventAllowed
        Rte_Call_Dem_CBClrEvt_DTC_0xc22a87_Event_ClearEventAllowed: implemented-entry=Rte_Call_Dem_CBClrEvt_DTC_0xc22a87_Event_ClearEventAllowed
        Rte_Call_Dem_CBClrEvt_DTC_0xc41487_Event_ClearEventAllowed: implemented-entry=Rte_Call_Dem_CBClrEvt_DTC_0xc41487_Event_ClearEventAllowed
        Rte_Call_Dem_CBClrEvt_DTC_0xd56217_Event_ClearEventAllowed: implemented-entry=Rte_Call_Dem_CBClrEvt_DTC_0xd56217_Event_ClearEventAllowed
        Rte_Call_Dem_CBClrEvt_DTC_0xd56316_Event_ClearEventAllowed: implemented-entry=Rte_Call_Dem_CBClrEvt_DTC_0xd56316_Event_ClearEventAllowed
        Rte_Call_Dem_CBClrEvt_DTC_0xe00141_Event_ClearEventAllowed: implemented-entry=Rte_Call_Dem_CBClrEvt_DTC_0xe00141_Event_ClearEventAllowed
        Rte_Call_Dem_CBClrEvt_DTC_0xe00142_Event_ClearEventAllowed: implemented-entry=Rte_Call_Dem_CBClrEvt_DTC_0xe00142_Event_ClearEventAllowed
        Rte_Call_Dem_CBClrEvt_DTC_0xe26200_Event_ClearEventAllowed: implemented-entry=Rte_Call_Dem_CBClrEvt_DTC_0xe26200_Event_ClearEventAllowed
        Rte_Call_DiagUT_ControlEventAvailable_EventParameter_DTC_0x000001_Event_SetEventAvailable: implemented-entry=Rte_Call_DiagUT_ControlEventAvailable_EventParameter_DTC_0x000001_Event_SetEventAvailable
        Rte_Call_DiagUT_ControlEventAvailable_EventParameter_DTC_0xc07388_Event_SetEventAvailable: implemented-entry=Rte_Call_DiagUT_ControlEventAvailable_EventParameter_DTC_0xc07388_Event_SetEventAvailable
        Rte_Call_DiagUT_ControlEventAvailable_EventParameter_DTC_0xc12687_Event_SetEventAvailable: implemented-entry=Rte_Call_DiagUT_ControlEventAvailable_EventParameter_DTC_0xc12687_Event_SetEventAvailable
        Rte_Call_DiagUT_ControlEventAvailable_EventParameter_DTC_0xc14587_Event_SetEventAvailable: implemented-entry=Rte_Call_DiagUT_ControlEventAvailable_EventParameter_DTC_0xc14587_Event_SetEventAvailable
        Rte_Call_DiagUT_ControlEventAvailable_EventParameter_DTC_0xc22a87_Event_SetEventAvailable: implemented-entry=Rte_Call_DiagUT_ControlEventAvailable_EventParameter_DTC_0xc22a87_Event_SetEventAvailable
        Rte_Call_DiagUT_ControlEventAvailable_EventParameter_DTC_0xc41487_Event_SetEventAvailable: implemented-entry=Rte_Call_DiagUT_ControlEventAvailable_EventParameter_DTC_0xc41487_Event_SetEventAvailable
        Rte_Call_DiagUT_ControlEventAvailable_EventParameter_DTC_0xd56217_Event_SetEventAvailable: implemented-entry=Rte_Call_DiagUT_ControlEventAvailable_EventParameter_DTC_0xd56217_Event_SetEventAvailable
        Rte_Call_DiagUT_ControlEventAvailable_EventParameter_DTC_0xd56316_Event_SetEventAvailable: implemented-entry=Rte_Call_DiagUT_ControlEventAvailable_EventParameter_DTC_0xd56316_Event_SetEventAvailable
        Rte_Call_DiagUT_ControlEventAvailable_EventParameter_DTC_0xe00141_Event_SetEventAvailable: implemented-entry=Rte_Call_DiagUT_ControlEventAvailable_EventParameter_DTC_0xe00141_Event_SetEventAvailable
        Rte_Call_DiagUT_ControlEventAvailable_EventParameter_DTC_0xe00142_Event_SetEventAvailable: implemented-entry=Rte_Call_DiagUT_ControlEventAvailable_EventParameter_DTC_0xe00142_Event_SetEventAvailable
        Rte_Call_DiagUT_ControlEventAvailable_EventParameter_DTC_0xe26200_Event_SetEventAvailable: implemented-entry=Rte_Call_DiagUT_ControlEventAvailable_EventParameter_DTC_0xe26200_Event_SetEventAvailable
        Rte_Call_DiagUT_DCMServices_GetActiveProtocol: implemented-entry=Rte_Call_DiagUT_DCMServices_GetActiveProtocol
        Rte_Call_DiagUT_DCMServices_GetSecurityLevel: implemented-entry=Rte_Call_DiagUT_DCMServices_GetSecurityLevel
        Rte_Call_DiagUT_DCMServices_GetSesCtrlType: implemented-entry=Rte_Call_DiagUT_DCMServices_GetSesCtrlType
        Rte_Call_DiagUT_DCMServices_ResetToDefaultSession: implemented-entry=Rte_Call_DiagUT_DCMServices_ResetToDefaultSession
        Rte_Call_DiagUT_DCMServices_SetActiveDiagnostic: implemented-entry=Rte_Call_DiagUT_DCMServices_SetActiveDiagnostic
        Rte_Call_DiagUT_EventStatus_EventParameter_DTC_0x000001_Event_SetWIRStatus: implemented-entry=Rte_Call_DiagUT_EventStatus_EventParameter_DTC_0x000001_Event_SetWIRStatus
        Rte_Call_DiagUT_EventStatus_EventParameter_DTC_0xc07388_Event_SetWIRStatus: implemented-entry=Rte_Call_DiagUT_EventStatus_EventParameter_DTC_0xc07388_Event_SetWIRStatus
        Rte_Call_DiagUT_EventStatus_EventParameter_DTC_0xc12687_Event_SetWIRStatus: implemented-entry=Rte_Call_DiagUT_EventStatus_EventParameter_DTC_0xc12687_Event_SetWIRStatus
        Rte_Call_DiagUT_EventStatus_EventParameter_DTC_0xc14587_Event_SetWIRStatus: implemented-entry=Rte_Call_DiagUT_EventStatus_EventParameter_DTC_0xc14587_Event_SetWIRStatus
        Rte_Call_DiagUT_EventStatus_EventParameter_DTC_0xc22a87_Event_SetWIRStatus: implemented-entry=Rte_Call_DiagUT_EventStatus_EventParameter_DTC_0xc22a87_Event_SetWIRStatus
        Rte_Call_DiagUT_EventStatus_EventParameter_DTC_0xc41487_Event_SetWIRStatus: implemented-entry=Rte_Call_DiagUT_EventStatus_EventParameter_DTC_0xc41487_Event_SetWIRStatus
        Rte_Call_DiagUT_EventStatus_EventParameter_DTC_0xd56217_Event_SetWIRStatus: implemented-entry=Rte_Call_DiagUT_EventStatus_EventParameter_DTC_0xd56217_Event_SetWIRStatus
        Rte_Call_DiagUT_EventStatus_EventParameter_DTC_0xd56316_Event_SetWIRStatus: implemented-entry=Rte_Call_DiagUT_EventStatus_EventParameter_DTC_0xd56316_Event_SetWIRStatus
        Rte_Call_DiagUT_EventStatus_EventParameter_DTC_0xe00141_Event_SetWIRStatus: implemented-entry=Rte_Call_DiagUT_EventStatus_EventParameter_DTC_0xe00141_Event_SetWIRStatus
        Rte_Call_DiagUT_EventStatus_EventParameter_DTC_0xe00142_Event_SetWIRStatus: implemented-entry=Rte_Call_DiagUT_EventStatus_EventParameter_DTC_0xe00142_Event_SetWIRStatus
        Rte_Call_DiagUT_EventStatus_EventParameter_DTC_0xe26200_Event_SetWIRStatus: implemented-entry=Rte_Call_DiagUT_EventStatus_EventParameter_DTC_0xe26200_Event_SetWIRStatus
        Rte_Call_DiagUT_Event_EventParameter_DTC_0x000001_Event_ClearPrestoredFreezeFrame: implemented-entry=Rte_Call_DiagUT_Event_EventParameter_DTC_0x000001_Event_ClearPrestoredFreezeFrame
        Rte_Call_DiagUT_Event_EventParameter_DTC_0x000001_Event_PrestoreFreezeFrame: implemented-entry=Rte_Call_DiagUT_Event_EventParameter_DTC_0x000001_Event_PrestoreFreezeFrame
        Rte_Call_DiagUT_Event_EventParameter_DTC_0x000001_Event_ResetEventDebounceStatus: implemented-entry=Rte_Call_DiagUT_Event_EventParameter_DTC_0x000001_Event_ResetEventDebounceStatus
        Rte_Call_DiagUT_Event_EventParameter_DTC_0x000001_Event_ResetEventStatus: implemented-entry=Rte_Call_DiagUT_Event_EventParameter_DTC_0x000001_Event_ResetEventStatus
        Rte_Call_DiagUT_Event_EventParameter_DTC_0x000001_Event_SetEventStatus: implemented-entry=Rte_Call_DiagUT_Event_EventParameter_DTC_0x000001_Event_SetEventStatus
        Rte_Call_DiagUT_Event_EventParameter_DTC_0x000001_Event_SetEventStatusWithEnvdata: implemented-entry=Rte_Call_DiagUT_Event_EventParameter_DTC_0x000001_Event_SetEventStatusWithEnvdata
        Rte_Call_DiagUT_Event_EventParameter_DTC_0xc07388_Event_ClearPrestoredFreezeFrame: implemented-entry=Rte_Call_DiagUT_Event_EventParameter_DTC_0xc07388_Event_ClearPrestoredFreezeFrame
        Rte_Call_DiagUT_Event_EventParameter_DTC_0xc07388_Event_PrestoreFreezeFrame: implemented-entry=Rte_Call_DiagUT_Event_EventParameter_DTC_0xc07388_Event_PrestoreFreezeFrame
        Rte_Call_DiagUT_Event_EventParameter_DTC_0xc07388_Event_ResetEventDebounceStatus: implemented-entry=Rte_Call_DiagUT_Event_EventParameter_DTC_0xc07388_Event_ResetEventDebounceStatus
        Rte_Call_DiagUT_Event_EventParameter_DTC_0xc07388_Event_ResetEventStatus: implemented-entry=Rte_Call_DiagUT_Event_EventParameter_DTC_0xc07388_Event_ResetEventStatus
        Rte_Call_DiagUT_Event_EventParameter_DTC_0xc07388_Event_SetEventStatus: implemented-entry=Rte_Call_DiagUT_Event_EventParameter_DTC_0xc07388_Event_SetEventStatus
        Rte_Call_DiagUT_Event_EventParameter_DTC_0xc07388_Event_SetEventStatusWithEnvdata: implemented-entry=Rte_Call_DiagUT_Event_EventParameter_DTC_0xc07388_Event_SetEventStatusWithEnvdata
        Rte_Call_DiagUT_Event_EventParameter_DTC_0xc12687_Event_ClearPrestoredFreezeFrame: implemented-entry=Rte_Call_DiagUT_Event_EventParameter_DTC_0xc12687_Event_ClearPrestoredFreezeFrame
        Rte_Call_DiagUT_Event_EventParameter_DTC_0xc12687_Event_PrestoreFreezeFrame: implemented-entry=Rte_Call_DiagUT_Event_EventParameter_DTC_0xc12687_Event_PrestoreFreezeFrame
        Rte_Call_DiagUT_Event_EventParameter_DTC_0xc12687_Event_ResetEventDebounceStatus: implemented-entry=Rte_Call_DiagUT_Event_EventParameter_DTC_0xc12687_Event_ResetEventDebounceStatus
        Rte_Call_DiagUT_Event_EventParameter_DTC_0xc12687_Event_ResetEventStatus: implemented-entry=Rte_Call_DiagUT_Event_EventParameter_DTC_0xc12687_Event_ResetEventStatus
        Rte_Call_DiagUT_Event_EventParameter_DTC_0xc12687_Event_SetEventStatus: implemented-entry=Rte_Call_DiagUT_Event_EventParameter_DTC_0xc12687_Event_SetEventStatus
        Rte_Call_DiagUT_Event_EventParameter_DTC_0xc12687_Event_SetEventStatusWithEnvdata: implemented-entry=Rte_Call_DiagUT_Event_EventParameter_DTC_0xc12687_Event_SetEventStatusWithEnvdata
        Rte_Call_DiagUT_Event_EventParameter_DTC_0xc14587_Event_ClearPrestoredFreezeFrame: implemented-entry=Rte_Call_DiagUT_Event_EventParameter_DTC_0xc14587_Event_ClearPrestoredFreezeFrame
        Rte_Call_DiagUT_Event_EventParameter_DTC_0xc14587_Event_PrestoreFreezeFrame: implemented-entry=Rte_Call_DiagUT_Event_EventParameter_DTC_0xc14587_Event_PrestoreFreezeFrame
        Rte_Call_DiagUT_Event_EventParameter_DTC_0xc14587_Event_ResetEventDebounceStatus: implemented-entry=Rte_Call_DiagUT_Event_EventParameter_DTC_0xc14587_Event_ResetEventDebounceStatus
        Rte_Call_DiagUT_Event_EventParameter_DTC_0xc14587_Event_ResetEventStatus: implemented-entry=Rte_Call_DiagUT_Event_EventParameter_DTC_0xc14587_Event_ResetEventStatus
        Rte_Call_DiagUT_Event_EventParameter_DTC_0xc14587_Event_SetEventStatus: implemented-entry=Rte_Call_DiagUT_Event_EventParameter_DTC_0xc14587_Event_SetEventStatus
        Rte_Call_DiagUT_Event_EventParameter_DTC_0xc14587_Event_SetEventStatusWithEnvdata: implemented-entry=Rte_Call_DiagUT_Event_EventParameter_DTC_0xc14587_Event_SetEventStatusWithEnvdata
        Rte_Call_DiagUT_Event_EventParameter_DTC_0xc22a87_Event_ClearPrestoredFreezeFrame: implemented-entry=Rte_Call_DiagUT_Event_EventParameter_DTC_0xc22a87_Event_ClearPrestoredFreezeFrame
        Rte_Call_DiagUT_Event_EventParameter_DTC_0xc22a87_Event_PrestoreFreezeFrame: implemented-entry=Rte_Call_DiagUT_Event_EventParameter_DTC_0xc22a87_Event_PrestoreFreezeFrame
        Rte_Call_DiagUT_Event_EventParameter_DTC_0xc22a87_Event_ResetEventDebounceStatus: implemented-entry=Rte_Call_DiagUT_Event_EventParameter_DTC_0xc22a87_Event_ResetEventDebounceStatus
        Rte_Call_DiagUT_Event_EventParameter_DTC_0xc22a87_Event_ResetEventStatus: implemented-entry=Rte_Call_DiagUT_Event_EventParameter_DTC_0xc22a87_Event_ResetEventStatus
        Rte_Call_DiagUT_Event_EventParameter_DTC_0xc22a87_Event_SetEventStatus: implemented-entry=Rte_Call_DiagUT_Event_EventParameter_DTC_0xc22a87_Event_SetEventStatus
        Rte_Call_DiagUT_Event_EventParameter_DTC_0xc22a87_Event_SetEventStatusWithEnvdata: implemented-entry=Rte_Call_DiagUT_Event_EventParameter_DTC_0xc22a87_Event_SetEventStatusWithEnvdata
        Rte_Call_DiagUT_Event_EventParameter_DTC_0xc41487_Event_ClearPrestoredFreezeFrame: implemented-entry=Rte_Call_DiagUT_Event_EventParameter_DTC_0xc41487_Event_ClearPrestoredFreezeFrame
        Rte_Call_DiagUT_Event_EventParameter_DTC_0xc41487_Event_PrestoreFreezeFrame: implemented-entry=Rte_Call_DiagUT_Event_EventParameter_DTC_0xc41487_Event_PrestoreFreezeFrame
        Rte_Call_DiagUT_Event_EventParameter_DTC_0xc41487_Event_ResetEventDebounceStatus: implemented-entry=Rte_Call_DiagUT_Event_EventParameter_DTC_0xc41487_Event_ResetEventDebounceStatus
        Rte_Call_DiagUT_Event_EventParameter_DTC_0xc41487_Event_ResetEventStatus: implemented-entry=Rte_Call_DiagUT_Event_EventParameter_DTC_0xc41487_Event_ResetEventStatus
        Rte_Call_DiagUT_Event_EventParameter_DTC_0xc41487_Event_SetEventStatus: implemented-entry=Rte_Call_DiagUT_Event_EventParameter_DTC_0xc41487_Event_SetEventStatus
        Rte_Call_DiagUT_Event_EventParameter_DTC_0xc41487_Event_SetEventStatusWithEnvdata: implemented-entry=Rte_Call_DiagUT_Event_EventParameter_DTC_0xc41487_Event_SetEventStatusWithEnvdata
        Rte_Call_DiagUT_Event_EventParameter_DTC_0xd56217_Event_ClearPrestoredFreezeFrame: implemented-entry=Rte_Call_DiagUT_Event_EventParameter_DTC_0xd56217_Event_ClearPrestoredFreezeFrame
        Rte_Call_DiagUT_Event_EventParameter_DTC_0xd56217_Event_PrestoreFreezeFrame: implemented-entry=Rte_Call_DiagUT_Event_EventParameter_DTC_0xd56217_Event_PrestoreFreezeFrame
        Rte_Call_DiagUT_Event_EventParameter_DTC_0xd56217_Event_ResetEventDebounceStatus: implemented-entry=Rte_Call_DiagUT_Event_EventParameter_DTC_0xd56217_Event_ResetEventDebounceStatus
        Rte_Call_DiagUT_Event_EventParameter_DTC_0xd56217_Event_ResetEventStatus: implemented-entry=Rte_Call_DiagUT_Event_EventParameter_DTC_0xd56217_Event_ResetEventStatus
        Rte_Call_DiagUT_Event_EventParameter_DTC_0xd56217_Event_SetEventStatus: implemented-entry=Rte_Call_DiagUT_Event_EventParameter_DTC_0xd56217_Event_SetEventStatus
        Rte_Call_DiagUT_Event_EventParameter_DTC_0xd56217_Event_SetEventStatusWithEnvdata: implemented-entry=Rte_Call_DiagUT_Event_EventParameter_DTC_0xd56217_Event_SetEventStatusWithEnvdata
        Rte_Call_DiagUT_Event_EventParameter_DTC_0xd56316_Event_ClearPrestoredFreezeFrame: implemented-entry=Rte_Call_DiagUT_Event_EventParameter_DTC_0xd56316_Event_ClearPrestoredFreezeFrame
        Rte_Call_DiagUT_Event_EventParameter_DTC_0xd56316_Event_PrestoreFreezeFrame: implemented-entry=Rte_Call_DiagUT_Event_EventParameter_DTC_0xd56316_Event_PrestoreFreezeFrame
        Rte_Call_DiagUT_Event_EventParameter_DTC_0xd56316_Event_ResetEventDebounceStatus: implemented-entry=Rte_Call_DiagUT_Event_EventParameter_DTC_0xd56316_Event_ResetEventDebounceStatus
        Rte_Call_DiagUT_Event_EventParameter_DTC_0xd56316_Event_ResetEventStatus: implemented-entry=Rte_Call_DiagUT_Event_EventParameter_DTC_0xd56316_Event_ResetEventStatus
        Rte_Call_DiagUT_Event_EventParameter_DTC_0xd56316_Event_SetEventStatus: implemented-entry=Rte_Call_DiagUT_Event_EventParameter_DTC_0xd56316_Event_SetEventStatus
        Rte_Call_DiagUT_Event_EventParameter_DTC_0xd56316_Event_SetEventStatusWithEnvdata: implemented-entry=Rte_Call_DiagUT_Event_EventParameter_DTC_0xd56316_Event_SetEventStatusWithEnvdata
        Rte_Call_DiagUT_Event_EventParameter_DTC_0xe00141_Event_ClearPrestoredFreezeFrame: implemented-entry=Rte_Call_DiagUT_Event_EventParameter_DTC_0xe00141_Event_ClearPrestoredFreezeFrame
        Rte_Call_DiagUT_Event_EventParameter_DTC_0xe00141_Event_PrestoreFreezeFrame: implemented-entry=Rte_Call_DiagUT_Event_EventParameter_DTC_0xe00141_Event_PrestoreFreezeFrame
        Rte_Call_DiagUT_Event_EventParameter_DTC_0xe00141_Event_ResetEventDebounceStatus: implemented-entry=Rte_Call_DiagUT_Event_EventParameter_DTC_0xe00141_Event_ResetEventDebounceStatus
        Rte_Call_DiagUT_Event_EventParameter_DTC_0xe00141_Event_ResetEventStatus: implemented-entry=Rte_Call_DiagUT_Event_EventParameter_DTC_0xe00141_Event_ResetEventStatus
        Rte_Call_DiagUT_Event_EventParameter_DTC_0xe00141_Event_SetEventStatus: implemented-entry=Rte_Call_DiagUT_Event_EventParameter_DTC_0xe00141_Event_SetEventStatus
        Rte_Call_DiagUT_Event_EventParameter_DTC_0xe00141_Event_SetEventStatusWithEnvdata: implemented-entry=Rte_Call_DiagUT_Event_EventParameter_DTC_0xe00141_Event_SetEventStatusWithEnvdata
        Rte_Call_DiagUT_Event_EventParameter_DTC_0xe00142_Event_ClearPrestoredFreezeFrame: implemented-entry=Rte_Call_DiagUT_Event_EventParameter_DTC_0xe00142_Event_ClearPrestoredFreezeFrame
        Rte_Call_DiagUT_Event_EventParameter_DTC_0xe00142_Event_PrestoreFreezeFrame: implemented-entry=Rte_Call_DiagUT_Event_EventParameter_DTC_0xe00142_Event_PrestoreFreezeFrame
        Rte_Call_DiagUT_Event_EventParameter_DTC_0xe00142_Event_ResetEventDebounceStatus: implemented-entry=Rte_Call_DiagUT_Event_EventParameter_DTC_0xe00142_Event_ResetEventDebounceStatus
        Rte_Call_DiagUT_Event_EventParameter_DTC_0xe00142_Event_ResetEventStatus: implemented-entry=Rte_Call_DiagUT_Event_EventParameter_DTC_0xe00142_Event_ResetEventStatus
        Rte_Call_DiagUT_Event_EventParameter_DTC_0xe00142_Event_SetEventStatus: implemented-entry=Rte_Call_DiagUT_Event_EventParameter_DTC_0xe00142_Event_SetEventStatus
        Rte_Call_DiagUT_Event_EventParameter_DTC_0xe00142_Event_SetEventStatusWithEnvdata: implemented-entry=Rte_Call_DiagUT_Event_EventParameter_DTC_0xe00142_Event_SetEventStatusWithEnvdata
        Rte_Call_DiagUT_Event_EventParameter_DTC_0xe26200_Event_ClearPrestoredFreezeFrame: implemented-entry=Rte_Call_DiagUT_Event_EventParameter_DTC_0xe26200_Event_ClearPrestoredFreezeFrame
        Rte_Call_DiagUT_Event_EventParameter_DTC_0xe26200_Event_PrestoreFreezeFrame: implemented-entry=Rte_Call_DiagUT_Event_EventParameter_DTC_0xe26200_Event_PrestoreFreezeFrame
        Rte_Call_DiagUT_Event_EventParameter_DTC_0xe26200_Event_ResetEventDebounceStatus: implemented-entry=Rte_Call_DiagUT_Event_EventParameter_DTC_0xe26200_Event_ResetEventDebounceStatus
        Rte_Call_DiagUT_Event_EventParameter_DTC_0xe26200_Event_ResetEventStatus: implemented-entry=Rte_Call_DiagUT_Event_EventParameter_DTC_0xe26200_Event_ResetEventStatus
        Rte_Call_DiagUT_Event_EventParameter_DTC_0xe26200_Event_SetEventStatus: implemented-entry=Rte_Call_DiagUT_Event_EventParameter_DTC_0xe26200_Event_SetEventStatus
        Rte_Call_DiagUT_Event_EventParameter_DTC_0xe26200_Event_SetEventStatusWithEnvdata: implemented-entry=Rte_Call_DiagUT_Event_EventParameter_DTC_0xe26200_Event_SetEventStatusWithEnvdata
        Rte_Call_DiagUT_EvtInfo_EventParameter_DTC_0x000001_Event_GetDTCOfEvent: implemented-entry=Rte_Call_DiagUT_EvtInfo_EventParameter_DTC_0x000001_Event_GetDTCOfEvent
        Rte_Call_DiagUT_EvtInfo_EventParameter_DTC_0x000001_Event_GetDebouncingOfEvent: implemented-entry=Rte_Call_DiagUT_EvtInfo_EventParameter_DTC_0x000001_Event_GetDebouncingOfEvent
        Rte_Call_DiagUT_EvtInfo_EventParameter_DTC_0x000001_Event_GetEventExtendedDataRecord: implemented-entry=Rte_Call_DiagUT_EvtInfo_EventParameter_DTC_0x000001_Event_GetEventExtendedDataRecord
        Rte_Call_DiagUT_EvtInfo_EventParameter_DTC_0x000001_Event_GetEventExtendedDataRecordEx: implemented-entry=Rte_Call_DiagUT_EvtInfo_EventParameter_DTC_0x000001_Event_GetEventExtendedDataRecordEx
        Rte_Call_DiagUT_EvtInfo_EventParameter_DTC_0x000001_Event_GetEventFailed: implemented-entry=Rte_Call_DiagUT_EvtInfo_EventParameter_DTC_0x000001_Event_GetEventFailed
        Rte_Call_DiagUT_EvtInfo_EventParameter_DTC_0x000001_Event_GetEventFreezeFrameData: implemented-entry=Rte_Call_DiagUT_EvtInfo_EventParameter_DTC_0x000001_Event_GetEventFreezeFrameData
        Rte_Call_DiagUT_EvtInfo_EventParameter_DTC_0x000001_Event_GetEventFreezeFrameDataEx: implemented-entry=Rte_Call_DiagUT_EvtInfo_EventParameter_DTC_0x000001_Event_GetEventFreezeFrameDataEx
        Rte_Call_DiagUT_EvtInfo_EventParameter_DTC_0x000001_Event_GetEventStatus: implemented-entry=Rte_Call_DiagUT_EvtInfo_EventParameter_DTC_0x000001_Event_GetEventStatus
        Rte_Call_DiagUT_EvtInfo_EventParameter_DTC_0x000001_Event_GetEventTested: implemented-entry=Rte_Call_DiagUT_EvtInfo_EventParameter_DTC_0x000001_Event_GetEventTested
        Rte_Call_DiagUT_EvtInfo_EventParameter_DTC_0x000001_Event_GetFaultDetectionCounter: implemented-entry=Rte_Call_DiagUT_EvtInfo_EventParameter_DTC_0x000001_Event_GetFaultDetectionCounter
        Rte_Call_DiagUT_EvtInfo_EventParameter_DTC_0x0d0400_CAN_Network_ETAS_BusOff_Event_GetDTCOfEvent: implemented-entry=Rte_Call_DiagUT_EvtInfo_EventParameter_DTC_0x0d0400_CAN_Network_ETAS_BusOff_Event_GetDTCOfEvent
        Rte_Call_DiagUT_EvtInfo_EventParameter_DTC_0x0d0400_CAN_Network_ETAS_BusOff_Event_GetDebouncingOfEvent: implemented-entry=Rte_Call_DiagUT_EvtInfo_EventParameter_DTC_0x0d0400_CAN_Network_ETAS_BusOff_Event_GetDebouncingOfEvent
        Rte_Call_DiagUT_EvtInfo_EventParameter_DTC_0x0d0400_CAN_Network_ETAS_BusOff_Event_GetEventExtendedDataRecord: implemented-entry=Rte_Call_DiagUT_EvtInfo_EventParameter_DTC_0x0d0400_CAN_Network_ETAS_BusOff_Event_GetEventExtendedDataRecord
        Rte_Call_DiagUT_EvtInfo_EventParameter_DTC_0x0d0400_CAN_Network_ETAS_BusOff_Event_GetEventExtendedDataRecordEx: implemented-entry=Rte_Call_DiagUT_EvtInfo_EventParameter_DTC_0x0d0400_CAN_Network_ETAS_BusOff_Event_GetEventExtendedDataRecordEx
        Rte_Call_DiagUT_EvtInfo_EventParameter_DTC_0x0d0400_CAN_Network_ETAS_BusOff_Event_GetEventFailed: implemented-entry=Rte_Call_DiagUT_EvtInfo_EventParameter_DTC_0x0d0400_CAN_Network_ETAS_BusOff_Event_GetEventFailed
        Rte_Call_DiagUT_EvtInfo_EventParameter_DTC_0x0d0400_CAN_Network_ETAS_BusOff_Event_GetEventFreezeFrameData: implemented-entry=Rte_Call_DiagUT_EvtInfo_EventParameter_DTC_0x0d0400_CAN_Network_ETAS_BusOff_Event_GetEventFreezeFrameData
        Rte_Call_DiagUT_EvtInfo_EventParameter_DTC_0x0d0400_CAN_Network_ETAS_BusOff_Event_GetEventFreezeFrameDataEx: implemented-entry=Rte_Call_DiagUT_EvtInfo_EventParameter_DTC_0x0d0400_CAN_Network_ETAS_BusOff_Event_GetEventFreezeFrameDataEx
        Rte_Call_DiagUT_EvtInfo_EventParameter_DTC_0x0d0400_CAN_Network_ETAS_BusOff_Event_GetEventStatus: implemented-entry=Rte_Call_DiagUT_EvtInfo_EventParameter_DTC_0x0d0400_CAN_Network_ETAS_BusOff_Event_GetEventStatus
        Rte_Call_DiagUT_EvtInfo_EventParameter_DTC_0x0d0400_CAN_Network_ETAS_BusOff_Event_GetEventTested: implemented-entry=Rte_Call_DiagUT_EvtInfo_EventParameter_DTC_0x0d0400_CAN_Network_ETAS_BusOff_Event_GetEventTested
        Rte_Call_DiagUT_EvtInfo_EventParameter_DTC_0x0d0400_CAN_Network_ETAS_BusOff_Event_GetFaultDetectionCounter: implemented-entry=Rte_Call_DiagUT_EvtInfo_EventParameter_DTC_0x0d0400_CAN_Network_ETAS_BusOff_Event_GetFaultDetectionCounter
        Rte_Call_DiagUT_EvtInfo_EventParameter_DTC_0xc07388_Event_GetDTCOfEvent: implemented-entry=Rte_Call_DiagUT_EvtInfo_EventParameter_DTC_0xc07388_Event_GetDTCOfEvent
        Rte_Call_DiagUT_EvtInfo_EventParameter_DTC_0xc07388_Event_GetDebouncingOfEvent: implemented-entry=Rte_Call_DiagUT_EvtInfo_EventParameter_DTC_0xc07388_Event_GetDebouncingOfEvent
        Rte_Call_DiagUT_EvtInfo_EventParameter_DTC_0xc07388_Event_GetEventExtendedDataRecord: implemented-entry=Rte_Call_DiagUT_EvtInfo_EventParameter_DTC_0xc07388_Event_GetEventExtendedDataRecord
        Rte_Call_DiagUT_EvtInfo_EventParameter_DTC_0xc07388_Event_GetEventExtendedDataRecordEx: implemented-entry=Rte_Call_DiagUT_EvtInfo_EventParameter_DTC_0xc07388_Event_GetEventExtendedDataRecordEx
        Rte_Call_DiagUT_EvtInfo_EventParameter_DTC_0xc07388_Event_GetEventFailed: implemented-entry=Rte_Call_DiagUT_EvtInfo_EventParameter_DTC_0xc07388_Event_GetEventFailed
        Rte_Call_DiagUT_EvtInfo_EventParameter_DTC_0xc07388_Event_GetEventFreezeFrameData: implemented-entry=Rte_Call_DiagUT_EvtInfo_EventParameter_DTC_0xc07388_Event_GetEventFreezeFrameData
        Rte_Call_DiagUT_EvtInfo_EventParameter_DTC_0xc07388_Event_GetEventFreezeFrameDataEx: implemented-entry=Rte_Call_DiagUT_EvtInfo_EventParameter_DTC_0xc07388_Event_GetEventFreezeFrameDataEx
        Rte_Call_DiagUT_EvtInfo_EventParameter_DTC_0xc07388_Event_GetEventStatus: implemented-entry=Rte_Call_DiagUT_EvtInfo_EventParameter_DTC_0xc07388_Event_GetEventStatus
        Rte_Call_DiagUT_EvtInfo_EventParameter_DTC_0xc07388_Event_GetEventTested: implemented-entry=Rte_Call_DiagUT_EvtInfo_EventParameter_DTC_0xc07388_Event_GetEventTested
        Rte_Call_DiagUT_EvtInfo_EventParameter_DTC_0xc07388_Event_GetFaultDetectionCounter: implemented-entry=Rte_Call_DiagUT_EvtInfo_EventParameter_DTC_0xc07388_Event_GetFaultDetectionCounter
        Rte_Call_DiagUT_EvtInfo_EventParameter_DTC_0xc12687_Event_GetDTCOfEvent: implemented-entry=Rte_Call_DiagUT_EvtInfo_EventParameter_DTC_0xc12687_Event_GetDTCOfEvent
        Rte_Call_DiagUT_EvtInfo_EventParameter_DTC_0xc12687_Event_GetDebouncingOfEvent: implemented-entry=Rte_Call_DiagUT_EvtInfo_EventParameter_DTC_0xc12687_Event_GetDebouncingOfEvent
        Rte_Call_DiagUT_EvtInfo_EventParameter_DTC_0xc12687_Event_GetEventExtendedDataRecord: implemented-entry=Rte_Call_DiagUT_EvtInfo_EventParameter_DTC_0xc12687_Event_GetEventExtendedDataRecord
        Rte_Call_DiagUT_EvtInfo_EventParameter_DTC_0xc12687_Event_GetEventExtendedDataRecordEx: implemented-entry=Rte_Call_DiagUT_EvtInfo_EventParameter_DTC_0xc12687_Event_GetEventExtendedDataRecordEx
        Rte_Call_DiagUT_EvtInfo_EventParameter_DTC_0xc12687_Event_GetEventFailed: implemented-entry=Rte_Call_DiagUT_EvtInfo_EventParameter_DTC_0xc12687_Event_GetEventFailed
        Rte_Call_DiagUT_EvtInfo_EventParameter_DTC_0xc12687_Event_GetEventFreezeFrameData: implemented-entry=Rte_Call_DiagUT_EvtInfo_EventParameter_DTC_0xc12687_Event_GetEventFreezeFrameData
        Rte_Call_DiagUT_EvtInfo_EventParameter_DTC_0xc12687_Event_GetEventFreezeFrameDataEx: implemented-entry=Rte_Call_DiagUT_EvtInfo_EventParameter_DTC_0xc12687_Event_GetEventFreezeFrameDataEx
        Rte_Call_DiagUT_EvtInfo_EventParameter_DTC_0xc12687_Event_GetEventStatus: implemented-entry=Rte_Call_DiagUT_EvtInfo_EventParameter_DTC_0xc12687_Event_GetEventStatus
        Rte_Call_DiagUT_EvtInfo_EventParameter_DTC_0xc12687_Event_GetEventTested: implemented-entry=Rte_Call_DiagUT_EvtInfo_EventParameter_DTC_0xc12687_Event_GetEventTested
        Rte_Call_DiagUT_EvtInfo_EventParameter_DTC_0xc12687_Event_GetFaultDetectionCounter: implemented-entry=Rte_Call_DiagUT_EvtInfo_EventParameter_DTC_0xc12687_Event_GetFaultDetectionCounter
        Rte_Call_DiagUT_EvtInfo_EventParameter_DTC_0xc14587_Event_GetDTCOfEvent: implemented-entry=Rte_Call_DiagUT_EvtInfo_EventParameter_DTC_0xc14587_Event_GetDTCOfEvent
        Rte_Call_DiagUT_EvtInfo_EventParameter_DTC_0xc14587_Event_GetDebouncingOfEvent: implemented-entry=Rte_Call_DiagUT_EvtInfo_EventParameter_DTC_0xc14587_Event_GetDebouncingOfEvent
        Rte_Call_DiagUT_EvtInfo_EventParameter_DTC_0xc14587_Event_GetEventExtendedDataRecord: implemented-entry=Rte_Call_DiagUT_EvtInfo_EventParameter_DTC_0xc14587_Event_GetEventExtendedDataRecord
        Rte_Call_DiagUT_EvtInfo_EventParameter_DTC_0xc14587_Event_GetEventExtendedDataRecordEx: implemented-entry=Rte_Call_DiagUT_EvtInfo_EventParameter_DTC_0xc14587_Event_GetEventExtendedDataRecordEx
        Rte_Call_DiagUT_EvtInfo_EventParameter_DTC_0xc14587_Event_GetEventFailed: implemented-entry=Rte_Call_DiagUT_EvtInfo_EventParameter_DTC_0xc14587_Event_GetEventFailed
        Rte_Call_DiagUT_EvtInfo_EventParameter_DTC_0xc14587_Event_GetEventFreezeFrameData: implemented-entry=Rte_Call_DiagUT_EvtInfo_EventParameter_DTC_0xc14587_Event_GetEventFreezeFrameData
        Rte_Call_DiagUT_EvtInfo_EventParameter_DTC_0xc14587_Event_GetEventFreezeFrameDataEx: implemented-entry=Rte_Call_DiagUT_EvtInfo_EventParameter_DTC_0xc14587_Event_GetEventFreezeFrameDataEx
        Rte_Call_DiagUT_EvtInfo_EventParameter_DTC_0xc14587_Event_GetEventStatus: implemented-entry=Rte_Call_DiagUT_EvtInfo_EventParameter_DTC_0xc14587_Event_GetEventStatus
        Rte_Call_DiagUT_EvtInfo_EventParameter_DTC_0xc14587_Event_GetEventTested: implemented-entry=Rte_Call_DiagUT_EvtInfo_EventParameter_DTC_0xc14587_Event_GetEventTested
        Rte_Call_DiagUT_EvtInfo_EventParameter_DTC_0xc14587_Event_GetFaultDetectionCounter: implemented-entry=Rte_Call_DiagUT_EvtInfo_EventParameter_DTC_0xc14587_Event_GetFaultDetectionCounter
        Rte_Call_DiagUT_EvtInfo_EventParameter_DTC_0xc22a87_Event_GetDTCOfEvent: implemented-entry=Rte_Call_DiagUT_EvtInfo_EventParameter_DTC_0xc22a87_Event_GetDTCOfEvent
        Rte_Call_DiagUT_EvtInfo_EventParameter_DTC_0xc22a87_Event_GetDebouncingOfEvent: implemented-entry=Rte_Call_DiagUT_EvtInfo_EventParameter_DTC_0xc22a87_Event_GetDebouncingOfEvent
        Rte_Call_DiagUT_EvtInfo_EventParameter_DTC_0xc22a87_Event_GetEventExtendedDataRecord: implemented-entry=Rte_Call_DiagUT_EvtInfo_EventParameter_DTC_0xc22a87_Event_GetEventExtendedDataRecord
        Rte_Call_DiagUT_EvtInfo_EventParameter_DTC_0xc22a87_Event_GetEventExtendedDataRecordEx: implemented-entry=Rte_Call_DiagUT_EvtInfo_EventParameter_DTC_0xc22a87_Event_GetEventExtendedDataRecordEx
        Rte_Call_DiagUT_EvtInfo_EventParameter_DTC_0xc22a87_Event_GetEventFailed: implemented-entry=Rte_Call_DiagUT_EvtInfo_EventParameter_DTC_0xc22a87_Event_GetEventFailed
        Rte_Call_DiagUT_EvtInfo_EventParameter_DTC_0xc22a87_Event_GetEventFreezeFrameData: implemented-entry=Rte_Call_DiagUT_EvtInfo_EventParameter_DTC_0xc22a87_Event_GetEventFreezeFrameData
        Rte_Call_DiagUT_EvtInfo_EventParameter_DTC_0xc22a87_Event_GetEventFreezeFrameDataEx: implemented-entry=Rte_Call_DiagUT_EvtInfo_EventParameter_DTC_0xc22a87_Event_GetEventFreezeFrameDataEx
        Rte_Call_DiagUT_EvtInfo_EventParameter_DTC_0xc22a87_Event_GetEventStatus: implemented-entry=Rte_Call_DiagUT_EvtInfo_EventParameter_DTC_0xc22a87_Event_GetEventStatus
        Rte_Call_DiagUT_EvtInfo_EventParameter_DTC_0xc22a87_Event_GetEventTested: implemented-entry=Rte_Call_DiagUT_EvtInfo_EventParameter_DTC_0xc22a87_Event_GetEventTested
        Rte_Call_DiagUT_EvtInfo_EventParameter_DTC_0xc22a87_Event_GetFaultDetectionCounter: implemented-entry=Rte_Call_DiagUT_EvtInfo_EventParameter_DTC_0xc22a87_Event_GetFaultDetectionCounter
        Rte_Call_DiagUT_EvtInfo_EventParameter_DTC_0xc41487_Event_GetDTCOfEvent: implemented-entry=Rte_Call_DiagUT_EvtInfo_EventParameter_DTC_0xc41487_Event_GetDTCOfEvent
        Rte_Call_DiagUT_EvtInfo_EventParameter_DTC_0xc41487_Event_GetDebouncingOfEvent: implemented-entry=Rte_Call_DiagUT_EvtInfo_EventParameter_DTC_0xc41487_Event_GetDebouncingOfEvent
        Rte_Call_DiagUT_EvtInfo_EventParameter_DTC_0xc41487_Event_GetEventExtendedDataRecord: implemented-entry=Rte_Call_DiagUT_EvtInfo_EventParameter_DTC_0xc41487_Event_GetEventExtendedDataRecord
        Rte_Call_DiagUT_EvtInfo_EventParameter_DTC_0xc41487_Event_GetEventExtendedDataRecordEx: implemented-entry=Rte_Call_DiagUT_EvtInfo_EventParameter_DTC_0xc41487_Event_GetEventExtendedDataRecordEx
        Rte_Call_DiagUT_EvtInfo_EventParameter_DTC_0xc41487_Event_GetEventFailed: implemented-entry=Rte_Call_DiagUT_EvtInfo_EventParameter_DTC_0xc41487_Event_GetEventFailed
        Rte_Call_DiagUT_EvtInfo_EventParameter_DTC_0xc41487_Event_GetEventFreezeFrameData: implemented-entry=Rte_Call_DiagUT_EvtInfo_EventParameter_DTC_0xc41487_Event_GetEventFreezeFrameData
        Rte_Call_DiagUT_EvtInfo_EventParameter_DTC_0xc41487_Event_GetEventFreezeFrameDataEx: implemented-entry=Rte_Call_DiagUT_EvtInfo_EventParameter_DTC_0xc41487_Event_GetEventFreezeFrameDataEx
        Rte_Call_DiagUT_EvtInfo_EventParameter_DTC_0xc41487_Event_GetEventStatus: implemented-entry=Rte_Call_DiagUT_EvtInfo_EventParameter_DTC_0xc41487_Event_GetEventStatus
        Rte_Call_DiagUT_EvtInfo_EventParameter_DTC_0xc41487_Event_GetEventTested: implemented-entry=Rte_Call_DiagUT_EvtInfo_EventParameter_DTC_0xc41487_Event_GetEventTested
        Rte_Call_DiagUT_EvtInfo_EventParameter_DTC_0xc41487_Event_GetFaultDetectionCounter: implemented-entry=Rte_Call_DiagUT_EvtInfo_EventParameter_DTC_0xc41487_Event_GetFaultDetectionCounter
        Rte_Call_DiagUT_EvtInfo_EventParameter_DTC_0xd56217_Event_GetDTCOfEvent: implemented-entry=Rte_Call_DiagUT_EvtInfo_EventParameter_DTC_0xd56217_Event_GetDTCOfEvent
        Rte_Call_DiagUT_EvtInfo_EventParameter_DTC_0xd56217_Event_GetDebouncingOfEvent: implemented-entry=Rte_Call_DiagUT_EvtInfo_EventParameter_DTC_0xd56217_Event_GetDebouncingOfEvent
        Rte_Call_DiagUT_EvtInfo_EventParameter_DTC_0xd56217_Event_GetEventExtendedDataRecord: implemented-entry=Rte_Call_DiagUT_EvtInfo_EventParameter_DTC_0xd56217_Event_GetEventExtendedDataRecord
        Rte_Call_DiagUT_EvtInfo_EventParameter_DTC_0xd56217_Event_GetEventExtendedDataRecordEx: implemented-entry=Rte_Call_DiagUT_EvtInfo_EventParameter_DTC_0xd56217_Event_GetEventExtendedDataRecordEx
        Rte_Call_DiagUT_EvtInfo_EventParameter_DTC_0xd56217_Event_GetEventFailed: implemented-entry=Rte_Call_DiagUT_EvtInfo_EventParameter_DTC_0xd56217_Event_GetEventFailed
        Rte_Call_DiagUT_EvtInfo_EventParameter_DTC_0xd56217_Event_GetEventFreezeFrameData: implemented-entry=Rte_Call_DiagUT_EvtInfo_EventParameter_DTC_0xd56217_Event_GetEventFreezeFrameData
        Rte_Call_DiagUT_EvtInfo_EventParameter_DTC_0xd56217_Event_GetEventFreezeFrameDataEx: implemented-entry=Rte_Call_DiagUT_EvtInfo_EventParameter_DTC_0xd56217_Event_GetEventFreezeFrameDataEx
        Rte_Call_DiagUT_EvtInfo_EventParameter_DTC_0xd56217_Event_GetEventStatus: implemented-entry=Rte_Call_DiagUT_EvtInfo_EventParameter_DTC_0xd56217_Event_GetEventStatus
        Rte_Call_DiagUT_EvtInfo_EventParameter_DTC_0xd56217_Event_GetEventTested: implemented-entry=Rte_Call_DiagUT_EvtInfo_EventParameter_DTC_0xd56217_Event_GetEventTested
        Rte_Call_DiagUT_EvtInfo_EventParameter_DTC_0xd56217_Event_GetFaultDetectionCounter: implemented-entry=Rte_Call_DiagUT_EvtInfo_EventParameter_DTC_0xd56217_Event_GetFaultDetectionCounter
        Rte_Call_DiagUT_EvtInfo_EventParameter_DTC_0xd56316_Event_GetDTCOfEvent: implemented-entry=Rte_Call_DiagUT_EvtInfo_EventParameter_DTC_0xd56316_Event_GetDTCOfEvent
        Rte_Call_DiagUT_EvtInfo_EventParameter_DTC_0xd56316_Event_GetDebouncingOfEvent: implemented-entry=Rte_Call_DiagUT_EvtInfo_EventParameter_DTC_0xd56316_Event_GetDebouncingOfEvent
        Rte_Call_DiagUT_EvtInfo_EventParameter_DTC_0xd56316_Event_GetEventExtendedDataRecord: implemented-entry=Rte_Call_DiagUT_EvtInfo_EventParameter_DTC_0xd56316_Event_GetEventExtendedDataRecord
        Rte_Call_DiagUT_EvtInfo_EventParameter_DTC_0xd56316_Event_GetEventExtendedDataRecordEx: implemented-entry=Rte_Call_DiagUT_EvtInfo_EventParameter_DTC_0xd56316_Event_GetEventExtendedDataRecordEx
        Rte_Call_DiagUT_EvtInfo_EventParameter_DTC_0xd56316_Event_GetEventFailed: implemented-entry=Rte_Call_DiagUT_EvtInfo_EventParameter_DTC_0xd56316_Event_GetEventFailed
        Rte_Call_DiagUT_EvtInfo_EventParameter_DTC_0xd56316_Event_GetEventFreezeFrameData: implemented-entry=Rte_Call_DiagUT_EvtInfo_EventParameter_DTC_0xd56316_Event_GetEventFreezeFrameData
        Rte_Call_DiagUT_EvtInfo_EventParameter_DTC_0xd56316_Event_GetEventFreezeFrameDataEx: implemented-entry=Rte_Call_DiagUT_EvtInfo_EventParameter_DTC_0xd56316_Event_GetEventFreezeFrameDataEx
        Rte_Call_DiagUT_EvtInfo_EventParameter_DTC_0xd56316_Event_GetEventStatus: implemented-entry=Rte_Call_DiagUT_EvtInfo_EventParameter_DTC_0xd56316_Event_GetEventStatus
        Rte_Call_DiagUT_EvtInfo_EventParameter_DTC_0xd56316_Event_GetEventTested: implemented-entry=Rte_Call_DiagUT_EvtInfo_EventParameter_DTC_0xd56316_Event_GetEventTested
        Rte_Call_DiagUT_EvtInfo_EventParameter_DTC_0xd56316_Event_GetFaultDetectionCounter: implemented-entry=Rte_Call_DiagUT_EvtInfo_EventParameter_DTC_0xd56316_Event_GetFaultDetectionCounter
        Rte_Call_DiagUT_EvtInfo_EventParameter_DTC_0xe00141_Event_GetDTCOfEvent: implemented-entry=Rte_Call_DiagUT_EvtInfo_EventParameter_DTC_0xe00141_Event_GetDTCOfEvent
        Rte_Call_DiagUT_EvtInfo_EventParameter_DTC_0xe00141_Event_GetDebouncingOfEvent: implemented-entry=Rte_Call_DiagUT_EvtInfo_EventParameter_DTC_0xe00141_Event_GetDebouncingOfEvent
        Rte_Call_DiagUT_EvtInfo_EventParameter_DTC_0xe00141_Event_GetEventExtendedDataRecord: implemented-entry=Rte_Call_DiagUT_EvtInfo_EventParameter_DTC_0xe00141_Event_GetEventExtendedDataRecord
        Rte_Call_DiagUT_EvtInfo_EventParameter_DTC_0xe00141_Event_GetEventExtendedDataRecordEx: implemented-entry=Rte_Call_DiagUT_EvtInfo_EventParameter_DTC_0xe00141_Event_GetEventExtendedDataRecordEx
        Rte_Call_DiagUT_EvtInfo_EventParameter_DTC_0xe00141_Event_GetEventFailed: implemented-entry=Rte_Call_DiagUT_EvtInfo_EventParameter_DTC_0xe00141_Event_GetEventFailed
        Rte_Call_DiagUT_EvtInfo_EventParameter_DTC_0xe00141_Event_GetEventFreezeFrameData: implemented-entry=Rte_Call_DiagUT_EvtInfo_EventParameter_DTC_0xe00141_Event_GetEventFreezeFrameData
        Rte_Call_DiagUT_EvtInfo_EventParameter_DTC_0xe00141_Event_GetEventFreezeFrameDataEx: implemented-entry=Rte_Call_DiagUT_EvtInfo_EventParameter_DTC_0xe00141_Event_GetEventFreezeFrameDataEx
        Rte_Call_DiagUT_EvtInfo_EventParameter_DTC_0xe00141_Event_GetEventStatus: implemented-entry=Rte_Call_DiagUT_EvtInfo_EventParameter_DTC_0xe00141_Event_GetEventStatus
        Rte_Call_DiagUT_EvtInfo_EventParameter_DTC_0xe00141_Event_GetEventTested: implemented-entry=Rte_Call_DiagUT_EvtInfo_EventParameter_DTC_0xe00141_Event_GetEventTested
        Rte_Call_DiagUT_EvtInfo_EventParameter_DTC_0xe00141_Event_GetFaultDetectionCounter: implemented-entry=Rte_Call_DiagUT_EvtInfo_EventParameter_DTC_0xe00141_Event_GetFaultDetectionCounter
        Rte_Call_DiagUT_EvtInfo_EventParameter_DTC_0xe00142_Event_GetDTCOfEvent: implemented-entry=Rte_Call_DiagUT_EvtInfo_EventParameter_DTC_0xe00142_Event_GetDTCOfEvent
        Rte_Call_DiagUT_EvtInfo_EventParameter_DTC_0xe00142_Event_GetDebouncingOfEvent: implemented-entry=Rte_Call_DiagUT_EvtInfo_EventParameter_DTC_0xe00142_Event_GetDebouncingOfEvent
        Rte_Call_DiagUT_EvtInfo_EventParameter_DTC_0xe00142_Event_GetEventExtendedDataRecord: implemented-entry=Rte_Call_DiagUT_EvtInfo_EventParameter_DTC_0xe00142_Event_GetEventExtendedDataRecord
        Rte_Call_DiagUT_EvtInfo_EventParameter_DTC_0xe00142_Event_GetEventExtendedDataRecordEx: implemented-entry=Rte_Call_DiagUT_EvtInfo_EventParameter_DTC_0xe00142_Event_GetEventExtendedDataRecordEx
        Rte_Call_DiagUT_EvtInfo_EventParameter_DTC_0xe00142_Event_GetEventFailed: implemented-entry=Rte_Call_DiagUT_EvtInfo_EventParameter_DTC_0xe00142_Event_GetEventFailed
        Rte_Call_DiagUT_EvtInfo_EventParameter_DTC_0xe00142_Event_GetEventFreezeFrameData: implemented-entry=Rte_Call_DiagUT_EvtInfo_EventParameter_DTC_0xe00142_Event_GetEventFreezeFrameData
        Rte_Call_DiagUT_EvtInfo_EventParameter_DTC_0xe00142_Event_GetEventFreezeFrameDataEx: implemented-entry=Rte_Call_DiagUT_EvtInfo_EventParameter_DTC_0xe00142_Event_GetEventFreezeFrameDataEx
        Rte_Call_DiagUT_EvtInfo_EventParameter_DTC_0xe00142_Event_GetEventStatus: implemented-entry=Rte_Call_DiagUT_EvtInfo_EventParameter_DTC_0xe00142_Event_GetEventStatus
        Rte_Call_DiagUT_EvtInfo_EventParameter_DTC_0xe00142_Event_GetEventTested: implemented-entry=Rte_Call_DiagUT_EvtInfo_EventParameter_DTC_0xe00142_Event_GetEventTested
        Rte_Call_DiagUT_EvtInfo_EventParameter_DTC_0xe00142_Event_GetFaultDetectionCounter: implemented-entry=Rte_Call_DiagUT_EvtInfo_EventParameter_DTC_0xe00142_Event_GetFaultDetectionCounter
        Rte_Call_DiagUT_EvtInfo_EventParameter_DTC_0xe26200_Event_GetDTCOfEvent: implemented-entry=Rte_Call_DiagUT_EvtInfo_EventParameter_DTC_0xe26200_Event_GetDTCOfEvent
        Rte_Call_DiagUT_EvtInfo_EventParameter_DTC_0xe26200_Event_GetDebouncingOfEvent: implemented-entry=Rte_Call_DiagUT_EvtInfo_EventParameter_DTC_0xe26200_Event_GetDebouncingOfEvent
        Rte_Call_DiagUT_EvtInfo_EventParameter_DTC_0xe26200_Event_GetEventExtendedDataRecord: implemented-entry=Rte_Call_DiagUT_EvtInfo_EventParameter_DTC_0xe26200_Event_GetEventExtendedDataRecord
        Rte_Call_DiagUT_EvtInfo_EventParameter_DTC_0xe26200_Event_GetEventExtendedDataRecordEx: implemented-entry=Rte_Call_DiagUT_EvtInfo_EventParameter_DTC_0xe26200_Event_GetEventExtendedDataRecordEx
        Rte_Call_DiagUT_EvtInfo_EventParameter_DTC_0xe26200_Event_GetEventFailed: implemented-entry=Rte_Call_DiagUT_EvtInfo_EventParameter_DTC_0xe26200_Event_GetEventFailed
        Rte_Call_DiagUT_EvtInfo_EventParameter_DTC_0xe26200_Event_GetEventFreezeFrameData: implemented-entry=Rte_Call_DiagUT_EvtInfo_EventParameter_DTC_0xe26200_Event_GetEventFreezeFrameData
        Rte_Call_DiagUT_EvtInfo_EventParameter_DTC_0xe26200_Event_GetEventFreezeFrameDataEx: implemented-entry=Rte_Call_DiagUT_EvtInfo_EventParameter_DTC_0xe26200_Event_GetEventFreezeFrameDataEx
        Rte_Call_DiagUT_EvtInfo_EventParameter_DTC_0xe26200_Event_GetEventStatus: implemented-entry=Rte_Call_DiagUT_EvtInfo_EventParameter_DTC_0xe26200_Event_GetEventStatus
        Rte_Call_DiagUT_EvtInfo_EventParameter_DTC_0xe26200_Event_GetEventTested: implemented-entry=Rte_Call_DiagUT_EvtInfo_EventParameter_DTC_0xe26200_Event_GetEventTested
        Rte_Call_DiagUT_EvtInfo_EventParameter_DTC_0xe26200_Event_GetFaultDetectionCounter: implemented-entry=Rte_Call_DiagUT_EvtInfo_EventParameter_DTC_0xe26200_Event_GetFaultDetectionCounter
        Rte_Call_DiagUT_GeneralEvtInfo_GetDTCOfEvent: implemented-entry=Rte_Call_DiagUT_GeneralEvtInfo_GetDTCOfEvent
        Rte_Call_DiagUT_GeneralEvtInfo_GetDebouncingOfEvent: implemented-entry=Rte_Call_DiagUT_GeneralEvtInfo_GetDebouncingOfEvent
        Rte_Call_DiagUT_GeneralEvtInfo_GetEventExtendedDataRecord: implemented-entry=Rte_Call_DiagUT_GeneralEvtInfo_GetEventExtendedDataRecord
        Rte_Call_DiagUT_GeneralEvtInfo_GetEventExtendedDataRecordEx: implemented-entry=Rte_Call_DiagUT_GeneralEvtInfo_GetEventExtendedDataRecordEx
        Rte_Call_DiagUT_GeneralEvtInfo_GetEventFailed: implemented-entry=Rte_Call_DiagUT_GeneralEvtInfo_GetEventFailed
        Rte_Call_DiagUT_GeneralEvtInfo_GetEventFreezeFrameData: implemented-entry=Rte_Call_DiagUT_GeneralEvtInfo_GetEventFreezeFrameData
        Rte_Call_DiagUT_GeneralEvtInfo_GetEventFreezeFrameDataEx: implemented-entry=Rte_Call_DiagUT_GeneralEvtInfo_GetEventFreezeFrameDataEx
        Rte_Call_DiagUT_GeneralEvtInfo_GetEventIdCausingLastDetError: implemented-entry=Rte_Call_DiagUT_GeneralEvtInfo_GetEventIdCausingLastDetError
        Rte_Call_DiagUT_GeneralEvtInfo_GetEventStatus: implemented-entry=Rte_Call_DiagUT_GeneralEvtInfo_GetEventStatus
        Rte_Call_DiagUT_GeneralEvtInfo_GetEventTested: implemented-entry=Rte_Call_DiagUT_GeneralEvtInfo_GetEventTested
        Rte_Call_DiagUT_GeneralEvtInfo_GetFaultDetectionCounter: implemented-entry=Rte_Call_DiagUT_GeneralEvtInfo_GetFaultDetectionCounter
        Rte_Call_DiagUT_OpCycle_DemOpCycle_DEM_POWER_GetCycleQualified: implemented-entry=Rte_Call_DiagUT_OpCycle_DemOpCycle_DEM_POWER_GetCycleQualified
        Rte_Call_DiagUT_OpCycle_DemOpCycle_DEM_POWER_GetOperationCycleState: implemented-entry=Rte_Call_DiagUT_OpCycle_DemOpCycle_DEM_POWER_GetOperationCycleState
        Rte_Call_DiagUT_OpCycle_DemOpCycle_DEM_POWER_SetCycleQualified: implemented-entry=Rte_Call_DiagUT_OpCycle_DemOpCycle_DEM_POWER_SetCycleQualified
        Rte_Call_DiagUT_OpCycle_DemOpCycle_DEM_POWER_SetOperationCycleState: implemented-entry=Rte_Call_DiagUT_OpCycle_DemOpCycle_DEM_POWER_SetOperationCycleState
        Rte_Call_DiagUT_StorageCond_DemStorageCondition_0_GetStorageCondition: implemented-entry=Rte_Call_DiagUT_StorageCond_DemStorageCondition_0_GetStorageCondition
        Rte_Call_DiagUT_StorageCond_DemStorageCondition_0_SetStorageCondition: implemented-entry=Rte_Call_DiagUT_StorageCond_DemStorageCondition_0_SetStorageCondition
        Rte_Call_ExeMgrUT_RP_EcuM_SelectResetTarget_GetLastShutdownTarget: implemented-entry=Rte_Call_ExeMgrUT_RP_EcuM_SelectResetTarget_GetLastShutdownTarget
        Rte_Call_ExeMgrUT_RP_EcuM_SelectResetTarget_GetShutdownCause: implemented-entry=Rte_Call_ExeMgrUT_RP_EcuM_SelectResetTarget_GetShutdownCause
        Rte_Call_ExeMgrUT_RP_EcuM_SelectResetTarget_GetShutdownTarget: implemented-entry=Rte_Call_ExeMgrUT_RP_EcuM_SelectResetTarget_GetShutdownTarget
        Rte_Call_ExeMgrUT_RP_EcuM_SelectResetTarget_SelectShutdownCause: implemented-entry=Rte_Call_ExeMgrUT_RP_EcuM_SelectResetTarget_SelectShutdownCause
        Rte_Call_ExeMgrUT_RP_EcuM_SelectResetTarget_SelectShutdownTarget: implemented-entry=Rte_Call_ExeMgrUT_RP_EcuM_SelectResetTarget_SelectShutdownTarget
        Rte_Call_NmUT_UR_ComMUser_Can_Network_ETAS_Channel_GetCurrentComMode: implemented-entry=Rte_Call_NmUT_UR_ComMUser_Can_Network_ETAS_Channel_GetCurrentComMode
        Rte_Call_NmUT_UR_ComMUser_Can_Network_ETAS_Channel_GetMaxComMode: implemented-entry=Rte_Call_NmUT_UR_ComMUser_Can_Network_ETAS_Channel_GetMaxComMode
        Rte_Call_NmUT_UR_ComMUser_Can_Network_ETAS_Channel_GetRequestedComMode: implemented-entry=Rte_Call_NmUT_UR_ComMUser_Can_Network_ETAS_Channel_GetRequestedComMode
        Rte_Call_NmUT_UR_ComMUser_Can_Network_ETAS_Channel_RequestComMode: implemented-entry=Rte_Call_NmUT_UR_ComMUser_Can_Network_ETAS_Channel_RequestComMode
        Rte_Call_NmUT_modeLimitation_LimitECUToNoComMode: implemented-entry=Rte_Call_NmUT_modeLimitation_LimitECUToNoComMode
        Rte_Call_NmUT_modeLimitation_ReadInhibitCounter: implemented-entry=Rte_Call_NmUT_modeLimitation_ReadInhibitCounter
        Rte_Call_NmUT_modeLimitation_ResetInhibitCounter: implemented-entry=Rte_Call_NmUT_modeLimitation_ResetInhibitCounter
        Rte_Call_NmUT_modeLimitation_SetECUGroupClassification: implemented-entry=Rte_Call_NmUT_modeLimitation_SetECUGroupClassification
        Rte_Call_NvMUT_RP_RequestReset_RequestReset: implemented-entry=Rte_Call_NvMUT_RP_RequestReset_RequestReset
        Rte_Call_NvMUT_RP_ResetInfo_GetLastResetInfo: implemented-entry=Rte_Call_NvMUT_RP_ResetInfo_GetLastResetInfo
        Rte_Call_NvMUT_RP_Startup_Source_GetLastStartupSource: implemented-entry=Rte_Call_NvMUT_RP_Startup_Source_GetLastStartupSource
        Rte_Call_TstM_GetStackInfo_GetStackInfo: implemented-entry=Rte_Call_TstM_GetStackInfo_GetStackInfo
        Rte_Call_WdgMUT_RP_AliveSupervision_ASW_10ms_CheckpointReached: implemented-entry=Rte_Call_WdgMUT_RP_AliveSupervision_ASW_10ms_CheckpointReached
        Rte_Call_WdgMUT_RP_Deadline_Start_ASW_10ms_CheckpointReached: implemented-entry=Rte_Call_WdgMUT_RP_Deadline_Start_ASW_10ms_CheckpointReached
        Rte_Call_WdgMUT_RP_Deadline_Stop_ASW_10ms_CheckpointReached: implemented-entry=Rte_Call_WdgMUT_RP_Deadline_Stop_ASW_10ms_CheckpointReached
        Rte_Call_WdgMUT_RP_PFM_CP0_ASW_10ms_CheckpointReached: implemented-entry=Rte_Call_WdgMUT_RP_PFM_CP0_ASW_10ms_CheckpointReached
        Rte_Call_WdgMUT_RP_PFM_CP1_ASW_10ms_CheckpointReached: implemented-entry=Rte_Call_WdgMUT_RP_PFM_CP1_ASW_10ms_CheckpointReached
        Rte_Call_WdgMUT_RP_WdgM_GlobalSupervision_GetFirstExpiredSEID: implemented-entry=Rte_Call_WdgMUT_RP_WdgM_GlobalSupervision_GetFirstExpiredSEID
        Rte_Call_WdgMUT_RP_WdgM_GlobalSupervision_GetGlobalStatus: implemented-entry=Rte_Call_WdgMUT_RP_WdgM_GlobalSupervision_GetGlobalStatus
        Rte_Call_WdgMUT_RP_WdgM_GlobalSupervision_GetMode: implemented-entry=Rte_Call_WdgMUT_RP_WdgM_GlobalSupervision_GetMode
        Rte_Call_WdgMUT_RP_WdgM_GlobalSupervision_PerformReset: implemented-entry=Rte_Call_WdgMUT_RP_WdgM_GlobalSupervision_PerformReset
        Rte_Call_WdgMUT_RP_WdgM_GlobalSupervision_SetMode: implemented-entry=Rte_Call_WdgMUT_RP_WdgM_GlobalSupervision_SetMode
        Rte_Call_WdgMUT_RP_WdgM_LocalSupervisionStatus_GetLocalStatus: implemented-entry=Rte_Call_WdgMUT_RP_WdgM_LocalSupervisionStatus_GetLocalStatus
        Rte_DecrementWaitingCount: implemented-entry=Rte_DecrementWaitingCount
        Rte_Enter_ExeMgrUT_ExeMgr_TriggerBswBg_EXCLUSIVE_AREA: implemented-entry=Rte_Enter_ExeMgrUT_ExeMgr_TriggerBswBg_EXCLUSIVE_AREA
        Rte_Exit_ExeMgrUT_ExeMgr_TriggerBswBg_EXCLUSIVE_AREA: implemented-entry=Rte_Exit_ExeMgrUT_ExeMgr_TriggerBswBg_EXCLUSIVE_AREA
        Rte_GetCurrentTaskIndex: implemented-entry=Rte_GetCurrentTaskIndex
        Rte_ImplCall_NvBlock_RP_StoreAtShutdownBlock_JobFinished: implemented-entry=Rte_ImplCall_NvBlock_RP_StoreAtShutdownBlock_JobFinished
        Rte_ImplCall_NvBlock_RP_StoreCyclicBlock_JobFinished: implemented-entry=Rte_ImplCall_NvBlock_RP_StoreCyclicBlock_JobFinished
        Rte_ImplCall_NvBlock_RP_StoreImmediateBlock_JobFinished: implemented-entry=Rte_ImplCall_NvBlock_RP_StoreImmediateBlock_JobFinished
        Rte_ImplWrite_OUTP_SWC_PP_ETAS03_Sig{10..19}_ComTx_0x55_ETAS03_Sig{10..19}_ComTx_0x55: implemented-entry=Rte_ImplWrite_OUTP_SWC_PP_ETAS03_Sig{10..19}_ComTx_0x55_ETAS03_Sig{10..19}_ComTx_0x55
        Rte_IrTrigger_ExeMgrUT_RE_ExeMgr_GetWakeupSource_ITP_GetWakeupSource: implemented-entry=Rte_IrTrigger_ExeMgrUT_RE_ExeMgr_GetWakeupSource_ITP_GetWakeupSource
        Rte_IrTrigger_ExeMgrUT_RE_ExeMgr_ValidateWakeup_ITP_ValidateWakeupSource: implemented-entry=Rte_IrTrigger_ExeMgrUT_RE_ExeMgr_ValidateWakeup_ITP_ValidateWakeupSource
        Rte_MSACbk_SW_11: implemented-entry=Rte_MSACbk_SW_11
        Rte_MSACbk_SW_12: implemented-entry=Rte_MSACbk_SW_12
        Rte_MainFunction: implemented-entry=Rte_MainFunction
        Rte_Mode_BswM_RP_BswM_MRP_SWC_AppMode_MDGP_APPMode: implemented-entry=Rte_Mode_BswM_RP_BswM_MRP_SWC_AppMode_MDGP_APPMode
        Rte_Mode_DiagUT_RR_DcmCommunicationControl_ComMChannel_Can_Network_ETAS_Channel_MDGP_DcmCommunicationControl_Can_Network_ETAS_Channel_Can_Network_ETAS: implemented-entry=Rte_Mode_DiagUT_RR_DcmCommunicationControl_ComMChannel_Can_Network_ETAS_Channel_MDGP_DcmCommunicationControl_Can_Network_ETAS_Channel_Can_Network_ETAS
        Rte_Mode_DiagUT_RR_DcmControlDTCSetting_MDGP_DcmControlDTCSetting: implemented-entry=Rte_Mode_DiagUT_RR_DcmControlDTCSetting_MDGP_DcmControlDTCSetting
        Rte_Mode_DiagUT_RR_DcmDiagnosticSessionControl_MDGP_DcmDiagnosticSessionControl: implemented-entry=Rte_Mode_DiagUT_RR_DcmDiagnosticSessionControl_MDGP_DcmDiagnosticSessionControl
        Rte_Mode_DiagUT_RR_DcmEcuReset_MDGP_DcmEcuReset: implemented-entry=Rte_Mode_DiagUT_RR_DcmEcuReset_MDGP_DcmEcuReset
        Rte_Mode_ExeMgrUT_PP_BswM_APPMode_MDGP_APPMode: implemented-entry=Rte_Mode_ExeMgrUT_PP_BswM_APPMode_MDGP_APPMode
        Rte_Mode_WdgMUT_RP_WdgM_GlobalMode_currentMode: implemented-entry=Rte_Mode_WdgMUT_RP_WdgM_GlobalMode_currentMode
        Rte_Mode_WdgMUT_RP_WdgM_WdgM_SE1_Mode_currentMode: implemented-entry=Rte_Mode_WdgMUT_RP_WdgM_WdgM_SE1_Mode_currentMode
        Rte_Prm_CalUT_RP_SpeedLimit_speedMax: implemented-entry=Rte_Prm_CalUT_RP_SpeedLimit_speedMax
        Rte_Prm_CalUT_RP_SpeedLimit_speedMin: implemented-entry=Rte_Prm_CalUT_RP_SpeedLimit_speedMin
        Rte_ReadQueue: implemented-entry=Rte_ReadQueue
        Rte_Read_Dcm_IOControlResponse_DID_0xD901_New_Data_Object_IOOperationResponse: implemented-entry=Rte_Read_Dcm_IOControlResponse_DID_0xD901_New_Data_Object_IOOperationResponse
        Rte_Read_Dcm_IOControlResponse_DID_0xE900_New_Data_Object_IOOperationResponse: implemented-entry=Rte_Read_Dcm_IOControlResponse_DID_0xE900_New_Data_Object_IOOperationResponse
        Rte_Read_Dcm_R_DataServices_DID_0x0100_New_Data_Object_Data: implemented-entry=Rte_Read_Dcm_R_DataServices_DID_0x0100_New_Data_Object_Data
        Rte_Read_Dcm_R_DataServices_DID_0x010B_Day_Data: implemented-entry=Rte_Read_Dcm_R_DataServices_DID_0x010B_Day_Data
        Rte_Read_Dcm_R_DataServices_DID_0x010B_Hour_Data: implemented-entry=Rte_Read_Dcm_R_DataServices_DID_0x010B_Hour_Data
        Rte_Read_Dcm_R_DataServices_DID_0x010B_Minute_Data: implemented-entry=Rte_Read_Dcm_R_DataServices_DID_0x010B_Minute_Data
        Rte_Read_Dcm_R_DataServices_DID_0x010B_Month_Data: implemented-entry=Rte_Read_Dcm_R_DataServices_DID_0x010B_Month_Data
        Rte_Read_Dcm_R_DataServices_DID_0x010B_Second_Data: implemented-entry=Rte_Read_Dcm_R_DataServices_DID_0x010B_Second_Data
        Rte_Read_Dcm_R_DataServices_DID_0x010B_Year_Data: implemented-entry=Rte_Read_Dcm_R_DataServices_DID_0x010B_Year_Data
        Rte_Read_Dcm_R_DataServices_DID_0x0112_New_Data_Object_Data: implemented-entry=Rte_Read_Dcm_R_DataServices_DID_0x0112_New_Data_Object_Data
        Rte_Read_Dcm_R_DataServices_DID_0xB950_New_Data_Object_Data: implemented-entry=Rte_Read_Dcm_R_DataServices_DID_0xB950_New_Data_Object_Data
        Rte_Read_Dcm_R_DataServices_DID_0xD001_New_Data_Object_Data: implemented-entry=Rte_Read_Dcm_R_DataServices_DID_0xD001_New_Data_Object_Data
        Rte_Read_Dcm_R_DataServices_DID_0xD901_New_Data_Object_Data: implemented-entry=Rte_Read_Dcm_R_DataServices_DID_0xD901_New_Data_Object_Data
        Rte_Read_Dcm_R_DataServices_DID_0xE101_New_Data_Object_Data: implemented-entry=Rte_Read_Dcm_R_DataServices_DID_0xE101_New_Data_Object_Data
        Rte_Read_Dcm_R_DataServices_DID_0xE900_New_Data_Object_Data: implemented-entry=Rte_Read_Dcm_R_DataServices_DID_0xE900_New_Data_Object_Data
        Rte_Read_Dcm_R_DataServices_DID_0xF100_New_Data_Object_1_Data: implemented-entry=Rte_Read_Dcm_R_DataServices_DID_0xF100_New_Data_Object_1_Data
        Rte_Read_Dcm_R_DataServices_DID_0xF100_New_Data_Object_Data: implemented-entry=Rte_Read_Dcm_R_DataServices_DID_0xF100_New_Data_Object_Data
        Rte_Read_Dcm_R_DataServices_DID_0xF{110..119}_New_Data_Object_Data: implemented-entry=Rte_Read_Dcm_R_DataServices_DID_0xF{110..119}_New_Data_Object_Data
        Rte_Read_Dcm_R_DataServices_DID_0xF11A_New_Data_Object_Data: implemented-entry=Rte_Read_Dcm_R_DataServices_DID_0xF11A_New_Data_Object_Data
        Rte_Read_Dcm_R_DataServices_DID_0xF11B_New_Data_Object_Data: implemented-entry=Rte_Read_Dcm_R_DataServices_DID_0xF11B_New_Data_Object_Data
        Rte_Read_Dcm_R_DataServices_DID_0xF11C_New_Data_Object_Data: implemented-entry=Rte_Read_Dcm_R_DataServices_DID_0xF11C_New_Data_Object_Data
        Rte_Read_Dcm_R_DataServices_DID_0xF11D_New_Data_Object_Data: implemented-entry=Rte_Read_Dcm_R_DataServices_DID_0xF11D_New_Data_Object_Data
        Rte_Read_Dcm_R_DataServices_DID_0xF11E_New_Data_Object_Data: implemented-entry=Rte_Read_Dcm_R_DataServices_DID_0xF11E_New_Data_Object_Data
        Rte_Read_Dcm_R_DataServices_DID_0xF11F_New_Data_Object_Data: implemented-entry=Rte_Read_Dcm_R_DataServices_DID_0xF11F_New_Data_Object_Data
        Rte_Read_Dcm_R_DataServices_DID_0xF120_New_Data_Object_Data: implemented-entry=Rte_Read_Dcm_R_DataServices_DID_0xF120_New_Data_Object_Data
        Rte_Read_Dcm_R_DataServices_DID_0xF121_New_Data_Object_Data: implemented-entry=Rte_Read_Dcm_R_DataServices_DID_0xF121_New_Data_Object_Data
        Rte_Read_Dcm_R_DataServices_DID_0xF122_New_Data_Object_2_Data: implemented-entry=Rte_Read_Dcm_R_DataServices_DID_0xF122_New_Data_Object_2_Data
        Rte_Read_Dcm_R_DataServices_DID_0xF122_New_Data_Object_Data: implemented-entry=Rte_Read_Dcm_R_DataServices_DID_0xF122_New_Data_Object_Data
        Rte_Read_Dcm_R_DataServices_DID_0xF187_New_Data_Object_Data: implemented-entry=Rte_Read_Dcm_R_DataServices_DID_0xF187_New_Data_Object_Data
        Rte_Read_Dcm_R_DataServices_DID_0xF18A_New_Data_Object_Data: implemented-entry=Rte_Read_Dcm_R_DataServices_DID_0xF18A_New_Data_Object_Data
        Rte_Read_Dcm_R_DataServices_DID_0xF18B_New_Data_Object_Data: implemented-entry=Rte_Read_Dcm_R_DataServices_DID_0xF18B_New_Data_Object_Data
        Rte_Read_Dcm_R_DataServices_DID_0xF18C_New_Data_Object_Data: implemented-entry=Rte_Read_Dcm_R_DataServices_DID_0xF18C_New_Data_Object_Data
        Rte_Read_Dcm_R_DataServices_DID_0xF190_New_Data_Object_Data: implemented-entry=Rte_Read_Dcm_R_DataServices_DID_0xF190_New_Data_Object_Data
        Rte_Read_Dcm_R_DataServices_DID_0xF192_New_Data_Object_3_Data: implemented-entry=Rte_Read_Dcm_R_DataServices_DID_0xF192_New_Data_Object_3_Data
        Rte_Read_Dcm_R_DataServices_DID_0xF192_New_Data_Object_Data: implemented-entry=Rte_Read_Dcm_R_DataServices_DID_0xF192_New_Data_Object_Data
        Rte_Read_Dcm_R_DataServices_DID_0xF194_New_Data_Object_4_Data: implemented-entry=Rte_Read_Dcm_R_DataServices_DID_0xF194_New_Data_Object_4_Data
        Rte_Read_Dcm_R_DataServices_DID_0xF194_New_Data_Object_Data: implemented-entry=Rte_Read_Dcm_R_DataServices_DID_0xF194_New_Data_Object_Data
        Rte_Read_Dcm_R_DataServices_DID_0xF198_New_Data_Object_5_Data: implemented-entry=Rte_Read_Dcm_R_DataServices_DID_0xF198_New_Data_Object_5_Data
        Rte_Read_Dcm_R_DataServices_DID_0xF198_New_Data_Object_Data: implemented-entry=Rte_Read_Dcm_R_DataServices_DID_0xF198_New_Data_Object_Data
        Rte_Read_Dcm_R_DataServices_DID_0xF1A{0..2}_New_Data_Object_Data: implemented-entry=Rte_Read_Dcm_R_DataServices_DID_0xF1A{0..2}_New_Data_Object_Data
        Rte_Read_Dcm_R_DataServices_DID_0xF1A5_New_Data_Object_Data: implemented-entry=Rte_Read_Dcm_R_DataServices_DID_0xF1A5_New_Data_Object_Data
        Rte_Read_Dcm_R_DataServices_DID_0xF1A8_New_Data_Object_Data: implemented-entry=Rte_Read_Dcm_R_DataServices_DID_0xF1A8_New_Data_Object_Data
        Rte_Read_Dcm_R_DataServices_DID_0xF1A9_New_Data_Object_Data: implemented-entry=Rte_Read_Dcm_R_DataServices_DID_0xF1A9_New_Data_Object_Data
        Rte_Read_Dcm_R_DataServices_DID_0xF1AA_New_Data_Object_Data: implemented-entry=Rte_Read_Dcm_R_DataServices_DID_0xF1AA_New_Data_Object_Data
        Rte_Read_DiagUT_IOControlRequest_DID_0xD901_New_Data_Object_IOControlRequest_DID_0xD901_New_Data_Object: implemented-entry=Rte_Read_DiagUT_IOControlRequest_DID_0xD901_New_Data_Object_IOControlRequest_DID_0xD901_New_Data_Object
        Rte_Read_DiagUT_IOControlRequest_DID_0xE900_New_Data_Object_IOControlRequest_DID_0xE900_New_Data_Object: implemented-entry=Rte_Read_DiagUT_IOControlRequest_DID_0xE900_New_Data_Object_IOControlRequest_DID_0xE900_New_Data_Object
        Rte_Read_DiagUT_R_DataServices_DID_0x0100_New_Data_Object_Data: implemented-entry=Rte_Read_DiagUT_R_DataServices_DID_0x0100_New_Data_Object_Data
        Rte_Read_DiagUT_R_DataServices_DID_0xF110_New_Data_Object_Data: implemented-entry=Rte_Read_DiagUT_R_DataServices_DID_0xF110_New_Data_Object_Data
        Rte_Read_DiagUT_R_DataServices_DID_0xF115_New_Data_Object_Data: implemented-entry=Rte_Read_DiagUT_R_DataServices_DID_0xF115_New_Data_Object_Data
        Rte_Read_DiagUT_R_DataServices_DID_0xF121_New_Data_Object_Data: implemented-entry=Rte_Read_DiagUT_R_DataServices_DID_0xF121_New_Data_Object_Data
        Rte_Read_DiagUT_R_DataServices_DID_0xF187_New_Data_Object_Data: implemented-entry=Rte_Read_DiagUT_R_DataServices_DID_0xF187_New_Data_Object_Data
        Rte_Read_DiagUT_R_DataServices_DID_0xF18B_New_Data_Object_Data: implemented-entry=Rte_Read_DiagUT_R_DataServices_DID_0xF18B_New_Data_Object_Data
        Rte_Read_DiagUT_R_DataServices_DID_0xF18C_New_Data_Object_Data: implemented-entry=Rte_Read_DiagUT_R_DataServices_DID_0xF18C_New_Data_Object_Data
        Rte_Read_DiagUT_R_DataServices_DID_0xF190_New_Data_Object_Data: implemented-entry=Rte_Read_DiagUT_R_DataServices_DID_0xF190_New_Data_Object_Data
        Rte_Read_DiagUT_R_DataServices_DID_0xF198_New_Data_Object_5_Data: implemented-entry=Rte_Read_DiagUT_R_DataServices_DID_0xF198_New_Data_Object_5_Data
        Rte_Read_DiagUT_R_DataServices_DID_0xF198_New_Data_Object_Data: implemented-entry=Rte_Read_DiagUT_R_DataServices_DID_0xF198_New_Data_Object_Data
        Rte_Read_DiagUT_R_DataServices_DID_0xF1A8_New_Data_Object_Data: implemented-entry=Rte_Read_DiagUT_R_DataServices_DID_0xF1A8_New_Data_Object_Data
        Rte_Read_DiagUT_R_DataServices_DID_0xF1A9_New_Data_Object_Data: implemented-entry=Rte_Read_DiagUT_R_DataServices_DID_0xF1A9_New_Data_Object_Data
        Rte_Read_DiagUT_R_DataServices_DID_0xF1AA_New_Data_Object_Data: implemented-entry=Rte_Read_DiagUT_R_DataServices_DID_0xF1AA_New_Data_Object_Data
        Rte_Read_INP_SWC_RP_ETAS01_Sig{00..08}_ComRx_0x81_ETAS01_Sig{00..08}_ComRx_0x81: implemented-entry=Rte_Read_INP_SWC_RP_ETAS01_Sig{00..08}_ComRx_0x81_ETAS01_Sig{00..08}_ComRx_0x81
        Rte_Read_INP_SWC_RP_ETAS02_Sig09_ComRx_0x261_ETAS02_Sig09_ComRx_0x261: implemented-entry=Rte_Read_INP_SWC_RP_ETAS02_Sig09_ComRx_0x261_ETAS02_Sig09_ComRx_0x261
        Rte_Read_INP_SWC_RP_ETAS06_Sig{34..41}_ComRx_0x456_ETAS06_Sig{34..41}_ComRx_0x456: implemented-entry=Rte_Read_INP_SWC_RP_ETAS06_Sig{34..41}_ComRx_0x456_ETAS06_Sig{34..41}_ComRx_0x456
        Rte_Read_NvMUT_PRP_CyclicNvBlock_CyclicNvBlock: implemented-entry=Rte_Read_NvMUT_PRP_CyclicNvBlock_CyclicNvBlock
        Rte_Read_NvMUT_PRP_ImmediateNvBlock_ImmediateNvBlock: implemented-entry=Rte_Read_NvMUT_PRP_ImmediateNvBlock_ImmediateNvBlock
        Rte_Read_NvMUT_PRP_ShutdownNvBlock_ShutDownNvBlock: implemented-entry=Rte_Read_NvMUT_PRP_ShutdownNvBlock_ShutDownNvBlock
        Rte_SetEvent: implemented-entry=Rte_SetEvent
        Rte_Start: implemented-entry=Rte_Start
        Rte_Stop: implemented-entry=Rte_Stop
        Rte_SwitchAck_WdgM_globalMode_currentMode: implemented-entry=Rte_SwitchAck_WdgM_globalMode_currentMode
        Rte_SwitchAck_WdgM_mode_WdgM_SE1_currentMode: implemented-entry=Rte_SwitchAck_WdgM_mode_WdgM_SE1_currentMode
        Rte_Switch_ComM_UM_ComMUser_Can_Network_ETAS_Channel_Can_Network_ETAS_currentMode: implemented-entry=Rte_Switch_ComM_UM_ComMUser_Can_Network_ETAS_Channel_Can_Network_ETAS_currentMode
        Rte_Switch_Dcm_Pp_DcmCommunicationControl_Can_Network_ETAS_Channel_Can_Network_ETAS_MDGP_DcmCommunicationControl_Can_Network_ETAS_Channel_Can_Network_ETAS: implemented-entry=Rte_Switch_Dcm_Pp_DcmCommunicationControl_Can_Network_ETAS_Channel_Can_Network_ETAS_MDGP_DcmCommunicationControl_Can_Network_ETAS_Channel_Can_Network_ETAS
        Rte_Switch_Dcm_Pp_DcmControlDTCSetting_MDGP_DcmControlDTCSetting: implemented-entry=Rte_Switch_Dcm_Pp_DcmControlDTCSetting_MDGP_DcmControlDTCSetting
        Rte_Switch_Dcm_Pp_DcmDiagnosticSessionControl_MDGP_DcmDiagnosticSessionControl: implemented-entry=Rte_Switch_Dcm_Pp_DcmDiagnosticSessionControl_MDGP_DcmDiagnosticSessionControl
        Rte_Switch_Dcm_Pp_DcmEcuReset_MDGP_DcmEcuReset: implemented-entry=Rte_Switch_Dcm_Pp_DcmEcuReset_MDGP_DcmEcuReset
        Rte_Switch_ExeMgrUT_PP_BswM_APPMode_MDGP_APPMode: implemented-entry=Rte_Switch_ExeMgrUT_PP_BswM_APPMode_MDGP_APPMode
        Rte_Switch_WdgM_globalMode_currentMode: implemented-entry=Rte_Switch_WdgM_globalMode_currentMode
        Rte_Switch_WdgM_mode_WdgM_SE1_currentMode: implemented-entry=Rte_Switch_WdgM_mode_WdgM_SE1_currentMode
        Rte_WaitWithTimeout: implemented-entry=Rte_WaitWithTimeout
        Rte_WriteQueue: implemented-entry=Rte_WriteQueue
        Rte_Write_Dcm_IOControlRequest_DID_0xD901_New_Data_Object_IOControlRequest_DID_0xD901_New_Data_Object: implemented-entry=Rte_Write_Dcm_IOControlRequest_DID_0xD901_New_Data_Object_IOControlRequest_DID_0xD901_New_Data_Object
        Rte_Write_Dcm_IOControlRequest_DID_0xE900_New_Data_Object_IOControlRequest_DID_0xE900_New_Data_Object: implemented-entry=Rte_Write_Dcm_IOControlRequest_DID_0xE900_New_Data_Object_IOControlRequest_DID_0xE900_New_Data_Object
        Rte_Write_Dcm_P_DataServices_DID_0x0100_New_Data_Object_Data: implemented-entry=Rte_Write_Dcm_P_DataServices_DID_0x0100_New_Data_Object_Data
        Rte_Write_Dcm_P_DataServices_DID_0xF110_New_Data_Object_Data: implemented-entry=Rte_Write_Dcm_P_DataServices_DID_0xF110_New_Data_Object_Data
        Rte_Write_Dcm_P_DataServices_DID_0xF115_New_Data_Object_Data: implemented-entry=Rte_Write_Dcm_P_DataServices_DID_0xF115_New_Data_Object_Data
        Rte_Write_Dcm_P_DataServices_DID_0xF121_New_Data_Object_Data: implemented-entry=Rte_Write_Dcm_P_DataServices_DID_0xF121_New_Data_Object_Data
        Rte_Write_Dcm_P_DataServices_DID_0xF187_New_Data_Object_Data: implemented-entry=Rte_Write_Dcm_P_DataServices_DID_0xF187_New_Data_Object_Data
        Rte_Write_Dcm_P_DataServices_DID_0xF18B_New_Data_Object_Data: implemented-entry=Rte_Write_Dcm_P_DataServices_DID_0xF18B_New_Data_Object_Data
        Rte_Write_Dcm_P_DataServices_DID_0xF18C_New_Data_Object_Data: implemented-entry=Rte_Write_Dcm_P_DataServices_DID_0xF18C_New_Data_Object_Data
        Rte_Write_Dcm_P_DataServices_DID_0xF190_New_Data_Object_Data: implemented-entry=Rte_Write_Dcm_P_DataServices_DID_0xF190_New_Data_Object_Data
        Rte_Write_Dcm_P_DataServices_DID_0xF198_New_Data_Object_5_Data: implemented-entry=Rte_Write_Dcm_P_DataServices_DID_0xF198_New_Data_Object_5_Data
        Rte_Write_Dcm_P_DataServices_DID_0xF198_New_Data_Object_Data: implemented-entry=Rte_Write_Dcm_P_DataServices_DID_0xF198_New_Data_Object_Data
        Rte_Write_Dcm_P_DataServices_DID_0xF1A8_New_Data_Object_Data: implemented-entry=Rte_Write_Dcm_P_DataServices_DID_0xF1A8_New_Data_Object_Data
        Rte_Write_Dcm_P_DataServices_DID_0xF1A9_New_Data_Object_Data: implemented-entry=Rte_Write_Dcm_P_DataServices_DID_0xF1A9_New_Data_Object_Data
        Rte_Write_Dcm_P_DataServices_DID_0xF1AA_New_Data_Object_Data: implemented-entry=Rte_Write_Dcm_P_DataServices_DID_0xF1AA_New_Data_Object_Data
        Rte_Write_DiagUT_IOControlResponse_DID_0xD901_New_Data_Object_IOOperationResponse: implemented-entry=Rte_Write_DiagUT_IOControlResponse_DID_0xD901_New_Data_Object_IOOperationResponse
        Rte_Write_DiagUT_IOControlResponse_DID_0xE900_New_Data_Object_IOOperationResponse: implemented-entry=Rte_Write_DiagUT_IOControlResponse_DID_0xE900_New_Data_Object_IOOperationResponse
        Rte_Write_DiagUT_P_DataServices_DID_0x0100_New_Data_Object_Data: implemented-entry=Rte_Write_DiagUT_P_DataServices_DID_0x0100_New_Data_Object_Data
        Rte_Write_DiagUT_P_DataServices_DID_0x010B_Day_Data: implemented-entry=Rte_Write_DiagUT_P_DataServices_DID_0x010B_Day_Data
        Rte_Write_DiagUT_P_DataServices_DID_0x010B_Hour_Data: implemented-entry=Rte_Write_DiagUT_P_DataServices_DID_0x010B_Hour_Data
        Rte_Write_DiagUT_P_DataServices_DID_0x010B_Minute_Data: implemented-entry=Rte_Write_DiagUT_P_DataServices_DID_0x010B_Minute_Data
        Rte_Write_DiagUT_P_DataServices_DID_0x010B_Month_Data: implemented-entry=Rte_Write_DiagUT_P_DataServices_DID_0x010B_Month_Data
        Rte_Write_DiagUT_P_DataServices_DID_0x010B_Second_Data: implemented-entry=Rte_Write_DiagUT_P_DataServices_DID_0x010B_Second_Data
        Rte_Write_DiagUT_P_DataServices_DID_0x010B_Year_Data: implemented-entry=Rte_Write_DiagUT_P_DataServices_DID_0x010B_Year_Data
        Rte_Write_DiagUT_P_DataServices_DID_0x0112_New_Data_Object_Data: implemented-entry=Rte_Write_DiagUT_P_DataServices_DID_0x0112_New_Data_Object_Data
        Rte_Write_DiagUT_P_DataServices_DID_0xB950_New_Data_Object_Data: implemented-entry=Rte_Write_DiagUT_P_DataServices_DID_0xB950_New_Data_Object_Data
        Rte_Write_DiagUT_P_DataServices_DID_0xD001_New_Data_Object_Data: implemented-entry=Rte_Write_DiagUT_P_DataServices_DID_0xD001_New_Data_Object_Data
        Rte_Write_DiagUT_P_DataServices_DID_0xD901_New_Data_Object_Data: implemented-entry=Rte_Write_DiagUT_P_DataServices_DID_0xD901_New_Data_Object_Data
        Rte_Write_DiagUT_P_DataServices_DID_0xE101_New_Data_Object_Data: implemented-entry=Rte_Write_DiagUT_P_DataServices_DID_0xE101_New_Data_Object_Data
        Rte_Write_DiagUT_P_DataServices_DID_0xE900_New_Data_Object_Data: implemented-entry=Rte_Write_DiagUT_P_DataServices_DID_0xE900_New_Data_Object_Data
        Rte_Write_DiagUT_P_DataServices_DID_0xF100_New_Data_Object_1_Data: implemented-entry=Rte_Write_DiagUT_P_DataServices_DID_0xF100_New_Data_Object_1_Data
        Rte_Write_DiagUT_P_DataServices_DID_0xF100_New_Data_Object_Data: implemented-entry=Rte_Write_DiagUT_P_DataServices_DID_0xF100_New_Data_Object_Data
        Rte_Write_DiagUT_P_DataServices_DID_0xF{110..119}_New_Data_Object_Data: implemented-entry=Rte_Write_DiagUT_P_DataServices_DID_0xF{110..119}_New_Data_Object_Data
        Rte_Write_DiagUT_P_DataServices_DID_0xF11A_New_Data_Object_Data: implemented-entry=Rte_Write_DiagUT_P_DataServices_DID_0xF11A_New_Data_Object_Data
        Rte_Write_DiagUT_P_DataServices_DID_0xF11B_New_Data_Object_Data: implemented-entry=Rte_Write_DiagUT_P_DataServices_DID_0xF11B_New_Data_Object_Data
        Rte_Write_DiagUT_P_DataServices_DID_0xF11C_New_Data_Object_Data: implemented-entry=Rte_Write_DiagUT_P_DataServices_DID_0xF11C_New_Data_Object_Data
        Rte_Write_DiagUT_P_DataServices_DID_0xF11D_New_Data_Object_Data: implemented-entry=Rte_Write_DiagUT_P_DataServices_DID_0xF11D_New_Data_Object_Data
        Rte_Write_DiagUT_P_DataServices_DID_0xF11E_New_Data_Object_Data: implemented-entry=Rte_Write_DiagUT_P_DataServices_DID_0xF11E_New_Data_Object_Data
        Rte_Write_DiagUT_P_DataServices_DID_0xF11F_New_Data_Object_Data: implemented-entry=Rte_Write_DiagUT_P_DataServices_DID_0xF11F_New_Data_Object_Data
        Rte_Write_DiagUT_P_DataServices_DID_0xF120_New_Data_Object_Data: implemented-entry=Rte_Write_DiagUT_P_DataServices_DID_0xF120_New_Data_Object_Data
        Rte_Write_DiagUT_P_DataServices_DID_0xF121_New_Data_Object_Data: implemented-entry=Rte_Write_DiagUT_P_DataServices_DID_0xF121_New_Data_Object_Data
        Rte_Write_DiagUT_P_DataServices_DID_0xF122_New_Data_Object_2_Data: implemented-entry=Rte_Write_DiagUT_P_DataServices_DID_0xF122_New_Data_Object_2_Data
        Rte_Write_DiagUT_P_DataServices_DID_0xF122_New_Data_Object_Data: implemented-entry=Rte_Write_DiagUT_P_DataServices_DID_0xF122_New_Data_Object_Data
        Rte_Write_DiagUT_P_DataServices_DID_0xF187_New_Data_Object_Data: implemented-entry=Rte_Write_DiagUT_P_DataServices_DID_0xF187_New_Data_Object_Data
        Rte_Write_DiagUT_P_DataServices_DID_0xF18A_New_Data_Object_Data: implemented-entry=Rte_Write_DiagUT_P_DataServices_DID_0xF18A_New_Data_Object_Data
        Rte_Write_DiagUT_P_DataServices_DID_0xF18B_New_Data_Object_Data: implemented-entry=Rte_Write_DiagUT_P_DataServices_DID_0xF18B_New_Data_Object_Data
        Rte_Write_DiagUT_P_DataServices_DID_0xF18C_New_Data_Object_Data: implemented-entry=Rte_Write_DiagUT_P_DataServices_DID_0xF18C_New_Data_Object_Data
        Rte_Write_DiagUT_P_DataServices_DID_0xF190_New_Data_Object_Data: implemented-entry=Rte_Write_DiagUT_P_DataServices_DID_0xF190_New_Data_Object_Data
        Rte_Write_DiagUT_P_DataServices_DID_0xF192_New_Data_Object_3_Data: implemented-entry=Rte_Write_DiagUT_P_DataServices_DID_0xF192_New_Data_Object_3_Data
        Rte_Write_DiagUT_P_DataServices_DID_0xF192_New_Data_Object_Data: implemented-entry=Rte_Write_DiagUT_P_DataServices_DID_0xF192_New_Data_Object_Data
        Rte_Write_DiagUT_P_DataServices_DID_0xF194_New_Data_Object_4_Data: implemented-entry=Rte_Write_DiagUT_P_DataServices_DID_0xF194_New_Data_Object_4_Data
        Rte_Write_DiagUT_P_DataServices_DID_0xF194_New_Data_Object_Data: implemented-entry=Rte_Write_DiagUT_P_DataServices_DID_0xF194_New_Data_Object_Data
        Rte_Write_DiagUT_P_DataServices_DID_0xF198_New_Data_Object_5_Data: implemented-entry=Rte_Write_DiagUT_P_DataServices_DID_0xF198_New_Data_Object_5_Data
        Rte_Write_DiagUT_P_DataServices_DID_0xF198_New_Data_Object_Data: implemented-entry=Rte_Write_DiagUT_P_DataServices_DID_0xF198_New_Data_Object_Data
        Rte_Write_DiagUT_P_DataServices_DID_0xF1A{0..2}_New_Data_Object_Data: implemented-entry=Rte_Write_DiagUT_P_DataServices_DID_0xF1A{0..2}_New_Data_Object_Data
        Rte_Write_DiagUT_P_DataServices_DID_0xF1A5_New_Data_Object_Data: implemented-entry=Rte_Write_DiagUT_P_DataServices_DID_0xF1A5_New_Data_Object_Data
        Rte_Write_DiagUT_P_DataServices_DID_0xF1A8_New_Data_Object_Data: implemented-entry=Rte_Write_DiagUT_P_DataServices_DID_0xF1A8_New_Data_Object_Data
        Rte_Write_DiagUT_P_DataServices_DID_0xF1A9_New_Data_Object_Data: implemented-entry=Rte_Write_DiagUT_P_DataServices_DID_0xF1A9_New_Data_Object_Data
        Rte_Write_DiagUT_P_DataServices_DID_0xF1AA_New_Data_Object_Data: implemented-entry=Rte_Write_DiagUT_P_DataServices_DID_0xF1AA_New_Data_Object_Data
        Rte_Write_NmUT_PP_NM_Tx_Sig_NM_Tx_0x600_NM_Tx_Sig_NM_Tx_0x600: implemented-entry=Rte_Write_NmUT_PP_NM_Tx_Sig_NM_Tx_0x600_NM_Tx_Sig_NM_Tx_0x600
        Rte_Write_NmUT_PP_NmState_uint8: implemented-entry=Rte_Write_NmUT_PP_NmState_uint8
        Rte_Write_NvMUT_PRP_CyclicNvBlock_CyclicNvBlock: implemented-entry=Rte_Write_NvMUT_PRP_CyclicNvBlock_CyclicNvBlock
        Rte_Write_NvMUT_PRP_ImmediateNvBlock_ImmediateNvBlock: implemented-entry=Rte_Write_NvMUT_PRP_ImmediateNvBlock_ImmediateNvBlock
        Rte_Write_NvMUT_PRP_ShutdownNvBlock_ShutDownNvBlock: implemented-entry=Rte_Write_NvMUT_PRP_ShutdownNvBlock_ShutDownNvBlock
        Rte_Write_OUTP_SWC_PP_ETAS04_Sig{20..25}_ComTx_0x98_ETAS04_Sig{20..25}_ComTx_0x98: implemented-entry=Rte_Write_OUTP_SWC_PP_ETAS04_Sig{20..25}_ComTx_0x98_ETAS04_Sig{20..25}_ComTx_0x98
        Rte_Write_OUTP_SWC_PP_ETAS05_Sig{26..33}_ComTx_0x123_ETAS05_Sig{26..33}_ComTx_0x123: implemented-entry=Rte_Write_OUTP_SWC_PP_ETAS05_Sig{26..33}_ComTx_0x123_ETAS05_Sig{26..33}_ComTx_0x123
        Rte_memcpy: implemented-entry=Rte_memcpy
        SchM_Deinit: implemented-entry=SchM_Deinit
        SchM_IModeInit: implemented-entry=SchM_IModeInit
        SchM_Init: implemented-entry=SchM_Init
        SchM_Mode_BswM_MDGR_BswM_MRP_BSWM_MDG: implemented-entry=SchM_Mode_BswM_MDGR_BswM_MRP_BSWM_MDG
        SchM_Mode_BswM_MDGR_BswM_MRP_DCM_DiagnosticSessionControl: implemented-entry=SchM_Mode_BswM_MDGR_BswM_MRP_DCM_DiagnosticSessionControl
        SchM_Mode_BswM_MDGR_BswM_MRP_DCM_ModeNotification_EcuReset: implemented-entry=SchM_Mode_BswM_MDGR_BswM_MRP_DCM_ModeNotification_EcuReset
        SchM_Mode_Dcm_R_DcmCommunicationControl_Can_Network_ETAS_Channel_Can_Network_ETAS: implemented-entry=SchM_Mode_Dcm_R_DcmCommunicationControl_Can_Network_ETAS_Channel_Can_Network_ETAS
        SchM_Mode_WdgM_Current_WdgMSupervisionCycle: implemented-entry=SchM_Mode_WdgM_Current_WdgMSupervisionCycle
        SchM_Switch_BswM_MDGP_AUTOSAR_BswM_ModeDeclarationGroups_MDG_ECUM_STATE: implemented-entry=SchM_Switch_BswM_MDGP_AUTOSAR_BswM_ModeDeclarationGroups_MDG_ECUM_STATE
        SchM_Switch_Dcm_DcmCommunicationControl_Can_Network_ETAS_Channel_Can_Network_ETAS: implemented-entry=SchM_Switch_Dcm_DcmCommunicationControl_Can_Network_ETAS_Channel_Can_Network_ETAS
        SchM_Switch_Dcm_DcmControlDTCSetting: implemented-entry=SchM_Switch_Dcm_DcmControlDTCSetting
        SchM_Switch_Dcm_DcmDiagnosticSessionControl: implemented-entry=SchM_Switch_Dcm_DcmDiagnosticSessionControl
        SchM_Switch_Dcm_DcmEcuReset: implemented-entry=SchM_Switch_Dcm_DcmEcuReset

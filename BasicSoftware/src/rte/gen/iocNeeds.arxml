AUTOSAR XML (schema 4-2-2)
standard types defined: uint8, boolean, uint16
package /ETAS_BIP/EcucModuleConfigurationValuess
  module config Os
    IocOs (OsIoc)
      18 x OsIocCommunication:
        Rte_Rx_000000: OsIocDataTypeRef=uint8
          iocSemantic00000 (OsIocCommunicationSemantics)
            iocLastIsBest00000 (OsIocLastIsBestCommunication)
          c00000rx (OsIocReceiverProperties): OsIocReceivingOsApplicationRef=OsApp_ComCore
          c00000tx (OsIocSenderProperties): OsIocSendingOsApplicationRef=OsApp_SysCore
        Rte_Rx_000001: OsIocDataTypeRef=boolean
          iocSemantic00001 (OsIocCommunicationSemantics)
            iocLastIsBest00001 (OsIocLastIsBestCommunication)
          c00001rx (OsIocReceiverProperties): OsIocReceivingOsApplicationRef=OsApp_ComCore
          c00001tx (OsIocSenderProperties): OsIocSendingOsApplicationRef=OsApp_SysCore
        Rte_Rx_000002: OsIocDataTypeRef=uint8
          iocSemantic00002 (OsIocCommunicationSemantics)
            iocLastIsBest00002 (OsIocLastIsBestCommunication)
          c00002rx (OsIocReceiverProperties): OsIocReceivingOsApplicationRef=OsApp_ComCore
          c00002tx (OsIocSenderProperties): OsIocSendingOsApplicationRef=OsApp_SysCore
        Rte_Rx_000003: OsIocDataTypeRef=uint8
          iocSemantic00003 (OsIocCommunicationSemantics)
            iocLastIsBest00003 (OsIocLastIsBestCommunication)
          c00003rx (OsIocReceiverProperties): OsIocReceivingOsApplicationRef=OsApp_ComCore
          c00003tx (OsIocSenderProperties): OsIocSendingOsApplicationRef=OsApp_SysCore
        Rte_Rx_000004: OsIocDataTypeRef=boolean
          iocSemantic00004 (OsIocCommunicationSemantics)
            iocLastIsBest00004 (OsIocLastIsBestCommunication)
          c00004rx (OsIocReceiverProperties): OsIocReceivingOsApplicationRef=OsApp_ComCore
          c00004tx (OsIocSenderProperties): OsIocSendingOsApplicationRef=OsApp_SysCore
        Rte_Rx_000005: OsIocDataTypeRef=boolean
          iocSemantic00005 (OsIocCommunicationSemantics)
            iocLastIsBest00005 (OsIocLastIsBestCommunication)
          c00005rx (OsIocReceiverProperties): OsIocReceivingOsApplicationRef=OsApp_ComCore
          c00005tx (OsIocSenderProperties): OsIocSendingOsApplicationRef=OsApp_SysCore
        Rte_Rx_000006: OsIocDataTypeRef=uint8
          iocSemantic00006 (OsIocCommunicationSemantics)
            iocLastIsBest00006 (OsIocLastIsBestCommunication)
          c00006rx (OsIocReceiverProperties): OsIocReceivingOsApplicationRef=OsApp_ComCore
          c00006tx (OsIocSenderProperties): OsIocSendingOsApplicationRef=OsApp_SysCore
        Rte_Rx_000007: OsIocDataTypeRef=uint16
          iocSemantic00007 (OsIocCommunicationSemantics)
            iocLastIsBest00007 (OsIocLastIsBestCommunication)
          c00007rx (OsIocReceiverProperties): OsIocReceivingOsApplicationRef=OsApp_ComCore
          c00007tx (OsIocSenderProperties): OsIocSendingOsApplicationRef=OsApp_SysCore
        Rte_Rx_000008: OsIocDataTypeRef=uint16
          iocSemantic00008 (OsIocCommunicationSemantics)
            iocLastIsBest00008 (OsIocLastIsBestCommunication)
          c00008rx (OsIocReceiverProperties): OsIocReceivingOsApplicationRef=OsApp_ComCore
          c00008tx (OsIocSenderProperties): OsIocSendingOsApplicationRef=OsApp_SysCore
        Rte_Rx_000009: OsIocDataTypeRef=boolean
          iocSemantic00009 (OsIocCommunicationSemantics)
            iocLastIsBest00009 (OsIocLastIsBestCommunication)
          c00009rx (OsIocReceiverProperties): OsIocReceivingOsApplicationRef=OsApp_ComCore
          c00009tx (OsIocSenderProperties): OsIocSendingOsApplicationRef=OsApp_SysCore
        Rte_Rx_000010: OsIocDataTypeRef=uint8
          iocSemantic00010 (OsIocCommunicationSemantics)
            iocLastIsBest00010 (OsIocLastIsBestCommunication)
          c00010rx (OsIocReceiverProperties): OsIocReceivingOsApplicationRef=OsApp_ComCore
          c00010tx (OsIocSenderProperties): OsIocSendingOsApplicationRef=OsApp_SysCore
        Rte_Rx_000011: OsIocDataTypeRef=uint8
          iocSemantic00011 (OsIocCommunicationSemantics)
            iocLastIsBest00011 (OsIocLastIsBestCommunication)
          c00011rx (OsIocReceiverProperties): OsIocReceivingOsApplicationRef=OsApp_ComCore
          c00011tx (OsIocSenderProperties): OsIocSendingOsApplicationRef=OsApp_SysCore
        Rte_Rx_000012: OsIocDataTypeRef=uint8
          iocSemantic00012 (OsIocCommunicationSemantics)
            iocLastIsBest00012 (OsIocLastIsBestCommunication)
          c00012rx (OsIocReceiverProperties): OsIocReceivingOsApplicationRef=OsApp_ComCore
          c00012tx (OsIocSenderProperties): OsIocSendingOsApplicationRef=OsApp_SysCore
        Rte_Rx_000013: OsIocDataTypeRef=uint8
          iocSemantic00013 (OsIocCommunicationSemantics)
            iocLastIsBest00013 (OsIocLastIsBestCommunication)
          c00013rx (OsIocReceiverProperties): OsIocReceivingOsApplicationRef=OsApp_ComCore
          c00013tx (OsIocSenderProperties): OsIocSendingOsApplicationRef=OsApp_SysCore
        Rte_Rx_000014: OsIocDataTypeRef=uint8
          iocSemantic00014 (OsIocCommunicationSemantics)
            iocLastIsBest00014 (OsIocLastIsBestCommunication)
          c00014rx (OsIocReceiverProperties): OsIocReceivingOsApplicationRef=OsApp_ComCore
          c00014tx (OsIocSenderProperties): OsIocSendingOsApplicationRef=OsApp_SysCore
        Rte_Rx_000015: OsIocDataTypeRef=uint8
          iocSemantic00015 (OsIocCommunicationSemantics)
            iocLastIsBest00015 (OsIocLastIsBestCommunication)
          c00015rx (OsIocReceiverProperties): OsIocReceivingOsApplicationRef=OsApp_ComCore
          c00015tx (OsIocSenderProperties): OsIocSendingOsApplicationRef=OsApp_SysCore
        Rte_Rx_000016: OsIocDataTypeRef=uint8
          iocSemantic00016 (OsIocCommunicationSemantics)
            iocLastIsBest00016 (OsIocLastIsBestCommunication)
          c00016rx (OsIocReceiverProperties): OsIocReceivingOsApplicationRef=OsApp_ComCore
          c00016tx (OsIocSenderProperties): OsIocSendingOsApplicationRef=OsApp_SysCore
        Rte_Rx_000017: OsIocDataTypeRef=uint8
          iocSemantic00017 (OsIocCommunicationSemantics)
            iocLastIsBest00017 (OsIocLastIsBestCommunication)
          c00017rx (OsIocReceiverProperties): OsIocReceivingOsApplicationRef=OsApp_ComCore
          c00017tx (OsIocSenderProperties): OsIocSendingOsApplicationRef=OsApp_SysCore
  base type AUTOSAR_Platform_BaseTypes_uint8: category=FIXED_LENGTH, base-type-size=8, base-type-encoding=NONE, mem-alignment=8  # unsigned integer 8bit | This standard AUTOSAR type shall be of 8 bit unsigned.
  base type AUTOSAR_Platform_BaseTypes_boolean: category=FIXED_LENGTH, base-type-size=8, base-type-encoding=BOOLEAN  # Boolean | The boolean type shall always be mapped to a platform specific type where pointers can be applied to enable a passing of parameters via API. There are specific BIT types of some HW platforms which are very efficient but where no pointers can point to. This standard AUTOSAR type shall only be used together with the definitions TRUE and FALSE. See PLATFORM027 for implementation and usage.
  compu method AUTOSAR_Platform_CompuMethods_boolean: 0=FALSE, 1=TRUE
  base type AUTOSAR_Platform_BaseTypes_uint16: category=FIXED_LENGTH, base-type-size=16, base-type-encoding=NONE, mem-alignment=16  # unsigned integer 16bit | This standard AUTOSAR type shall be of 16 bit unsigned.

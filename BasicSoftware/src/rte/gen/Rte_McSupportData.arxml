AUTOSAR XML (schema 4-2-2)
package /AUTOSAR_Rte/BswImplementations
  bsw implementation Rte
    mc-support mc-sw-emulation-method-support=category=NONE:
      mc-parameter-instances:
        6 x mc data instance:
          SpeedLimitLower: category=VALUE, flat-map-entry=SpeedLimitLower, resulting-properties={base-type=AUTOSAR_Platform_BaseTypes_uint32, sw-calibration-access=READ-WRITE, compu-method=ETAS_BIP_CompuMethods_N1, data-constr=ETAS_BIP_DataConstrs_N1, sw-refresh-timing={cse-code=1000, cse-code-factor=1}, unit=ETAS_BIP_Units_Rpm}  # This is ETAS BIP AUTOSAR PerInstanceParameter Scalar example 1
          sharedCURVE:  # This is ETAS BIP AUTOSAR SharedParameter CURVE example
            category=CURVE
            flat-map-entry=sharedCURVE
            resulting-properties={sw-calibration-access=READ-WRITE, sw-calprm-axis-set={sw-axis-index=1, category=STD-AXIS, sw-axis-individual={input-variable-type=ETAS_BIP_ApplicationDataTypes_ADT_CurveAxis, sw-variable=curveAxisInputVar, compu-method=ETAS_BIP_CompuMethods_OneToOne, unit=ETAS_BIP_Units_DegCgrd, sw-max-axis-points=10, data-constr=ETAS_BIP_DataConstrs_DataConstrC_m300p0_300p0}, sw-calibration-access=READ-ONLY, display-format=%2.1f, base-type=AUTOSAR_Platform_BaseTypes_sint8}, compu-method=ETAS_BIP_CompuMethods_OneToOne_Curr_A, data-constr=ETAS_BIP_DataConstrs_DataConstrC_m300p0_300p0, display-format=%1.1f, sw-record-layout=ETAS_BIP_SwRecordLayouts_IntCurve_f32_f32, sw-refresh-timing={cse-code=1000, cse-code-factor=1}, unit=ETAS_BIP_Units_Ampr}
          sharedMAP:  # This is ETAS BIP AUTOSAR SharedParameter MAP example
            category=MAP
            flat-map-entry=sharedMAP
            resulting-properties={sw-calibration-access=READ-WRITE, sw-calprm-axis-set=[{sw-axis-index=1, category=STD-AXIS, sw-axis-individual={input-variable-type=ETAS_BIP_ApplicationDataTypes_ADT_MapAxisX, sw-variable=mapAxisXInputVar, compu-method=ETAS_BIP_CompuMethods_OneToOne_Volt, unit=ETAS_BIP_Units_Volt, sw-max-axis-points=10, data-constr=ETAS_BIP_DataConstrs_DataConstrC_m300p0_300p0}, sw-calibration-access=READ-WRITE, display-format=%5.1f, base-type=AUTOSAR_Platform_BaseTypes_uint16}, {sw-axis-index=2, category=STD-AXIS, sw-axis-individual={input-variable-type=ETAS_BIP_ApplicationDataTypes_ADT_MapAxisY, sw-variable=mapAxisYInputVar, compu-method=ETAS_BIP_CompuMethods_OneToOne_Perc, unit=ETAS_BIP_Units_Perc, sw-max-axis-points=10, data-constr=ETAS_BIP_DataConstrs_DataConstrC_m400p0_390p0}, sw-calibration-access=READ-WRITE, display-format=%6.1f, base-type=AUTOSAR_Platform_BaseTypes_sint16}], compu-method=ETAS_BIP_CompuMethods_OneToOne_Curr_A, data-constr=ETAS_BIP_DataConstrs_DataConstrC_m3p4E38_3p4E38, display-format=%4.1f, sw-record-layout=ETAS_BIP_SwRecordLayouts_IntMap_f32f32_f32, sw-refresh-timing={cse-code=1000, cse-code-factor=1}, unit=ETAS_BIP_Units_Ampr}
          SpeedLimitUpper: category=VALUE, flat-map-entry=SpeedLimitUpper, resulting-properties={base-type=AUTOSAR_Platform_BaseTypes_uint32, sw-calibration-access=READ-WRITE, compu-method=ETAS_BIP_CompuMethods_N1, data-constr=ETAS_BIP_DataConstrs_N1, sw-refresh-timing={cse-code=1000, cse-code-factor=1}, unit=ETAS_BIP_Units_Rpm}  # This is ETAS BIP AUTOSAR PerInstanceParameter Scalar example 2
          speedMax: category=VALUE, flat-map-entry=speedMax, resulting-properties={base-type=AUTOSAR_Platform_BaseTypes_uint32, sw-calibration-access=READ-WRITE, compu-method=ETAS_BIP_CompuMethods_N1, data-constr=ETAS_BIP_DataConstrs_N1, unit=ETAS_BIP_Units_Rpm}  # This is ETAS BIP AUTOSAR Interface Scalar example 2
          speedMin: category=VALUE, flat-map-entry=speedMin, resulting-properties={base-type=AUTOSAR_Platform_BaseTypes_uint32, sw-calibration-access=READ-WRITE, compu-method=ETAS_BIP_CompuMethods_N1, data-constr=ETAS_BIP_DataConstrs_N1, unit=ETAS_BIP_Units_Rpm}  # This is ETAS BIP AUTOSAR Interface Scalar example 1
      mc-variable-instances:
        7 x mc data instance:
          curveAxisInputVar: category=VALUE, resulting-properties={base-type=AUTOSAR_Platform_BaseTypes_sint8, sw-calibration-access=READ-WRITE}  # signed integer 8bit
          mapAxisXInputVar: category=VALUE, resulting-properties={base-type=AUTOSAR_Platform_BaseTypes_uint16, sw-calibration-access=READ-ONLY}  # unsigned integer 16bit
          mapAxisYInputVar: category=VALUE, resulting-properties={base-type=AUTOSAR_Platform_BaseTypes_sint16, sw-calibration-access=READ-ONLY}  # signed integer 16bit
          ArTypedPIM_1: category=VALUE, flat-map-entry=ArTypedPIM_1, resulting-properties={base-type=AUTOSAR_Platform_BaseTypes_uint32, sw-calibration-access=READ-ONLY, compu-method=ETAS_BIP_CompuMethods_N1, data-constr=ETAS_BIP_DataConstrs_N1, sw-refresh-timing={cse-code=1000, cse-code-factor=1}, unit=ETAS_BIP_Units_Rpm}, symbol=Rte_ArPim_CalUT_ArTypedPIM_1  # This is ETAS BIP AUTOSAR Typed PerInstance Memory Variable example
          CyclicNvBlock: category=ARRAY, array-size=1024, flat-map-entry=CyclicNvBlock, resulting-properties=sw-calibration-access=READ-ONLY, symbol=Rte_RamBlk_NvBlock_NvBlockDescriptor_StoreCyclicBlock_CyclicRamBlock
            1024 x mc data instance, all with category=VALUE, resulting-properties={base-type=AUTOSAR_Platform_BaseTypes_uint8, sw-calibration-access=READ-ONLY, compu-method=RB_RBA_Common_CentralElements_CompuMethods_Identical, unit=RB_RBA_Common_CentralElements_Units_NoUnit}:
              element_{0..1023}
          ImmediateNvBlock: category=ARRAY, array-size=96, flat-map-entry=ImmediateNvBlock, resulting-properties=sw-calibration-access=READ-ONLY, symbol=Rte_RamBlk_NvBlock_NvBlockDescriptor_StoreImmediateBlock_ImmediateRamBlock
            96 x mc data instance, all with category=VALUE, resulting-properties={base-type=AUTOSAR_PlatformTypes_SwBaseTypes_uint32, sw-calibration-access=READ-ONLY, compu-method=RB_RBA_Common_CentralElements_CompuMethods_Identical, unit=RB_RBA_Common_CentralElements_Units_NoUnit}:
              element_{0..95}
          ShutDownNvBlock: category=ARRAY, array-size=96, flat-map-entry=ShutDownNvBlock, resulting-properties=sw-calibration-access=READ-ONLY, symbol=Rte_RamBlk_NvBlock_NvBlockDescriptor_StoreAtShutdownBlock_ShutdownRamBlock
            96 x mc data instance, all with category=VALUE, resulting-properties={base-type=AUTOSAR_PlatformTypes_SwBaseTypes_boolean, sw-calibration-access=READ-ONLY, compu-method=AUTOSAR_PlatformTypes_CompuMethods_boolean}:
              element_{0..95}
package /AUTOSAR_Rte/ApplicationPrimitiveDataTypes
  app type ETAS_BIP_ApplicationDataTypes_ADT_CurveAxis: category=VALUE, sw-calibration-access=READ-WRITE
  app type ETAS_BIP_ApplicationDataTypes_ADT_MapAxisX: category=VALUE, sw-calibration-access=READ-ONLY
  app type ETAS_BIP_ApplicationDataTypes_ADT_MapAxisY: category=VALUE, sw-calibration-access=READ-ONLY
package /AUTOSAR_Rte/Units
  25 x unit:
    ETAS_BIP_Units_Rpm: display-name=rpm  # LongName of Rpm | Desc of Rpm
    ETAS_BIP_Units_NoUnit: display-name=-  # The imported MSR Element did not contain any description. Therefore this information was inserted while generating the corresponding ARElement
    ETAS_BIP_Units_DegCgrd: display-name=degC  # The imported MSR Element did not contain any description. Therefore this information was inserted while generating the corresponding ARElement
    ETAS_BIP_Units_Ampr: display-name=A  # The imported MSR Element did not contain any description. Therefore this information was inserted while generating the corresponding ARElement
    ETAS_BIP_Units_Volt: display-name=V  # The imported MSR Element did not contain any description. Therefore this information was inserted while generating the corresponding ARElement
    ETAS_BIP_Units_Perc: display-name=%  # The imported MSR Element did not contain any description. Therefore this information was inserted while generating the corresponding ARElement
    RB_RBA_Common_CentralElements_Units_NoUnit: display-name=noUnit, factor-si-to-unit=1.0, offset-si-to-unit=0.0, physical-dimension=RB_RBA_Common_CentralElements_PhysicalDimensions_NoUnit  # No Unit
    SysDesc_Pkg_Units_deg
    SysDesc_Pkg_Units_V
    SysDesc_Pkg_Units_A
    SysDesc_Pkg_Units_Nm
    SysDesc_Pkg_Units_rpm
    AUTOSAR_CanIf_Units_NoUnit: display-name=noUnit, factor-si-to-unit=1.0, offset-si-to-unit=0.0, physical-dimension=AUTOSAR_CanIf_PhysicalDimensions_NoUnit  # No Unit
    AUTOSAR_CanNm_Units_NoUnit: display-name=noUnit, factor-si-to-unit=1.0, offset-si-to-unit=0.0, physical-dimension=AUTOSAR_CanNm_PhysicalDimensions_NoUnit  # No Unit
    AUTOSAR_CanSM_Units_NoUnit: display-name=noUnit, factor-si-to-unit=1.0, offset-si-to-unit=0.0, physical-dimension=AUTOSAR_CanSM_PhysicalDimensions_NoUnit  # No Unit
    AUTOSAR_ComM_Units_NoUnit: display-name=noUnit, factor-si-to-unit=1.0, offset-si-to-unit=0.0, physical-dimension=AUTOSAR_ComM_PhysicalDimensions_NoUnit  # No Unit
    AUTOSAR_Com_Units_NoUnit: display-name=noUnit, factor-si-to-unit=1.0, offset-si-to-unit=0.0, physical-dimension=AUTOSAR_Com_PhysicalDimensions_NoUnit  # No Unit
    AUTOSAR_Nm_Units_NoUnit: display-name=noUnit, factor-si-to-unit=1.0, offset-si-to-unit=0.0, physical-dimension=AUTOSAR_Nm_PhysicalDimensions_NoUnit  # No Unit
    AUTOSAR_NvM_Units_NoUnit: display-name=noUnit, factor-si-to-unit=1.0, offset-si-to-unit=0.0, physical-dimension=AUTOSAR_NvM_PhysicalDimensions_NoUnit  # No Unit
    AUTOSAR_PduR_Units_NoUnit: display-name=noUnit, factor-si-to-unit=1.0, offset-si-to-unit=0.0, physical-dimension=AUTOSAR_PduR_PhysicalDimensions_NoUnit  # No Unit
    AUTOSAR_Xcp_Units_NoUnit: display-name=noUnit, factor-si-to-unit=1.0, offset-si-to-unit=0.0, physical-dimension=AUTOSAR_Xcp_PhysicalDimensions_NoUnit  # No Unit
    RB_RBA_rba_MemLib_Units_Mem_NoUnit: display-name=Mem_NoUnit, factor-si-to-unit=1.0, offset-si-to-unit=0.0, physical-dimension=RB_RBA_rba_MemLib_PhysicalDimensions_Mem_NoPhysDim  # Mem No Unit / 1:1 / Identical
    ETAS_BIP_BswModuleDescriptions_Units_Microseconds  # Microseconds
    ETAS_BIP_BswModuleDescriptions_Units_PerCent  # Percent
    Units_No_Unit
package /AUTOSAR_Rte/CompuMethods
  compu method ETAS_BIP_CompuMethods_N1: raw=phys*0.5; unit ETAS_BIP_Units_Rpm  # LongName of N1 | Descr of N1 - Generic rotational speed data type 1
  compu method ETAS_BIP_CompuMethods_OneToOne: phys=raw; unit ETAS_BIP_Units_NoUnit  # The imported MSR Element did not contain any description. Therefore this information was inserted while generating the corresponding ARElement
  compu method ETAS_BIP_CompuMethods_OneToOne_Curr_A: phys=raw; unit ETAS_BIP_Units_Ampr  # The imported MSR Element did not contain any description. Therefore this information was inserted while generating the corresponding ARElement
  compu method ETAS_BIP_CompuMethods_OneToOne_Volt: phys=raw; unit ETAS_BIP_Units_Volt  # The imported MSR Element did not contain any description. Therefore this information was inserted while generating the corresponding ARElement
  compu method ETAS_BIP_CompuMethods_OneToOne_Perc: phys=raw; unit ETAS_BIP_Units_Perc  # The imported MSR Element did not contain any description. Therefore this information was inserted while generating the corresponding ARElement
  compu method RB_RBA_Common_CentralElements_CompuMethods_Identical: identical; unit RB_RBA_Common_CentralElements_Units_NoUnit  # The internal value and the physical one are identical. No physical unit available
  compu method AUTOSAR_PlatformTypes_CompuMethods_boolean: 0=FALSE, 1=TRUE
package /AUTOSAR_Rte/DataConstrs
  range ETAS_BIP_DataConstrs_N1: phys 0..16383.5
  range ETAS_BIP_DataConstrs_DataConstrC_m300p0_300p0: phys -300..300, raw -300..300  # The imported MSR Element did not contain any description. Therefore this information was inserted while generating the corresponding ARElement
  range ETAS_BIP_DataConstrs_DataConstrC_m400p0_390p0: phys -400..390, raw -400..390  # The imported MSR Element did not contain any description. Therefore this information was inserted while generating the corresponding ARElement
  range ETAS_BIP_DataConstrs_DataConstrC_m3p4E38_3p4E38: phys -3.4e+38..3.4e+38, raw -3.4e+38..3.4e+38  # The imported MSR Element did not contain any description. Therefore this information was inserted while generating the corresponding ARElement
package /AUTOSAR_Rte/PhysicalDimensions
  11 x physical dimension, all with length-exp=0:
    RB_RBA_Common_CentralElements_PhysicalDimensions_NoUnit
    AUTOSAR_CanIf_PhysicalDimensions_NoUnit
    AUTOSAR_CanNm_PhysicalDimensions_NoUnit
    AUTOSAR_CanSM_PhysicalDimensions_NoUnit
    AUTOSAR_ComM_PhysicalDimensions_NoUnit
    AUTOSAR_Com_PhysicalDimensions_NoUnit
    AUTOSAR_Nm_PhysicalDimensions_NoUnit
    AUTOSAR_NvM_PhysicalDimensions_NoUnit
    AUTOSAR_PduR_PhysicalDimensions_NoUnit
    AUTOSAR_Xcp_PhysicalDimensions_NoUnit
    RB_RBA_rba_MemLib_PhysicalDimensions_Mem_NoPhysDim
package /AUTOSAR_Rte/SwBaseTypes
  9 x base type, all with category=FIXED_LENGTH:
    AUTOSAR_Platform_BaseTypes_uint32: base-type-size=32, base-type-encoding=NONE, mem-alignment=32  # unsigned integer 32bit | This standard AUTOSAR type shall be 32 bit unsigned
    AUTOSAR_Platform_BaseTypes_sint8: base-type-size=8, base-type-encoding=2C, mem-alignment=8  # signed integer 8bit | This standard AUTOSAR type shall be 8 bit signed
    AUTOSAR_Platform_SwBaseTypes_uint32: base-type-size=32, base-type-encoding=NONE, mem-alignment=32  # unsigned integer 32bit | This standard AUTOSAR type shall be 32 bit unsigned
    AUTOSAR_Platform_SwBaseTypes_float32: base-type-size=32, base-type-encoding=IEEE754, mem-alignment=32  # Float | This standard AUTOSAR type shall follow the 32-bit binary interchange format according to IEEE 754-2008 with encoding parameters specified in chapter 3.6, table 3.5, column"binary32".
    AUTOSAR_Platform_BaseTypes_uint16: base-type-size=16, base-type-encoding=NONE, mem-alignment=16  # unsigned integer 16bit | This standard AUTOSAR type shall be of 16 bit unsigned.
    AUTOSAR_Platform_BaseTypes_sint16: base-type-size=16, base-type-encoding=2C, mem-alignment=16  # signed integer 16bit | This standard AUTOSAR type shall be 16 bit signed.
    AUTOSAR_Platform_BaseTypes_uint8: base-type-size=8, base-type-encoding=NONE, mem-alignment=8  # unsigned integer 8bit | This standard AUTOSAR type shall be of 8 bit unsigned.
    AUTOSAR_PlatformTypes_SwBaseTypes_uint32: base-type-size=32, base-type-encoding=NONE, mem-alignment=32  # unsigned integer 32bit | This standard AUTOSAR type shall be 32 bit unsigned
    AUTOSAR_PlatformTypes_SwBaseTypes_boolean: base-type-size=8, base-type-encoding=BOOLEAN  # Boolean | The boolean type shall always be mapped to a platform specific type where pointers can be applied to enable a passing of parameters via API. There are specific BIT types of some HW platforms which are very efficient but where no pointers can point to. This standard AUTOSAR type shall only be used together with the definitions TRUE and FALSE. See PLATFORM027 for implementation and usage.
package /AUTOSAR_Rte/SwRecordLayouts
  sw record layout ETAS_BIP_SwRecordLayouts_IntCurve_f32_f32: sw-record-layout-group={sw-record-layout-v={short-label=N, base-type=AUTOSAR_Platform_SwBaseTypes_uint32, sw-record-layout-v-axis=1, sw-record-layout-v-prop=COUNT}, sw-record-layout-group={short-label=X, category=INDEX_INCR, sw-record-layout-group-axis=1, sw-record-layout-group-index=X, sw-record-layout-group-from=1, sw-record-layout-group-to=-1, sw-record-layout-v={base-type=AUTOSAR_Platform_SwBaseTypes_float32, sw-record-layout-v-axis=1, sw-record-layout-v-prop=VALUE}}, sw-record-layout-group={short-label=Val, category=COLUMN_DIR, sw-record-layout-group-axis=0, sw-record-layout-group-from=1, sw-record-layout-group-to=-1, sw-record-layout-v={base-type=AUTOSAR_Platform_SwBaseTypes_float32, sw-record-layout-v-axis=0, sw-record-layout-v-prop=VALUE, sw-record-layout-v-index=X}}}
  sw record layout ETAS_BIP_SwRecordLayouts_IntMap_f32f32_f32: sw-record-layout-group={sw-record-layout-v={short-label=Nx, base-type=AUTOSAR_Platform_SwBaseTypes_uint32, sw-record-layout-v-axis=1, sw-record-layout-v-prop=COUNT}, sw-record-layout-v={short-label=Ny, base-type=AUTOSAR_Platform_SwBaseTypes_uint32, sw-record-layout-v-axis=2, sw-record-layout-v-prop=COUNT}, sw-record-layout-group={short-label=X, category=INDEX_INCR, sw-record-layout-group-axis=1, sw-record-layout-group-index=X, sw-record-layout-group-from=1, sw-record-layout-group-to=-1, sw-record-layout-v={base-type=AUTOSAR_Platform_SwBaseTypes_float32, sw-record-layout-v-axis=1, sw-record-layout-v-prop=VALUE}}, sw-record-layout-group={short-label=Y, category=INDEX_INCR, sw-record-layout-group-axis=2, sw-record-layout-group-index=Y, sw-record-layout-group-from=1, sw-record-layout-group-to=-1, sw-record-layout-v={base-type=AUTOSAR_Platform_SwBaseTypes_float32, sw-record-layout-v-axis=2, sw-record-layout-v-prop=VALUE}}, sw-record-layout-group={short-label=Val, category=COLUMN_DIR, sw-record-layout-group-axis=1, sw-record-layout-group-index=X, sw-record-layout-group-from=1, sw-record-layout-group-to=-1, sw-record-layout-group={sw-record-layout-group-axis=2, sw-record-layout-group-index=Y, sw-record-layout-group-from=1, sw-record-layout-group-to=-1, sw-record-layout-v={base-type=AUTOSAR_Platform_SwBaseTypes_float32, sw-record-layout-v-axis=0, sw-record-layout-v-prop=VALUE, sw-record-layout-v-index=X Y}}}}

AUTOSAR XML (schema 4-2-2)
package /Interfaces
  7 x sender receiver interface:
    ETAS_SenderReceiverInterface_uint16
      data uint16: type=uint16
    ETAS_SenderReceiverInterface_sint8
      data sint8: type=sint8
    ETAS_SenderReceiverInterface_uint32
      data uint32: type=uint32
    ETAS_SenderReceiverInterface_sint32
      data sint32: type=sint32
    ETAS_SenderReceiverInterface_uint8
      data uint8: type=uint8
    ETAS_SenderReceiverInterface_sint16
      data sint16: type=sint16
    ETAS_SenderReceiverInterface_float32
      data float32: type=float32

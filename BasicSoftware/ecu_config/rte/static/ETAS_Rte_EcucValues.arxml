AUTOSAR XML (schema 00047)
package /ETAS_BIP/EcucModuleConfigurationValuess
  module config Rte
    CPT_BswM (RteSwComponentInstance): RteSoftwareComponentInstanceRef=CPT_BswM
      MSE_BswM_Cfg_DfrdSwcNotification_BswM_MRP_SWC_AppMode_ECUM_STATE_APP_RUN (RteEventToTaskMapping):
        RtePositionInTask = 5
        RteActivationOffset = 0.0
        RteEventRef = MSE_BswM_Cfg_DfrdSwcNotification_BswM_MRP_SWC_AppMode_ECUM_STATE_APP_RUN
        RteMappedToTaskRef = OsTask_SysCore_BSW_SwcRequest
      MSE_BswM_Cfg_DfrdSwcNotification_BswM_MRP_SWC_AppMode_ECUM_STATE_POST_RUN (RteEventToTaskMapping):
        RtePositionInTask = 4
        RteActivationOffset = 0.0
        RteEventRef = MSE_BswM_Cfg_DfrdSwcNotification_BswM_MRP_SWC_AppMode_ECUM_STATE_POST_RUN
        RteMappedToTaskRef = OsTask_SysCore_BSW_SwcRequest
    RteGeneration:
      RteGenerationMode = COMPATIBILITY_MODE
      RteCalibrationSupport = NONE
      RteDevErrorDetect = true
      RteDevErrorDetectUninit = false
      RteMeasurementSupport = true
      RteOptimizationMode = RUNTIME
      RteToolChainSignificantCharacters = 127
      RteVfbTraceEnabled = false
      RteBypassSupport = NONE
      RteValueRangeCheckEnabled = false
      RteInExclusiveAreaCheckEnabled = true
    9 x RteBswModuleInstance:
      EcuM: RteBswImplementationRef=EcuM
        TE_EcuM_MainFunction (RteBswEventToTaskMapping): RteBswPositionInTask=2, RteBswActivationOffset=0.0, RteBswMappedToTaskRef=OsTask_SysCore_BSW_10ms, RteBswEventRef=TE_EcuM_MainFunction
      CanNm: RteBswImplementationRef=CanNm
        EV_SE_MainFunction (RteBswEventToTaskMapping): RteBswPositionInTask=3, RteBswActivationOffset=0.0, RteBswMappedToTaskRef=OsTask_SysCore_BSW_10ms, RteBswEventRef=EV_SE_MainFunction
      Com: RteBswImplementationRef=Com
        EV_SE_MainFunctionRx (RteBswEventToTaskMapping): RteBswPositionInTask=4, RteBswActivationOffset=0.0, RteBswMappedToTaskRef=OsTask_SysCore_BSW_10ms, RteBswEventRef=EV_SE_MainFunctionRx
        EV_SE_MainFunctionTx (RteBswEventToTaskMapping): RteBswPositionInTask=5, RteBswActivationOffset=0.0, RteBswMappedToTaskRef=OsTask_SysCore_BSW_10ms, RteBswEventRef=EV_SE_MainFunctionTx
      BSWIMPL_BswM: RteBswImplementationRef=BSWIMPL_BswM
        4 x RteBswEventToTaskMapping:
          TE_BswM_MainFunction: RteBswPositionInTask=6, RteBswActivationOffset=0.0, RteBswMappedToTaskRef=OsTask_SysCore_BSW_10ms, RteBswEventRef=TE_BswM_MainFunction
          MSE_BswM_Cfg_ImdtBswNotification_BswM_MRP_DCM_DiagnosticSessionControl_EXTENDED_DIAGNOSTIC_SESSION: RteBswEventRef=MSE_BswM_Cfg_ImdtBswNotification_BswM_MRP_DCM_DiagnosticSessionControl_EXTENDED_DIAGNOSTIC_SESSION
          MSE_BswM_Cfg_ImdtBswNotification_BswM_MRP_DCM_DiagnosticSessionControl_DEFAULT_SESSION: RteBswEventRef=MSE_BswM_Cfg_ImdtBswNotification_BswM_MRP_DCM_DiagnosticSessionControl_DEFAULT_SESSION
          MSE_BswM_Cfg_ImdtBswNotification_BswM_MRP_DCM_DiagnosticSessionControl_PROGRAMMING_SESSION: RteBswEventRef=MSE_BswM_Cfg_ImdtBswNotification_BswM_MRP_DCM_DiagnosticSessionControl_PROGRAMMING_SESSION
        RteBswRequiredModeGroupConnection:
          RteBswProvidedModeGroupRef = MDGP_AUTOSAR_BswM_ModeDeclarationGroups_MDG_ECUM_STATE
          RteBswRequiredModeGroupRef = MDGR_BswM_MRP_BSWM_MDG
          RteBswProvidedModeGrpModInstRef = BSWIMPL_BswM
        5 x RteBswEventToTaskMapping:
          MSE_BswM_Cfg_ImdtBswNotification_BswM_MRP_BSWM_MDG_ECUM_STATE_PREP_SHUTDOWN: RteBswEventRef=MSE_BswM_Cfg_ImdtBswNotification_BswM_MRP_BSWM_MDG_ECUM_STATE_PREP_SHUTDOWN
          MSE_BswM_Cfg_ImdtBswNotification_BswM_MRP_BSWM_MDG_ECUM_STATE_SHUTDOWN: RteBswEventRef=MSE_BswM_Cfg_ImdtBswNotification_BswM_MRP_BSWM_MDG_ECUM_STATE_SHUTDOWN
          MSE_BswM_Cfg_ImdtBswNotification_BswM_MRP_BSWM_MDG_ECUM_STATE_RUN: RteBswEventRef=MSE_BswM_Cfg_ImdtBswNotification_BswM_MRP_BSWM_MDG_ECUM_STATE_RUN
          MSE_BswM_Cfg_ImdtBswNotification_BswM_MRP_BSWM_MDG_ECUM_STATE_STARTUP_TWO: RteBswEventRef=MSE_BswM_Cfg_ImdtBswNotification_BswM_MRP_BSWM_MDG_ECUM_STATE_STARTUP_TWO
          MSE_BswM_Cfg_ImdtBswNotification_BswM_MRP_BSWM_MDG_ECUM_STATE_STARTUP_ONE: RteBswEventRef=MSE_BswM_Cfg_ImdtBswNotification_BswM_MRP_BSWM_MDG_ECUM_STATE_STARTUP_ONE
        RteBswRequiredModeGroupConnection_0 (RteBswRequiredModeGroupConnection):
          RteBswProvidedModeGroupRef = DcmEcuReset
          RteBswProvidedModeGrpModInstRef = Dcm
          RteBswRequiredModeGroupRef = MDGR_BswM_MRP_DCM_ModeNotification_EcuReset
        5 x RteBswEventToTaskMapping:
          MSE_BswM_Cfg_ImdtBswNotification_BswM_MRP_BSWM_MDG_ECUM_STATE_APP_RUN: RteBswEventRef=MSE_BswM_Cfg_ImdtBswNotification_BswM_MRP_BSWM_MDG_ECUM_STATE_APP_RUN
          MSE_BswM_Cfg_ImdtBswNotification_BswM_MRP_BSWM_MDG_ECUM_STATE_POST_RUN: RteBswEventRef=MSE_BswM_Cfg_ImdtBswNotification_BswM_MRP_BSWM_MDG_ECUM_STATE_POST_RUN
          MSE_BswM_Cfg_DfrdBswNotification_BswM_MRP_DCM_ModeNotification_EcuReset_JUMPTOBOOTLOADER: RteBswPositionInTask=3, RteBswActivationOffset=0.0, RteBswMappedToTaskRef=OsTask_SysCore_BSW_SwcRequest, RteBswEventRef=MSE_BswM_Cfg_DfrdBswNotification_BswM_MRP_DCM_ModeNotification_EcuReset_JUMPTOBOOTLOADER
          MSE_BswM_Cfg_DfrdBswNotification_BswM_MRP_DCM_ModeNotification_EcuReset_SOFT: RteBswPositionInTask=2, RteBswActivationOffset=0.0, RteBswMappedToTaskRef=OsTask_SysCore_BSW_SwcRequest, RteBswEventRef=MSE_BswM_Cfg_DfrdBswNotification_BswM_MRP_DCM_ModeNotification_EcuReset_SOFT
          MSE_BswM_Cfg_DfrdBswNotification_BswM_MRP_DCM_ModeNotification_EcuReset_HARD: RteBswPositionInTask=1, RteBswActivationOffset=0.0, RteBswMappedToTaskRef=OsTask_SysCore_BSW_SwcRequest, RteBswEventRef=MSE_BswM_Cfg_DfrdBswNotification_BswM_MRP_DCM_ModeNotification_EcuReset_HARD
      ComM: RteBswImplementationRef=ComM
        EV_SE_MainFunction_Can_Network_ETAS_Channel_Can_Network_ETAS (RteBswEventToTaskMapping):
          RteBswPositionInTask = 1
          RteBswActivationOffset = 0.0
          RteBswMappedToTaskRef = OsTask_SysCore_BSW_10ms
          RteBswEventRef = EV_SE_MainFunction_Can_Network_ETAS_Channel_Can_Network_ETAS
      BSWIMPL_FiM: RteBswImplementationRef=BSWIMPL_FiM
        RTE_TEV_FiM_MainFunction (RteBswEventToTaskMapping): RteBswPositionInTask=7, RteBswActivationOffset=0.0, RteBswMappedToTaskRef=OsTask_SysCore_BSW_10ms, RteBswEventRef=RTE_TEV_FiM_MainFunction
      CanTp: RteBswImplementationRef=CanTp
        TE_CanTpNormalOperatingMode (RteBswEventToTaskMapping): RteBswPositionInTask=6, RteBswActivationOffset=0.0, RteBswMappedToTaskRef=OsTask_SysCore_BSW_1ms, RteBswEventRef=TE_CanTpNormalOperatingMode
      CanSM: RteBswImplementationRef=CanSM
        EV_SE_MainFunction (RteBswEventToTaskMapping): RteBswPositionInTask=5, RteBswActivationOffset=0.0, RteBswMappedToTaskRef=OsTask_SysCore_BSW_1ms, RteBswEventRef=EV_SE_MainFunction
      Xcp: RteBswImplementationRef=Xcp
        4 x RteBswEventToTaskMapping, all with RteBswActivationOffset=0.0:
          EV_SE_EventChannel_100ms: RteBswPositionInTask=3, RteBswMappedToTaskRef=OsTask_SysCore_ASW_100ms, RteBswEventRef=EV_SE_EventChannel_100ms
          EV_SE_EventChannel_50ms: RteBswPositionInTask=1, RteBswMappedToTaskRef=OsTask_SysCore_ASW_50ms, RteBswEventRef=EV_SE_EventChannel_50ms
          EV_SE_MainFunction: RteBswPositionInTask=9, RteBswMappedToTaskRef=OsTask_SysCore_BSW_10ms, RteBswEventRef=EV_SE_MainFunction
          EV_SE_EventChannel_10ms: RteBswPositionInTask=63, RteBswMappedToTaskRef=OsTask_SysCore_ASW_10ms, RteBswEventRef=EV_SE_EventChannel_10ms
    CPT_ExeMgrUT (RteSwComponentInstance): RteSoftwareComponentInstanceRef=CPT_ExeMgrUT
      6 x RteEventToTaskMapping:
        IE_ExeMgr_EvaluateReset: RtePositionInTask=1, RteActivationOffset=0.0, RteMappedToTaskRef=OsTask_SysCore_Startup, RteEventRef=IE_ExeMgr_EvaluateReset
        IE_ExeMgr_EvaluateWakeup: RtePositionInTask=2, RteActivationOffset=0.0, RteMappedToTaskRef=OsTask_SysCore_Startup, RteEventRef=IE_ExeMgr_EvaluateWakeup
        TE_ExeMgr_TriggerBswBg: RtePositionInTask=8, RteActivationOffset=0.0, RteMappedToTaskRef=OsTask_SysCore_BSW_1ms, RteEventRef=TE_ExeMgr_TriggerBswBg
        ITE_ExeMgr_GetWakeupSource: RteEventRef=ITE_ExeMgr_GetWakeupSource
        ETE_ExeMgr_ExecuteShutdown: RteEventRef=ETE_ExeMgr_ExecuteShutdown
        TE_ExeMgr_MainFunction: RtePositionInTask=56, RteActivationOffset=0.0, RteMappedToTaskRef=OsTask_SysCore_ASW_10ms, RteEventRef=TE_ExeMgr_MainFunction
    CPT_NvMUT (RteSwComponentInstance): RteSoftwareComponentInstanceRef=CPT_NvMUT
      TE_NvMUT_100ms (RteEventToTaskMapping): RtePositionInTask=1, RteActivationOffset=0.0, RteMappedToTaskRef=OsTask_SysCore_ASW_100ms, RteEventRef=TE_NvMUT_100ms
      TE_NvFW_10ms (RteEventToTaskMapping): RtePositionInTask=1, RteActivationOffset=0.0, RteMappedToTaskRef=OsTask_SysCore_ASW_10ms, RteEventRef=TE_NvFW_10ms
    NvM (RteBswModuleInstance): RteBswImplementationRef=NvM
      EV_SE_MainFunction (RteBswEventToTaskMapping): RteBswPositionInTask=8, RteBswActivationOffset=0.0, RteBswMappedToTaskRef=OsTask_SysCore_BSW_10ms, RteBswEventRef=EV_SE_MainFunction
    CPT_NvBlock (RteSwComponentInstance): RteSoftwareComponentInstanceRef=CPT_NvBlock
      RteNvRamAllocation_Cyclic (RteNvRamAllocation): RteSwNvBlockDescriptorRef=NvBlockDescriptor_StoreCyclicBlock, RteNvmBlockRef=NvBlock_NvBlockDescriptor_StoreCyclicBlock
      TE_StoreCyclic_NvBlock (RteEventToTaskMapping): RtePositionInTask=2, RteActivationOffset=0.0, RteMappedToTaskRef=OsTask_SysCore_ASW_100ms, RteEventRef=TE_StoreCyclic_NvBlock
      RteNvRamAllocation_Immediate (RteNvRamAllocation): RteSwNvBlockDescriptorRef=NvBlockDescriptor_StoreImmediateBlock, RteNvmBlockRef=NvBlock_NvBlockDescriptor_StoreImmediateBlock
      RteNvRamAllocation_Shutdown (RteNvRamAllocation): RteSwNvBlockDescriptorRef=NvBlockDescriptor_StoreAtShutdownBlock, RteNvmBlockRef=NvBlock_NvBlockDescriptor_StoreAtShutdownBlock
      DRE_NvBlock_StoreImmediateNvBlock (RteEventToTaskMapping): RtePositionInTask=1, RteActivationOffset=0.0, RteMappedToTaskRef=OsTask_SysCore_DRE, RteEventRef=DRE_NvBlock_StoreImmediateNvBlock
      DRE_NvBlock_StoreAtShutdownNvBlock (RteEventToTaskMapping): RtePositionInTask=2, RteActivationOffset=0.0, RteMappedToTaskRef=OsTask_SysCore_DRE, RteEventRef=DRE_NvBlock_StoreAtShutdownNvBlock
    CPT_WdgMUT (RteSwComponentInstance): RteSoftwareComponentInstanceRef=CPT_WdgMUT
      5 x RteEventToTaskMapping, all with RteActivationOffset=0.0, RteMappedToTaskRef=OsTask_SysCore_ASW_10ms:
        TE_ASW_10ms_Logical: RtePositionInTask=60, RteEventRef=TE_ASW_10ms_Logical
        TE_ASW_10ms_Deadline: RtePositionInTask=59, RteEventRef=TE_ASW_10ms_Deadline
        TE_ASW_10ms_Alive: RtePositionInTask=58, RteEventRef=TE_ASW_10ms_Alive
        TE_WdgM_GlobalSupervision: RtePositionInTask=61, RteEventRef=TE_WdgM_GlobalSupervision
        TE_WdgM_LocalSupervisionStatus: RtePositionInTask=62, RteEventRef=TE_WdgM_LocalSupervisionStatus
    WdgM (RteBswModuleInstance): RteBswImplementationRef=WdgM
      TE_WdgMSupervisionCycle0 (RteBswEventToTaskMapping): RteBswPositionInTask=9, RteBswActivationOffset=0.0, RteBswMappedToTaskRef=OsTask_SysCore_BSW_1ms, RteBswEventRef=TE_WdgMSupervisionCycle0
    Can (RteBswModuleInstance): RteBswImplementationRef=BSWIMPL_Can
      4 x RteBswEventToTaskMapping, all with RteBswActivationOffset=0.0, RteBswMappedToTaskRef=OsTask_SysCore_BSW_1ms:
        Can_MainFunction_Mode: RteBswPositionInTask=7, RteBswEventRef=Can_MainFunction_Mode
        Can_MainFunction_Read: RteBswPositionInTask=3, RteBswEventRef=Can_MainFunction_Read
        Can_MainFunction_Write: RteBswPositionInTask=2, RteBswEventRef=Can_MainFunction_Write
        Can_MainFunction_BusOff: RteBswPositionInTask=4, RteBswEventRef=Can_MainFunction_BusOff
    CPT_INP_SWC (RteSwComponentInstance): RteSoftwareComponentInstanceRef=CPT_INP_SWC
      TE_INP_SWC_10ms (RteEventToTaskMapping): RtePositionInTask=1, RteActivationOffset=0.0, RteMappedToTaskRef=OsTask_ComCore_ASW_10ms, RteEventRef=TE_INP_SWC_10ms
    CPT_OUTP_SWC (RteSwComponentInstance): RteSoftwareComponentInstanceRef=CPT_OUTP_SWC
      TE_OUTP_SWC_10ms (RteEventToTaskMapping): RtePositionInTask=2, RteActivationOffset=0.0, RteMappedToTaskRef=OsTask_ComCore_ASW_10ms, RteEventRef=TE_OUTP_SWC_10ms
    RteInitializationBehavior_0 (RteInitializationBehavior)
    CPT_CalUT (RteSwComponentInstance): RteSoftwareComponentInstanceRef=CPT_CalUT
      TE_CalUT (RteEventToTaskMapping): RtePositionInTask=1, RteActivationOffset=0.0, RteMappedToTaskRef=OsTask_AppCore_ASW_10ms, RteEventRef=TE_CalUT
    7 x RteBswModuleInstance:
      PduR: RteBswImplementationRef=PduR
      CanIf: RteBswImplementationRef=CanIf
      Dem: RteBswImplementationRef=Dem
        EV_MainFunction (RteBswEventToTaskMapping): RteBswPositionInTask=10, RteBswActivationOffset=0.0, RteBswMappedToTaskRef=OsTask_SysCore_BSW_10ms, RteBswEventRef=EV_MainFunction
      Dcm: RteBswImplementationRef=Dcm
        EV_Dcm_MainFunction (RteBswEventToTaskMapping): RteBswPositionInTask=11, RteBswActivationOffset=0.0, RteBswMappedToTaskRef=OsTask_SysCore_BSW_10ms, RteBswEventRef=EV_Dcm_MainFunction
      TstM: RteBswImplementationRef=TstM
        TE_TstM_Run (RteBswEventToTaskMapping): RteBswPositionInTask=1, RteBswActivationOffset=0.0, RteBswMappedToTaskRef=OsTask_SysCore_BswBg_100ms, RteBswEventRef=TE_TstM_Run
      Rtm: RteBswImplementationRef=Rtm
        TE_Rtm_MainFunction (RteBswEventToTaskMapping): RteBswPositionInTask=2, RteBswActivationOffset=0.0, RteBswMappedToTaskRef=OsTask_SysCore_BswBg_100ms, RteBswEventRef=TE_Rtm_MainFunction
      StackM: RteBswImplementationRef=StackM
        TE_StackM_ScanAllStacks (RteBswEventToTaskMapping): RteBswPositionInTask=1, RteBswActivationOffset=0.0, RteBswMappedToTaskRef=OsTask_SysCore_BSW_1ms, RteBswEventRef=TE_StackM_ScanAllStacks
    CPT_DiagUT (RteSwComponentInstance): RteSoftwareComponentInstanceRef=CPT_DiagUT
      41 x RteEventToTaskMapping, all with RteActivationOffset=0.0, RteMappedToTaskRef=OsTask_SysCore_ASW_10ms:
        TE_Dem_GetEventExtendedDataRecord_GeneralEvtInfo_Adapt_Appl: RtePositionInTask=53, RteEventRef=TE_Dem_GetEventExtendedDataRecord_GeneralEvtInfo_Adapt_Appl
        TE_Dem_GetEventFreezeFrameDataEx_GeneralEvtInfo_Adapt_Appl: RtePositionInTask=52, RteEventRef=TE_Dem_GetEventFreezeFrameDataEx_GeneralEvtInfo_Adapt_Appl
        TE_Dem_GetEventFreezeFrameData_GeneralEvtInfo_Adapt_Appl: RtePositionInTask=51, RteEventRef=TE_Dem_GetEventFreezeFrameData_GeneralEvtInfo_Adapt_Appl
        TE_GetEventExtendedDataRecordEx_Adapt_Appl: RtePositionInTask=50, RteEventRef=TE_GetEventExtendedDataRecordEx_Adapt_Appl
        TE_Dem_GetEventFailed_GeneralEvtInfo_Adapt_Appl: RtePositionInTask=49, RteEventRef=TE_Dem_GetEventFailed_GeneralEvtInfo_Adapt_Appl
        TE_ResetEventStatus_Adapt_Appl: RtePositionInTask=48, RteEventRef=TE_ResetEventStatus_Adapt_Appl
        TE_SetEventAvailable_Adapt_Appl: RtePositionInTask=47, RteEventRef=TE_SetEventAvailable_Adapt_Appl
        TE_Dcm_GetActiveProtocol_Adapt_Appl: RtePositionInTask=45, RteEventRef=TE_Dcm_GetActiveProtocol_Adapt_Appl
        TE_Dem_GetEventIdCausingLastDetError_Adapt_Appl: RtePositionInTask=44, RteEventRef=TE_Dem_GetEventIdCausingLastDetError_Adapt_Appl
        TE_GetCycleQualified_Adapt_Appl: RtePositionInTask=43, RteEventRef=TE_GetCycleQualified_Adapt_Appl
        TE_Dcm_GetSecurityLevel_Adapt_Appl: RtePositionInTask=42, RteEventRef=TE_Dcm_GetSecurityLevel_Adapt_Appl
        TE_GetStorageCondition_Adapt_Appl: RtePositionInTask=41, RteEventRef=TE_GetStorageCondition_Adapt_Appl
        TE_SetOperationCycleState_Adapt_Appl: RtePositionInTask=40, RteEventRef=TE_SetOperationCycleState_Adapt_Appl
        TE_Dcm_MainFunction_Adapt_Appl: RtePositionInTask=39, RteEventRef=TE_Dcm_MainFunction_Adapt_Appl
        TE_Dcm_GetSesCtrlType_Adapt_Appl: RtePositionInTask=38, RteEventRef=TE_Dcm_GetSesCtrlType_Adapt_Appl
        TE_Dem_GetEventStatus_GeneralEvtInfo_Adapt_Appl: RtePositionInTask=37, RteEventRef=TE_Dem_GetEventStatus_GeneralEvtInfo_Adapt_Appl
        TE_SetCycleQualified_Adapt_Appl: RtePositionInTask=36, RteEventRef=TE_SetCycleQualified_Adapt_Appl
        TE_ResetEventDebounceStatus_Adapt_Appl: RtePositionInTask=34, RteEventRef=TE_ResetEventDebounceStatus_Adapt_Appl
        TE_SetStorageCondition_Adapt_Appl: RtePositionInTask=35, RteEventRef=TE_SetStorageCondition_Adapt_Appl
        TE_PrestoreFreezeFrame_Adapt_Appl: RtePositionInTask=33, RteEventRef=TE_PrestoreFreezeFrame_Adapt_Appl
        TE_SetEventStatus_Adapt_Appl: RtePositionInTask=32, RteEventRef=TE_SetEventStatus_Adapt_Appl
        TE_ClearPrestoredFreezeFrame_Adapt_Appl: RtePositionInTask=31, RteEventRef=TE_ClearPrestoredFreezeFrame_Adapt_Appl
        TE_GetDTCOfEvent_Adapt_Appl: RtePositionInTask=30, RteEventRef=TE_GetDTCOfEvent_Adapt_Appl
        TE_GetOperationCycleState_Adapt_Appl: RtePositionInTask=29, RteEventRef=TE_GetOperationCycleState_Adapt_Appl
        TE_SetEventStatusWithEnvdata_Adapt_Appl: RtePositionInTask=28, RteEventRef=TE_SetEventStatusWithEnvdata_Adapt_Appl
        TE_GetEventStatus_Adapt_Appl: RtePositionInTask=27, RteEventRef=TE_GetEventStatus_Adapt_Appl
        TE_Dem_GetEventTested_GeneralEvtInfo_Adapt_Appl: RtePositionInTask=26, RteEventRef=TE_Dem_GetEventTested_GeneralEvtInfo_Adapt_Appl
        TE_GetEventFailed_Adapt_Appl: RtePositionInTask=24, RteEventRef=TE_GetEventFailed_Adapt_Appl
        TE_Dcm_ResetToDefaultSession_Adapt_Appl: RtePositionInTask=23, RteEventRef=TE_Dcm_ResetToDefaultSession_Adapt_Appl
        TE_Dcm_SetActiveDiagnostic_Adapt_Appl: RtePositionInTask=22, RteEventRef=TE_Dcm_SetActiveDiagnostic_Adapt_Appl
        TE_Dem_GetEventExtendedDataRecordEx_GeneralEvtInfo_Adapt_Appl: RtePositionInTask=21, RteEventRef=TE_Dem_GetEventExtendedDataRecordEx_GeneralEvtInfo_Adapt_Appl
        TE_GetEventFreezeFrameDataEx_Adapt_Appl: RtePositionInTask=20, RteEventRef=TE_GetEventFreezeFrameDataEx_Adapt_Appl
        TE_GetDebouncingOfEvent_GeneralEvtInfo_Adapt_Appl: RtePositionInTask=19, RteEventRef=TE_GetDebouncingOfEvent_GeneralEvtInfo_Adapt_Appl
        TE_GetFaultDetectionCounter_Adapt_Appl: RtePositionInTask=18, RteEventRef=TE_GetFaultDetectionCounter_Adapt_Appl
        TE_Dem_GetDTCOfEvent_GeneralEvtInfo_Adapt_Appl: RtePositionInTask=17, RteEventRef=TE_Dem_GetDTCOfEvent_GeneralEvtInfo_Adapt_Appl
        TE_Dem_GetFaultDetectionCounter_GeneralEvtInfo_Adapt_Appl: RtePositionInTask=16, RteEventRef=TE_Dem_GetFaultDetectionCounter_GeneralEvtInfo_Adapt_Appl
        TE_GetEventExtendedDataRecord_Adapt_Appl: RtePositionInTask=14, RteEventRef=TE_GetEventExtendedDataRecord_Adapt_Appl
        TE_GetEventFreezeFrameData_Adapt_Appl: RtePositionInTask=15, RteEventRef=TE_GetEventFreezeFrameData_Adapt_Appl
        TE_GetDebouncingOfEvent_Adapt_Appl: RtePositionInTask=13, RteEventRef=TE_GetDebouncingOfEvent_Adapt_Appl
        TE_GetEventTested_Adapt_Appl: RtePositionInTask=11, RteEventRef=TE_GetEventTested_Adapt_Appl
        TE_SetWIRStatus_Adapt_Appl: RtePositionInTask=12, RteEventRef=TE_SetWIRStatus_Adapt_Appl
    CPT_NmUT (RteSwComponentInstance): RteSoftwareComponentInstanceRef=CPT_NmUT
      TE_ASW_Nm_10ms (RteEventToTaskMapping): RtePositionInTask=57, RteActivationOffset=0.0, RteMappedToTaskRef=OsTask_SysCore_ASW_10ms, RteEventRef=TE_ASW_Nm_10ms

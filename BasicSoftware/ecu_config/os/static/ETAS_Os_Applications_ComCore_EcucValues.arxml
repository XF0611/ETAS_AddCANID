AUTOSAR XML (schema 00047)
package /ETAS_BIP/EcucModuleConfigurationValuess
  module config Os
    OsApp_ComCore (OsApplication):
      OsTrusted = true
      OsTrustedApplicationDelayTimingViolationCall = false
      OsTrustedApplicationWithProtection = false
      OsAppEcucPartitionRef = EcucPartition_ComCore
      OsAppTaskRef = OsTask_ComCore_ASW_10ms
      OsAppTaskRef = OsTask_ComCore_BSW_10ms
      OsApplicationCoreRef = EcucCore_SysCore
      OsApplicationHooks: OsAppStartupHook=false, OsAppShutdownHook=false, OsAppErrorHook=false
    OsTask_ComCore_ASW_10ms (OsTask):
      OsTaskActivation = 1
      OsTaskPriority = 8
      OsTaskSchedule = FULL
      OsTaskStackAllocation = 512
      OsTaskAccessingApplication = OsApp_ComCore
      OsTaskResourceRef = RTE_RESOURCE_OS_APP_OsApp_ComCore
      OsTaskAccessingApplication = OsApp_SysCore
    RTE_RESOURCE_OS_APP_OsApp_ComCore (OsResource): OsResourceProperty=STANDARD, OsResourceAccessingApplication=OsApp_ComCore
    OsTask_ComCore_BSW_10ms (OsTask):
      OsTaskActivation = 1
      OsTaskPriority = 11
      OsTaskSchedule = FULL
      OsTaskStackAllocation = 512
      OsTaskAccessingApplication = OsApp_ComCore
      OsTaskAccessingApplication = OsApp_SysCore
      OsTaskResourceRef = RTE_RESOURCE_OS_APP_OsApp_ComCore

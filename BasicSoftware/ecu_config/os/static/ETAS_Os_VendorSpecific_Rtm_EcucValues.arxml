AUTOSAR XML (schema 4-2-2)
package /ETAS_BIP/EcucModuleConfigurationValuess
  module config Os
    OsOS
      VendorSpecific (Param)
        meter_elapsed_time: VALUE=true
        meter_execution: VALUE=true
        monitor_activations: VALUE=true
        isr_lifetime_hooks: VALUE=true
        task_lifetime_hooks: VALUE=true

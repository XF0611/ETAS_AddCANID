AUTOSAR XML (schema 00047)
package /ETAS_BIP/EcucModuleConfigurationValuess
  module config Os
    OsOS:
      OsUseResScheduler = 0
      OsSuppressVectorGen = false
      OsNumberOfCores = 1
      OsScalabilityClass = SC1
      OsStatus = EXTENDED
      OsStackMonitoring = true
      OsUseGetServiceId = true
      OsUseParameterAccess = true
      OsCyclesPerSecond = 300000000
      OsTicksPerSecond = 100000000
      OsDefaultInterrupt = DefaultInterruptHandler
      OsHooks: OsStackFaultHook=false, OsStartupHook=true, OsShutdownHook=true, OsPreTaskHook=true, OsPostTaskHook=true, OsErrorHook=true, OsProtectionHook=true
      VendorSpecific (Param)
        lightweight: VALUE=true
        no_memory_protection: VALUE=true
        no_timing_protection: VALUE=true

AUTOSAR XML (schema 4-2-2)
package /ETAS_BIP/EcucModuleConfigurationValuess
  module config Os
    Millisecond_TickCounter (OsCounter):
      OsCounterMaxAllowedValue = 65535
      OsCounterMinCycle = 1
      OsCounterType = SOFTWARE
      OsSecondsPerTick = 0.001
      OsCounterTicksPerBase = 1
      OsCounterAccessingApplication = OsApp_SysCore

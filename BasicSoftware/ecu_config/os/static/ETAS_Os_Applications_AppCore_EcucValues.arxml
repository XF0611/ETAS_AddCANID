AUTOSAR XML (schema 00047)
package /ETAS_BIP/EcucModuleConfigurationValuess
  module config Os
    OsApp_AppCore (OsApplication):
      OsTrusted = true
      OsTrustedApplicationDelayTimingViolationCall = false
      OsTrustedApplicationWithProtection = false
      OsAppEcucPartitionRef = EcucPartition_AppCore
      OsAppTaskRef = OsTask_AppCore_ASW_10ms
      OsAppTaskRef = OsTask_AppCore_BSW_10ms
      OsApplicationCoreRef = EcucCore_SysCore
      OsApplicationHooks: OsAppErrorHook=false, OsAppShutdownHook=false, OsAppStartupHook=false
    RTE_RESOURCE_OS_APP_OsApp_AppCore (OsResource): OsResourceProperty=STANDARD, OsResourceAccessingApplication=OsApp_AppCore
    OsTask_AppCore_ASW_10ms (OsTask):
      OsTaskActivation = 1
      OsTaskPriority = 5
      OsTaskSchedule = FULL
      OsTaskStackAllocation = 512
      OsTaskAccessingApplication = OsApp_AppCore
      OsTaskAccessingApplication = OsApp_SysCore
      OsTaskResourceRef = RTE_RESOURCE_OS_APP_OsApp_AppCore
    OsTask_AppCore_BSW_10ms (OsTask):
      OsTaskActivation = 1
      OsTaskPriority = 10
      OsTaskSchedule = FULL
      OsTaskStackAllocation = 512
      OsTaskAccessingApplication = OsApp_AppCore
      OsTaskAccessingApplication = OsApp_SysCore
      OsTaskResourceRef = RTE_RESOURCE_OS_APP_OsApp_AppCore

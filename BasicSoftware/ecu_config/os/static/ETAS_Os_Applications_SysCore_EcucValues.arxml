AUTOSAR XML (schema 00047)
package /ETAS_BIP/EcucModuleConfigurationValuess
  module config Os
    7 x OsTask, all with OsTaskActivation=1, OsTaskSchedule=FULL, OsTaskAccessingApplication=OsApp_SysCore, OsTaskResourceRef=RTE_RESOURCE_OS_APP_OsApp_SysCore:
      OsTask_SysCore_ASW_10ms: OsTaskPriority=9, OsTaskStackAllocation=16000
      OsTask_SysCore_BSW_10ms: OsTaskPriority=12, OsTaskStackAllocation=16000, OsTaskResourceRef=RES_AUTOSAR_ECUM
      OsTask_SysCore_BSW_1ms: OsTaskPriority=13, OsTaskStackAllocation=512
      OsTask_SysCore_ASW_100ms: OsTaskPriority=6, OsTaskStackAllocation=512
      OsTask_SysCore_BSW_SwcRequest: OsTaskPriority=14, OsTaskStackAllocation=512
      OsTask_ECU_Startup: OsTaskPriority=60, OsTaskStackAllocation=3072, OsTaskResourceRef=RES_AUTOSAR_ECUM
        OsTaskAutostart: OsTaskAppModeRef=OSDEFAULTAPPMODE
      OsTask_SysCore_BswBg_1ms: OsTaskPriority=2, OsTaskStackAllocation=1024
    RES_AUTOSAR_ECUM (OsResource): OsResourceProperty=STANDARD, OsResourceAccessingApplication=OsApp_SysCore
    RTE_RESOURCE_OS_APP_OsApp_SysCore (OsResource): OsResourceProperty=STANDARD, OsResourceAccessingApplication=OsApp_SysCore
    3 x OsTask, all with OsTaskActivation=1, OsTaskStackAllocation=512, OsTaskAccessingApplication=OsApp_SysCore, OsTaskResourceRef=RTE_RESOURCE_OS_APP_OsApp_SysCore:
      OsTask_SysCore_ASW_50ms: OsTaskPriority=7, OsTaskSchedule=FULL
      OsTask_SysCore_BswBg_100ms: OsTaskPriority=1, OsTaskSchedule=FULL
      OsTask_SysCore_Startup: OsTaskPriority=50, OsTaskSchedule=NON, OsTaskResourceRef=RES_AUTOSAR_ECUM
        OsTaskAutostart: OsTaskAppModeRef=OSDEFAULTAPPMODE
    Rte_ScheduleTable (OsScheduleTable): OsSchTblAccessingApplication=OsApp_SysCore
      OsScheduleTableSync: OsScheduleTblSyncStrategy=EXPLICIT, OsScheduleTblExplicitPrecision=0
    OsApp_SysCore (OsApplication):
      OsTrusted = true
      OsTrustedApplicationDelayTimingViolationCall = false
      OsTrustedApplicationWithProtection = false
      OsAppEcucPartitionRef = EcucPartition_SysCore
      OsAppCounterRef = Rte_TickCounter
      OsAppScheduleTableRef = Rte_ScheduleTable
      OsAppTaskRef = OsTask_SysCore_BSW_1ms
      OsAppTaskRef = OsTask_SysCore_BSW_10ms
      OsAppTaskRef = OsTask_SysCore_BswBg_1ms
      OsAppTaskRef = OsTask_SysCore_ASW_10ms
      OsAppTaskRef = OsTask_SysCore_ASW_100ms
      OsAppTaskRef = OsTask_ECU_Startup
      OsAppTaskRef = OsTask_SysCore_BSW_SwcRequest
      OsAppTaskRef = OsTask_SysCore_ASW_50ms
      OsAppTaskRef = OsTask_SysCore_BswBg_100ms
      OsAppTaskRef = OsTask_SysCore_Startup
      OsAppCounterRef = Millisecond_TickCounter
      OsAppTaskRef = OsTask_SysCore_DRE
      OsAppIsrRef = SystemCounter
      OsAppIsrRef = Gpt1_Isr
      OsApplicationCoreRef = EcucCore_SysCore
      OsApplicationHooks: OsAppStartupHook=false, OsAppShutdownHook=false, OsAppErrorHook=false
    OsTask_SysCore_DRE (OsTask):
      OsTaskActivation = 2
      OsTaskSchedule = FULL
      OsTaskStackAllocation = 512
      OsTaskPriority = 40
      OsTaskAccessingApplication = OsApp_SysCore
      OsTaskResourceRef = RTE_RESOURCE_OS_APP_OsApp_SysCore

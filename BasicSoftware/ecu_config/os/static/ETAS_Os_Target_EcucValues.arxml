AUTOSAR XML (schema 00047)
package /ETAS_BIP/EcucModuleConfigurationValuess
  module config Os
    OSDEFAULTAPPMODE (OsAppMode)
    OsRTATarget: OsRTATargetName=TDA4VM-R5-TI, OsRTATargetVariant=TDA4VM_MCU_R5FSS0_CORE0
      Param
        SpECC: VALUE=512
        support_interruptsource: VALUE=true
    SystemCounter (OsIsr): OsIsrCategory=CATEGORY_2, OsIsrPriority=IPL_14, OsIsrStackAllocation=512, OsIsrAddress=Interrupt_VIM113
    Gpt1_Isr (OsIsr): OsIsrCategory=CATEGORY_2, OsIsrStackAllocation=512, OsIsrAddress=Interrupt_VIM0, OsIsrPriority=IPL_2
    Rte_TickCounter (OsCounter): OsSecondsPerTick=0.001, OsCounterType=SOFTWARE, OsCounterAccessingApplication=OsApp_SysCore
      OsDriver

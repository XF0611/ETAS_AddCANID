/*
* This is a template file. It defines integration functions necessary to complete RTA-BSW.
* The integrator must complete the templates before deploying software containing functions defined in this file.
* Once templates have been completed, the integrator should delete the #error line.
* Note: The integrator is responsible for updates made to this file.
* To remove the following error define the macro NOT_READY_FOR_TESTING_OR_DEPLOYMENT with a compiler option (e.g. -D NOT_READY_FOR_TESTING_OR_DEPLOYMENT)
* The removal of the error only allows the user to proceed with the building phase
*/ ASAP2_VERSION 1 61
/begin PROJECT ETAS_BIP ""
/begin MODULE ETAS_BIP ""
/* A2ML - Language definitions */
/begin MOD_COMMON "" DEPOSIT ABSOLUTE BYTE_ORDER MSB_LAST /* small endian */ /end MOD_COMMON
/begin MOD_PAR "" VERSION "" CUSTOMER_NO "" USER "" PHONE_NO "" ECU "" CPU_TYPE ""
 /begin MEMORY_SEGMENT AppCode "Application code on internal memory" CODE FLASH INTERN 0x00770000 /*Initial address */ 0x00089000 /*length of segment*/ -1 -1 -1 -1 -1
  /begin IF_DATA XCPplus 0x0102
   /begin SEGMENT 0x00 /* segment logical number */ 0x01 /* number of pages */ 0x00 /* address extension */ 0x00 /* compression method */ 0x00 /* encryption method */ /begin CHECKSUM XCP_CRC_32 MAX_BLOCK_SIZE 0x400 /end CHECKSUM
    /begin PAGE 0x00 /* page number */ ECU_ACCESS_WITH_XCP_ONLY XCP_READ_ACCESS_WITH_ECU_ONLY /*means "tool" page is the same as "ECU" page*/ XCP_WRITE_ACCESS_NOT_ALLOWED INIT_SEGMENT 0 /end PAGE
   /end SEGMENT
  /end IF_DATA
 /end MEMORY_SEGMENT
 /begin MEMORY_SEGMENT CalRAM "Application calibration" DATA FLASH INTERN 0x007FA000 /*Initial address */ 0x00004000 /*length of segment*/ -1 -1 -1 -1 -1
  /begin IF_DATA XCPplus 0x0102
   /begin SEGMENT 0x01 /* segment logical number */ 0x01 /* number of pages */ 0x00 /* address extension */ 0x00 /* compression method */ 0x00 /* encryption method */ /begin CHECKSUM XCP_CRC_32 MAX_BLOCK_SIZE 0x400 /end CHECKSUM
    /begin PAGE 0x00 /* page number - working page */ ECU_ACCESS_WITH_XCP_ONLY XCP_READ_ACCESS_WITH_ECU_ONLY XCP_WRITE_ACCESS_WITH_ECU_ONLY INIT_SEGMENT 1 /end PAGE
   /end SEGMENT
  /end IF_DATA
 /end MEMORY_SEGMENT
 /* ******************** end Block Memory Segment ******************** */ /end MOD_PAR
/begin IF_DATA XCPplus 0x0102 /* Include of the generated TL/PL-information */
 /begin XCP_ON_CAN /************************ start of CAN *********************/ 0x0102 /* XCP on CAN version */ CAN_ID_MASTER 0x332 /* CMD/STIM CAN-ID */ /* master -> slave */ CAN_ID_SLAVE 0x333 /* RES/ERR/EV/SERV/DAQ CAN-ID */ /* slave -> master */ /* Bit31= 1: extended identifier */ BAUDRATE 500000 /* BAUDRATE [Hz] */ SAMPLE_POINT 75 /* sample point */ /* [% complete bit time] */ BTL_CYCLES 20 /* BTL_CYCLES */ /* [slots per bit time] */ SJW 1 /* length synchr. segment */ /* [BTL_CYCLES] */ /************************* end of CAN **********************/ /*************** start of PROTOCOL_LAYER *******************/
  /begin PROTOCOL_LAYER /* At MODULE */ 0x0102 /* XCP protocol layer version */ 2000 /* T1 [ms] */ 2000 /* T2 [ms] */ 0 /* T3 [ms] */ 0 /* T4 [ms] */ 0 /* T5 [ms] */ 0 /* T6 [ms] */ 2000 /* T7 [ms] */ 8 /* MAX_CTO */ 8 /* MAX_DTO default for DAQ and STIM */ BYTE_ORDER_MSB_LAST /* BYTE_ORDER: INTEL */ ADDRESS_GRANULARITY_BYTE /* ADDRESS_GRANULARITY */ OPTIONAL_CMD GET_SEED OPTIONAL_CMD UNLOCK OPTIONAL_CMD SET_MTA OPTIONAL_CMD UPLOAD OPTIONAL_CMD SHORT_UPLOAD OPTIONAL_CMD BUILD_CHECKSUM OPTIONAL_CMD DOWNLOAD OPTIONAL_CMD DOWNLOAD_NEXT OPTIONAL_CMD DOWNLOAD_MAX OPTIONAL_CMD CLEAR_DAQ_LIST OPTIONAL_CMD SET_DAQ_PTR OPTIONAL_CMD WRITE_DAQ OPTIONAL_CMD SET_DAQ_LIST_MODE OPTIONAL_CMD START_STOP_DAQ_LIST OPTIONAL_CMD START_STOP_SYNCH OPTIONAL_CMD GET_DAQ_CLOCK OPTIONAL_CMD READ_DAQ OPTIONAL_CMD GET_DAQ_PROCESSOR_INFO OPTIONAL_CMD GET_DAQ_RESOLUTION_INFO OPTIONAL_CMD GET_DAQ_EVENT_INFO OPTIONAL_CMD FREE_DAQ OPTIONAL_CMD ALLOC_DAQ OPTIONAL_CMD ALLOC_ODT OPTIONAL_CMD ALLOC_ODT_ENTRY COMMUNICATION_MODE_SUPPORTED /* optional modes supported */ BLOCK SLAVE /* Slave Block Mode supported */ MASTER /* Master Block Mode supported */ 255 /* MAX_BS */ 0 /* MIN_ST */ SEED_AND_KEY_EXTERNAL_FUNCTION "XcpSeedNKey.dll" /* Name of the SeedAndKey function */ /* including file extension */ /* without path */ /end PROTOCOL_LAYER
  /***************** end of PROTOCOL_LAYER *******************/ /********************* start of DAQ ************************/
  /begin DAQ /* DAQ supported, at MODULE*/ DYNAMIC /* DAQ_CONFIG_TYPE */ 65535 /* MAX_DAQ */ 3 /* MAX_EVENT_CHANNEL */ 0 /* MIN_DAQ */ OPTIMISATION_TYPE_DEFAULT /* OPTIMISATION_TYPE */ ADDRESS_EXTENSION_FREE /* ADDRESS_EXTENSION */ IDENTIFICATION_FIELD_TYPE_ABSOLUTE /* IDENTIFICATION_FIELD */ GRANULARITY_ODT_ENTRY_SIZE_DAQ_BYTE /* GRANULARITY_ODT_ENTRY_SIZE_DAQ */ 255 /* MAX_ODT_ENTRY_SIZE_DAQ */ OVERLOAD_INDICATION_EVENT /* OVERLOAD_INDICATION */ PRESCALER_SUPPORTED
   /begin TIMESTAMP_SUPPORTED 1 /* TIMESTAMP_TICKS */ SIZE_WORD /* TIMESTAMP_SIZE */ UNIT_1MS /* RESOLUTION OF TIMESTAMP */ /end TIMESTAMP_SUPPORTED
   /begin DAQ_MEMORY_CONSUMPTION 1019 /* DAQ_MEMORY_LIMIT: in Elements[AG] */ 46 /* DAQ_SIZE: number of elements[AG] per DAQ list */ 6 /* ODT_SIZE: number of elements[AG] per ODT */ 5 /* ODT_ENTRY_SIZE: number of elements[AG] per ODT_entry */ 2 /* ODT_DAQ_BUFFER_ELEMENT_SIZE: number of */ /* payload elements[AG]*factor = sizeof(send buffer)[AG] */ 0 /* ODT_STIM_BUFFER_ELEMENT_SIZE: number of */ /* payload elements[AG]*factor = sizeof(receive buffer)[AG] */ /end DAQ_MEMORY_CONSUMPTION
   /******************* start of EVENT ************************/
   /begin EVENT "10msRStr" "10ms" 0 DAQ 1 1 7 /* EVENT_CHANNEL_TIME_UNIT: UNIT_10MS */ 8 /end EVENT
   /begin EVENT "100msRStr" "100ms" 1 DAQ 1 1 8 /* EVENT_CHANNEL_TIME_UNIT: UNIT_100MS */ 10 /end EVENT
   /begin EVENT "50msRStr" "50ms" 2 DAQ 1 5 7 /* EVENT_CHANNEL_TIME_UNIT: UNIT_10MS */ 9 /end EVENT
   /********************* end of EVENT ************************/ /end DAQ
  /********************* end of DAQ **************************/ TRANSPORT_LAYER_INSTANCE "Transport" /end XCP_ON_CAN
/end IF_DATA
/begin CHARACTERISTIC SpeedLimitLower "This is ETAS BIP AUTOSAR PerInstanceParameter Scalar example 1" VALUE 0x007fc000 RTAA2L_Internal_Scalar_UnsignedLong 0 ETAS_BIP_CompuMethods_N1 0 16383.5 MAX_REFRESH 1000 1 /end CHARACTERISTIC
/begin CHARACTERISTIC sharedCURVE "This is ETAS BIP AUTOSAR SharedParameter CURVE example" CURVE 0x007fc008 ETAS_BIP_SwRecordLayouts_IntCurve_f32_f32 0 ETAS_BIP_CompuMethods_OneToOne_Curr_A -300 300
 /begin AXIS_DESCR STD_AXIS curveAxisInputVar ETAS_BIP_CompuMethods_OneToOne 10 -300 300 FORMAT "%2.1" PHYS_UNIT "degC" READ_ONLY /end AXIS_DESCR
 FORMAT "%1.1" MAX_REFRESH 1000 1 /end CHARACTERISTIC
/begin CHARACTERISTIC sharedMAP "This is ETAS BIP AUTOSAR SharedParameter MAP example" MAP 0x007fc01c ETAS_BIP_SwRecordLayouts_IntMap_f32f32_f32 0 ETAS_BIP_CompuMethods_OneToOne_Curr_A -3.4E+38 3.4E+38
 /begin AXIS_DESCR STD_AXIS mapAxisXInputVar ETAS_BIP_CompuMethods_OneToOne_Volt 10 -300 300 FORMAT "%5.1" /end AXIS_DESCR
 /begin AXIS_DESCR STD_AXIS mapAxisYInputVar ETAS_BIP_CompuMethods_OneToOne_Perc 10 -400 390 FORMAT "%6.1" /end AXIS_DESCR
 FORMAT "%4.1" MAX_REFRESH 1000 1 /end CHARACTERISTIC
/begin CHARACTERISTIC SpeedLimitUpper "This is ETAS BIP AUTOSAR PerInstanceParameter Scalar example 2" VALUE 0x007fc004 RTAA2L_Internal_Scalar_UnsignedLong 0 ETAS_BIP_CompuMethods_N1 0 16383.5 MAX_REFRESH 1000 1 /end CHARACTERISTIC
/begin CHARACTERISTIC speedMax "This is ETAS BIP AUTOSAR Interface Scalar example 2" VALUE 0x007fc204 RTAA2L_Internal_Scalar_UnsignedLong 0 ETAS_BIP_CompuMethods_N1 0 16383.5 /end CHARACTERISTIC
/begin CHARACTERISTIC speedMin "This is ETAS BIP AUTOSAR Interface Scalar example 1" VALUE 0x007fc208 RTAA2L_Internal_Scalar_UnsignedLong 0 ETAS_BIP_CompuMethods_N1 0 16383.5 /end CHARACTERISTIC
/begin MEASUREMENT curveAxisInputVar "signed integer 8bit" SBYTE NO_COMPU_METHOD 0 0 -128 127 ECU_ADDRESS 0x007c8400 READ_WRITE /end MEASUREMENT
/begin MEASUREMENT mapAxisXInputVar "unsigned integer 16bit" UWORD NO_COMPU_METHOD 0 0 0 65535 ECU_ADDRESS 0x007c8404 /end MEASUREMENT
/begin MEASUREMENT mapAxisYInputVar "signed integer 16bit" SWORD NO_COMPU_METHOD 0 0 -32768 32767 ECU_ADDRESS 0x007c8408 /end MEASUREMENT
/begin MEASUREMENT Rte_ArPim_CalUT_ArTypedPIM_1 "This is ETAS BIP AUTOSAR Typed PerInstance Memory Variable example" ULONG ETAS_BIP_CompuMethods_N1 0 0 0 16383.5 DISPLAY_IDENTIFIER ArTypedPIM_1 ECU_ADDRESS 0x007c840c MAX_REFRESH 1000 1 /end MEASUREMENT
/begin MEASUREMENT Rte_RamBlk_NvBlock_NvBlockDescriptor_StoreCyclicBlock_CyclicRamBlock "CyclicNvBlock" UBYTE RB_RBA_Common_CentralElements_CompuMethods_Identical 0 0 0 255 ARRAY_SIZE 1024 DISPLAY_IDENTIFIER CyclicNvBlock ECU_ADDRESS 0x00000000 MATRIX_DIM 1024 1 1 /end MEASUREMENT
/begin MEASUREMENT Rte_RamBlk_NvBlock_NvBlockDescriptor_StoreImmediateBlock_ImmediateRamBlock "ImmediateNvBlock" ULONG RB_RBA_Common_CentralElements_CompuMethods_Identical 0 0 0 4294967295 ARRAY_SIZE 96 DISPLAY_IDENTIFIER ImmediateNvBlock ECU_ADDRESS 0x00000000 MATRIX_DIM 96 1 1 /end MEASUREMENT
/begin MEASUREMENT Rte_RamBlk_NvBlock_NvBlockDescriptor_StoreAtShutdownBlock_ShutdownRamBlock "ShutDownNvBlock" UBYTE AUTOSAR_PlatformTypes_CompuMethods_boolean 0 0 0 1 ARRAY_SIZE 96 DISPLAY_IDENTIFIER ShutDownNvBlock ECU_ADDRESS 0x00000000 MATRIX_DIM 96 1 1 /end MEASUREMENT
/begin UNIT ETAS_BIP_Units_Rpm "LongName of Rpm" "rpm" EXTENDED_SI SI_EXPONENTS 0 0 0 0 0 0 0 /end UNIT
/begin COMPU_METHOD ETAS_BIP_CompuMethods_N1 "LongName of N1" LINEAR "%.2" "rpm" COEFFS_LINEAR 2 0 REF_UNIT ETAS_BIP_Units_Rpm /end COMPU_METHOD
/begin UNIT ETAS_BIP_Units_Ampr "ETAS_BIP_Units_Ampr" "A" EXTENDED_SI SI_EXPONENTS 0 0 0 0 0 0 0 /end UNIT
/begin COMPU_METHOD ETAS_BIP_CompuMethods_OneToOne_Curr_A "ETAS_BIP_CompuMethods_OneToOne_Curr_A" LINEAR "%.2" "A" COEFFS_LINEAR 1 0 REF_UNIT ETAS_BIP_Units_Ampr /end COMPU_METHOD
/begin UNIT ETAS_BIP_Units_DegCgrd "ETAS_BIP_Units_DegCgrd" "degC" EXTENDED_SI SI_EXPONENTS 0 0 0 0 0 0 0 /end UNIT
/begin UNIT ETAS_BIP_Units_NoUnit "ETAS_BIP_Units_NoUnit" "-" EXTENDED_SI SI_EXPONENTS 0 0 0 0 0 0 0 /end UNIT
/begin COMPU_METHOD ETAS_BIP_CompuMethods_OneToOne "ETAS_BIP_CompuMethods_OneToOne" LINEAR "%.2" "-" COEFFS_LINEAR 1 0 REF_UNIT ETAS_BIP_Units_NoUnit /end COMPU_METHOD
/begin UNIT ETAS_BIP_Units_Volt "ETAS_BIP_Units_Volt" "V" EXTENDED_SI SI_EXPONENTS 0 0 0 0 0 0 0 /end UNIT
/begin COMPU_METHOD ETAS_BIP_CompuMethods_OneToOne_Volt "ETAS_BIP_CompuMethods_OneToOne_Volt" LINEAR "%.2" "V" COEFFS_LINEAR 1 0 REF_UNIT ETAS_BIP_Units_Volt /end COMPU_METHOD
/begin UNIT ETAS_BIP_Units_Perc "ETAS_BIP_Units_Perc" "%" EXTENDED_SI SI_EXPONENTS 0 0 0 0 0 0 0 /end UNIT
/begin COMPU_METHOD ETAS_BIP_CompuMethods_OneToOne_Perc "ETAS_BIP_CompuMethods_OneToOne_Perc" LINEAR "%.2" "%" COEFFS_LINEAR 1 0 REF_UNIT ETAS_BIP_Units_Perc /end COMPU_METHOD
/begin UNIT RB_RBA_Common_CentralElements_PhysicalDimensions_NoUnit "RB_RBA_Common_CentralElements_PhysicalDimensions_NoUnit" "RB_RBA_Common_CentralElements_PhysicalDimensions_NoUnit" EXTENDED_SI SI_EXPONENTS 0 0 0 0 0 0 0 /end UNIT
/begin UNIT RB_RBA_Common_CentralElements_Units_NoUnit "No Unit" "noUnit" DERIVED REF_UNIT RB_RBA_Common_CentralElements_PhysicalDimensions_NoUnit UNIT_CONVERSION 1 0 /end UNIT
/begin COMPU_METHOD RB_RBA_Common_CentralElements_CompuMethods_Identical "The internal value and the physical one are identical. No physical unit available" IDENTICAL "%.2" "noUnit" REF_UNIT RB_RBA_Common_CentralElements_Units_NoUnit /end COMPU_METHOD
/begin COMPU_METHOD AUTOSAR_PlatformTypes_CompuMethods_boolean "AUTOSAR_PlatformTypes_CompuMethods_boolean" TAB_VERB "%.2" "" COMPU_TAB_REF AUTOSAR_PlatformTypes_CompuMethods_boolean_TAB /end COMPU_METHOD
/begin COMPU_VTAB AUTOSAR_PlatformTypes_CompuMethods_boolean_TAB "AUTOSAR_PlatformTypes_CompuMethods_boolean" TAB_VERB 2 0 "FALSE" 1 "TRUE" /end COMPU_VTAB
/begin RECORD_LAYOUT RTAA2L_Internal_Scalar_UnsignedLong FNC_VALUES 1 ULONG ROW_DIR DIRECT /end RECORD_LAYOUT
/begin RECORD_LAYOUT ETAS_BIP_SwRecordLayouts_IntCurve_f32_f32 NO_AXIS_PTS_X 1 ULONG AXIS_PTS_X 2 FLOAT32_IEEE INDEX_INCR DIRECT FNC_VALUES 3 FLOAT32_IEEE COLUMN_DIR DIRECT /end RECORD_LAYOUT
/begin RECORD_LAYOUT ETAS_BIP_SwRecordLayouts_IntMap_f32f32_f32 NO_AXIS_PTS_X 1 ULONG NO_AXIS_PTS_Y 2 ULONG AXIS_PTS_X 3 FLOAT32_IEEE INDEX_INCR DIRECT AXIS_PTS_Y 4 FLOAT32_IEEE INDEX_INCR DIRECT FNC_VALUES 5 FLOAT32_IEEE COLUMN_DIR DIRECT /end RECORD_LAYOUT
/end MODULE
/end PROJECT

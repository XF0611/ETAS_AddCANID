AUTOSAR XML (schema 4-2-2)
package /ETAS_BIP/BswImplementations
  bsw implementation TstM: programming-language=C, sw-version=1.0.0, vendor-id=11, ar-release-version=4.2.2, behavior=BswInternalBehavior

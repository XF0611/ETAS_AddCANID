AUTOSAR XML (schema 4-2-2)
package /ETAS_BIP/BswModuleDescriptions
  bsw module description TstM: category=BSW_MODULE, module-id=255
    bsw internal behavior BswInternalBehavior
      bsw schedulable entity TstM_Run: implemented-entry=TstM_Run
      bsw timing event TE_TstM_Run: starts-on-event=TstM_Run, period=0.1
  bsw module entry TstM_Run: is-reentrant=false, is-synchronous=true, call-type=SCHEDULED, execution-context=TASK, sw-service-impl-policy=STANDARD

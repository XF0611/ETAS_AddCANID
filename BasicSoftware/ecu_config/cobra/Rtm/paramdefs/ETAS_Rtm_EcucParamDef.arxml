AUTOSAR XML (schema 4-2-2)
package /ETAS_BIP/EcucModuleDefs
  module definition Rtm [0..1]: category=VENDOR_SPECIFIC_MODULE_DEFINITION, variants pre-compile  # Runtime | Module Rtm. It supports runtime measurement in series devices of tasks, runables and functions. It also monitores defined tasks. It uses the onchip debug features. If a user wants to work with a debugger at the same time as taking measurements, it is necessary to tell the debugger that the here configured breakpoint units are used otherwise. Up to 4 cores and 255 tasks are supported. Please refer to the manual for further details.
    container RtmControl: multiplicity set at pre-compile  # Controlled measure | Configuration for function measure feature
      enumeration RtmConcurrentMeasure: set at pre-compile, origin=ETAS ERS-Sgh EIP, default-value=One  # Concurrent measures number | Number of concurrent measurements per core. Increasing this value will speed up the measurement but does occupy RAM and breakpoint units. Breakpoint unit 0 and 1 is occupied in setting One. On IFX: 0 to 2 in setting Two, 0 to 3 in setting Three and 0 to 4 in setting Four. On JDP: 0 to 3 in setting Two, 0 to 5 in setting Three and 0 to 7 in setting Four. If a debugger is used during measurements these breakpoint units must be disable in the breakpoint configuration of the debugger.
        One  # One concurrent measure
        Two  # Two concurrent measure
        Three  # Three concurrent measures
        Four  # Four concurrent measures
      boolean RtmControlEnabled: set at pre-compile, origin=ETAS ERS-Sgh EIP  # Controlled measure on/off | The controlled measure (function measure) can be turned off here globally
    container RtmGeneral: multiplicity set at pre-compile  # General settings | Configuration of general aspects of the module.
      enumeration RtmInterface: set at pre-compile, origin=ETAS ERS-Sgh EIP, default-value=CalibrationMeasurement  # Interface selection | Definition of interface type: * Debugger or ECU internal only: Values are only accessable through the debugger or ECU internal * Calibration and measurement tool: All interface elements will be accessesable through a calibration and measurement tool (e.g. INCA)
        Debugger  # Debugger or ECU internal only
        CalibrationMeasurement  # Calibration and measurement tool
      string RtmMainFunctionPeriod: set at pre-compile, origin=ETAS ERS-Sgh EIP, default-value=10  # Allow to configure the time for the MainFunction (as float in seconds). This shall be configured to less than one second typically.
      string RtmNumberOfCores: set at pre-compile, origin=ETAS ERS-Sgh EIP  # Number of cores | On how many cores runs the OS
      boolean RtmVersionInfoApi: set at pre-compile, origin=ETAS ERS-Sgh EIP  # Version information API | Enables/disables the GetVersionInfo() API. This functionality can be used e.g. for providing version information to test equipment.
      symbolic name reference RtmMcuClockRef: origin=ETAS ERS-Sgh EIP, set at pre-compile, destination=McuClockReferencePoint  # Mcu clock source reference | Reference to one clock source container of MCU Clock tree. The frequency of referenced container mcuClockReferencePoint represend How fast is the free running counter clocked.
    container RtmMonitor: multiplicity set at pre-compile  # Monitoring | Configuration of the monitoring feature
      boolean RtmMonitorISR: set at pre-compile, origin=ETAS ERS-Sgh EIP  # Statistical values for ISRs | Should the ISR monitoring build statistical values
      string RtmMonitorSamplesPerMinute: set at pre-compile, origin=ETAS ERS-Sgh EIP, default-value=60  # Statistical values generated per minute | How often should the monitoring build statistical values per minute (systemload and task/ISR stats that are turned on)
      boolean RtmMonitorTask: set at pre-compile, origin=ETAS ERS-Sgh EIP  # Statistical values for tasks | Should the task monitoring build statistical values
      boolean RtmMonitorProcess: set at pre-compile, origin=ETAS ERS-Sgh EIP  # Statistical values for process | Should the task monitoring build statistical values
      boolean RtmMonitorIpc: set at pre-compile, origin=ETAS ERS-Sgh EIP  # Statistical values for IPC | Should the IPC monitoring build statistical values
      boolean RtmMonitorDirectIpc: set at pre-compile, origin=ETAS ERS-Sgh EIP  # Statistical values for DirectIPC | Should the DirectIPC monitoring build statistical values
      string RtmMonitorProcessList [0..*]: multiplicity set at pre-compile, origin=ETAS ERS-Sgh EIP, set at pre-compile  # Process name to be monitored.
      reference RtmMonitorISRList [0..255]: origin=ETAS ERS-Sgh EIP, set at link in variant link-time+post-build / pre-compile in variant pre-compile, destination=OsIsr  # List of ISRs | List of ISRs which should be monitored. The order will define the tasks index in the monitoring structure. The list can be extracted from the OS configuration.
      reference RtmMonitorTaskList [0..255]: origin=ETAS ERS-Sgh EIP, set at link in variant link-time+post-build / pre-compile in variant pre-compile, destination=OsTask  # List of tasks | List of tasks which should be monitored. The order will define the tasks index in the monitoring structure. The list can be extracted from the OS configuration.
      reference RtmMonitorIpcList [0..40]: origin=ETAS ERS-Sgh EIP, set at link in variant link-time+post-build / pre-compile in variant pre-compile, destination=CddIpcCommChs  # List of Ipc | List of Ipc which should be monitored. The order will define the ipc index in the monitoring structure. The list can be extracted from the Cdd_Ipc configuration.
      reference RtmMonitorDirectIpcList10 [0..4]: origin=ETAS ERS-Sgh EIP, set at link in variant link-time+post-build / pre-compile in variant pre-compile, destination=MessageQueue  # List of Direct Ipc | List of Direct Ipc which should be monitored. The order will define the ipc index in the monitoring structure. The list can be extracted from the DirectIpc configuration.
      reference RtmMonitorDirectIpcList11 [0..4]: origin=ETAS ERS-Sgh EIP, set at link in variant link-time+post-build / pre-compile in variant pre-compile, destination=MessageQueue  # List of Direct Ipc | List of Direct Ipc which should be monitored. The order will define the ipc index in the monitoring structure. The list can be extracted from the DirectIpc configuration.

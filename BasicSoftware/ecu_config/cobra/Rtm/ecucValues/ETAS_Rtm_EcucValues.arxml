AUTOSAR XML (schema 00047)
package /ETAS_BIP/EcucModuleConfigurationValuess
  module config Rtm: implementation-config-variant=VARIANT-PRE-COMPILE
    RtmControl: RtmConcurrentMeasure=One, RtmControlEnabled=true
    RtmGeneral: RtmInterface=Debugger, RtmNumberOfCores=1, RtmVersionInfoApi=true, RtmMainFunctionPeriod=0.1, RtmMcuClockRef=F_MCU_SYSTIMER
    RtmMonitor:
      RtmMonitorISR = true
      RtmMonitorTask = true
      RtmMonitorSamplesPerMinute = 12
      RtmMonitorIpc = false
      RtmMonitorDirectIpc = false
      RtmMonitorProcess = true
      RtmMonitorProcessList = NvM_ReadAll
      RtmMonitorProcessList = NvM_WriteAll
      RtmMonitorProcessList = NvM_WriteBlock
      RtmMonitorProcessList = MemIf_MainFunction
      RtmMonitorProcessList = Fee_Init
      RtmMonitorProcessList = NvM_Init
      RtmMonitorTaskList = OsTask_ComCore_ASW_10ms
      RtmMonitorTaskList = OsTask_SysCore_BswBg_100ms
      RtmMonitorTaskList = OsTask_SysCore_BSW_1ms
      RtmMonitorTaskList = OsTask_AppCore_BSW_10ms
      RtmMonitorTaskList = OsTask_SysCore_BSW_SwcRequest
      RtmMonitorTaskList = OsTask_SysCore_BSW_10ms
      RtmMonitorTaskList = OsTask_AppCore_ASW_10ms
      RtmMonitorTaskList = OsTask_SysCore_ASW_50ms
      RtmMonitorTaskList = OsTask_SysCore_Startup
      RtmMonitorTaskList = OsTask_SysCore_ASW_10ms
      RtmMonitorTaskList = OsTask_SysCore_BswBg_1ms
      RtmMonitorTaskList = OsTask_ECU_Startup
      RtmMonitorTaskList = OsTask_SysCore_ASW_100ms
      RtmMonitorTaskList = OsTask_SysCore_DRE
      RtmMonitorTaskList = OsTask_ComCore_BSW_10ms
      RtmMonitorISRList = SystemCounter
      RtmMonitorISRList = Gpt1_Isr

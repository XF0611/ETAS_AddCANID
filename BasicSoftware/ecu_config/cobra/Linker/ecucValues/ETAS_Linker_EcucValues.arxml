AUTOSAR XML (schema 00047)
package /ETAS_BIP/EcucModuleConfigurationValuess
  module config Linker
    LinkerGeneral: LinkerEnable=true
    LinkerConfigSet
      TargetStack: TargetStackGrowDown=true, TargetNumberOfStack=1
        SYSCORE_STACK (TargetStackConfigSet): TargetStackSize=4096
      MemMapSection: TargetCompiler=HIGHTEC_AURIX
        HIGHTEC_AURIX:
          PragmaCodeSection = #pragma code("SectionName");
          LinkerCodeSection = : ALIGN(4)
          PragmaConstSection = #pragma code("SectionName");
          LinkerConstSection = : ALIGN(4)
          PragmaClearedDataSection = #pragma data("SectionName");
          LinkerClearedDataSection = : ALIGN(4)
          PragmaInitDataSection = #pragma data("SectionName");
          LinkerInitDataSection = : ALIGN(4)

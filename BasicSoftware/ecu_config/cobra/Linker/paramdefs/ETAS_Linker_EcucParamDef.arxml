AUTOSAR XML (schema 4-2-2)
package /ETAS_EIP/EcucModuleDefs
  module definition Linker [0..1]: category=VENDOR_SPECIFIC_MODULE_DEFINITION, variants pre-compile  # Linker File | Module Linker file.
    container LinkerGeneral: multiplicity set at pre-compile  # General settings | Configuration of general aspects of the module.
      boolean LinkerEnable: origin=ETAS ERS-Sgh EIP, set at pre-compile, symbolic-name-value=true  # Linker File Enabling | Set to STD_ON if this feature has to be enabled, otherwise set STD_OFF. When StackM used, Linker shall be enabled.
    container LinkerConfigSet: multiplicity set at pre-compile  # Linker configuration | Configuration of the Linker properties
      container TargetStack: multiplicity set at pre-compile  # Target stack configuration | The container describes target stack parameters.
        boolean TargetStackGrowDown: origin=ETAS ERS-Sgh EIP, set at pre-compile, symbolic-name-value=true  # Stack growing direction is down | Set to TRUE if stack on this target is growing down, otherwise set FALSE
        integer TargetNumberOfStack: 0..255, scope=ECU, origin=ETAS ERS-Sgh EIP, set at pre-compile  # Number of Stacks available in AUTOSAR context | This container shall contain the total number of stacks configured in StackMStackConfigSet. Normally one core has a single stack. However its target dependent, e.g. for some ARM cores, multiple stacks required for different context for a single core.
        container TargetStackConfigSet [1..255]: multiplicity set at pre-compile  # Stack properties | This container configures properties of a stack on the target.
          integer TargetStackSize: 0..4294967295, scope=ECU, origin=ETAS ERS-Sgh EIP, set at pre-compile  # Size in byte of the Stack | This container contain the size of stacks configured in TargetStackConfigSet.
      container TargetFlsTst [0..1]: multiplicity set at pre-compile  # Target Flash Test configuration | The container describes target flash test block parameters.
        container BackgroundMemorySegment [0..255]: multiplicity set at pre-compile  # FlsTst block properties | This container configures properties of memory section for background test on the target.
          integer BlockBaseAddress: 0..4294967295, scope=ECU, origin=ETAS ERS-Sgh EIP, set at pre-compile  # Start address of the background test block. | This container contain the start address of the background test block.
          integer BlockSize: 0..255, scope=ECU, origin=ETAS ERS-Sgh EIP, set at pre-compile  # Size in byte of the background test block. | This container contain the number of cells of the background test block. Max allow 255 cells to test in a block.
        container ForegroundMemorySegment [0..255]: multiplicity set at pre-compile  # FlsTst block properties | This container configures properties of memory section for foreground test on the target.
          integer BlockBaseAddress: 0..4294967295, scope=ECU, origin=ETAS ERS-Sgh EIP, set at pre-compile  # Start address of the foreground test block. | This container contain the start address of the foreground test block.
          integer BlockSize: 0..255, scope=ECU, origin=ETAS ERS-Sgh EIP, set at pre-compile  # Size in byte of the foreground test block. | This container contain the number of cells of the foreground test block. Max allow 255 cells to test in a block.
      container TargetRamTst [0..1]: multiplicity set at pre-compile  # Target RAM Test configuration | The container describes target RAM test block parameters.
        container BlockParams [0..255]: multiplicity set at pre-compile  # RAM block properties | This container configures properties of RAM blocks for RAM test on the target.
          integer BlockBaseAddress: 0..4294967295, scope=ECU, origin=ETAS ERS-Sgh EIP, set at pre-compile  # Start address of the background test block. | This container contain the start address of the background test block.
          integer EndAddress: 0..4294967295, scope=ECU, origin=ETAS ERS-Sgh EIP, set at pre-compile  # End address of the background test block. | This container contain the end address of the background test block.
      container MemMapSection: multiplicity set at pre-compile  # Target MemMap and section configuration | The container describes target memory map and section parameters dependent on target and compiler.
        enumeration TargetCompiler: {HIGHTEC_AURIX, ARM_RCAR, TIARM_TDA4, TASKING_AURIX, GHS_ARM}, origin=ETAS ERS-Sgh EIP, set at pre-compile, symbolic-name-value=true  # Target family and compiler variant | The container describes target compiler selected to use from a set of support list.
        container HIGHTEC_AURIX [0..1]: multiplicity set at pre-compile  # Compiler properties for MemMap and Linker sections. | This container configures properties of compiler properties for MemMap and Linker sections..
          enumeration PragmaCodeSection: {#pragma code("SectionName");}, scope=ECU, origin=ETAS ERS-Sgh EIP, set at pre-compile  # Compiler pragma syntex and option describing code section. | This container contain the pragma syntex and option for code sections to be generated into MemMap.h. Note: user is responsible for guarantee its correct and fit for use.
          enumeration LinkerCodeSection: {: ALIGN(4)}, scope=ECU, origin=ETAS ERS-Sgh EIP, set at pre-compile  # Linker options describing code section. | This container contain the linker options for code sections to be generated into MemMap.h. Note: user is responsible for guarantee its correct and fit for use.
          enumeration PragmaConstSection: {#pragma code("SectionName");}, scope=ECU, origin=ETAS ERS-Sgh EIP, set at pre-compile  # Compiler pragma syntex and option describing const data section. | This container contain the pragma syntex and option for const data sections to be generated into MemMap.h. Note: user is responsible for guarantee its correct and fit for use.
          enumeration LinkerConstSection: {: ALIGN(4)}, scope=ECU, origin=ETAS ERS-Sgh EIP, set at pre-compile  # Linker options describing const section. | This container contain the linker options for const sections to be generated into MemMap.h. Note: user is responsible for guarantee its correct and fit for use.
          enumeration PragmaClearedDataSection: {#pragma data("SectionName");}, scope=ECU, origin=ETAS ERS-Sgh EIP, set at pre-compile  # Compiler pragma syntex and option describing cleared data section. | This container contain the pragma syntex and option for cleared data sections to be generated into MemMap.h. Note: user is responsible for guarantee its correct and fit for use.
          enumeration LinkerClearedDataSection: {: ALIGN(4)}, scope=ECU, origin=ETAS ERS-Sgh EIP, set at pre-compile  # Linker options describing cleared data section. | This container contain the linker options for cleared data sections to be generated into MemMap.h. Note: user is responsible for guarantee its correct and fit for use.
          enumeration PragmaInitDataSection: {#pragma data("SectionName");}, scope=ECU, origin=ETAS ERS-Sgh EIP, set at pre-compile  # Compiler pragma syntex and option describing initialized data section. | This container contain the pragma syntex and option for initialized data sections to be generated into MemMap.h. Note: user is responsible for guarantee its correct and fit for use.
          enumeration LinkerInitDataSection: {: ALIGN(4)}, scope=ECU, origin=ETAS ERS-Sgh EIP, set at pre-compile  # Linker options describing initialized data section. | This container contain the linker options for initialized data sections to be generated into MemMap.h. Note: user is responsible for guarantee its correct and fit for use.
        container ARM_RCAR [0..1]: multiplicity set at pre-compile  # Compiler properties for MemMap and Linker sections. | This container configures properties of compiler properties for MemMap and Linker sections..
          enumeration PragmaCodeSection: {#pragma clang section text="[SectionName]"}, scope=ECU, origin=ETAS ERS-Sgh EIP, set at pre-compile  # Compiler pragma syntex and option describing code section. | This container contain the pragma syntex and option for code sections to be generated into MemMap.h. Note: user is responsible for guarantee its correct and fit for use.
          enumeration PragmaConstSection: {#pragma clang section rodata="[SectionName]"}, scope=ECU, origin=ETAS ERS-Sgh EIP, set at pre-compile  # Compiler pragma syntex and option describing const data section. | This container contain the pragma syntex and option for const data sections to be generated into MemMap.h. Note: user is responsible for guarantee its correct and fit for use.
          enumeration PragmaClearedDataSection: {#pragma clang section bss="[SectionName]"}, scope=ECU, origin=ETAS ERS-Sgh EIP, set at pre-compile  # Compiler pragma syntex and option describing cleared data section. | This container contain the pragma syntex and option for cleared data sections to be generated into MemMap.h. Note: user is responsible for guarantee its correct and fit for use.
          enumeration PragmaInitDataSection: {#pragma clang section data="[SectionName]"}, scope=ECU, origin=ETAS ERS-Sgh EIP, set at pre-compile  # Compiler pragma syntex and option describing initialized data section. | This container contain the pragma syntex and option for initialized data sections to be generated into MemMap.h. Note: user is responsible for guarantee its correct and fit for use.
        container TIARM_TDA4 [0..1]: multiplicity set at pre-compile  # Compiler properties for MemMap and Linker sections. | This container configures properties of compiler properties for MemMap and Linker sections..
          enumeration PragmaCodeSection: {#pragma SET_CODE_SECTION("[SectionName]")}, scope=ECU, origin=ETAS ERS-Sgh EIP, set at pre-compile  # Compiler pragma syntex and option describing code section. | This container contain the pragma syntex and option for code sections to be generated into MemMap.h. Note: user is responsible for guarantee its correct and fit for use.
          enumeration LinkerCodeSection: {: align=4}, scope=ECU, origin=ETAS ERS-Sgh EIP, set at pre-compile  # Linker options describing code section. | This container contain the linker options for code sections to be generated into MemMap.h. Note: user is responsible for guarantee its correct and fit for use.
          enumeration PragmaConstSection: {#pragma SET_DATA_SECTION("[SectionName]")}, scope=ECU, origin=ETAS ERS-Sgh EIP, set at pre-compile  # Compiler pragma syntex and option describing const data section. | This container contain the pragma syntex and option for const data sections to be generated into MemMap.h. Note: user is responsible for guarantee its correct and fit for use.
          enumeration LinkerConstSection: {: align=4}, scope=ECU, origin=ETAS ERS-Sgh EIP, set at pre-compile  # Linker options describing const section. | This container contain the linker options for const sections to be generated into MemMap.h. Note: user is responsible for guarantee its correct and fit for use.
          enumeration PragmaClearedDataSection: {#pragma SET_DATA_SECTION("[SectionName]")}, scope=ECU, origin=ETAS ERS-Sgh EIP, set at pre-compile  # Compiler pragma syntex and option describing cleared data section. | This container contain the pragma syntex and option for cleared data sections to be generated into MemMap.h. Note: user is responsible for guarantee its correct and fit for use.
          enumeration LinkerClearedDataSection: {: align=4}, scope=ECU, origin=ETAS ERS-Sgh EIP, set at pre-compile  # Linker options describing cleared data section. | This container contain the linker options for cleared data sections to be generated into MemMap.h. Note: user is responsible for guarantee its correct and fit for use.
          enumeration PragmaInitDataSection: {#pragma SET_DATA_SECTION("[SectionName]")}, scope=ECU, origin=ETAS ERS-Sgh EIP, set at pre-compile  # Compiler pragma syntex and option describing initialized data section. | This container contain the pragma syntex and option for initialized data sections to be generated into MemMap.h. Note: user is responsible for guarantee its correct and fit for use.
          enumeration LinkerInitDataSection: {: align=4}, scope=ECU, origin=ETAS ERS-Sgh EIP, set at pre-compile  # Linker options describing initialized data section. | This container contain the linker options for initialized data sections to be generated into MemMap.h. Note: user is responsible for guarantee its correct and fit for use.
        container TASKING_AURIX [0..1]: multiplicity set at pre-compile
          enumeration PragmaCodeSection: {#pragma section code = "[SectionName]"}, scope=ECU, origin=ETAS ERS-Sgh EIP, set at pre-compile  # Compiler pragma syntex and option describing code section. | This container contain the pragma syntex and option for code sections to be generated into MemMap.h. Note: user is responsible for guarantee its correct and fit for use.
          enumeration CodeSectionAlign: {align = 4, align = 8, align = 16, align = 32}, scope=ECU, origin=ETAS ERS-Sgh EIP, set at pre-compile  # Compiler pragma syntex and option describing code section. | This container contain the pragma syntex and option for code sections to be generated into MemMap.h. Note: user is responsible for guarantee its correct and fit for use.
          enumeration LinkerCodeSection: {:vtc:linear}, scope=ECU, origin=ETAS ERS-Sgh EIP, set at pre-compile  # Linker options describing code section. | This container contain the linker options for code sections to be generated into MemMap.h. Note: user is responsible for guarantee its correct and fit for use.
          enumeration PragmaConstSection: {#pragma section farrom = "[SectionName]"}, scope=ECU, origin=ETAS ERS-Sgh EIP, set at pre-compile  # Compiler pragma syntex and option describing const data section. | This container contain the pragma syntex and option for const data sections to be generated into MemMap.h. Note: user is responsible for guarantee its correct and fit for use.
          enumeration ConstSectionAlign: {align = 4, align = 8, align = 16, align = 32}, scope=ECU, origin=ETAS ERS-Sgh EIP, set at pre-compile  # Compiler pragma syntex and option describing code section. | This container contain the pragma syntex and option for code sections to be generated into MemMap.h. Note: user is responsible for guarantee its correct and fit for use.
          enumeration LinkerConstSection: {:vtc:linear}, scope=ECU, origin=ETAS ERS-Sgh EIP, set at pre-compile  # Linker options describing const section. | This container contain the linker options for const sections to be generated into MemMap.h. Note: user is responsible for guarantee its correct and fit for use.
          enumeration PragmaClearedDataSection: {#pragma section farbss = "[SectionName]"}, scope=ECU, origin=ETAS ERS-Sgh EIP, set at pre-compile  # Compiler pragma syntex and option describing cleared data section. | This container contain the pragma syntex and option for cleared data sections to be generated into MemMap.h. Note: user is responsible for guarantee its correct and fit for use.
          enumeration ClearedDataSectionAlign: {align = 4, align = 8, align = 16, align = 32}, scope=ECU, origin=ETAS ERS-Sgh EIP, set at pre-compile  # Compiler pragma syntex and option describing code section. | This container contain the pragma syntex and option for code sections to be generated into MemMap.h. Note: user is responsible for guarantee its correct and fit for use.
          enumeration LinkerClearedDataSection: {:vtc:linear}, scope=ECU, origin=ETAS ERS-Sgh EIP, set at pre-compile  # Linker options describing cleared data section. | This container contain the linker options for cleared data sections to be generated into MemMap.h. Note: user is responsible for guarantee its correct and fit for use.
          enumeration PragmaInitDataSection: {#pragma section fardata = "[SectionName]"}, scope=ECU, origin=ETAS ERS-Sgh EIP, set at pre-compile  # Compiler pragma syntex and option describing initialized data section. | This container contain the pragma syntex and option for initialized data sections to be generated into MemMap.h. Note: user is responsible for guarantee its correct and fit for use.
          enumeration InitDataSectionAlign: {align = 4, align = 8, align = 16, align = 32}, scope=ECU, origin=ETAS ERS-Sgh EIP, set at pre-compile  # Compiler pragma syntex and option describing code section. | This container contain the pragma syntex and option for code sections to be generated into MemMap.h. Note: user is responsible for guarantee its correct and fit for use.
          enumeration LinkerInitDataSection: {:vtc:linear}, scope=ECU, origin=ETAS ERS-Sgh EIP, set at pre-compile  # Linker options describing initialized data section. | This container contain the linker options for initialized data sections to be generated into MemMap.h. Note: user is responsible for guarantee its correct and fit for use.
        container GHS_ARM [0..1]: multiplicity set at pre-compile  # Compiler properties for MemMap and Linker sections.Compiler properties for MemMap and Linker sections. | This container configures properties of compiler properties for MemMap and Linker sections..This container configures properties of compiler properties for MemMap and Linker sections..
          enumeration PragmaCodeSection: {#pragma ghs section text="[SectionName]"}, scope=ECU, origin=ETAS ERS-Sgh EIP, set at pre-compile  # Compiler pragma syntex and option describing code section.Compiler pragma syntex and option describing code section. | This container contain the pragma syntex and option for code sections to be generated into MemMap.h. Note: user is responsible for guarantee its correct and fit for use.This container contain the pragma syntex and option for code sections to be generated into MemMap.h. Note: user is responsible for guarantee its correct and fit for use.
          enumeration LinkerCodeSection: {ALIGN(4):}, scope=ECU, origin=ETAS ERS-Sgh EIP, set at pre-compile  # Linker options describing code section.Linker options describing code section. | This container contain the linker options for code sections to be generated into MemMap.h. Note: user is responsible for guarantee its correct and fit for use.This container contain the linker options for code sections to be generated into MemMap.h. Note: user is responsible for guarantee its correct and fit for use.
          enumeration PragmaConstSection: {#pragma ghs section rodata="[SectionName]"}, scope=ECU, origin=ETAS ERS-Sgh EIP, set at pre-compile  # Compiler pragma syntex and option describing const data section.Compiler pragma syntex and option describing const data section. | This container contain the pragma syntex and option for const data sections to be generated into MemMap.h. Note: user is responsible for guarantee its correct and fit for use.This container contain the pragma syntex and option for const data sections to be generated into MemMap.h. Note: user is responsible for guarantee its correct and fit for use.
          enumeration LinkerConstSection: {ALIGN(4):}, scope=ECU, origin=ETAS ERS-Sgh EIP, set at pre-compile  # Linker options describing const section.Linker options describing const section. | This container contain the linker options for const sections to be generated into MemMap.h. Note: user is responsible for guarantee its correct and fit for use.This container contain the linker options for const sections to be generated into MemMap.h. Note: user is responsible for guarantee its correct and fit for use.
          enumeration PragmaClearedDataSection: {#pragma ghs section bss="[SectionName]"}, scope=ECU, origin=ETAS ERS-Sgh EIP, set at pre-compile  # Compiler pragma syntex and option describing cleared data section.Compiler pragma syntex and option describing cleared data section. | This container contain the pragma syntex and option for cleared data sections to be generated into MemMap.h. Note: user is responsible for guarantee its correct and fit for use.This container contain the pragma syntex and option for cleared data sections to be generated into MemMap.h. Note: user is responsible for guarantee its correct and fit for use.
          enumeration LinkerClearedDataSection: {ALIGN(4):}, scope=ECU, origin=ETAS ERS-Sgh EIP, set at pre-compile  # Linker options describing cleared data section.Linker options describing cleared data section. | This container contain the linker options for cleared data sections to be generated into MemMap.h. Note: user is responsible for guarantee its correct and fit for use.This container contain the linker options for cleared data sections to be generated into MemMap.h. Note: user is responsible for guarantee its correct and fit for use.
          enumeration PragmaInitDataSection: {#pragma ghs section data="[SectionName]"}, scope=ECU, origin=ETAS ERS-Sgh EIP, set at pre-compile  # Compiler pragma syntex and option describing initialized data section.Compiler pragma syntex and option describing initialized data section. | This container contain the pragma syntex and option for initialized data sections to be generated into MemMap.h. Note: user is responsible for guarantee its correct and fit for use.This container contain the pragma syntex and option for initialized data sections to be generated into MemMap.h. Note: user is responsible for guarantee its correct and fit for use.
          enumeration LinkerInitDataSection: {ALIGN(4):}, scope=ECU, origin=ETAS ERS-Sgh EIP, set at pre-compile  # Linker options describing initialized data section.Linker options describing initialized data section. | This container contain the linker options for initialized data sections to be generated into MemMap.h. Note: user is responsible for guarantee its correct and fit for use.This container contain the linker options for initialized data sections to be generated into MemMap.h. Note: user is responsible for guarantee its correct and fit for use.

AUTOSAR XML (schema 00047)
package /ETAS_EIP/EcucModuleConfigurationValuess
  module config StackM
    StackMGeneral:
      StackMEnable = true
      StackMTraceEnable = true
      StackMPatternEnable = true
      StackMDevErrorDetect = true
      StackMPattern = 1280067910
      StackMLimitHigh = 830039403
      StackMLimitLow = 846816619
    StackMConfigSet
      StackMTarget
        StackMStackConfigSet_0 (StackMStackConfigSet):
          StackMStackID = 0
          StackMStackLimit1 = STACKM_LIMIT_PERCENT_12p5
          StackMStackLimit2 = STACKM_LIMIT_PERCENT_25
          StackMStackLimit3 = STACKM_LIMIT_PERCENT_50
          StackMStackCoreID = EcucCore_SysCore
          StackMStackName = SYSCORE_STACK

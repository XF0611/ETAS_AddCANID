AUTOSAR XML (schema 4-2-2)
package /ETAS_BIP/BswModuleDescriptions
  bsw module description StackM: category=BSW_MODULE, module-id=255
    bsw internal behavior BswInternalBehavior
      bsw schedulable entity StackM_ScanAllStacks: implemented-entry=StackM_ScanAllStacks
      bsw called entity StackM_GetStackInfo: implemented-entry=StackM_GetStackInfo
      bsw timing event TE_StackM_ScanAllStacks: starts-on-event=StackM_ScanAllStacks, period=0.001
  bsw module entry StackM_ScanAllStacks: is-reentrant=false, is-synchronous=true, call-type=SCHEDULED, execution-context=TASK, sw-service-impl-policy=STANDARD
  bsw module entry StackM_GetStackInfo: is-reentrant=false, is-synchronous=true, call-type=REGULAR, execution-context=UNSPECIFIED, sw-service-impl-policy=STANDARD
    return type StackM_ReturnType: direction=OUT, implementation-data-type=StackM_ReturnType  # E_OK is returned if the service has succeeded.E_NOT_OK is returned if the service has failed, e.g. due to NULL pointer being passed
    sw service arg StackId: category=DATA_REFERENCE, direction=IN, sw-pointer-target-props={target-category=VALUE, implementation-data-type=uint8}  # The parameter identify the stack whose monitor information shall be get.
    sw service arg StackInfo: category=DATA_REFERENCE, direction=OUT, sw-pointer-target-props={target-category=VALUE, implementation-data-type=StackM_StackMeasureType}  # The parameter points to the variable which contains the selected stack minotor information.
package /ETAS_BIP/ImplementationDataTypes
  impl type StackM_ReturnType: compu {0=STACKM_OK, 1=STACKM_NOK_LIMIT, 2=STACKM_NOK_INIT, 2=STACKM_NOK_ID, 2=COREID_NOTUSED}, implementation-data-type=uint32, type-emitter=HEADER_FILE  # Return type of the StackM module | The StackM_ReturnType values are returned indication status of the function execution.
  impl type StackM_StackMeasureType: category=STRUCTURE, type-emitter=RTE  # Type of stack monitor informaiton of the StackM module | The StackM_StackMeasureType values are output informaiton of the stack scanning execution.
    element FreeSpace: implementation-data-type=uint32
    element FreePercent: implementation-data-type=float32
    element CheckWordReached: implementation-data-type=uint8
package /ETAS_BIP/PortInterfaces
  client server interface StackMService: is-service=true
    operation GetStackInfo: possible-error=[STACKM_NOK_LIMIT, STACKM_NOK_ID, STACKM_NOK_INIT, COREID_NOTUSED]
      arg coreId: sw-calibration-access=READ-ONLY, type=uint32, direction=IN
      arg StackId: sw-calibration-access=READ-ONLY, type=uint8, direction=IN
      arg pStackInfo: sw-calibration-access=READ-ONLY, type=StackM_StackMeasureType, direction=OUT
    4 x error:
      STACKM_NOK_LIMIT: error-code=1
      STACKM_NOK_INIT: error-code=2
      STACKM_NOK_ID: error-code=3
      COREID_NOTUSED: error-code=4

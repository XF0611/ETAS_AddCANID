AUTOSAR XML (schema 4-2-2)
package /ETAS_EIP/EcucModuleDefs
  module definition StackM [0..1]: category=VENDOR_SPECIFIC_MODULE_DEFINITION, variants pre-compile  # Stack Monitor | Module StackM. It supports runtime minotor of stack.
    container StackMGeneral: multiplicity set at pre-compile  # General settings | Configuration of general aspects of the module.
      boolean StackMDevErrorDetect: origin=ETAS ERS-Sgh EIP, set at pre-compile  # Development error enable | Switches the development error detection and notification on or off. true: detection and notification is enabled. false: detection and notification is disabled.
      boolean StackMEnable: origin=ETAS ERS-Sgh EIP, set at pre-compile, symbolic-name-value=true  # Stack Monitor Enabling | Set to STD_ON if this feature has to be enabled, otherwise set STD_OFF
      boolean StackMTraceEnable: origin=ETAS ERS-Sgh EIP, set at pre-compile, symbolic-name-value=true  # Stack Monitor trace Enabling | Set to STD_ON if this feature has to be enabled, otherwise set STD_OFF
      boolean StackMPatternEnable: origin=ETAS ERS-Sgh EIP, set at pre-compile, symbolic-name-value=true  # Stack Monitor pattern filling Enabling | Set to STD_ON if this feature has to be enabled, otherwise set STD_OFF
      integer StackMPattern [0..1]: 0..4294967295, scope=ECU, multiplicity set at pre-compile, origin=ETAS ERS-Sgh EIP, set at pre-compile  # The pattern to be used for stack filling.
      integer StackMLimitHigh [0..1]: 0..4294967295, scope=ECU, multiplicity set at pre-compile, origin=ETAS ERS-Sgh EIP, set at pre-compile  # The 32 bits high part of the 64 bits threshold key.
      integer StackMLimitLow [0..1]: 0..4294967295, scope=ECU, multiplicity set at pre-compile, origin=ETAS ERS-Sgh EIP, set at pre-compile  # The 32 bits low part of the 64 bits threshold key.
    container StackMConfigSet: multiplicity set at pre-compile  # Stack Monitor configuration | Configuration of the stack monitoring feature
      container StackMTarget: multiplicity set at pre-compile  # StackM target dependent configuration | The container describes target dependent parts of Stack Monitor.
        container StackMStackConfigSet [1..255]: multiplicity set at pre-compile  # Stack Monitor properties | This container configures properties of a stack that will be monitored during runtime, e.g. Cores belonging to, start address and endaddress
          integer StackMStackID  # The stack ID in view of StackM | This parameter contains the id of stack which Stack Monitor will use to perform runtime monitoring.
          enumeration StackMStackLimit1 [0..1]: {STACKM_LIMIT_PERCENT_12p5}, scope=ECU, origin=ETAS ERS-Sgh EIP, set at pre-compile  # Stack limit threshold 1 | Stack Monitoring limit threshold 1.
          enumeration StackMStackLimit2 [0..1]: {STACKM_LIMIT_PERCENT_25}, scope=ECU, origin=ETAS ERS-Sgh EIP, set at pre-compile  # Stack limit threshold 2 | Stack Monitoring limit threshold 2.
          enumeration StackMStackLimit3 [0..1]: {STACKM_LIMIT_PERCENT_50}, scope=ECU, origin=ETAS ERS-Sgh EIP, set at pre-compile  # Stack limit threshold 3 | Stack Monitoring limit threshold 3.
          symbolic name reference StackMStackCoreID: origin=ETAS ERS-Sgh EIP, set at pre-compile, destination=EcucCoreDefinition  # The core ID which the stack belongs to | This parameter contains the reference to AUTOSAR OS core ID which the stack blongs to.
          symbolic name reference StackMStackName: origin=ETAS ERS-Sgh EIP, set at pre-compile, destination=TargetStackConfigSet  # The name of the Stack in linker file | This parameter contains the reference to Stack name referencing LInker component.

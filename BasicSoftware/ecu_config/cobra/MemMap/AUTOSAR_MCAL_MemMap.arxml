AUTOSAR XML (schema 4-2-2)
package /AUTOSAR_MemMap/SwAddrMethods
  sw addr method SHAREDMEMORY: memory-allocation-keyword-policy=ADDR-METHOD-SHORT-NAME-AND-ALIGNMENT, section-initialization-policy=CLEARED, section-type=VAR

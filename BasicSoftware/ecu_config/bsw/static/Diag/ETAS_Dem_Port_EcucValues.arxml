AUTOSAR XML (schema 4-2-2)
package /ETAS_BIP/EcucModuleConfigurationValuess
  module config Dem
    DemConfigSet
      5 x DemEventParameter, all with DemEventKind=DEM_EVENT_KIND_BSW, DemEventAvailable=false, DemEventFailureCycleCounterThreshold=1, DemFFPrestorageSupported=false, DemOperationCycleRef=DemOpCycle_DEM_POWER:
        PORT_E_WRITE_VERIFY_FAILURE
          DemDebounceAlgorithmClass
          DemRbEventClass: DemRbEventBufferTime=0, DemRbEventRecoverableInSameOperationCycle=true, DemRbEventStatusBitStorageTestFailed=false
        PORT_E_CONFIGURATION_CHECK_PERMANENT_FAILURE
          DemDebounceAlgorithmClass
          DemRbEventClass: DemRbEventBufferTime=0, DemRbEventRecoverableInSameOperationCycle=true, DemRbEventStatusBitStorageTestFailed=false
        PORT_E_GET_CONTROL_FAILURE
          DemDebounceAlgorithmClass
          DemRbEventClass: DemRbEventBufferTime=0, DemRbEventRecoverableInSameOperationCycle=true, DemRbEventStatusBitStorageTestFailed=false
        PORT_E_FUSE_MONITORING_FAILURE
          DemDebounceAlgorithmClass
          DemRbEventClass: DemRbEventBufferTime=0, DemRbEventRecoverableInSameOperationCycle=true, DemRbEventStatusBitStorageTestFailed=false
        PORT_E_CONFIGURATION_CHECK_TRANSIENT_FAILURE
          DemDebounceAlgorithmClass
          DemRbEventClass: DemRbEventBufferTime=0, DemRbEventRecoverableInSameOperationCycle=true, DemRbEventStatusBitStorageTestFailed=false
      DemDebounceTimeBase_Port (DemDebounceTimeBaseClass): DemDebounceBehavior=DEM_DEBOUNCE_FREEZE, DemDebounceTimeFailedThreshold=0.001, DemDebounceTimePassedThreshold=0.001

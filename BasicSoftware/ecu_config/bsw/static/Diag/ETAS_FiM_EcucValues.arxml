AUTOSAR XML (schema 4-2-2)
package /ETAS_BIP/EcucModuleConfigurationValuess
  module config FiM
    FiMConfigSet
      FiMFID
      FiMInhibitionConfiguration_0 (FiMInhibitionConfiguration): FiMInhInhibitionMask=FIM_LAST_FAILED, FiMInhFunctionIdRef=FiMFID, FiMInhEventRef=DTC_0x0d0400_CAN_Network_ETAS_BusOff_Event
    FiMGeneral: FiMDevErrorDetect=true, FiMEventUpdateTriggeredByDem=false, FiMTaskTime=0.01, FiMVersionInfoApi=false
      FiMRbGeneral: FiMRbCheckApiConsistency=true, FiMRbObdServ07VisCalc=false, FiMRbEventsPerMonitorCycle=1, FiMRbFidsPerMonitorCycle=1

AUTOSAR XML (schema 4-2-2)
package /ETAS_BIP/EcucModuleConfigurationValuess
  module config Dem
    DemConfigSet
      5 x DemEventParameter, all with DemEventKind=DEM_EVENT_KIND_BSW, DemEventAvailable=false, DemEventFailureCycleCounterThreshold=1, DemFFPrestorageSupported=false, DemOperationCycleRef=DemOpCycle_DEM_POWER:
        WDG_E_MODE_FAILED
          DemDebounceAlgorithmClass
          DemRbEventClass: DemRbEventBufferTime=0, DemRbEventRecoverableInSameOperationCycle=true, DemRbEventStatusBitStorageTestFailed=false
        WDG_E_WRITEVERIFY_FAILURE
          DemDebounceAlgorithmClass
          DemRbEventClass: DemRbEventBufferTime=0, DemRbEventRecoverableInSameOperationCycle=true, DemRbEventStatusBitStorageTestFailed=false
        WDG_E_DISABLE_REJECTED
          DemDebounceAlgorithmClass
          DemRbEventClass: DemRbEventBufferTime=0, DemRbEventRecoverableInSameOperationCycle=true, DemRbEventStatusBitStorageTestFailed=false
        WDG_E_WRITE_REGISTER_FAILED
          DemDebounceAlgorithmClass
          DemRbEventClass: DemRbEventBufferTime=0, DemRbEventRecoverableInSameOperationCycle=true, DemRbEventStatusBitStorageTestFailed=false
        WDG_E_VALUE_COUNTER_FAILED
          DemDebounceAlgorithmClass
          DemRbEventClass: DemRbEventBufferTime=0, DemRbEventRecoverableInSameOperationCycle=true, DemRbEventStatusBitStorageTestFailed=false
      DemDebounceTimeBase_Wdg (DemDebounceTimeBaseClass): DemDebounceBehavior=DEM_DEBOUNCE_FREEZE, DemDebounceTimeFailedThreshold=0.001, DemDebounceTimePassedThreshold=0.001

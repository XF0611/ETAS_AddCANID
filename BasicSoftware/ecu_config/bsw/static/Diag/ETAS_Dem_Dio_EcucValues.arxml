AUTOSAR XML (schema 4-2-2)
package /ETAS_BIP/EcucModuleConfigurationValuess
  module config Dem
    DemConfigSet
      DIO_E_GET_CONTROL_FAILURE (DemEventParameter):
        DemEventKind = DEM_EVENT_KIND_BSW
        DemEventAvailable = false
        DemEventFailureCycleCounterThreshold = 1
        DemFFPrestorageSupported = false
        DemOperationCycleRef = DemOpCycle_DEM_POWER
        DemDebounceAlgorithmClass
        DemRbEventClass: DemRbEventBufferTime=0, DemRbEventRecoverableInSameOperationCycle=true, DemRbEventStatusBitStorageTestFailed=false
      DemDebounceTimeBase_Dio (DemDebounceTimeBaseClass): DemDebounceBehavior=DEM_DEBOUNCE_FREEZE, DemDebounceTimeFailedThreshold=0.001, DemDebounceTimePassedThreshold=0.001

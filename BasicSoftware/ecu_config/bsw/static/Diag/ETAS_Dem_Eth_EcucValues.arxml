AUTOSAR XML (schema 4-2-2)
package /ETAS_BIP/EcucModuleConfigurationValuess
  module config Dem
    DemConfigSet
      22 x DemEventParameter, all with DemEventKind=DEM_EVENT_KIND_BSW, DemEventAvailable=false, DemEventFailureCycleCounterThreshold=1, DemFFPrestorageSupported=false, DemOperationCycleRef=DemOpCycle_DEM_POWER:
        ETH_E_ACCESS
          DemDebounceAlgorithmClass
          DemRbEventClass: DemRbEventBufferTime=0, DemRbEventRecoverableInSameOperationCycle=true, DemRbEventStatusBitStorageTestFailed=false
        ETH_E_ALIGNMENT
          DemDebounceAlgorithmClass
          DemRbEventClass: DemRbEventBufferTime=0, DemRbEventRecoverableInSameOperationCycle=true, DemRbEventStatusBitStorageTestFailed=false
        ETH_E_CRC
          DemDebounceAlgorithmClass
          DemRbEventClass: DemRbEventBufferTime=0, DemRbEventRecoverableInSameOperationCycle=true, DemRbEventStatusBitStorageTestFailed=false
        ETH_E_LATECOLLISION
          DemDebounceAlgorithmClass
          DemRbEventClass: DemRbEventBufferTime=0, DemRbEventRecoverableInSameOperationCycle=true, DemRbEventStatusBitStorageTestFailed=false
        ETH_E_MULTIPLECOLLISION
          DemDebounceAlgorithmClass
          DemRbEventClass: DemRbEventBufferTime=0, DemRbEventRecoverableInSameOperationCycle=true, DemRbEventStatusBitStorageTestFailed=false
        ETH_E_OVERSIZEFRAME
          DemDebounceAlgorithmClass
          DemRbEventClass: DemRbEventBufferTime=0, DemRbEventRecoverableInSameOperationCycle=true, DemRbEventStatusBitStorageTestFailed=false
        ETH_E_RX_FRAMES_LOST
          DemDebounceAlgorithmClass
          DemRbEventClass: DemRbEventBufferTime=0, DemRbEventRecoverableInSameOperationCycle=true, DemRbEventStatusBitStorageTestFailed=false
        ETH_E_SINGLECOLLISION
          DemDebounceAlgorithmClass
          DemRbEventClass: DemRbEventBufferTime=0, DemRbEventRecoverableInSameOperationCycle=true, DemRbEventStatusBitStorageTestFailed=false
        ETH_E_UNDERSIZEFRAME
          DemDebounceAlgorithmClass
          DemRbEventClass: DemRbEventBufferTime=0, DemRbEventRecoverableInSameOperationCycle=true, DemRbEventStatusBitStorageTestFailed=false
        ETH_E_TIMEOUT
          DemDebounceAlgorithmClass
          DemRbEventClass: DemRbEventBufferTime=0, DemRbEventRecoverableInSameOperationCycle=true, DemRbEventStatusBitStorageTestFailed=false
        ETH_E_TIMERINC_FAILED
          DemDebounceAlgorithmClass
          DemRbEventClass: DemRbEventBufferTime=0, DemRbEventRecoverableInSameOperationCycle=true, DemRbEventStatusBitStorageTestFailed=false
        ETH_E_TRANSMIT_RETRY_OVER
          DemDebounceAlgorithmClass
          DemRbEventClass: DemRbEventBufferTime=0, DemRbEventRecoverableInSameOperationCycle=true, DemRbEventStatusBitStorageTestFailed=false
        ETH_E_FRAME_RECEIVE
          DemDebounceAlgorithmClass
          DemRbEventClass: DemRbEventBufferTime=0, DemRbEventRecoverableInSameOperationCycle=true, DemRbEventStatusBitStorageTestFailed=false
        ETH_E_RESIDUAL_BIT_FRAME
          DemDebounceAlgorithmClass
          DemRbEventClass: DemRbEventBufferTime=0, DemRbEventRecoverableInSameOperationCycle=true, DemRbEventStatusBitStorageTestFailed=false
        ETH_E_DESC_DATA
          DemDebounceAlgorithmClass
          DemRbEventClass: DemRbEventBufferTime=0, DemRbEventRecoverableInSameOperationCycle=true, DemRbEventStatusBitStorageTestFailed=false
        ETH_E_INTERRUPT_CTL_CHECK
          DemDebounceAlgorithmClass
          DemRbEventClass: DemRbEventBufferTime=0, DemRbEventRecoverableInSameOperationCycle=true, DemRbEventStatusBitStorageTestFailed=false
        ETH_E_MODULE_STOP_CHECK
          DemDebounceAlgorithmClass
          DemRbEventClass: DemRbEventBufferTime=0, DemRbEventRecoverableInSameOperationCycle=true, DemRbEventStatusBitStorageTestFailed=false
        ETH_E_PAYLOAD_CRC
          DemDebounceAlgorithmClass
          DemRbEventClass: DemRbEventBufferTime=0, DemRbEventRecoverableInSameOperationCycle=true, DemRbEventStatusBitStorageTestFailed=false
        ETH_E_REG_READ_VERIFY
          DemDebounceAlgorithmClass
          DemRbEventClass: DemRbEventBufferTime=0, DemRbEventRecoverableInSameOperationCycle=true, DemRbEventStatusBitStorageTestFailed=false
        ETH_E_REG_WRITE_VERIFY
          DemDebounceAlgorithmClass
          DemRbEventClass: DemRbEventBufferTime=0, DemRbEventRecoverableInSameOperationCycle=true, DemRbEventStatusBitStorageTestFailed=false
        ETH_E_OPMODE
          DemDebounceAlgorithmClass
          DemRbEventClass: DemRbEventBufferTime=0, DemRbEventRecoverableInSameOperationCycle=true, DemRbEventStatusBitStorageTestFailed=false
        ETH_E_AVB_DMAC
          DemDebounceAlgorithmClass
          DemRbEventClass: DemRbEventBufferTime=0, DemRbEventRecoverableInSameOperationCycle=true, DemRbEventStatusBitStorageTestFailed=false
      DemDebounceTimeBase_Eth (DemDebounceTimeBaseClass): DemDebounceBehavior=DEM_DEBOUNCE_RESET, DemDebounceTimeFailedThreshold=1, DemDebounceTimePassedThreshold=1

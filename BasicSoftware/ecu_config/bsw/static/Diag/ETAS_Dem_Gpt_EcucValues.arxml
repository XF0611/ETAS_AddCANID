AUTOSAR XML (schema 4-2-2)
package /ETAS_BIP/EcucModuleConfigurationValuess
  module config Dem
    DemConfigSet
      4 x DemEventParameter, all with DemEventKind=DEM_EVENT_KIND_BSW, DemEventAvailable=false, DemEventFailureCycleCounterThreshold=1, DemFFPrestorageSupported=false, DemOperationCycleRef=DemOpCycle_DEM_POWER:
        GPT_E_WRITEVERIFY_FAILURE
          DemDebounceAlgorithmClass
          DemRbEventClass: DemRbEventBufferTime=0, DemRbEventRecoverableInSameOperationCycle=true, DemRbEventStatusBitStorageTestFailed=false
        GPT_E_INTERRUPT_CONTROLLER_FAILURE
          DemDebounceAlgorithmClass
          DemRbEventClass: DemRbEventBufferTime=0, DemRbEventRecoverableInSameOperationCycle=true, DemRbEventStatusBitStorageTestFailed=false
        GPT_E_CONFIGURATION_CHECK_PERMANENT_FAILURE
          DemDebounceAlgorithmClass
          DemRbEventClass: DemRbEventBufferTime=0, DemRbEventRecoverableInSameOperationCycle=true, DemRbEventStatusBitStorageTestFailed=false
        GPT_E_CONFIGURATION_CHECK_TRANSIENT_FAILURE
          DemDebounceAlgorithmClass
          DemRbEventClass: DemRbEventBufferTime=0, DemRbEventRecoverableInSameOperationCycle=true, DemRbEventStatusBitStorageTestFailed=false
      DemDebounceTimeBase_Gpt (DemDebounceTimeBaseClass): DemDebounceBehavior=DEM_DEBOUNCE_FREEZE, DemDebounceTimeFailedThreshold=0.001, DemDebounceTimePassedThreshold=0.001

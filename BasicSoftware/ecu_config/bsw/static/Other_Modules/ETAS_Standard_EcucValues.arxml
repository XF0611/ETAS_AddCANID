AUTOSAR XML (schema 4-2-2)
package /ETAS_BIP/EcucModuleConfigurationValuess
  module config Standard
    StandardRbSettings: StandardRbArRelease=AR42_Rev2

AUTOSAR XML (schema 00047)
package /ETAS_BIP/EcucModuleConfigurationValuess
  module config EcuC: implementation-config-variant=VARIANT-PRE-COMPILE
    EcucHardware
      EcucCore_SysCore (EcucCoreDefinition): EcucCoreId=0
    EcucPartitionCollection
      EcucPartition_SysCore (EcucPartition):
        EcucPartitionBswModuleExecution = 1
        PartitionCanBeRestarted = false
        EcucPartitionSoftwareComponentInstanceRef = CPT_NmUT
        EcucPartitionSoftwareComponentInstanceRef = CPT_WdgMUT
        EcucPartitionSoftwareComponentInstanceRef = CPT_rba_DiagLib
        EcucPartitionSoftwareComponentInstanceRef = CPT_TstM
        EcucPartitionSoftwareComponentInstanceRef = CPT_StackM
        EcucPartitionSoftwareComponentInstanceRef = CPT_DiagUT
        EcucPartitionSoftwareComponentInstanceRef = CPT_ExeMgrUT
        EcucPartitionSoftwareComponentInstanceRef = CPT_Det
        EcucPartitionSoftwareComponentInstanceRef = CPT_Dcm
        EcucPartitionSoftwareComponentInstanceRef = CPT_ComM
        EcucPartitionSoftwareComponentInstanceRef = CPT_Rtm
        EcucPartitionSoftwareComponentInstanceRef = CPT_FiM
        EcucPartitionSoftwareComponentInstanceRef = CPT_NvBlock
        EcucPartitionSoftwareComponentInstanceRef = CPT_NvMUT
        EcucPartitionSoftwareComponentInstanceRef = CPT_Dem
        EcucPartitionSoftwareComponentInstanceRef = CPT_BswM
        EcucPartitionSoftwareComponentInstanceRef = CPT_WdgM
        EcucPartitionSoftwareComponentInstanceRef = CPT_EcuM
        EcucPartitionSoftwareComponentInstanceRef = CPT_NvM

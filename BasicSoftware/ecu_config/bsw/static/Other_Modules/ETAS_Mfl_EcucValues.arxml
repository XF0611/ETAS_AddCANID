AUTOSAR XML (schema 4-2-2)
package /ETAS_BIP/EcucModuleConfigurationValuess
  module config Mfl: implementation-config-variant=VARIANT-PRE-COMPILE
    MflGeneral: MflRbOptimizationMcuExtract=false, MflRbOptimization=NO_OPTIMIZATION, Mfl_VersionInfoAPI=OFF
    MflMemoryLocations (MflRbMemoryLocations):
      mflRbMemLocAbsf32 = NORMAL
      mflRbMemLocArcCosf32 = NORMAL
      mflRbMemLocArcSinf32 = NORMAL
      mflRbMemLocArcTanf32 = NORMAL
      mflRbMemLocArcTan2f32 = NORMAL
      mflRbMemLocArrayAveragef32f32 = NORMAL
      mflRbMemLocAveragef32f32 = NORMAL
      mflRbMemLocCalcTeQf32 = NORMAL
      mflRbMemLocCalcTeQAppf32 = NORMAL
      mflRbMemLocCeilf32 = NORMAL
      mflRbMemLocCosf32 = NORMAL
      mflRbMemLocCtrlSetLimit = NORMAL
      mflRbMemLocCvrtf32s16 = NORMAL
      mflRbMemLocCvrtf32s32 = NORMAL
      mflRbMemLocCvrtf32u16 = NORMAL
      mflRbMemLocCvrtf32u32 = NORMAL
      mflRbMemLocCvrts16f32 = NORMAL
      mflRbMemLocCvrts32f32 = NORMAL
      mflRbMemLocCvrtu16f32 = NORMAL
      mflRbMemLocCvrtu32f32 = NORMAL
      mflRbMemLocDeadTimef32f32 = NORMAL
      mflRbMemLocDebounceu8u8 = NORMAL
      mflRbMemLocDebounceInit = NORMAL
      mflRbMemLocDebounceSetParam = NORMAL
      mflRbMemLocDT1Typ1Calc = NORMAL
      mflRbMemLocDT1Typ1Outf32 = NORMAL
      mflRbMemLocDT1Typ1SetState = NORMAL
      mflRbMemLocDT1Typ2Calc = NORMAL
      mflRbMemLocDT1Typ2Outf32 = NORMAL
      mflRbMemLocDT1Typ2SetState = NORMAL
      mflRbMemLocExpf32 = NORMAL
      mflRbMemLocFloorf32 = NORMAL
      mflRbMemLocHypotf32f32f32 = NORMAL
      mflRbMemLocHystCenterHalfDeltaf32u8 = NORMAL
      mflRbMemLocHystDeltaRightf32u8 = NORMAL
      mflRbMemLocHystLeftDeltaf32u8 = NORMAL
      mflRbMemLocHystLeftRightf32u8 = NORMAL
      mflRbMemLocICalc = NORMAL
      mflRbMemLocILimCalc = NORMAL
      mflRbMemLocIOutf32 = NORMAL
      mflRbMemLocISetState = NORMAL
      mflRbMemLocLimitf32 = NORMAL
      mflRbMemLocLogf32 = NORMAL
      mflRbMemLocMaxf32 = NORMAL
      mflRbMemLocMedianSortf32f32 = NORMAL
      mflRbMemLocMinf32 = NORMAL
      mflRbMemLocPCalc = NORMAL
      mflRbMemLocPDCalc = NORMAL
      mflRbMemLocPDOutf32 = NORMAL
      mflRbMemLocPDSetParam = NORMAL
      mflRbMemLocPDSetState = NORMAL
      mflRbMemLocPIDOutf32 = NORMAL
      mflRbMemLocPIDSetParam = NORMAL
      mflRbMemLocPIDSetState = NORMAL
      mflRbMemLocPIDTyp1Calc = NORMAL
      mflRbMemLocPIDTyp1LimCalc = NORMAL
      mflRbMemLocPIDTyp2Calc = NORMAL
      mflRbMemLocPIDTyp2LimCalc = NORMAL
      mflRbMemLocPIOutf32 = NORMAL
      mflRbMemLocPISetParam = NORMAL
      mflRbMemLocPISetState = NORMAL
      mflRbMemLocPITyp1Calc = NORMAL
      mflRbMemLocPITyp1LimCalc = NORMAL
      mflRbMemLocPITyp2Calc = NORMAL
      mflRbMemLocPITyp2LimCalc = NORMAL
      mflRbMemLocPOutf32 = NORMAL
      mflRbMemLocPowf32 = NORMAL
      mflRbMemLocPT1Calc = NORMAL
      mflRbMemLocPT1Outf32 = NORMAL
      mflRbMemLocPT1SetState = NORMAL
      mflRbMemLocRampCalc = NORMAL
      mflRbMemLocRampCalcJump = NORMAL
      mflRbMemLocRampCalcSwitch = NORMAL
      mflRbMemLocRampCheckActivity = NORMAL
      mflRbMemLocRampGetSwitchPos = NORMAL
      mflRbMemLocRampInitState = NORMAL
      mflRbMemLocRampOutf32 = NORMAL
      mflRbMemLocRampSetParam = NORMAL
      mflRbMemLocRateLimiterf32 = NORMAL
      mflRbMemLocRoundf32 = NORMAL
      mflRbMemLocSignf32 = NORMAL
      mflRbMemLocSinf32 = NORMAL
      mflRbMemLocSortAscendf32 = NORMAL
      mflRbMemLocSortDescendf32 = NORMAL
      mflRbMemLocSqrtf32 = NORMAL
      mflRbMemLocTanf32 = NORMAL
      mflRbMemLocTruncf32 = NORMAL
      mflRbMemLocFloatToIntCvrtf32s16 = NORMAL
      mflRbMemLocFloatToIntCvrtf32s32 = NORMAL
      mflRbMemLocFloatToIntCvrtf32s8 = NORMAL
      mflRbMemLocFloatToIntCvrtf32u16 = NORMAL
      mflRbMemLocFloatToIntCvrtf32u32 = NORMAL
      mflRbMemLocFloatToIntCvrtf32u8 = NORMAL
      mflRbMemLocIntToFloatCvrts16f32 = NORMAL
      mflRbMemLocIntToFloatCvrts32f32 = NORMAL
      mflRbMemLocIntToFloatCvrts8f32 = NORMAL
      mflRbMemLocIntToFloatCvrtu16f32 = NORMAL
      mflRbMemLocIntToFloatCvrtu32f32 = NORMAL
      mflRbMemLocIntToFloatCvrtu8f32 = NORMAL

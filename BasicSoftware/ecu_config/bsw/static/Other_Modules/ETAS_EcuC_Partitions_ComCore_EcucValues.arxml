AUTOSAR XML (schema 00047)
package /ETAS_BIP/EcucModuleConfigurationValuess
  module config EcuC: implementation-config-variant=VARIANT-PRE-COMPILE
    EcucHardware
    EcucPartitionCollection
      EcucPartition_ComCore (EcucPartition):
        EcucPartitionBswModuleExecution = false
        PartitionCanBeRestarted = false
        EcucPartitionSoftwareComponentInstanceRef = CPT_INP_SWC
        EcucPartitionSoftwareComponentInstanceRef = CPT_OUTP_SWC

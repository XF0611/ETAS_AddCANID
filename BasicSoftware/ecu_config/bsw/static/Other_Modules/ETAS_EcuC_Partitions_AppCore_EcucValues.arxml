AUTOSAR XML (schema 00047)
package /ETAS_BIP/EcucModuleConfigurationValuess
  module config EcuC
    EcucHardware
    EcucPartitionCollection
      EcucPartition_AppCore (EcucPartition):
        EcucPartitionBswModuleExecution = false
        PartitionCanBeRestarted = false
        EcucPartitionSoftwareComponentInstanceRef = CPT_ParameterSWC
        EcucPartitionSoftwareComponentInstanceRef = CPT_CalUT

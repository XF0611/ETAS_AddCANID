AUTOSAR XML (schema 4-2-2)
package /ETAS_BIP/EcucModuleConfigurationValuess
  module config Wdg
    WdgGeneral_Int (WdgGeneral): WdgDevErrorDetect=true, WdgMaxTimeout=10.0, WdgVersionInfoApi=false
    WdgPublishedInformation
    WdgSettingsConfig

AUTOSAR XML (schema 4-2-2)
package /ETAS_BIP/EcucModuleConfigurationValuess
  module config WdgM
    WdgMConfigSet: WdgMInitialMode=WdgMMode_SlowMode
      WdgMMode_SlowMode (WdgMMode): WdgMExpiredSupervisionCycleTol=0, WdgMModeId=1, WdgMSupervisionCycle=0.001
        WdgMAliveSupervision_ASW_10ms (WdgMAliveSupervision):
          WdgMExpectedAliveIndications = 10
          WdgMMaxMargin = 0
          WdgMMinMargin = 1
          WdgMSupervisionReferenceCycle = 1000
          WdgMAliveSupervisionCheckpointRef = WdgM_SE1_Alive_CP
        WdgMDeadline_Supervision_ASW_10ms (WdgMDeadlineSupervision): WdgMDeadlineMax=1.0, WdgMDeadlineMin=0.0, WdgMDeadlineStartRef=WdgM_SE1_Deadline_CP_0, WdgMDeadlineStopRef=WdgM_SE1_Deadline_CP_1
        WdgMLocalStatusParams_SE1 (WdgMLocalStatusParams): WdgMFailedAliveSupervisionRefCycleTol=0, WdgMLocalStatusSupervisedEntityRef=WdgM_SE1
        WdgMTrigger_SlowMode_IntWdg (WdgMTrigger): WdgMTriggerConditionValue=1000, WdgMWatchDogMode=WDGIF_SLOW_MODE, WdgMTriggerWatchDogRef=WdgMWatchdog_Int
        WdgMTrigger_SlowMode_ExtWdg (WdgMTrigger): WdgMTriggerConditionValue=100, WdgMWatchDogMode=WDGIF_SLOW_MODE, WdgMTriggerWatchDogRef=WdgMWatchdog_Ext
      WdgMMode_FastMode (WdgMMode): WdgMExpiredSupervisionCycleTol=0, WdgMModeId=0, WdgMSupervisionCycle=0.001
        WdgMAliveSupervision_ASW_10ms (WdgMAliveSupervision):
          WdgMExpectedAliveIndications = 10
          WdgMMaxMargin = 0
          WdgMMinMargin = 1
          WdgMSupervisionReferenceCycle = 100
          WdgMAliveSupervisionCheckpointRef = WdgM_SE1_Alive_CP
        WdgMDeadline_Supervision_ASW_10ms (WdgMDeadlineSupervision): WdgMDeadlineMax=0.01, WdgMDeadlineMin=0.0, WdgMDeadlineStartRef=WdgM_SE1_Deadline_CP_0, WdgMDeadlineStopRef=WdgM_SE1_Deadline_CP_1
        WdgMLocalStatusParams_SE1 (WdgMLocalStatusParams): WdgMFailedAliveSupervisionRefCycleTol=0, WdgMLocalStatusSupervisedEntityRef=WdgM_SE1
        WdgMTrigger_FastMode_IntWdg (WdgMTrigger): WdgMTriggerConditionValue=100, WdgMWatchDogMode=WDGIF_FAST_MODE, WdgMTriggerWatchDogRef=WdgMWatchdog_Int
        WdgMTrigger_FastMode_ExtWdg (WdgMTrigger): WdgMTriggerConditionValue=40, WdgMWatchDogMode=WDGIF_FAST_MODE, WdgMTriggerWatchDogRef=WdgMWatchdog_Ext
    WdgMGeneral:
      WdgMDemStoppedSupervisionReport = false
      WdgMDevErrorDetect = true
      WdgMImmediateReset = false
      WdgMOffModeEnabled = false
      WdgMRbDeadlineTimeOutDetect = true
      WdgMRbDeadlineTimerSelection = MCU_RB_TIMER
      WdgMRbDebugOptionEnable = false
      WdgMRbInterruptLockDisable = true
      WdgMRbRteDisabled = false
      WdgMVersionInfoApi = false
      WdgM_SE1 (WdgMSupervisedEntity): WdgMInternalCheckpointInitialRef=WdgM_SE1_PFM_CP_0, WdgMInternalCheckpointFinalRef=WdgM_SE1_PFM_CP_1
        5 x WdgMCheckpoint:
          WdgM_SE1_Alive_CP: WdgMCheckpointId=0
          WdgM_SE1_Deadline_CP_0
          WdgM_SE1_Deadline_CP_1
          WdgM_SE1_PFM_CP_0
          WdgM_SE1_PFM_CP_1
        WdgMInternalTransition: WdgMInternalTransitionSourceRef=WdgM_SE1_PFM_CP_0, WdgMInternalTransitionDestRef=WdgM_SE1_PFM_CP_1
      WdgMWatchdog_Int (WdgMWatchdog): WdgMWatchdogDeviceRef=WdgIfDevice_Int
      WdgMWatchdog_Ext (WdgMWatchdog): WdgMWatchdogDeviceRef=WdgIfDevice_Ext

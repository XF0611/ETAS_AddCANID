AUTOSAR XML (schema 4-2-2)
package /ETAS_BIP/EcucModuleConfigurationValuess
  module config ExtWdg: definition=Wdg
    WdgGeneral_Ext (WdgGeneral): WdgDevErrorDetect=true, WdgMaxTimeout=10.0, WdgVersionInfoApi=false, WdgIndex=1
    WdgPublishedInformation_0 (WdgPublishedInformation)
    WdgSettingsConfig_0 (WdgSettingsConfig)

AUTOSAR XML (schema 4-2-2)
package /ETAS_BIP/EcucModuleConfigurationValuess
  module config WdgIf
    WdgIfDevice_Int (WdgIfDevice): WdgIfDriverRef=WdgGeneral_Int
    WdgIfGeneral: WdgIfDevErrorDetect=true, WdgIfVersionInfoApi=false
    WdgIfDevice_Ext (WdgIfDevice): WdgIfDriverRef=WdgGeneral_Ext

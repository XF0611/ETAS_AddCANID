AUTOSAR XML (schema 00047)
package /ETAS_BIP/EcucModuleConfigurationValuess
  module config NvM
    NvMBlock_LogisticData (NvMBlockDescriptor):
      NvMBlockCrcType = NVM_CRC16
      NvMBlockJobPriority = 1
      NvMBlockManagementType = NVM_BLOCK_NATIVE
      NvMBlockUseCrc = true
      NvMBlockUseSyncMechanism = false
      NvMBlockWriteProt = false
      NvMCalcRamBlockCrc = false
      NvMInitBlockCallback = NULL_PTR
      NvMMaxNumOfReadRetries = 0
      NvMMaxNumOfWriteRetries = 0
      NvMNvBlockLength = 128
      NvMNvBlockNum = 1
      NvMNvramBlockIdentifier = 2
      NvMNvramDeviceId = 0
      NvMRbGenRteServicePort = false
      NvMReadRamBlockFromNvCallback = NULL_PTR
      NvMResistantToChangedSw = true
      NvMRomBlockNum = 0
      NvMSelectBlockForReadAll = true
      NvMSelectBlockForWriteAll = false
      NvMSingleBlockCallback = NULL_PTR
      NvMStaticBlockIDCheck = false
      NvMWriteBlockOnce = false
      NvMWriteRamBlockToNvCallback = NULL_PTR
      NvMWriteVerification = false
      NvMWriteVerificationDataSize = 0
      NvMRamBlockDataAddress = NvBlock_ECU_LogisticData
      NvMRomBlockDataAddress = NULL_PTR
    NvMBlockDescriptor_ECUConfiguration (NvMBlockDescriptor):
      NvMBlockCrcType = NVM_CRC16
      NvMBlockUseSyncMechanism = 0
      NvMCalcRamBlockCrc = 0
      NvMRbSelectBlockForFirstInitAll = true
      NvMSelectBlockForReadAll = true
      NvMSelectBlockForWriteAll = true
      NvMBlockJobPriority = 1
      NvMBlockManagementType = NVM_BLOCK_REDUNDANT
      NvMBlockUseCrc = true
      NvMBlockWriteProt = false
      NvMInitBlockCallback = NULL_PTR
      NvMMaxNumOfReadRetries = 0
      NvMMaxNumOfWriteRetries = 0
      NvMNvBlockNum = 2
      NvMNvramBlockIdentifier = 15
      NvMNvramDeviceId = 0
      NvMRamBlockDataAddress = NvBlock_ECU_Configuration
      NvMNvBlockLength = 4
      NvMReadRamBlockFromNvCallback = NULL_PTR
      NvMResistantToChangedSw = false
      NvMRomBlockDataAddress = NULL_PTR
      NvMRomBlockNum = 0
      NvMSingleBlockCallback = NULL_PTR
      NvMStaticBlockIDCheck = false
      NvMWriteBlockOnce = false
      NvMWriteRamBlockToNvCallback = NULL_PTR
      NvMWriteVerification = false
      NvMWriteVerificationDataSize = 0

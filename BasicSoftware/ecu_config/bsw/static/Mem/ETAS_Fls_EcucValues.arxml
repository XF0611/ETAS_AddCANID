AUTOSAR XML (schema 4-2-2)
package /ETAS_BIP
  module config Fls
    FlsConfigSet_0 (FlsConfigSet)
      FlsSectorList_0 (FlsSectorList)
        FlsSector_0 (FlsSector)
    FlsGeneral_0 (FlsGeneral):
      FlsBaseAddress = 2936012800
      FlsBlankCheckApi = true
      FlsCancelApi = true
      FlsCompareApi = true
      FlsDriverIndex = 0
      FlsGetJobResultApi = true
      FlsGetStatusApi = true
      FlsRbDeInitApi = false
      FlsSetModeApi = true
      FlsTotalSize = 1048576
      FlsVersionInfoApi = false
      FlsUseInterrupts = false
    FlsPublishedInformation_0 (FlsPublishedInformation)

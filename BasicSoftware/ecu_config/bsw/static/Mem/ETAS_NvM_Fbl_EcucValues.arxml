AUTOSAR XML (schema 00047)
package /ETAS_BIP/EcucModuleConfigurationValuess
  module config NvM
    NV_ExternalReprogrammingRequestFlagBlock (NvMBlockDescriptor):
      NvMBlockCrcType = NVM_CRC16
      NvMBlockManagementType = NVM_BLOCK_NATIVE
      NvMBlockUseCrc = true
      NvMBlockUseSyncMechanism = false
      NvMMaxNumOfReadRetries = 0
      NvMMaxNumOfWriteRetries = 0
      NvMNvBlockNum = 1
      NvMNvramDeviceId = 0
      NvMRomBlockNum = 1
      NvMStaticBlockIDCheck = false
      NvMWriteVerificationDataSize = 0
      NvMCalcRamBlockCrc = false
      NvMInitBlockCallback = NULL_PTR
      NvMNvBlockLength = 4
      NvMRamBlockDataAddress = Fbl_DataM_RamMirrorNV_ReprogrammingRequestFlagBlock
      NvMRomBlockDataAddress = Fbl_DataM_RomDataNV_ReprogrammingRequestFlagBlock
      NvMRbGenRteAdminPort = 0
      NvMRbGenRteServicePort = 0
      NvMBlockJobPriority = 1
      NvMBlockWriteProt = false
      NvMSelectBlockForWriteAll = true
      NvMSelectBlockForReadAll = true
      NvMWriteBlockOnce = false
      NvMResistantToChangedSw = false
      NvMWriteVerification = false
      NvMRbFirstReadDataMigration = false
      NvMRbInitBlockAtLayoutChange = false
      NvMRbNoFallback = false
      NvMRbSelectBlockForFirstInitAll = false
      NvMRbResistantToLayoutRemoval = false
      NvMBlockUseAutoValidation = false

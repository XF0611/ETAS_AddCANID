AUTOSAR XML (schema 00047)
package /ETAS_BIP/EcucModuleConfigurationValuess
  module config BswM
    BswMGeneral:
      BswMCanSMEnabled = 1
      BswMComMEnabled = 1
      BswMDcmEnabled = true
      BswMDevErrorDetect = true
      BswMEcuMEnabled = true
      BswMEthSMEnabled = false
      BswMFrSMEnabled = false
      BswMGenericRequestEnabled = true
      BswMLinSMEnabled = false
      BswMLinTPEnabled = false
      BswMMainFunctionPeriod = 0.01
      BswMNvMEnabled = true
      BswMSchMEnabled = true
      BswMSdEnabled = false
      BswMVersionInfoApi = true
      BswMRbDebugEnable = false
      BswMRbIntrptQueueMaxSize = 5
      BswMEthIfEnabled = false
      BswMJ1939DcmEnabled = false
      BswMJ1939NmEnabled = false
      BswMNmEnabled = true
      BswMRbMaxNumOfRules = 255
      BswMRbComEnabled = true
      BswMUserIncludeFiles: BswMUserIncludeFile=BswM_PBDefine.h
    BswMConfig
      BswMArbitration
        8 x BswMLogicalExpression:
          BswM_LE_StartupOne2StartupTwo: BswMArgumentRef=BswM_MC_BSWM_StartupOne
          BswM_LE_StartupTwo2Run: BswMLogicalOperator=BSWM_AND, BswMArgumentRef=BswM_MC_BSWM_StartupTwo, BswMArgumentRef=BswM_MC_NVM_ReadAllComplete
          BswM_LE_Run2AppRun: BswMLogicalOperator=BSWM_AND, BswMArgumentRef=BswM_MC_BSWM_Run, BswMArgumentRef=BswM_MC_WKSRC_Valid
          BswM_LE_AppRun2PostRun: BswMLogicalOperator=BSWM_AND, BswMArgumentRef=BswM_MC_AppModeReq_PostRun, BswMArgumentRef=BswM_MC_BSWM_AppRun, BswMArgumentRef=BswM_MC_WKSRC_Invalid
          BswM_LE_PostRun2AppRun: BswMLogicalOperator=BSWM_AND, BswMArgumentRef=BswM_MC_BSWM_PostRun, BswMArgumentRef=BswM_LE_PostRun2AppRun_SubLE
          BswM_LE_PostRun2AppRun_SubLE: BswMLogicalOperator=BSWM_OR, BswMArgumentRef=BswM_MC_WKSRC_Valid, BswMArgumentRef=BswM_MC_AppModeReq_AppRun
          BswM_LE_PostRun2PrepShutdown: BswMLogicalOperator=BSWM_AND, BswMArgumentRef=BswM_MC_BSWM_PostRun, BswMArgumentRef=BswM_MC_WKSRC_Invalid, BswMArgumentRef=BswM_MC_Can_Network_ETAS_NOCOM
          BswM_LE_PrepShutdown2Shutdown: BswMArgumentRef=BswM_MC_BSWM_PrepShutdown
        5 x BswMModeCondition, all with BswMConditionType=BSWM_EQUALS, BswMConditionMode=BswM_MRP_BSWM_MDG:
          BswM_MC_BSWM_StartupOne
            BswM_MC_Val (BswMConditionValue)
              BswMModeDeclaration: BswMModeValueRef=ECUM_STATE_STARTUP_ONE
          BswM_MC_BSWM_StartupTwo
            BswM_MC_Val (BswMConditionValue)
              BswMModeDeclaration: BswMModeValueRef=ECUM_STATE_STARTUP_TWO
          BswM_MC_BSWM_Run
            BswM_MC_Val (BswMConditionValue)
              BswMModeDeclaration: BswMModeValueRef=ECUM_STATE_RUN
          BswM_MC_BSWM_PrepShutdown
            BswM_MC_Val (BswMConditionValue)
              BswMModeDeclaration: BswMModeValueRef=ECUM_STATE_PREP_SHUTDOWN
          BswM_MC_BSWM_Shutdown
            BswM_MC_Val (BswMConditionValue)
              BswMModeDeclaration: BswMModeValueRef=ECUM_STATE_SHUTDOWN
        BswM_MRP_BSWM_MDG (BswMModeRequestPort): BswMRequestProcessing=BSWM_IMMEDIATE
          BswMModeRequestSource
            BswMBswModeNotification: BswMRbBswModeDeclarationGroup=/AUTOSAR_BswM/ModeDeclarationGroups/MDG_ECUM_STATE
        7 x BswMRule, all with BswMRuleInitState=BSWM_FALSE:
          BswM_AR_StartupOne2StartupTwo: BswMRuleExpressionRef=BswM_LE_StartupOne2StartupTwo, BswMRuleTrueActionList=BswM_AL_BswMSwitchStartupTwo
          BswM_AR_StartupTwo2Run: BswMRuleExpressionRef=BswM_LE_StartupTwo2Run, BswMRuleTrueActionList=BswM_AL_BswMSwitchRun
          BswM_AR_Run2AppRun: BswMRuleExpressionRef=BswM_LE_Run2AppRun, BswMRuleTrueActionList=BswM_AL_BswMSwitchAppRun
          BswM_AR_AppRun2PostRun: BswMRuleExpressionRef=BswM_LE_AppRun2PostRun, BswMRuleTrueActionList=BswM_AL_BswMSwitchPostRun
          BswM_AR_PostRun2AppRun: BswMRuleExpressionRef=BswM_LE_PostRun2AppRun, BswMRuleTrueActionList=BswM_AL_BswMSwitchAppRun
          BswM_AR_PostRun2PrepShutdown: BswMRuleExpressionRef=BswM_LE_PostRun2PrepShutdown, BswMRuleTrueActionList=BswM_AL_BswMSwitchPrepShutdown
          BswM_AR_Shutdown: BswMRuleExpressionRef=BswM_LE_PrepShutdown2Shutdown, BswMRuleTrueActionList=BswM_AL_BswMSwitchShutdown
        3 x BswMModeRequestPort:
          BswM_MRP_SWC_AppMode: BswMRequestProcessing=BSWM_DEFERRED
            BswMModeRequestSource
              BswMSwcModeNotification: BswMSwcModeNotificationModeDeclarationGroupPrototypeRef=MDGP_APPMode
          BswM_MRP_NVM_ReadAllComplete: BswMRequestProcessing=BSWM_IMMEDIATE
            BswMModeRequestSource
              BswMNvMJobModeIndication: BswMNvmService=NvmReadAll
            BswMModeInitValue: BswMBswModeInitValue=NVM_REQ_PENDING
          BswM_MRP_NVM_WriteAllComplete: BswMRequestProcessing=BSWM_IMMEDIATE
            BswMModeRequestSource
              BswMNvMJobModeIndication: BswMNvmService=NvmWriteAll
            BswMModeInitValue: BswMBswModeInitValue=NVM_REQ_PENDING
        4 x BswMModeCondition:
          BswM_MC_BSWM_AppRun: BswMConditionType=BSWM_EQUALS, BswMConditionMode=BswM_MRP_BSWM_MDG
            BswM_MC_Val (BswMConditionValue)
              BswMModeDeclaration: BswMModeValueRef=ECUM_STATE_APP_RUN
          BswM_MC_BSWM_PostRun: BswMConditionType=BSWM_EQUALS, BswMConditionMode=BswM_MRP_BSWM_MDG
            BswM_MC_Val (BswMConditionValue)
              BswMModeDeclaration: BswMModeValueRef=ECUM_STATE_POST_RUN
          BswM_MC_NVM_ReadAllComplete: BswMConditionType=BSWM_EQUALS_NOT, BswMConditionMode=BswM_MRP_NVM_ReadAllComplete
            BswMConditionValue
              BswMBswMode: BswMBswRequestedMode=NVM_REQ_PENDING
          BswM_MC_NVM_WriteAllComplete: BswMConditionType=BSWM_EQUALS_NOT, BswMConditionMode=BswM_MRP_NVM_WriteAllComplete
            BswMConditionValue
              BswMBswMode: BswMBswRequestedMode=NVM_REQ_PENDING
        BswM_MRP_DCM_ModeNotification_EcuReset (BswMModeRequestPort): BswMRequestProcessing=BSWM_DEFERRED
          BswMModeRequestSource_0 (BswMModeRequestSource)
            BswMBswModeNotification: BswMRbBswModeDeclarationGroup=/AUTOSAR_Dcm/ModeDeclarationGroups/DcmEcuReset
          BswMModeInitValue: BswMBswModeInitValue=RTE_MODE_DcmEcuReset_NONE
        BswM_MC_DCM_EcuReset_HARD (BswMModeCondition): BswMConditionType=BSWM_EQUALS, BswMConditionMode=BswM_MRP_DCM_ModeNotification_EcuReset
          BswMConditionValue
            BswMModeDeclaration: BswMModeValueRef=HARD
        BswM_MC_DCM_EcuReset_SOFT (BswMModeCondition): BswMConditionType=BSWM_EQUALS, BswMConditionMode=BswM_MRP_DCM_ModeNotification_EcuReset
          BswMConditionValue
            BswMModeDeclaration: BswMModeValueRef=SOFT
        BswM_MRP_DCM_DiagnosticSessionControl (BswMModeRequestPort): BswMRequestProcessing=BSWM_IMMEDIATE
          BswMModeRequestSource
            BswMBswModeNotification: BswMRbBswModeDeclarationGroup=/AUTOSAR_Dcm/ModeDeclarationGroups/DcmDiagnosticSessionControl
          BswMModeInitValue: BswMBswModeInitValue=RTE_MODE_DcmDiagnosticSessionControl_DEFAULT_SESSION
        4 x BswMModeCondition, all with BswMConditionType=BSWM_EQUALS:
          BswM_MC_DCM_EcuReset_JUMPTOBOOTLOADER: BswMConditionMode=BswM_MRP_DCM_ModeNotification_EcuReset
            BswMConditionValue
              BswMModeDeclaration: BswMModeValueRef=JUMPTOBOOTLOADER
          BswM_MC_DCM_DiagSessionControl_Default: BswMConditionMode=BswM_MRP_DCM_DiagnosticSessionControl
            BswMConditionValue
              BswMModeDeclaration: BswMModeValueRef=DEFAULT_SESSION
          BswM_MC_DCM_DiagSessionControl_Extended: BswMConditionMode=BswM_MRP_DCM_DiagnosticSessionControl
            BswMConditionValue
              BswMModeDeclaration: BswMModeValueRef=EXTENDED_DIAGNOSTIC_SESSION
          BswM_MC_DCM_DiagSessionControl_Programming: BswMConditionMode=BswM_MRP_DCM_DiagnosticSessionControl
            BswMConditionValue
              BswMModeDeclaration: BswMModeValueRef=PROGRAMMING_SESSION
        BswM_LE_DCM_EcuReset_SOFT (BswMLogicalExpression): BswMArgumentRef=BswM_MC_DCM_EcuReset_SOFT
        BswM_LE_DCM_EcuReset_HARD (BswMLogicalExpression): BswMLogicalOperator=BSWM_OR, BswMArgumentRef=BswM_MC_DCM_EcuReset_HARD, BswMArgumentRef=BswM_MC_DCM_EcuReset_JUMPTOBOOTLOADER
        BswM_AR_DCM_EcuReset_SOFT (BswMRule): BswMRuleInitState=BSWM_FALSE, BswMRuleExpressionRef=BswM_LE_DCM_EcuReset_SOFT, BswMRuleTrueActionList=BswM_AL_DCM_EcuReset_SOFT
        BswM_AR_DCM_EcuReset_HARD (BswMRule): BswMRuleInitState=BSWM_FALSE, BswMRuleExpressionRef=BswM_LE_DCM_EcuReset_HARD, BswMRuleTrueActionList=BswM_AL_DCM_EcuReset_HARD
        5 x BswMLogicalExpression:
          BswM_LE_DCM_ENABLE_RX_TX_NORM: BswMArgumentRef=BswM_MC_DCM_ENABLE_RX_TX_NORM
          BswM_LE_DCM_DISABLE_RX_TX_NORM: BswMArgumentRef=BswM_MC_DCM_DISABLE_RX_TX_NORM
          BswM_LE_DCM_ENABLE_RX_DISABLE_TX_NORM: BswMArgumentRef=BswM_MC_DCM_ENABLE_RX_DISABLE_TX_NORM
          BswM_LE_DCM_DISABLE_RX_ENABLE_TX_NORM: BswMArgumentRef=BswM_MC_DCM_DISABLE_RX_ENABLE_TX_NORM
          BswM_LE_DCM_ENABLE_RX_TX_NORM_NM: BswMArgumentRef=BswM_MC_DCM_ENABLE_RX_TX_NORM_NM
        4 x BswMModeCondition, all with BswMConditionType=BSWM_EQUALS, BswMConditionMode=BswM_MRP_DCM_ComControl_Can_Network_ETAS:
          BswM_MC_DCM_ENABLE_RX_TX_NORM
            BswMConditionValue
              BswMBswMode: BswMBswRequestedMode=DCM_ENABLE_RX_TX_NORM
          BswM_MC_DCM_DISABLE_RX_TX_NORM
            BswMConditionValue
              BswMBswMode: BswMBswRequestedMode=DCM_DISABLE_RX_TX_NORMAL
          BswM_MC_DCM_ENABLE_RX_DISABLE_TX_NORM
            BswMConditionValue
              BswMBswMode: BswMBswRequestedMode=DCM_ENABLE_RX_DISABLE_TX_NORM
          BswM_MC_DCM_DISABLE_RX_ENABLE_TX_NORM
            BswMConditionValue
              BswMBswMode: BswMBswRequestedMode=DCM_DISABLE_RX_ENABLE_TX_NORM
        BswM_MRP_DCM_ComControl_Can_Network_ETAS (BswMModeRequestPort): BswMRequestProcessing=BSWM_IMMEDIATE
          BswMModeRequestSource
            BswMDcmComModeRequest: BswMDcmComMChannelRef=Can_Network_ETAS_Channel_Can_Network_ETAS
        4 x BswMRule, all with BswMRuleInitState=BSWM_FALSE:
          BswM_AR_DCM_ENABLE_RX_TX_NORM: BswMRuleExpressionRef=BswM_LE_DCM_ENABLE_RX_TX_NORM, BswMRuleTrueActionList=BswM_AL_DCM_ENABLE_RX_TX_NORM
          BswM_AR_DCM_DISABLE_RX_TX_NORM: BswMRuleExpressionRef=BswM_LE_DCM_DISABLE_RX_TX_NORM, BswMRuleTrueActionList=BswM_AL_DCM_DISABLE_RX_TX_NORM
          BswM_AR_DCM_ENABLE_RX_DISABLE_TX_NORM: BswMRuleExpressionRef=BswM_LE_DCM_ENABLE_RX_DISABLE_TX_NORM, BswMRuleTrueActionList=BswM_AL_DCM_ENABLE_RX_DISABLE_TX_NORM
          BswM_AR_DCM_DISABLE_RX_ENABLE_TX_NORM: BswMRuleExpressionRef=BswM_LE_DCM_DISABLE_RX_ENABLE_TX_NORM, BswMRuleTrueActionList=BswM_AL_DCM_DISABLE_RX_ENABLE_TX_NORM
        BswM_MC_DCM_ENABLE_RX_TX_NORM_NM (BswMModeCondition): BswMConditionType=BSWM_EQUALS, BswMConditionMode=BswM_MRP_DCM_ComControl_Can_Network_ETAS
          BswMConditionValue
            BswMBswMode: BswMBswRequestedMode=DCM_ENABLE_RX_TX_NORM_NM
        BswM_MC_DCM_DISABLE_RX_TX_NORM_NM (BswMModeCondition): BswMConditionType=BSWM_EQUALS, BswMConditionMode=BswM_MRP_DCM_ComControl_Can_Network_ETAS
          BswMConditionValue
            BswMBswMode: BswMBswRequestedMode=DCM_DISABLE_RX_TX_NORM_NM
        BswM_MRP_ComM_Can_Network_ETAS (BswMModeRequestPort): BswMRequestProcessing=BSWM_DEFERRED
          BswMModeRequestSource
            BswMComMIndication: BswMComMChannelRef=Can_Network_ETAS_Channel_Can_Network_ETAS
        5 x BswMModeCondition, all with BswMConditionType=BSWM_EQUALS:
          BswM_MC_DCM_ENABLE_NM: BswMConditionMode=BswM_MRP_DCM_ComControl_Can_Network_ETAS
            BswMConditionValue
              BswMBswMode: BswMBswRequestedMode=DCM_ENABLE_RX_TX_NM
          BswM_MC_DCM_DISABLE_NM: BswMConditionMode=BswM_MRP_DCM_ComControl_Can_Network_ETAS
            BswMConditionValue
              BswMBswMode: BswMBswRequestedMode=DCM_DISABLE_RX_TX_NM
          BswM_MC_Can_Network_ETAS_NOCOM: BswMConditionMode=BswM_MRP_ComM_Can_Network_ETAS
            BswMConditionValue
              BswMBswMode: BswMBswRequestedMode=COMM_NO_COMMUNICATION
          BswM_MC_AppModeReq_AppRun: BswMConditionMode=BswM_MRP_SWC_AppMode
            BswMConditionValue
              BswMModeDeclaration: BswMModeValueRef=ECUM_STATE_APP_RUN
          BswM_MC_AppModeReq_PostRun: BswMConditionMode=BswM_MRP_SWC_AppMode
            BswM_MC_Val (BswMConditionValue)
              BswMModeDeclaration: BswMModeValueRef=ECUM_STATE_POST_RUN
        4 x BswMRule, all with BswMRuleInitState=BSWM_FALSE:
          BswM_AR_DCM_ENABLE_RX_TX_NORM_NM: BswMRuleExpressionRef=BswM_LE_DCM_ENABLE_RX_TX_NORM_NM, BswMRuleTrueActionList=BswM_AL_DCM_ENABLE_RX_TX_NORM_NM
          BswM_AR_DCM_DISABLE_RX_TX_NORM_NM: BswMRuleExpressionRef=BswM_LE_DCM_DISABLE_RX_TX_NORM_NM, BswMRuleTrueActionList=BswM_AL_DCM_DISABLE_RX_ENABLE_TX_NORM_NM
          BswM_AR_DCM_ENABLE_NM: BswMRuleExpressionRef=BswM_LE_DCM_ENABLE_NM, BswMRuleTrueActionList=BswM_AL_DCM_ENABLE_TX_RX_NM
          BswM_AR_DCM_DISABLE_NM: BswMRuleExpressionRef=BswM_LE_DCM_DISABLE_NM, BswMRuleTrueActionList=BswM_AL_DCM_DISABLE_TX_RX_NM
        BswM_MC_WKSRC_Valid (BswMModeCondition): BswMConditionType=BSWM_EQUALS, BswMConditionMode=BswM_MRP_WKSRC_PWR
          BswMConditionValue
            BswMBswMode: BswMBswRequestedMode=ECUM_WKSTATUS_VALIDATED
        BswM_MC_WKSRC_Invalid (BswMModeCondition): BswMConditionType=BSWM_EQUALS, BswMConditionMode=BswM_MRP_WKSRC_PWR
          BswMConditionValue
            BswMBswMode: BswMBswRequestedMode=ECUM_WKSTATUS_NONE
        3 x BswMLogicalExpression:
          BswM_LE_DCM_DISABLE_RX_TX_NORM_NM: BswMArgumentRef=BswM_MC_DCM_DISABLE_RX_TX_NORM_NM
          BswM_LE_DCM_ENABLE_NM: BswMArgumentRef=BswM_MC_DCM_ENABLE_NM
          BswM_LE_DCM_DISABLE_NM: BswMArgumentRef=BswM_MC_DCM_DISABLE_NM
        BswM_MRP_WKSRC_PWR (BswMModeRequestPort): BswMRequestProcessing=BSWM_DEFERRED
          BswMModeRequestSource
            BswMEcuMWakeupSource: BswMEcuMWakeupSrcRef=ECUM_WKSOURCE_POWER
        BswM_LE_Run2PrepShutdown (BswMLogicalExpression): BswMLogicalOperator=BSWM_AND, BswMArgumentRef=BswM_MC_WKSRC_Invalid, BswMArgumentRef=BswM_MC_BSWM_Run
        BswM_AR_Run2PrepShutdown (BswMRule): BswMRuleInitState=BSWM_FALSE, BswMRuleExpressionRef=BswM_LE_Run2PrepShutdown, BswMRuleTrueActionList=BswM_AL_BswMSwitchPrepShutdown
      BswMDataTypeMappingSets:
        BswMDataTypeMappingSetRef = ECUM_STATE_Mapping
        BswMDataTypeMappingSetRef = ComMModeMapping
        BswMDataTypeMappingSetRef = DTS_DcmEcuReset
        BswMDataTypeMappingSetRef = DTS_DcmDiagnosticSessionControl
      BswMModeControl
        8 x BswMAction:
          BswM_AI_BswMSwitchStartupTwo
            BswMAvailableActions
              BswMSchMSwitch: BswMSchMSwitchedMode=ECUM_STATE_STARTUP_TWO
          BswM_AI_BswMSwitchRun
            BswMAvailableActions
              BswMSchMSwitch: BswMSchMSwitchedMode=ECUM_STATE_RUN
          BswM_AI_BswMSwitchAppRun
            BswMAvailableActions
              BswMSchMSwitch: BswMSchMSwitchedMode=ECUM_STATE_APP_RUN
          BswM_AI_BswMSwitchPostRun
            BswMAvailableActions
              BswMSchMSwitch: BswMSchMSwitchedMode=ECUM_STATE_POST_RUN
          BswM_AI_BswMSwitchPrepShutdown
            BswMAvailableActions
              BswMSchMSwitch: BswMSchMSwitchedMode=ECUM_STATE_PREP_SHUTDOWN
          BswM_AI_BswMSwitchShutdown
            BswMAvailableActions
              BswMSchMSwitch: BswMSchMSwitchedMode=ECUM_STATE_SHUTDOWN
          BswM_AI_RteStart
            BswMAvailableActions
              BswMRteStart
          BswM_AI_GoDown
            BswMAvailableActions
              BswMUserCallout: BswMUserCalloutFunction=EcuM_GoDown(0)
        6 x BswMActionList:
          BswM_AL_BswMSwitchStartupTwo: BswMActionListExecution=BSWM_CONDITION
            10 x BswMActionListItem:
              BswM_ALI_StartupTwo_CddInit: BswMAbortOnFail=false, BswMActionListItemIndex=0, BswMActionListItemRef=BswM_AI_StartupTwo_CddInit
              BswM_ALI_Rtm_Fee_ProcessStart: BswMAbortOnFail=0, BswMActionListItemIndex=1, BswMActionListItemRef=BswM_AI_Rtm_Fee_ProcessStart
              BswM_ALI_FeeInit: BswMAbortOnFail=0, BswMActionListItemIndex=2, BswMActionListItemRef=BswM_AI_FeeInit
              BswM_ALI_Rtm_Fee_ProcessEnd: BswMAbortOnFail=0, BswMActionListItemIndex=3, BswMActionListItemRef=BswM_AI_Rtm_Fee_ProcessEnd
              BswM_ALI_FeeInitEnd: BswMAbortOnFail=0, BswMActionListItemIndex=4, BswMActionListItemRef=BswM_AI_FeeInitEnd
              BswM_ALI_Rtm_NvM_ProcessStart: BswMAbortOnFail=0, BswMActionListItemIndex=5, BswMActionListItemRef=BswM_AI_Rtm_NvM_ProcessStart
              BswM_ALI_NvMInit: BswMAbortOnFail=0, BswMActionListItemIndex=6, BswMActionListItemRef=BswM_AI_NvMInit
              BswM_ALI_Rtm_NvM_ProcessEnd: BswMAbortOnFail=0, BswMActionListItemIndex=7, BswMActionListItemRef=BswM_AI_Rtm_NvM_ProcessEnd
              BswM_ALI_NvMReadAll: BswMAbortOnFail=0, BswMActionListItemIndex=8, BswMActionListItemRef=BswM_AI_NvMReadAll
              BswM_ALI_BswMStartupTwo: BswMAbortOnFail=false, BswMActionListItemIndex=9, BswMActionListItemRef=BswM_AI_BswMSwitchStartupTwo
          BswM_AL_BswMSwitchRun: BswMActionListExecution=BSWM_TRIGGER
            23 x BswMActionListItem:
              BswM_ALl_FimInit: BswMAbortOnFail=0, BswMActionListItemIndex=0, BswMActionListItemRef=BswM_AI_FimInit
              BswM_ALI_DemInit: BswMAbortOnFail=false, BswMActionListItemIndex=1, BswMActionListItemRef=BswM_AI_DemInit
              BswM_ALI_Dem_EnableStorage: BswMAbortOnFail=false, BswMActionListItemIndex=2, BswMActionListItemRef=BswM_AI_Dem_EnableStorage
              BswM_ALI_Dem_ExtendedData_Init: BswMAbortOnFail=false, BswMActionListItemIndex=3, BswMActionListItemRef=BswM_AI_Dem_ExtendedData_Init
              BswM_ALI_Run_CddInitZero: BswMAbortOnFail=false, BswMActionListItemIndex=4, BswMActionListItemRef=BswM_AI_Run_CddInitZero
              BswM_ALI_Enable_PeripheralSply: BswMAbortOnFail=false, BswMActionListItemIndex=5, BswMActionListItemRef=BswM_AI_Enable_PeripheralSply
              BswM_ALI_Run_CddInitOne: BswMAbortOnFail=false, BswMActionListItemIndex=6, BswMActionListItemRef=BswM_Al_Run_CddInitOne
              BswM_ALI_SelfHold: BswMAbortOnFail=false, BswMActionListItemIndex=7, BswMActionListItemRef=BswM_AI_SelfHold
              BswM_ALI_CanTrcv_Init: BswMAbortOnFail=false, BswMActionListItemIndex=9, BswMActionListItemRef=BswM_AI_CanTrcv_Init
              BswM_ALI_CanTrcv_GotoNormal: BswMAbortOnFail=false, BswMActionListItemIndex=10, BswMActionListItemRef=BswM_AI_CanTrcv_GotoNormal
              BswM_ALI_CanIfInit: BswMAbortOnFail=0, BswMActionListItemIndex=11, BswMActionListItemRef=BswM_AI_CanIfInit
              BswM_ALI_CanSmInit: BswMAbortOnFail=0, BswMActionListItemIndex=12, BswMActionListItemRef=BswM_AI_CanSmInit
              BswM_ALI_PduRInit: BswMAbortOnFail=0, BswMActionListItemIndex=13, BswMActionListItemRef=BswM_AI_PduRInit
              BswM_ALI_ComMInit: BswMAbortOnFail=0, BswMActionListItemIndex=14, BswMActionListItemRef=BswM_AI_ComMInit
              BswM_ALI_ComInit: BswMAbortOnFail=0, BswMActionListItemIndex=15, BswMActionListItemRef=BswM_AI_ComInit
              BswM_ALI_Nm_Init: BswMAbortOnFail=0, BswMActionListItemIndex=16, BswMActionListItemRef=BswM_AI_Nm_Init
              BswM_ALI_CanNm_Init: BswMAbortOnFail=0, BswMActionListItemIndex=17, BswMActionListItemRef=BswM_AI_CanNm_Init
              BswM_ALI_DcmInit: BswMAbortOnFail=0, BswMActionListItemIndex=18, BswMActionListItemRef=BswM_AI_Dcm_Init
              BswM_ALI_CanTpInit: BswMAbortOnFail=false, BswMActionListItemIndex=19, BswMActionListItemRef=BswM_AI_CanTp_Init
              BswM_ALI_XcpInit: BswMAbortOnFail=false, BswMActionListItemIndex=20, BswMActionListItemRef=BswM_AI_XcpInit
              BswM_ALI_WdgMInit: BswMAbortOnFail=false, BswMActionListItemIndex=21, BswMActionListItemRef=BswM_AI_WdgMInit
              BswM_ALI_RteStart: BswMAbortOnFail=0, BswMActionListItemIndex=28, BswMActionListItemRef=BswM_AI_RteStart
              BswM_ALI_BswMRun: BswMAbortOnFail=false, BswMActionListItemIndex=29, BswMActionListItemRef=BswM_AI_BswMSwitchRun
          BswM_AL_BswMSwitchAppRun: BswMActionListExecution=BSWM_TRIGGER
            4 x BswMActionListItem:
              BswM_ALI_AllowComm_Can_Network_ETAS: BswMAbortOnFail=0, BswMActionListItemIndex=1, BswMActionListItemRef=BswM_AI_ComMCommAllowed_Can_Network_ETAS
              BswM_ALI_ReqFullComm_Can_Network_ETAS: BswMAbortOnFail=0, BswMActionListItemIndex=2, BswMActionListItemRef=BswM_AI_ComMReqFullComm_Can_Network_ETAS
              BswM_ALI_StartPduGroup: BswMAbortOnFail=0, BswMActionListItemIndex=5, BswMActionListItemRef=BswM_AI_StartPduGroup_All
              BswM_ALI_BswMAppRun: BswMAbortOnFail=false, BswMActionListItemIndex=6, BswMActionListItemRef=BswM_AI_BswMSwitchAppRun
          BswM_AL_BswMSwitchPostRun: BswMActionListExecution=BSWM_TRIGGER
            4 x BswMActionListItem:
              BswM_ALI_StopPduGroup_All: BswMAbortOnFail=0, BswMActionListItemIndex=0, BswMActionListItemRef=BswM_AI_StopPduGroup_All
              BswM_ALI_ReqNoComm_Can_Network_ETAS: BswMAbortOnFail=0, BswMActionListItemIndex=1, BswMActionListItemRef=BswM_AI_ComMReqNoComm_Can_Network_ETAS
              BswM_ALI_CommNotAllowed_Can_Network_ETAS: BswMAbortOnFail=0, BswMActionListItemIndex=2, BswMActionListItemRef=BswM_AI_ComMCommNotAllowed_Can_Network_ETAS
              BswM_ALI_BswMPostRun: BswMAbortOnFail=false, BswMActionListItemIndex=5, BswMActionListItemRef=BswM_AI_BswMSwitchPostRun
          BswM_AL_BswMSwitchPrepShutdown: BswMActionListExecution=BSWM_TRIGGER
            3 x BswMActionListItem:
              BswM_ALI_CanTrcv_GotoSleep: BswMAbortOnFail=0, BswMActionListItemIndex=0, BswMActionListItemRef=BswM_AI_CanTrcv_GotoSleep
              BswM_ALI_SelfHold_Unlock: BswMAbortOnFail=false, BswMActionListItemIndex=1, BswMActionListItemRef=BswM_AI_SelfHold_Unlock
              BswM_ALI_BswMPrepShutdown: BswMAbortOnFail=false, BswMActionListItemIndex=2, BswMActionListItemRef=BswM_AI_BswMSwitchPrepShutdown
          BswM_AL_BswMSwitchShutdown: BswMActionListExecution=BSWM_TRIGGER
            BswM_ALI_GoDown (BswMActionListItem): BswMAbortOnFail=false, BswMActionListItemIndex=1, BswMActionListItemRef=BswM_AI_GoDown
            BswM_ALI_BswMShutdown (BswMActionListItem): BswMAbortOnFail=false, BswMActionListItemIndex=2, BswMActionListItemRef=BswM_AI_BswMSwitchShutdown
        18 x BswMAction:
          BswM_AI_ComMReqFullComm_Can_Network_ETAS
            BswMAvailableActions
              BswMComMModeSwitch: BswMComMRequestedMode=BSWM_FULL_COM, BswMComMUserRef=ComMUser_Can_Network_ETAS_Channel_Can_Network_ETAS
          BswM_AI_ComMCommAllowed_Can_Network_ETAS
            BswMAvailableActions
              BswMComMAllowCom: BswMComAllowed=1, BswMComMAllowChannelRef=Can_Network_ETAS_Channel_Can_Network_ETAS
          BswM_AI_ComMReqNoComm_Can_Network_ETAS
            BswMAvailableActions
              BswMComMModeSwitch: BswMComMRequestedMode=BSWM_NO_COM, BswMComMUserRef=ComMUser_Can_Network_ETAS_Channel_Can_Network_ETAS
          BswM_AI_ComMCommNotAllowed_Can_Network_ETAS
            BswMAvailableActions
              BswMComMAllowCom: BswMComAllowed=0, BswMComMAllowChannelRef=Can_Network_ETAS_Channel_Can_Network_ETAS
          BswM_AI_StartPduGroup_All
            BswMAvailableActions
              BswMPduGroupSwitch: BswMPduGroupSwitchReinit=false, BswMEnabledPduGroupRef=ComIPduGroup_Rx, BswMEnabledPduGroupRef=ComIPduGroup_Tx
          BswM_AI_StopPduGroup_All
            BswMAvailableActions
              BswMPduGroupSwitch: BswMPduGroupSwitchReinit=false, BswMDisabledPduGroupRef=ComIPduGroup_Rx, BswMDisabledPduGroupRef=ComIPduGroup_Tx
          BswM_AI_CanIfInit
            BswMAvailableActions
              BswMUserCallout: BswMUserCalloutFunction=CanIf_Init(NULL_PTR)
          BswM_AI_ComMInit
            BswMAvailableActions
              BswMUserCallout: BswMUserCalloutFunction=ComM_Init(NULL_PTR)
          BswM_AI_CanSmInit
            BswMAvailableActions
              BswMUserCallout: BswMUserCalloutFunction=CanSM_Init(NULL_PTR)
          BswM_AI_ComInit
            BswMAvailableActions
              BswMUserCallout: BswMUserCalloutFunction=Com_Init(NULL_PTR)
          BswM_AI_PduRInit
            BswMAvailableActions
              BswMUserCallout: BswMUserCalloutFunction=PduR_Init(&PduR_Config)
          BswM_AI_FeeInit
            BswMAvailableActions
              BswMUserCallout: BswMUserCalloutFunction=Fee_Init(NULL_PTR)
          BswM_AI_CanTrcv_GotoSleep
            BswMAvailableActions
              BswMUserCallout: BswMUserCalloutFunction=BswM_CanTrcv_GotoSleep()
          BswM_AI_NvMReadAll
            BswMAvailableActions
              BswMUserCallout: BswMUserCalloutFunction=NvM_Integration_ReadAll()
          BswM_AI_NvMInit
            BswMAvailableActions
              BswMUserCallout: BswMUserCalloutFunction=NvM_Init()
          BswM_AI_SwitchAppMode
            BswMAvailableActions
              BswMSchMSwitch: BswMSchMSwitchedMode=ECUM_STATE_POST_RUN
          BswM_AI_Dcm_Init
            BswMAvailableActions
              BswMUserCallout: BswMUserCalloutFunction=Dcm_Init(NULL_PTR)
          BswM_AI_CanTp_Init
            BswMAvailableActions
              BswMUserCallout: BswMUserCalloutFunction=CanTp_Init(NULL_PTR)
        BswM_AL_DCM_EcuReset_SOFT (BswMActionList): BswMActionListExecution=BSWM_TRIGGER
          BswM_ALI_EcuM_SelectShutdownTarget_RESET_MCU (BswMActionListItem): BswMAbortOnFail=false, BswMActionListItemIndex=0, BswMActionListItemRef=BswM_AI_EcuM_SelectShutdownTarget_RESET_MCU
          BswM_ALI_EcuM_GoDown (BswMActionListItem): BswMAbortOnFail=0, BswMActionListItemIndex=1, BswMActionListItemRef=BswM_AI_GoDown
        BswM_AL_DCM_EcuReset_HARD (BswMActionList): BswMActionListExecution=BSWM_TRIGGER
          5 x BswMActionListItem:
            BswM_ALI_EcuM_SelectShutdownTarget_RESET_IO: BswMAbortOnFail=false, BswMActionListItemIndex=0, BswMActionListItemRef=BswM_AI_EcuM_SelectShutdownTarget_RESET_IO
            BswM_ALI_Dem_endOperation: BswMAbortOnFail=false, BswMActionListItemIndex=1, BswMActionListItemRef=BswM_AI_Dem_EndOperation
            BswM_ALI_Dem_Shutdown: BswMAbortOnFail=0, BswMActionListItemIndex=2, BswMActionListItemRef=BswM_AI_DemShutdown
            BswM_ALI_CanTrcv_GotoSleep: BswMAbortOnFail=0, BswMActionListItemIndex=3, BswMActionListItemRef=BswM_AI_CanTrcv_GotoSleep
            BswM_ALI_GoDown: BswMAbortOnFail=0, BswMActionListItemIndex=4, BswMActionListItemRef=BswM_AI_GoDown
        6 x BswMAction:
          BswM_AI_EcuM_SelectShutdownTarget_RESET_MCU
            BswMAvailableActions
              BswMUserCallout: BswMUserCalloutFunction=EcuM_SelectShutdownTarget(ECUM_SHUTDOWN_TARGET_RESET,ECUM_RESET_MCU)
          BswM_AI_EcuM_SelectShutdownTarget_RESET_IO
            BswMAvailableActions
              BswMUserCallout: BswMUserCalloutFunction=EcuM_SelectShutdownTarget(ECUM_SHUTDOWN_TARGET_RESET,ECUM_RESET_IO)
          BswM_AI_EnableRxPduGroup
            BswMAvailableActions
              BswMPduGroupSwitch: BswMPduGroupSwitchReinit=false, BswMEnabledPduGroupRef=ComIPduGroup_Rx
          BswM_AI_DisableRxPduGroup
            BswMAvailableActions
              BswMPduGroupSwitch: BswMPduGroupSwitchReinit=false, BswMDisabledPduGroupRef=ComIPduGroup_Rx
          BswM_AI_EnableTxPduGroup
            BswMAvailableActions
              BswMPduGroupSwitch: BswMPduGroupSwitchReinit=false, BswMEnabledPduGroupRef=ComIPduGroup_Tx
          BswM_AI_DisableTxPduGroup
            BswMAvailableActions
              BswMPduGroupSwitch: BswMPduGroupSwitchReinit=false, BswMDisabledPduGroupRef=ComIPduGroup_Tx
        4 x BswMActionList, all with BswMActionListExecution=BSWM_TRIGGER:
          BswM_AL_DCM_ENABLE_RX_TX_NORM
            BswM_ALI_EnableRxPduGroup (BswMActionListItem): BswMAbortOnFail=false, BswMActionListItemIndex=0, BswMActionListItemRef=BswM_AI_EnableRxPduGroup
            BswM_ALI_EnableTxPduGroup (BswMActionListItem): BswMAbortOnFail=false, BswMActionListItemIndex=1, BswMActionListItemRef=BswM_AI_EnableTxPduGroup
          BswM_AL_DCM_DISABLE_RX_TX_NORM
            BswM_ALI_DisableRxPduGroup (BswMActionListItem): BswMAbortOnFail=false, BswMActionListItemIndex=0, BswMActionListItemRef=BswM_AI_DisableRxPduGroup
            BswM_ALI_DisableTxPduGroup (BswMActionListItem): BswMAbortOnFail=false, BswMActionListItemIndex=1, BswMActionListItemRef=BswM_AI_DisableTxPduGroup
          BswM_AL_DCM_ENABLE_RX_DISABLE_TX_NORM
            BswM_ALI_EnableRxPduGroup (BswMActionListItem): BswMAbortOnFail=false, BswMActionListItemIndex=0, BswMActionListItemRef=BswM_AI_EnableRxPduGroup
            BswM_ALI_DisableTxPduGroup (BswMActionListItem): BswMAbortOnFail=false, BswMActionListItemIndex=1, BswMActionListItemRef=BswM_AI_DisableTxPduGroup
          BswM_AL_DCM_DISABLE_RX_ENABLE_TX_NORM
            BswM_ALI_DisableRxPduGroup (BswMActionListItem): BswMAbortOnFail=false, BswMActionListItemIndex=0, BswMActionListItemRef=BswM_AI_DisableRxPduGroup
            BswM_ALI_EnableTxPduGroup (BswMActionListItem): BswMAbortOnFail=false, BswMActionListItemIndex=1, BswMActionListItemRef=BswM_AI_EnableTxPduGroup
        5 x BswMAction:
          BswM_AI_DemInit
            BswMAvailableActions_0 (BswMAvailableActions)
              BswMUserCallout: BswMUserCalloutFunction=Dem_Init()
          BswM_AI_DemShutdown
            BswMAvailableActions
              BswMUserCallout: BswMUserCalloutFunction=Dem_Shutdown()
          BswM_AI_Dem_EndOperation
            BswMAvailableActions
              BswMUserCallout: BswMUserCalloutFunction=Dem_SetOperationCycleState(0,DEM_CYCLE_STATE_END)
          BswM_AI_WdgMInit
            BswMAvailableActions
              BswMUserCallout: BswMUserCalloutFunction=WdgM_Init(NULL_PTR)
          BswM_AI_XcpInit
            BswMAvailableActions
              BswMUserCallout: BswMUserCalloutFunction=Xcp_Init(NULL_PTR)
        4 x BswMActionList, all with BswMActionListExecution=BSWM_TRIGGER:
          BswM_AL_DCM_DISABLE_RX_ENABLE_TX_NORM_NM
            3 x BswMActionListItem:
              BswM_ALI_DisableRxPduGroup_NORM: BswMAbortOnFail=false, BswMActionListItemIndex=0, BswMActionListItemRef=BswM_AI_DisableRxPduGroup
              BswM_ALI_DisableTxPduGroup_NORM: BswMAbortOnFail=0, BswMActionListItemIndex=1, BswMActionListItemRef=BswM_AI_DisableTxPduGroup
              BswM_ALI_DisableRxTxPduGroup_NM: BswMAbortOnFail=0, BswMActionListItemIndex=2, BswMActionListItemRef=BswM_AI_NM_Stop
          BswM_AL_DCM_ENABLE_RX_TX_NORM_NM
            3 x BswMActionListItem:
              BswM_ALI_EnableRxPduGroup_NORM: BswMAbortOnFail=false, BswMActionListItemIndex=0, BswMActionListItemRef=BswM_AI_EnableRxPduGroup
              BswM_ALI_EnableRxTxPduGroup_NM: BswMAbortOnFail=0, BswMActionListItemIndex=1, BswMActionListItemRef=BswM_AI_NM_Start
              BswM_ALI_EnableTxPduGroup_NORM: BswMAbortOnFail=0, BswMActionListItemIndex=2, BswMActionListItemRef=BswM_AI_EnableTxPduGroup
          BswM_AL_DCM_ENABLE_TX_RX_NM
            BswM_ALI_NM_Start (BswMActionListItem): BswMAbortOnFail=false, BswMActionListItemIndex=0, BswMActionListItemRef=BswM_AI_NM_Start
          BswM_AL_DCM_DISABLE_TX_RX_NM
            BswM_ALI_NM_STOP (BswMActionListItem): BswMAbortOnFail=false, BswMActionListItemIndex=0, BswMActionListItemRef=BswM_AI_NM_Stop
        20 x BswMAction:
          BswM_AI_CanNm_Init
            BswMAvailableActions
              BswMUserCallout: BswMUserCalloutFunction=CanNm_Init(NULL_PTR)
          BswM_AI_Nm_Init
            BswMAvailableActions
              BswMUserCallout: BswMUserCalloutFunction=Nm_Init(NULL_PTR)
          BswM_AI_NM_Start
            BswMAvailableActions
              BswMNMControl: BswMNMAction=BSWM_NM_ENABLE, BswMComMNetworkHandleRef=Can_Network_ETAS_Channel_Can_Network_ETAS
          BswM_AI_NM_Stop
            BswMAvailableActions
              BswMNMControl: BswMNMAction=BSWM_NM_DISABLE, BswMComMNetworkHandleRef=Can_Network_ETAS_Channel_Can_Network_ETAS
          BswM_AI_FimInit
            BswMAvailableActions_0 (BswMAvailableActions)
              BswMUserCallout: BswMUserCalloutFunction=FiM_Init(NULL_PTR)
          BswM_AI_FeeInitEnd
            BswMAvailableActions
              BswMUserCallout: BswMUserCalloutFunction=Fee_Rb_EndInit()
          BswM_AI_StartupTwo_CddInit
            BswMAvailableActions
              BswMUserCallout: BswMUserCalloutFunction=BswM_StartupTwo_CddInit()
          BswM_AI_Dem_EnableStorage
            BswMAvailableActions
              BswMUserCallout: BswMUserCalloutFunction=Dem_SetEnableCondition(0, TRUE)
          BswM_AI_Dem_ExtendedData_Init
            BswMAvailableActions
              BswMUserCallout: BswMUserCalloutFunction=Dem_ExtendedData_Init()
          BswM_AI_Run_CddInitZero
            BswMAvailableActions
              BswMUserCallout: BswMUserCalloutFunction=BswM_Run_CddInitZero()
          BswM_AI_Enable_PeripheralSply
            BswMAvailableActions
              BswMUserCallout: BswMUserCalloutFunction=BswM_Enable_PeripheralSply()
          BswM_Al_Run_CddInitOne
            BswMAvailableActions
              BswMUserCallout: BswMUserCalloutFunction=BswM_Run_CddInitOne()
          BswM_AI_SelfHold
            BswMAvailableActions
              BswMUserCallout: BswMUserCalloutFunction=BswM_PerformSelfHold()
          BswM_AI_CanTrcv_Init
            BswMAvailableActions
              BswMUserCallout: BswMUserCalloutFunction=CanTrcv_Init(NULL_PTR)
          BswM_AI_CanTrcv_GotoNormal
            BswMAvailableActions
              BswMUserCallout: BswMUserCalloutFunction=BswM_CanTrcv_GotoNormal()
          BswM_AI_SelfHold_Unlock
            BswMAvailableActions
              BswMUserCallout: BswMUserCalloutFunction=BswM_SelfHold_Unlock()
          BswM_AI_Rtm_Fee_ProcessStart
            BswMAvailableActions
              BswMUserCallout: BswMUserCalloutFunction=Rtm_ProcessStart(Rtm_Mon_Cfg_ProcessId_Fee_Init)
          BswM_AI_Rtm_Fee_ProcessEnd
            BswMAvailableActions
              BswMUserCallout: BswMUserCalloutFunction=Rtm_ProcessEnd(Rtm_Mon_Cfg_ProcessId_Fee_Init)
          BswM_AI_Rtm_NvM_ProcessStart
            BswMAvailableActions
              BswMUserCallout: BswMUserCalloutFunction=Rtm_ProcessStart(Rtm_Mon_Cfg_ProcessId_NvM_Init)
          BswM_AI_Rtm_NvM_ProcessEnd
            BswMAvailableActions
              BswMUserCallout: BswMUserCalloutFunction=Rtm_ProcessEnd(Rtm_Mon_Cfg_ProcessId_NvM_Init)

AUTOSAR XML (schema 00047)
package /ETAS_BIP/EcucModuleConfigurationValuess
  module config EcuM
    EcuMConfiguration
      EcuMCommonConfiguration
        ECUM_WKSOURCE_INTERNAL_GPT (EcuMWakeupSource): EcuMValidationTimeout=0.0, EcuMWakeupSourcePolling=false, EcuMResetReasonRef=McuResetReasonConf
        ECUM_WKSOURCE_INTERNAL_CAN (EcuMWakeupSource):
          EcuMValidationTimeout = 0.0
          EcuMWakeupSourcePolling = false
          EcuMResetReasonRef = McuResetReasonConf
          EcuMComMChannelRef = Can_Network_ETAS_Channel_Can_Network_ETAS

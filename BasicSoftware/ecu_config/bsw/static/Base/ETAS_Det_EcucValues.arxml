AUTOSAR XML (schema 4-2-2)
package /ETAS_BIP/EcucModuleConfigurationValuess
  module config Det
    DetGeneral:
      DetForwardToDlt = 0
      DetRbCheckApiConsistency = 1
      DetVersionInfoApi = false
      DetReportRuntimeErrorCallout = Det_ReportRuntimeErrorHook
      DetReportTransientFaultCallout = Det_ReportTransientFaultHook
      DetRbBuffer: DetRbUseErrorBufferApi=true, DetRbErrorBufferSize=100, DetRbFilterDuplicateBufferEntries=true
    DetNotification: DetErrorHook=Det_ReportErrorHook
    DetNotification
    DetConfigSet
      3 x DetModule:
        ComplexDriver: DetModuleId=4096
        IoHwAb: DetModuleId=4097
        ASW: DetModuleId=4098

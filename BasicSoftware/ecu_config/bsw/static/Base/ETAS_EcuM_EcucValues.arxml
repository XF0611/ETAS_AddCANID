AUTOSAR XML (schema 00047)
package /ETAS_BIP/EcucModuleConfigurationValuess
  module config EcuM
    EcuMConfiguration
      EcuMCommonConfiguration: EcuMDefaultAppMode=OSDEFAULTAPPMODE, EcuMOSResource=RES_AUTOSAR_ECUM
        EcuMDefaultShutdownTarget: EcuMDefaultState=EcuMStateOff, EcuMDefaultResetModeRef=ECUM_RESET_MCU
        5 x EcuMWakeupSource, all with EcuMValidationTimeout=0.0, EcuMWakeupSourcePolling=true:
          ECUM_WKSOURCE_POWER: EcuMWakeupSourceId=0, EcuMResetReasonRef=McuResetReasonConf
          ECUM_WKSOURCE_RESET: EcuMWakeupSourceId=1, EcuMResetReasonRef=McuResetReasonConf_001
          ECUM_WKSOURCE_INTERNAL_RESET: EcuMWakeupSourceId=2, EcuMResetReasonRef=McuResetReasonConf_002
          ECUM_WKSOURCE_INTERNAL_WDG: EcuMWakeupSourceId=3, EcuMResetReasonRef=McuResetReasonConf_003
          ECUM_WKSOURCE_EXTERNAL_WDG: EcuMWakeupSourceId=4, EcuMResetReasonRef=McuResetReasonConf_003
        EcuMDriverInitListOne
          15 x EcuMDriverInitItem:
            Det: EcuMModuleID=Det, EcuMModuleParameter=NULL_PTR, EcuMModuleService=Init
            Rtm: EcuMModuleID=Rtm, EcuMModuleParameter=VOID, EcuMModuleService=PreOSInit
            StackMCore0: EcuMModuleID=StackM, EcuMModuleParameter=VOID, EcuMModuleService=InitCoreStack
            TstM: EcuMModuleID=TstM, EcuMModuleParameter=VOID, EcuMModuleService=PreRun
            Dem_PreInit: EcuMModuleID=Dem, EcuMModuleParameter=NULL_PTR, EcuMModuleService=PreInit
            Mcu: EcuMModuleID=Mcu, EcuMModuleParameter=POSTBUILD_PTR, EcuMModuleService=Init
            Gpt: EcuMModuleParameter=POSTBUILD_PTR, EcuMModuleID=Gpt, EcuMModuleService=Init
            VectorTableCore0: EcuMModuleID=VectorTableCore0, EcuMModuleParameter=VOID, EcuMModuleService=Init
            Target: EcuMModuleID=Target, EcuMModuleService=Init, EcuMModuleParameter=VOID
            Port: EcuMModuleID=Port, EcuMModuleService=Init, EcuMModuleParameter=POSTBUILD_PTR
            Dio: EcuMModuleID=Dio, EcuMModuleParameter=POSTBUILD_PTR, EcuMModuleService=Init
            Fls: EcuMModuleID=Fls, EcuMModuleParameter=POSTBUILD_PTR, EcuMModuleService=Init
            Can: EcuMModuleID=Can, EcuMModuleParameter=POSTBUILD_PTR, EcuMModuleService=Init
            Wdg: EcuMModuleID=Wdg, EcuMModuleParameter=POSTBUILD_PTR, EcuMModuleService=Init
            Uart: EcuMModuleID=Uart, EcuMModuleParameter=POSTBUILD_PTR, EcuMModuleService=Init
        EcuMSleepMode:
          EcuMSleepModeSuspend = false
          EcuMSleepModeMcuModeRef = McuModeSettingConf_0
          EcuMWakeupSourceMask = ECUM_WKSOURCE_POWER
          EcuMWakeupSourceMask = ECUM_WKSOURCE_INTERNAL_RESET
          EcuMWakeupSourceMask = ECUM_WKSOURCE_INTERNAL_WDG
          EcuMWakeupSourceMask = ECUM_WKSOURCE_RESET
          EcuMWakeupSourceMask = ECUM_WKSOURCE_EXTERNAL_WDG
      EcuMFlexConfiguration: EcuMNormalMcuModeRef=McuModeSettingConf_0
        EcuMFlexUserConfig: EcuMFlexUser=0
        EcuMGoDownAllowedUsers: EcuMGoDownAllowedUserRef=EcuMFlexUserConfig
        3 x EcuMResetMode:
          ECUM_RESET_MCU: EcuMResetModeId=0
          ECUM_RESET_WDGM: EcuMResetModeId=1
          ECUM_RESET_IO: EcuMResetModeId=2
        3 x EcuMShutdownCause:
          ECUM_CAUSE_ECU_STATE: EcuMShutdownCauseId=1
          ECUM_CAUSE_WDGM: EcuMShutdownCauseId=2
          ECUM_CAUSE_DCM: EcuMShutdownCauseId=3
    EcuMGeneral: EcuMDevErrorDetect=1, EcuMIncludeDet=1, EcuMMainFunctionPeriod=0.01, EcuMVersionInfoApi=true
      EcuMRbIncludeHeaderList: EcuMRbModuleHeader=EcuM_PBDefine
      EcuMRbOnGoOffOneCallout
        EcuM_GoOffOne (EcuMRbCallOutItem): EcuMRbCalloutFunction=EcuM_GoOffOne, EcuMRbModuleID=EcuM_Integration, EcuMRbSequenceID=0, EcuMRbServiceIsNonAutosar=true
      EcuMRbOnGoOffTwoCallout
        3 x EcuMRbCallOutItem, all with EcuMRbServiceIsNonAutosar=true:
          TstM_PostRun: EcuMRbCalloutFunction=TstM_PostRun, EcuMRbModuleID=TstM, EcuMRbSequenceID=0
          NvM_Integration_WriteAll: EcuMRbCalloutFunction=NvM_Integration_WriteAll, EcuMRbModuleID=NvM_Integration, EcuMRbSequenceID=1
          ExeMgr_ExecuteShutdown: EcuMRbCalloutFunction=RE_ExeMgr_ExecuteShutdown, EcuMRbModuleID=Rte_ExeMgrUT, EcuMRbSequenceID=2
      EcuMRbAlSwitchOffCallout
        Ecu_SwitchOff (EcuMRbCallOutItem): EcuMRbCalloutFunction=Ecu_SwitchOff, EcuMRbModuleID=Ecu, EcuMRbServiceIsNonAutosar=true

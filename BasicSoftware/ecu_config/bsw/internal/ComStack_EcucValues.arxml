AUTOSAR XML (schema 4-2-2)
package /RB/UBK/Project/EcucModuleConfigurationValuess
  module config ComStack: implementation-config-variant=VARIANT-PRE-COMPILE
    ComStackRbSettings: ComStackRbArRelease=AR42_Rev2

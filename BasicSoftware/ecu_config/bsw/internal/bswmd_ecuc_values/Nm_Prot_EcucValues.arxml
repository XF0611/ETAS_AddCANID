AUTOSAR XML (schema 4-2-2)
package /RB/UBK/Project/EcucModuleConfigurationValuess
  module config rba_ArxmlGen
    Nm (rba_ArxmlGen_Comp):
      rba_ArxmlGen_CompCategory = BswModule
      rba_ArxmlGen_CompId = 29
      rba_ArxmlGen_CompIsConfigurable = true
      rba_ArxmlGen_CompIsStandalone = true
      rba_ArxmlGen_CompIsStandardized = true
      rba_ArxmlGen_CompLongName = NetworkManagementInterface
      rba_ArxmlGen_CompVersionAr = 4.2.2
      rba_ArxmlGen_CompVersionSw = 8.0.0
      CE_Init (rba_ArxmlGen_ExecEntity): rba_ArxmlGen_ExecEntityCategory=Called, rba_ArxmlGen_ExecEntityImplEntryRef=Nm_Init
      3 x rba_ArxmlGen_Memsection:
        CODE: rba_ArxmlGen_MemsectionAddrMethodRef=CODE
        VAR_CLEARED: rba_ArxmlGen_MemsectionDatatype_32=true, rba_ArxmlGen_MemsectionDatatype_UNSPECIFIED=true, rba_ArxmlGen_MemsectionAddrMethodRef=VAR_CLEARED
        CONST: rba_ArxmlGen_MemsectionDatatype_08=true, rba_ArxmlGen_MemsectionDatatype_UNSPECIFIED=true, rba_ArxmlGen_MemsectionAddrMethodRef=CONST

AUTOSAR XML (schema 4-2-2)
package /RB/UBK/Project/EcucModuleConfigurationValuess
  module config rba_ArxmlGen
    Xcp (rba_ArxmlGen_Comp):
      rba_ArxmlGen_CompCategory = BswModule
      rba_ArxmlGen_CompId = 212
      rba_ArxmlGen_CompIsConfigurable = true
      rba_ArxmlGen_CompIsStandalone = true
      rba_ArxmlGen_CompIsStandardized = true
      rba_ArxmlGen_CompLongName = Xcp
      rba_ArxmlGen_CompVersionAr = 4.2.2
      6 x rba_ArxmlGen_Memsection:
        VAR_POWER_ON_CLEARED: rba_ArxmlGen_MemsectionDatatype_32=true, rba_ArxmlGen_MemsectionDatatype_UNSPECIFIED=true, rba_ArxmlGen_MemsectionAddrMethodRef=VAR_POWER_ON_CLEARED
        VAR_CLEARED: rba_ArxmlGen_MemsectionDatatype_UNSPECIFIED=true, rba_ArxmlGen_MemsectionAddrMethodRef=VAR_CLEARED
        VAR_INIT: rba_ArxmlGen_MemsectionDatatype_32=true, rba_ArxmlGen_MemsectionAddrMethodRef=VAR_INIT
        CONST: rba_ArxmlGen_MemsectionDatatype_32=true, rba_ArxmlGen_MemsectionDatatype_UNSPECIFIED=true, rba_ArxmlGen_MemsectionAddrMethodRef=CONST
        CODE: rba_ArxmlGen_MemsectionAddrMethodRef=CODE
        CODE_FAST: rba_ArxmlGen_MemsectionAddrMethodRef=CODE_FAST

AUTOSAR XML (schema 4-2-2)
package /RB/UBK/Project/EcucModuleConfigurationValuess
  module config rba_ArxmlGen
    CanIf (rba_ArxmlGen_Comp):
      rba_ArxmlGen_CompCategory = BswModule
      rba_ArxmlGen_CompId = 60
      rba_ArxmlGen_CompIsConfigurable = true
      rba_ArxmlGen_CompIsStandalone = true
      rba_ArxmlGen_CompIsStandardized = true
      rba_ArxmlGen_CompLongName = CANInterface
      rba_ArxmlGen_CompVersionAr = 4.2.2
      rba_ArxmlGen_CompVersionSw = 8.0.0
      10 x rba_ArxmlGen_ApplDataType:
        CanIf_boolean_app: rba_ArxmlGen_ApplDataTypeCategory=Simple, rba_ArxmlGen_ApplDataTypeDispFormat=%5.0f, rba_ArxmlGen_ApplDataTypeLongName=boolean application datatype in CanIf, rba_ArxmlGen_ApplDataTypeCompuMethodRef=Identical, rba_ArxmlGen_ApplDataTypeDataConstrOwnRef=CanIf_DataConstraint_bool, rba_ArxmlGen_ApplDataTypeImplOwnRef=CanIf_boolean_impl
        CanIf_ControllerStateType_struct_app: rba_ArxmlGen_ApplDataTypeCategory=Struct, rba_ArxmlGen_ApplDataTypeLongName=structure in CanIf, rba_ArxmlGen_ApplDataTypeImplOwnRef=CanIf_ControllerStateType_struct_impl
          Ctrl_Pdu_mode (rba_ArxmlGen_ApplDataTypeSub): rba_ArxmlGen_ApplDataTypeSubOwnRef=CanIf_u8_app
        CanIf_CanIdBuffer_struct_app: rba_ArxmlGen_ApplDataTypeCategory=Struct, rba_ArxmlGen_ApplDataTypeLongName=structure in CanIf, rba_ArxmlGen_ApplDataTypeImplOwnRef=CanIf_CanIdBuffer_struct_impl
          4 x rba_ArxmlGen_ApplDataTypeSub:
            CanId: rba_ArxmlGen_ApplDataTypeSubOwnRef=CanIf_u32_app
            swPduHandle: rba_ArxmlGen_ApplDataTypeSubOwnRef=CanIf_u16_app
            SduLength: rba_ArxmlGen_ApplDataTypeSubOwnRef=CanIf_u8_app
            BufferIndex: rba_ArxmlGen_ApplDataTypeSubOwnRef=CanIf_u8_app
        CanIf_Prv_TxBufferStatus_tst_struct_app: rba_ArxmlGen_ApplDataTypeCategory=Struct, rba_ArxmlGen_ApplDataTypeLongName=structure in CanIf, rba_ArxmlGen_ApplDataTypeImplOwnRef=CanIf_Prv_TxBufferStatus_tst_struct_impl
          last_index (rba_ArxmlGen_ApplDataTypeSub): rba_ArxmlGen_ApplDataTypeSubOwnRef=CanIf_u8_app
          bufferstatus (rba_ArxmlGen_ApplDataTypeSub): rba_ArxmlGen_ApplDataTypeSubOwnRef=CanIf_u8_app
        CanIf_NotifStatusType_Enum_app: rba_ArxmlGen_ApplDataTypeCategory=Simple, rba_ArxmlGen_ApplDataTypeDispFormat=%5.0f, rba_ArxmlGen_ApplDataTypeLongName=enumeration data type, rba_ArxmlGen_ApplDataTypeCompuMethodOwnRef=CanIf_NotifStatusType_Enum_comp, rba_ArxmlGen_ApplDataTypeDataConstrOwnRef=CanIf_DataConstraint_enum, rba_ArxmlGen_ApplDataTypeImplRef=uint8
        CanIf_ControllerModeType_Enum_app: rba_ArxmlGen_ApplDataTypeCategory=Simple, rba_ArxmlGen_ApplDataTypeDispFormat=%5.0f, rba_ArxmlGen_ApplDataTypeLongName=enumeration data type, rba_ArxmlGen_ApplDataTypeCompuMethodOwnRef=CanIf_ControllerModeType_Enum_comp, rba_ArxmlGen_ApplDataTypeDataConstrOwnRef=CanIf_DataConstraint_enum, rba_ArxmlGen_ApplDataTypeImplRef=uint8
        CanIf_PduModeType_Enum_app: rba_ArxmlGen_ApplDataTypeCategory=Simple, rba_ArxmlGen_ApplDataTypeDispFormat=%5.0f, rba_ArxmlGen_ApplDataTypeLongName=enumeration data type, rba_ArxmlGen_ApplDataTypeCompuMethodOwnRef=CanIf_PduModeType_Enum_comp, rba_ArxmlGen_ApplDataTypeDataConstrOwnRef=CanIf_DataConstraint_enum, rba_ArxmlGen_ApplDataTypeImplRef=uint8
        CanIf_u8_app: rba_ArxmlGen_ApplDataTypeCategory=Simple, rba_ArxmlGen_ApplDataTypeDispFormat=%5.0f, rba_ArxmlGen_ApplDataTypeLongName=unsigned char application datatype in CanIf, rba_ArxmlGen_ApplDataTypeCompuMethodRef=Identical, rba_ArxmlGen_ApplDataTypeDataConstrOwnRef=CanIf_DataConstraint_u8, rba_ArxmlGen_ApplDataTypeImplOwnRef=CanIf_u8_impl
        CanIf_u16_app: rba_ArxmlGen_ApplDataTypeCategory=Simple, rba_ArxmlGen_ApplDataTypeDispFormat=%5.0f, rba_ArxmlGen_ApplDataTypeLongName=unsigned short application datatype in CanIf, rba_ArxmlGen_ApplDataTypeCompuMethodRef=Identical, rba_ArxmlGen_ApplDataTypeDataConstrOwnRef=CanIf_DataConstraint_u16, rba_ArxmlGen_ApplDataTypeImplOwnRef=CanIf_u16_impl
        CanIf_u32_app: rba_ArxmlGen_ApplDataTypeCategory=Simple, rba_ArxmlGen_ApplDataTypeDispFormat=%5.0f, rba_ArxmlGen_ApplDataTypeLongName=unsigned long application datatype in CanIf, rba_ArxmlGen_ApplDataTypeCompuMethodRef=Identical, rba_ArxmlGen_ApplDataTypeDataConstrOwnRef=CanIf_DataConstraint_u32, rba_ArxmlGen_ApplDataTypeImplOwnRef=CanIf_u32_impl
      3 x rba_ArxmlGen_CompuMethod, all with rba_ArxmlGen_CompuMethodCategory=TextTable:
        CanIf_NotifStatusType_Enum_comp: rba_ArxmlGen_CompuMethodLongName=Computation method for enum type CanIf_NotifStatusType
          CANIF_NO_NOTIFICATION (rba_ArxmlGen_CompuMethodTextEntry): rba_ArxmlGen_CompuMethodTEIntVal=0, rba_ArxmlGen_CompuMethodTENumVals=1, rba_ArxmlGen_CompuMethodTEText=CANIF_NO_NOTIFICATION
          CANIF_TX_RX_NOTIFICATION (rba_ArxmlGen_CompuMethodTextEntry): rba_ArxmlGen_CompuMethodTEIntVal=1, rba_ArxmlGen_CompuMethodTENumVals=1, rba_ArxmlGen_CompuMethodTEText=CANIF_TX_RX_NOTIFICATION
        CanIf_ControllerModeType_Enum_comp: rba_ArxmlGen_CompuMethodLongName=Computation method for enum type CanIf_ControllerModeType
          4 x rba_ArxmlGen_CompuMethodTextEntry, all with rba_ArxmlGen_CompuMethodTENumVals=1:
            CANIF_CS_UNINIT: rba_ArxmlGen_CompuMethodTEIntVal=0, rba_ArxmlGen_CompuMethodTEText=CANIF_CS_UNINIT
            CANIF_CS_SLEEP: rba_ArxmlGen_CompuMethodTEIntVal=1, rba_ArxmlGen_CompuMethodTEText=CANIF_CS_SLEEP
            CANIF_CS_STARTED: rba_ArxmlGen_CompuMethodTEIntVal=2, rba_ArxmlGen_CompuMethodTEText=CANIF_CS_STARTED
            CANIF_CS_STOPPED: rba_ArxmlGen_CompuMethodTEIntVal=3, rba_ArxmlGen_CompuMethodTEText=CANIF_CS_STOPPED
        CanIf_PduModeType_Enum_comp: rba_ArxmlGen_CompuMethodLongName=Computation method for enum type CanIf_PduModeType
          4 x rba_ArxmlGen_CompuMethodTextEntry, all with rba_ArxmlGen_CompuMethodTENumVals=1:
            CANIF_OFFLINE: rba_ArxmlGen_CompuMethodTEIntVal=0, rba_ArxmlGen_CompuMethodTEText=CANIF_OFFLINE
            CANIF_TX_OFFLINE: rba_ArxmlGen_CompuMethodTEIntVal=1, rba_ArxmlGen_CompuMethodTEText=CANIF_TX_OFFLINE
            CANIF_TX_OFFLINE_ACTIVE: rba_ArxmlGen_CompuMethodTEIntVal=2, rba_ArxmlGen_CompuMethodTEText=CANIF_TX_OFFLINE_ACTIVE
            CANIF_ONLINE: rba_ArxmlGen_CompuMethodTEIntVal=3, rba_ArxmlGen_CompuMethodTEText=CANIF_ONLINE
      5 x rba_ArxmlGen_DataConstraint, all with rba_ArxmlGen_DataConstraintCategory=Physical, rba_ArxmlGen_DataConstraintLower=0, rba_ArxmlGen_DataConstraintUnitRef=NoUnit:
        CanIf_DataConstraint_enum: rba_ArxmlGen_DataConstraintUpper=255
        CanIf_DataConstraint_bool: rba_ArxmlGen_DataConstraintUpper=1
        CanIf_DataConstraint_u8: rba_ArxmlGen_DataConstraintUpper=255
        CanIf_DataConstraint_u16: rba_ArxmlGen_DataConstraintUpper=65535
        CanIf_DataConstraint_u32: rba_ArxmlGen_DataConstraintUpper=4294967295
      CE_Init (rba_ArxmlGen_ExecEntity): rba_ArxmlGen_ExecEntityCategory=Called, rba_ArxmlGen_ExecEntityImplEntryRef=CanIf_Init
      11 x rba_ArxmlGen_ImplDataType:
        CanIf_boolean_impl: rba_ArxmlGen_ImplDataTypeCategory=Simple, rba_ArxmlGen_ImplDataTypeLongName=implementation data type for application data type boolean, rba_ArxmlGen_ImplDataTypeBaseRef=uint8
        CanIf_u8_impl: rba_ArxmlGen_ImplDataTypeCategory=Simple, rba_ArxmlGen_ImplDataTypeLongName=implementation data type for application data type uint8, rba_ArxmlGen_ImplDataTypeBaseRef=uint8
        CanIf_u16_impl: rba_ArxmlGen_ImplDataTypeCategory=Simple, rba_ArxmlGen_ImplDataTypeLongName=implementation data type for application data type uint16, rba_ArxmlGen_ImplDataTypeBaseRef=uint16
        CanIf_u32_impl: rba_ArxmlGen_ImplDataTypeCategory=Simple, rba_ArxmlGen_ImplDataTypeLongName=implementation data type for application data type uint32, rba_ArxmlGen_ImplDataTypeBaseRef=uint32
        CanIf_NotifStatusType_Enum_impl: rba_ArxmlGen_ImplDataTypeCategory=Simple, rba_ArxmlGen_ImplDataTypeLongName=implementation data type for application data type enum, rba_ArxmlGen_ImplDataTypeBaseRef=uint8
        CanIf_ControllerModeType_Enum_impl: rba_ArxmlGen_ImplDataTypeCategory=Simple, rba_ArxmlGen_ImplDataTypeLongName=implementation data type for application data type enum, rba_ArxmlGen_ImplDataTypeBaseRef=uint8
        CanIf_PduModeType_Enum_impl: rba_ArxmlGen_ImplDataTypeCategory=Simple, rba_ArxmlGen_ImplDataTypeLongName=implementation data type for application data type enum, rba_ArxmlGen_ImplDataTypeBaseRef=uint8
        CanIf_Prv_BuffStatus_ten_Enum_impl: rba_ArxmlGen_ImplDataTypeCategory=Simple, rba_ArxmlGen_ImplDataTypeLongName=implementation data type for application data type enum, rba_ArxmlGen_ImplDataTypeBaseRef=uint8
        CanIf_ControllerStateType_struct_impl: rba_ArxmlGen_ImplDataTypeCategory=Struct, rba_ArxmlGen_ImplDataTypeLongName=implementation data type for structure
          Ctrl_Pdu_mode (rba_ArxmlGen_ImplDataTypeSub): rba_ArxmlGen_ImplDataTypeSubOwnRef=CanIf_u8_impl
        CanIf_CanIdBuffer_struct_impl: rba_ArxmlGen_ImplDataTypeCategory=Struct, rba_ArxmlGen_ImplDataTypeLongName=implementation data type for structure
          4 x rba_ArxmlGen_ImplDataTypeSub:
            CanId: rba_ArxmlGen_ImplDataTypeSubOwnRef=CanIf_u32_impl
            swPduHandle: rba_ArxmlGen_ImplDataTypeSubOwnRef=CanIf_u16_impl
            SduLength: rba_ArxmlGen_ImplDataTypeSubOwnRef=CanIf_u8_impl
            BufferIndex: rba_ArxmlGen_ImplDataTypeSubOwnRef=CanIf_u8_impl
        CanIf_Prv_TxBufferStatus_tst_struct_impl: rba_ArxmlGen_ImplDataTypeCategory=Struct, rba_ArxmlGen_ImplDataTypeLongName=implementation data type for structure
          last_index (rba_ArxmlGen_ImplDataTypeSub): rba_ArxmlGen_ImplDataTypeSubOwnRef=CanIf_u8_impl
          bufferstatus (rba_ArxmlGen_ImplDataTypeSub): rba_ArxmlGen_ImplDataTypeSubOwnRef=CanIf_u8_impl
      CanIf_Prv_InitStatus_b (rba_ArxmlGen_Measurement):
        rba_ArxmlGen_MeasCategory = Simple
        rba_ArxmlGen_MeasDispFormat = %5.0f
        rba_ArxmlGen_MeasLongName = Flag to check if CANIF is Initialized(TRUE) or Not Initialized (FALSE)
        rba_ArxmlGen_MeasAddrMethodRef = INTERNAL_VAR_CLEARED
        rba_ArxmlGen_MeasApplDataTypeOwnRef = CanIf_boolean_app
      6 x rba_ArxmlGen_Memsection:
        VAR_CLEARED: rba_ArxmlGen_MemsectionDatatype_08=true, rba_ArxmlGen_MemsectionDatatype_16=true, rba_ArxmlGen_MemsectionDatatype_32=true, rba_ArxmlGen_MemsectionDatatype_UNSPECIFIED=true, rba_ArxmlGen_MemsectionAddrMethodRef=VAR_CLEARED
        CONST: rba_ArxmlGen_MemsectionDatatype_08=true, rba_ArxmlGen_MemsectionDatatype_16=true, rba_ArxmlGen_MemsectionDatatype_32=true, rba_ArxmlGen_MemsectionDatatype_UNSPECIFIED=true, rba_ArxmlGen_MemsectionAddrMethodRef=CONST
        CONFIG_DATA_POSTBUILD: rba_ArxmlGen_MemsectionDatatype_32=true, rba_ArxmlGen_MemsectionDatatype_UNSPECIFIED=true, rba_ArxmlGen_MemsectionAddrMethodRef=CONFIG_DATA_POSTBUILD
        VAR_FAST_CLEARED: rba_ArxmlGen_MemsectionDatatype_08=true, rba_ArxmlGen_MemsectionDatatype_32=true, rba_ArxmlGen_MemsectionDatatype_UNSPECIFIED=true, rba_ArxmlGen_MemsectionAddrMethodRef=VAR_FAST_CLEARED
        CODE_FAST: rba_ArxmlGen_MemsectionAddrMethodRef=CODE_FAST
        CODE: rba_ArxmlGen_MemsectionAddrMethodRef=CODE

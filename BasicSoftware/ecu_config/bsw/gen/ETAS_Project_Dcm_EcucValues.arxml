AUTOSAR XML (schema 00047)
package /ETAS_BIP/EcucModuleConfigurationValuess
  module config Dcm: implementation-config-variant=VARIANT-PRE-COMPILE
    DcmConfigSet
      DcmDsd: DcmDsdRequestManufacturerNotificationEnabled=false, DcmDsdRequestSupplierNotificationEnabled=false
        ETAS_ServiceTable (DcmDsdServiceTable)
          12 x DcmDsdService:
            SessionControlClass: DcmDsdSidTabSubfuncAvail=true, DcmDsdSidTabServiceId=16, DcmDsdSidTabSessionLevelRef=Extended, DcmDsdSidTabSessionLevelRef=Programming, DcmDsdSidTabSessionLevelRef=Default
              3 x DcmDsdSubService, all with DcmDsdSubServiceSessionLevelRef=Default, DcmDsdSubServiceSessionLevelRef=Extended, DcmDsdSubServiceSessionLevelRef=Programming:
                Default_SessionControl: DcmDsdSubServiceId=1
                Programming_SessionControl: DcmDsdSubServiceId=2
                Extended_SessionControl: DcmDsdSubServiceId=3
            SecurityAccessClass: DcmDsdSidTabSubfuncAvail=true, DcmDsdSidTabServiceId=39, DcmDsdSidTabSessionLevelRef=Extended, DcmDsdSidTabSessionLevelRef=Programming
              4 x DcmDsdSubService:
                UnlockedL1_SecurityAccess: DcmDsdSubServiceId=1, DcmDsdSubServiceSessionLevelRef=Extended
                UnlockedL1_SecurityAccess_Even: DcmDsdSubServiceId=2, DcmDsdSubServiceSessionLevelRef=Extended
                Unlocked_L3_SecurityAccess: DcmDsdSubServiceId=5, DcmDsdSubServiceSessionLevelRef=Programming
                Unlocked_L3_SecurityAccess_Even: DcmDsdSubServiceId=6, DcmDsdSubServiceSessionLevelRef=Programming
            EcuResetClass: DcmDsdSidTabSubfuncAvail=true, DcmDsdSidTabServiceId=17
              Hard (DcmDsdSubService): DcmDsdSubServiceId=1
              Soft (DcmDsdSubService): DcmDsdSubServiceId=3
            ReadDtcInformationClass: DcmDsdSidTabSubfuncAvail=true, DcmDsdSidTabServiceId=25, DcmDsdSidTabSessionLevelRef=Default, DcmDsdSidTabSessionLevelRef=Extended
              5 x DcmDsdSubService, all with DcmDsdSubServiceSessionLevelRef=Default, DcmDsdSubServiceSessionLevelRef=Extended:
                RDTCBSM: DcmDsdSubServiceId=2
                RNODTCBSM: DcmDsdSubServiceId=1
                RDTCSSBDTC: DcmDsdSubServiceId=4
                RDTCEDRBDN: DcmDsdSubServiceId=6
                RSUPDTC: DcmDsdSubServiceId=10
            ControlDtcSettingClass: DcmDsdSidTabSubfuncAvail=true, DcmDsdSidTabServiceId=133, DcmDsdSidTabSessionLevelRef=Default, DcmDsdSidTabSessionLevelRef=Extended
              Enable (DcmDsdSubService): DcmDsdSubServiceId=1, DcmDsdSubServiceSessionLevelRef=Default, DcmDsdSubServiceSessionLevelRef=Extended
              Disable (DcmDsdSubService): DcmDsdSubServiceId=2, DcmDsdSubServiceSessionLevelRef=Default, DcmDsdSubServiceSessionLevelRef=Extended
            ClearDiagnosticInformationClass: DcmDsdSidTabSubfuncAvail=false, DcmDsdSidTabServiceId=20, DcmDsdSidTabSessionLevelRef=Default, DcmDsdSidTabSessionLevelRef=Extended
            ReadDataByIdentifierClass: DcmDsdSidTabSubfuncAvail=false, DcmDsdSidTabServiceId=34
            WriteDataByIdentifierClass: DcmDsdSidTabSubfuncAvail=false, DcmDsdSidTabServiceId=46, DcmDsdSidTabSecurityLevelRef=UnlockedL1, DcmDsdSidTabSessionLevelRef=Extended
            IoControlClass: DcmDsdSidTabSubfuncAvail=false, DcmDsdSidTabServiceId=47, DcmDsdSidTabSessionLevelRef=Extended
            ComControlClass: DcmDsdSidTabSubfuncAvail=true, DcmDsdSidTabServiceId=40, DcmDsdSidTabSessionLevelRef=Extended, DcmDsdSidTabSessionLevelRef=Programming
              EnableRxAndTx (DcmDsdSubService): DcmDsdSubServiceId=0, DcmDsdSubServiceSessionLevelRef=Extended, DcmDsdSubServiceSessionLevelRef=Programming
              DisableRxAndTx (DcmDsdSubService): DcmDsdSubServiceId=3, DcmDsdSubServiceSessionLevelRef=Extended, DcmDsdSubServiceSessionLevelRef=Programming
            RoutineControlClass: DcmDsdSidTabSubfuncAvail=true, DcmDsdSidTabServiceId=49, DcmDsdSidTabSessionLevelRef=Extended
            TesterPresentClass: DcmDsdSidTabFnc=Dcm_DcmTesterPresent, DcmDsdSidTabServiceId=62, DcmDsdSidTabSubfuncAvail=true, DcmRbDsdSidTabSidInitFunction=NULL_PTR
              zeroSubFunction (DcmDsdSubService): DcmDsdSubServiceId=0
      DcmDsp: DcmDspMaxDidToRead=5, DcmRbDspSesSecUsedInProtocol=UDS, DcmDspDataDefaultEndianness=opaque
        DcmDspControlDTCSetting: DcmSupportDTCSettingControlOptionRecord=false
        DcmDspSession
          3 x DcmDspSessionRow, all with DcmDspSessionP2ServerMax=0.05, DcmDspSessionP2StarServerMax=5.0:
            Extended: DcmDspSessionForBoot=DCM_NO_BOOT, DcmDspSessionLevel=3
            Programming: DcmDspSessionForBoot=DCM_OEM_BOOT, DcmDspSessionLevel=2
            Default: DcmDspSessionForBoot=DCM_NO_BOOT, DcmDspSessionLevel=1
        DcmDspSecurity: DcmRbDspSecurityStoreSeed=false
          UnlockedL1 (DcmDspSecurityRow):
            DcmDspSecurityLevel = 1
            DcmDspSecurityKeySize = 4
            DcmDspSecurityDelayTimeOnBoot = 10.0
            DcmRbDspSecurityNumAttLock = 0
            DcmDspSecurityDelayTime = 10.0
            DcmDspSecurityUsePort = USE_ASYNCH_CLIENT_SERVER
            DcmDspSecurityAttemptCounterEnabled = false
            DcmDspSecurityNumAttDelay = 3
            DcmDspSecuritySeedSize = 4
          Unlocked_L3 (DcmDspSecurityRow):
            DcmDspSecurityLevel = 3
            DcmDspSecurityKeySize = 4
            DcmDspSecurityDelayTimeOnBoot = 10.0
            DcmRbDspSecurityNumAttLock = 0
            DcmDspSecurityDelayTime = 10.0
            DcmDspSecurityUsePort = USE_ASYNCH_CLIENT_SERVER
            DcmDspSecurityAttemptCounterEnabled = false
            DcmDspSecurityNumAttDelay = 3
            DcmDspSecuritySeedSize = 4
        DID_0x0100 (DcmDspDid):
          DcmDspDidUsePort = USE_DATA_ELEMENT_SPECIFIC_INTERFACES
          DcmRbAtomicSenderReceiverCommunication = false
          DcmDspDidIdentifier = 256
          DcmDspDidInfoRef = DID_0x0100_info
          New_Data_Object (DcmDspDidSignal): DcmDspDidByteOffset=0, DcmDspDidDataRef=DID_0x0100_New_Data_Object
        DID_0x0100_info (DcmDspDidInfo): DcmDspDidDynamicallyDefined=false
          DcmDspDidRead
          DcmDspDidWrite: DcmDspDidWriteSessionRef=Extended, DcmDspDidWriteSecurityLevelRef=UnlockedL1
        DID_0x0100_New_Data_Object (DcmDspData):
          DcmDspDataType = UINT8_N
          DcmDspDataUsePort = USE_DATA_SENDER_RECEIVER
          DcmDspDataByteSize = 16
          DcmDspDataEndianness = opaque
          DcmDspDataConditionCheckReadFncUsed = false
          DcmDspDiagnosisScaling
            DcmDspAlternativeDataType: DcmApplicationDataType=Dcm_ArrDataType_0x100_New_Data_Object
        DID_0x010B (DcmDspDid):
          DcmDspDidUsePort = USE_DATA_ELEMENT_SPECIFIC_INTERFACES
          DcmRbAtomicSenderReceiverCommunication = false
          DcmDspDidIdentifier = 267
          DcmDspDidInfoRef = DID_0x010B_info
          6 x DcmDspDidSignal:
            Year: DcmDspDidByteOffset=0, DcmDspDidDataRef=DID_0x010B_Year
            Month: DcmDspDidByteOffset=1, DcmDspDidDataRef=DID_0x010B_Month
            Day: DcmDspDidByteOffset=2, DcmDspDidDataRef=DID_0x010B_Day
            Hour: DcmDspDidByteOffset=3, DcmDspDidDataRef=DID_0x010B_Hour
            Minute: DcmDspDidByteOffset=4, DcmDspDidDataRef=DID_0x010B_Minute
            Second: DcmDspDidByteOffset=5, DcmDspDidDataRef=DID_0x010B_Second
        DID_0x010B_info (DcmDspDidInfo): DcmDspDidDynamicallyDefined=false
          DcmDspDidRead
        6 x DcmDspData, all with DcmDspDataType=UINT8, DcmDspDataUsePort=USE_DATA_SENDER_RECEIVER, DcmDspDataByteSize=1, DcmDspDataEndianness=opaque, DcmDspDataConditionCheckReadFncUsed=false:
          DID_0x010B_Year
            DcmDspDiagnosisScaling
              DcmDspAlternativeDataType: DcmApplicationDataType=Dcm_DataType_0x10B_Year
          DID_0x010B_Month
            DcmDspDiagnosisScaling
              DcmDspAlternativeDataType: DcmApplicationDataType=Dcm_DataType_0x10B_Month
          DID_0x010B_Day
            DcmDspDiagnosisScaling
              DcmDspAlternativeDataType: DcmApplicationDataType=Dcm_DataType_0x10B_Day
          DID_0x010B_Hour
            DcmDspDiagnosisScaling
              DcmDspAlternativeDataType: DcmApplicationDataType=Dcm_DataType_0x10B_Hour
          DID_0x010B_Minute
            DcmDspDiagnosisScaling
              DcmDspAlternativeDataType: DcmApplicationDataType=Dcm_DataType_0x10B_Minute
          DID_0x010B_Second
            DcmDspDiagnosisScaling
              DcmDspAlternativeDataType: DcmApplicationDataType=Dcm_DataType_0x10B_Second
        DID_0x0112 (DcmDspDid):
          DcmDspDidUsePort = USE_DATA_ELEMENT_SPECIFIC_INTERFACES
          DcmRbAtomicSenderReceiverCommunication = false
          DcmDspDidIdentifier = 274
          DcmDspDidInfoRef = DID_0x0112_info
          New_Data_Object (DcmDspDidSignal): DcmDspDidByteOffset=0, DcmDspDidDataRef=DID_0x0112_New_Data_Object
        DID_0x0112_info (DcmDspDidInfo): DcmDspDidDynamicallyDefined=false
          DcmDspDidRead
        DID_0x0112_New_Data_Object (DcmDspData):
          DcmDspDataType = UINT8
          DcmDspDataUsePort = USE_DATA_SENDER_RECEIVER
          DcmDspDataByteSize = 1
          DcmDspDataEndianness = opaque
          DcmDspDataConditionCheckReadFncUsed = false
          DcmDspDiagnosisScaling
            DcmDspAlternativeDataType: DcmApplicationDataType=Dcm_DataType_0x112_New_Data_Object
        DID_0xB950 (DcmDspDid):
          DcmDspDidUsePort = USE_DATA_ELEMENT_SPECIFIC_INTERFACES
          DcmRbAtomicSenderReceiverCommunication = false
          DcmDspDidIdentifier = 47440
          DcmDspDidInfoRef = DID_0xB950_info
          New_Data_Object (DcmDspDidSignal): DcmDspDidByteOffset=0, DcmDspDidDataRef=DID_0xB950_New_Data_Object
        DID_0xB950_info (DcmDspDidInfo): DcmDspDidDynamicallyDefined=false
          DcmDspDidRead
        DID_0xB950_New_Data_Object (DcmDspData):
          DcmDspDataType = UINT8_N
          DcmDspDataUsePort = USE_DATA_SENDER_RECEIVER
          DcmDspDataByteSize = 8
          DcmDspDataEndianness = opaque
          DcmDspDataConditionCheckReadFncUsed = false
          DcmDspDiagnosisScaling
            DcmDspAlternativeDataType: DcmApplicationDataType=Dcm_ArrDataType_0xB950_New_Data_Object
        DID_0xD001 (DcmDspDid):
          DcmDspDidUsePort = USE_DATA_ELEMENT_SPECIFIC_INTERFACES
          DcmRbAtomicSenderReceiverCommunication = false
          DcmDspDidIdentifier = 53249
          DcmDspDidInfoRef = DID_0xD001_info
          New_Data_Object (DcmDspDidSignal): DcmDspDidByteOffset=0, DcmDspDidDataRef=DID_0xD001_New_Data_Object
        DID_0xD001_info (DcmDspDidInfo): DcmDspDidDynamicallyDefined=false
          DcmDspDidRead
        DID_0xD001_New_Data_Object (DcmDspData):
          DcmDspDataType = UINT8
          DcmDspDataUsePort = USE_DATA_SENDER_RECEIVER
          DcmDspDataByteSize = 1
          DcmDspDataEndianness = opaque
          DcmDspDataConditionCheckReadFncUsed = false
          DcmDspDiagnosisScaling
            DcmDspAlternativeDataType: DcmApplicationDataType=Dcm_DataType_0xD001_New_Data_Object
        DID_0xD901 (DcmDspDid):
          DcmDspDidUsePort = USE_DATA_ELEMENT_SPECIFIC_INTERFACES
          DcmRbAtomicSenderReceiverCommunication = false
          DcmDspDidIdentifier = 55553
          DcmDspDidInfoRef = DID_0xD901_info
          New_Data_Object (DcmDspDidSignal): DcmDspDidByteOffset=0, DcmDspDidDataRef=DID_0xD901_New_Data_Object
        DID_0xD901_info (DcmDspDidInfo): DcmDspDidDynamicallyDefined=false
          DcmDspDidRead
          DcmDspDidControl:
            DcmDspDidShortTermAdjustment = true
            DcmDspDidControlMask = DCM_CONTROLMASK_EXTERNAL
            DcmDspDidFreezeCurrentState = true
            DcmDspDidResetToDefault = false
            DcmDspDidControlMaskSize = 4
            DcmDspDidControlSessionRef = Extended
        DID_0xD901_New_Data_Object (DcmDspData):
          DcmDspDataType = UINT8
          DcmDspDataUsePort = USE_DATA_SENDER_RECEIVER
          DcmDspDataByteSize = 1
          DcmDspDataEndianness = opaque
          DcmDspDataConditionCheckReadFncUsed = false
          DcmDspDiagnosisScaling
            DcmDspAlternativeDataType: DcmApplicationDataType=Dcm_DataType_0xD901_New_Data_Object
        DID_0xE101 (DcmDspDid):
          DcmDspDidUsePort = USE_DATA_ELEMENT_SPECIFIC_INTERFACES
          DcmRbAtomicSenderReceiverCommunication = false
          DcmDspDidIdentifier = 57601
          DcmDspDidInfoRef = DID_0xE101_info
          New_Data_Object (DcmDspDidSignal): DcmDspDidByteOffset=0, DcmDspDidDataRef=DID_0xE101_New_Data_Object
        DID_0xE101_info (DcmDspDidInfo): DcmDspDidDynamicallyDefined=false
          DcmDspDidRead
        DID_0xE101_New_Data_Object (DcmDspData):
          DcmDspDataType = UINT8_N
          DcmDspDataUsePort = USE_DATA_SENDER_RECEIVER
          DcmDspDataByteSize = 3
          DcmDspDataEndianness = opaque
          DcmDspDataConditionCheckReadFncUsed = false
          DcmDspDiagnosisScaling
            DcmDspAlternativeDataType: DcmApplicationDataType=Dcm_ArrDataType_0xE101_New_Data_Object
        DID_0xE900 (DcmDspDid):
          DcmDspDidUsePort = USE_DATA_ELEMENT_SPECIFIC_INTERFACES
          DcmRbAtomicSenderReceiverCommunication = false
          DcmDspDidIdentifier = 59648
          DcmDspDidInfoRef = DID_0xE900_info
          New_Data_Object (DcmDspDidSignal): DcmDspDidByteOffset=0, DcmDspDidDataRef=DID_0xE900_New_Data_Object
        DID_0xE900_info (DcmDspDidInfo): DcmDspDidDynamicallyDefined=false
          DcmDspDidRead
          DcmDspDidControl:
            DcmDspDidShortTermAdjustment = true
            DcmDspDidControlMask = DCM_CONTROLMASK_EXTERNAL
            DcmDspDidFreezeCurrentState = true
            DcmDspDidResetToDefault = false
            DcmDspDidControlMaskSize = 4
            DcmDspDidControlSessionRef = Extended
        DID_0xE900_New_Data_Object (DcmDspData):
          DcmDspDataType = UINT8
          DcmDspDataUsePort = USE_DATA_SENDER_RECEIVER
          DcmDspDataByteSize = 1
          DcmDspDataEndianness = opaque
          DcmDspDataConditionCheckReadFncUsed = false
          DcmDspDiagnosisScaling
            DcmDspAlternativeDataType: DcmApplicationDataType=Dcm_DataType_0xE900_New_Data_Object
        DID_0xF100 (DcmDspDid):
          DcmDspDidUsePort = USE_DATA_ELEMENT_SPECIFIC_INTERFACES
          DcmRbAtomicSenderReceiverCommunication = false
          DcmDspDidIdentifier = 61696
          DcmDspDidInfoRef = DID_0xF100_info
          New_Data_Object (DcmDspDidSignal): DcmDspDidByteOffset=0, DcmDspDidDataRef=DID_0xF100_New_Data_Object
          New_Data_Object_1 (DcmDspDidSignal): DcmDspDidByteOffset=5, DcmDspDidDataRef=DID_0xF100_New_Data_Object_1
        DID_0xF100_info (DcmDspDidInfo): DcmDspDidDynamicallyDefined=false
          DcmDspDidRead
        DID_0xF100_New_Data_Object (DcmDspData):
          DcmDspDataType = UINT8_N
          DcmDspDataUsePort = USE_DATA_SENDER_RECEIVER
          DcmDspDataByteSize = 5
          DcmDspDataEndianness = opaque
          DcmDspDataConditionCheckReadFncUsed = false
          DcmDspDiagnosisScaling
            DcmDspAlternativeDataType: DcmApplicationDataType=Dcm_ArrDataType_0xF100_New_Data_Object
        DID_0xF100_New_Data_Object_1 (DcmDspData):
          DcmDspDataType = UINT8_N
          DcmDspDataUsePort = USE_DATA_SENDER_RECEIVER
          DcmDspDataByteSize = 6
          DcmDspDataEndianness = opaque
          DcmDspDataConditionCheckReadFncUsed = false
          DcmDspDiagnosisScaling
            DcmDspAlternativeDataType: DcmApplicationDataType=Dcm_ArrDataType_0xF100_New_Data_Object_1
        DID_0xF110 (DcmDspDid):
          DcmDspDidUsePort = USE_DATA_ELEMENT_SPECIFIC_INTERFACES
          DcmRbAtomicSenderReceiverCommunication = false
          DcmDspDidIdentifier = 61712
          DcmDspDidInfoRef = DID_0xF110_info
          New_Data_Object (DcmDspDidSignal): DcmDspDidByteOffset=0, DcmDspDidDataRef=DID_0xF110_New_Data_Object
        DID_0xF110_info (DcmDspDidInfo): DcmDspDidDynamicallyDefined=false
          DcmDspDidRead
          DcmDspDidWrite: DcmDspDidWriteSessionRef=Extended, DcmDspDidWriteSecurityLevelRef=UnlockedL1
        DID_0xF110_New_Data_Object (DcmDspData):
          DcmDspDataType = UINT8_N
          DcmDspDataUsePort = USE_DATA_SENDER_RECEIVER
          DcmDspDataByteSize = 16
          DcmDspDataEndianness = opaque
          DcmDspDataConditionCheckReadFncUsed = false
          DcmDspDiagnosisScaling
            DcmDspAlternativeDataType: DcmApplicationDataType=Dcm_ArrDataType_0xF110_New_Data_Object
        DID_0xF111 (DcmDspDid):
          DcmDspDidUsePort = USE_DATA_ELEMENT_SPECIFIC_INTERFACES
          DcmRbAtomicSenderReceiverCommunication = false
          DcmDspDidIdentifier = 61713
          DcmDspDidInfoRef = DID_0xF111_info
          New_Data_Object (DcmDspDidSignal): DcmDspDidByteOffset=0, DcmDspDidDataRef=DID_0xF111_New_Data_Object
        DID_0xF111_info (DcmDspDidInfo): DcmDspDidDynamicallyDefined=false
          DcmDspDidRead
        DID_0xF111_New_Data_Object (DcmDspData):
          DcmDspDataType = UINT8_N
          DcmDspDataUsePort = USE_DATA_SENDER_RECEIVER
          DcmDspDataByteSize = 16
          DcmDspDataEndianness = opaque
          DcmDspDataConditionCheckReadFncUsed = false
          DcmDspDiagnosisScaling
            DcmDspAlternativeDataType: DcmApplicationDataType=Dcm_ArrDataType_0xF111_New_Data_Object
        DID_0xF112 (DcmDspDid):
          DcmDspDidUsePort = USE_DATA_ELEMENT_SPECIFIC_INTERFACES
          DcmRbAtomicSenderReceiverCommunication = false
          DcmDspDidIdentifier = 61714
          DcmDspDidInfoRef = DID_0xF112_info
          New_Data_Object (DcmDspDidSignal): DcmDspDidByteOffset=0, DcmDspDidDataRef=DID_0xF112_New_Data_Object
        DID_0xF112_info (DcmDspDidInfo): DcmDspDidDynamicallyDefined=false
          DcmDspDidRead
        DID_0xF112_New_Data_Object (DcmDspData):
          DcmDspDataType = UINT8_N
          DcmDspDataUsePort = USE_DATA_SENDER_RECEIVER
          DcmDspDataByteSize = 16
          DcmDspDataEndianness = opaque
          DcmDspDataConditionCheckReadFncUsed = false
          DcmDspDiagnosisScaling
            DcmDspAlternativeDataType: DcmApplicationDataType=Dcm_ArrDataType_0xF112_New_Data_Object
        DID_0xF113 (DcmDspDid):
          DcmDspDidUsePort = USE_DATA_ELEMENT_SPECIFIC_INTERFACES
          DcmRbAtomicSenderReceiverCommunication = false
          DcmDspDidIdentifier = 61715
          DcmDspDidInfoRef = DID_0xF113_info
          New_Data_Object (DcmDspDidSignal): DcmDspDidByteOffset=0, DcmDspDidDataRef=DID_0xF113_New_Data_Object
        DID_0xF113_info (DcmDspDidInfo): DcmDspDidDynamicallyDefined=false
          DcmDspDidRead
        DID_0xF113_New_Data_Object (DcmDspData):
          DcmDspDataType = UINT8_N
          DcmDspDataUsePort = USE_DATA_SENDER_RECEIVER
          DcmDspDataByteSize = 16
          DcmDspDataEndianness = opaque
          DcmDspDataConditionCheckReadFncUsed = false
          DcmDspDiagnosisScaling
            DcmDspAlternativeDataType: DcmApplicationDataType=Dcm_ArrDataType_0xF113_New_Data_Object
        DID_0xF114 (DcmDspDid):
          DcmDspDidUsePort = USE_DATA_ELEMENT_SPECIFIC_INTERFACES
          DcmRbAtomicSenderReceiverCommunication = false
          DcmDspDidIdentifier = 61716
          DcmDspDidInfoRef = DID_0xF114_info
          New_Data_Object (DcmDspDidSignal): DcmDspDidByteOffset=0, DcmDspDidDataRef=DID_0xF114_New_Data_Object
        DID_0xF114_info (DcmDspDidInfo): DcmDspDidDynamicallyDefined=false
          DcmDspDidRead
        DID_0xF114_New_Data_Object (DcmDspData):
          DcmDspDataType = UINT8_N
          DcmDspDataUsePort = USE_DATA_SENDER_RECEIVER
          DcmDspDataByteSize = 16
          DcmDspDataEndianness = opaque
          DcmDspDataConditionCheckReadFncUsed = false
          DcmDspDiagnosisScaling
            DcmDspAlternativeDataType: DcmApplicationDataType=Dcm_ArrDataType_0xF114_New_Data_Object
        DID_0xF115 (DcmDspDid):
          DcmDspDidUsePort = USE_DATA_ELEMENT_SPECIFIC_INTERFACES
          DcmRbAtomicSenderReceiverCommunication = false
          DcmDspDidIdentifier = 61717
          DcmDspDidInfoRef = DID_0xF115_info
          New_Data_Object (DcmDspDidSignal): DcmDspDidByteOffset=0, DcmDspDidDataRef=DID_0xF115_New_Data_Object
        DID_0xF115_info (DcmDspDidInfo): DcmDspDidDynamicallyDefined=false
          DcmDspDidRead
          DcmDspDidWrite: DcmDspDidWriteSessionRef=Extended, DcmDspDidWriteSecurityLevelRef=UnlockedL1
        DID_0xF115_New_Data_Object (DcmDspData):
          DcmDspDataType = UINT8_N
          DcmDspDataUsePort = USE_DATA_SENDER_RECEIVER
          DcmDspDataByteSize = 16
          DcmDspDataEndianness = opaque
          DcmDspDataConditionCheckReadFncUsed = false
          DcmDspDiagnosisScaling
            DcmDspAlternativeDataType: DcmApplicationDataType=Dcm_ArrDataType_0xF115_New_Data_Object
        DID_0xF116 (DcmDspDid):
          DcmDspDidUsePort = USE_DATA_ELEMENT_SPECIFIC_INTERFACES
          DcmRbAtomicSenderReceiverCommunication = false
          DcmDspDidIdentifier = 61718
          DcmDspDidInfoRef = DID_0xF116_info
          New_Data_Object (DcmDspDidSignal): DcmDspDidByteOffset=0, DcmDspDidDataRef=DID_0xF116_New_Data_Object
        DID_0xF116_info (DcmDspDidInfo): DcmDspDidDynamicallyDefined=false
          DcmDspDidRead
        DID_0xF116_New_Data_Object (DcmDspData):
          DcmDspDataType = UINT8_N
          DcmDspDataUsePort = USE_DATA_SENDER_RECEIVER
          DcmDspDataByteSize = 16
          DcmDspDataEndianness = opaque
          DcmDspDataConditionCheckReadFncUsed = false
          DcmDspDiagnosisScaling
            DcmDspAlternativeDataType: DcmApplicationDataType=Dcm_ArrDataType_0xF116_New_Data_Object
        DID_0xF117 (DcmDspDid):
          DcmDspDidUsePort = USE_DATA_ELEMENT_SPECIFIC_INTERFACES
          DcmRbAtomicSenderReceiverCommunication = false
          DcmDspDidIdentifier = 61719
          DcmDspDidInfoRef = DID_0xF117_info
          New_Data_Object (DcmDspDidSignal): DcmDspDidByteOffset=0, DcmDspDidDataRef=DID_0xF117_New_Data_Object
        DID_0xF117_info (DcmDspDidInfo): DcmDspDidDynamicallyDefined=false
          DcmDspDidRead
        DID_0xF117_New_Data_Object (DcmDspData):
          DcmDspDataType = UINT8_N
          DcmDspDataUsePort = USE_DATA_SENDER_RECEIVER
          DcmDspDataByteSize = 16
          DcmDspDataEndianness = opaque
          DcmDspDataConditionCheckReadFncUsed = false
          DcmDspDiagnosisScaling
            DcmDspAlternativeDataType: DcmApplicationDataType=Dcm_ArrDataType_0xF117_New_Data_Object
        DID_0xF118 (DcmDspDid):
          DcmDspDidUsePort = USE_DATA_ELEMENT_SPECIFIC_INTERFACES
          DcmRbAtomicSenderReceiverCommunication = false
          DcmDspDidIdentifier = 61720
          DcmDspDidInfoRef = DID_0xF118_info
          New_Data_Object (DcmDspDidSignal): DcmDspDidByteOffset=0, DcmDspDidDataRef=DID_0xF118_New_Data_Object
        DID_0xF118_info (DcmDspDidInfo): DcmDspDidDynamicallyDefined=false
          DcmDspDidRead
        DID_0xF118_New_Data_Object (DcmDspData):
          DcmDspDataType = UINT8_N
          DcmDspDataUsePort = USE_DATA_SENDER_RECEIVER
          DcmDspDataByteSize = 16
          DcmDspDataEndianness = opaque
          DcmDspDataConditionCheckReadFncUsed = false
          DcmDspDiagnosisScaling
            DcmDspAlternativeDataType: DcmApplicationDataType=Dcm_ArrDataType_0xF118_New_Data_Object
        DID_0xF119 (DcmDspDid):
          DcmDspDidUsePort = USE_DATA_ELEMENT_SPECIFIC_INTERFACES
          DcmRbAtomicSenderReceiverCommunication = false
          DcmDspDidIdentifier = 61721
          DcmDspDidInfoRef = DID_0xF119_info
          New_Data_Object (DcmDspDidSignal): DcmDspDidByteOffset=0, DcmDspDidDataRef=DID_0xF119_New_Data_Object
        DID_0xF119_info (DcmDspDidInfo): DcmDspDidDynamicallyDefined=false
          DcmDspDidRead
        DID_0xF119_New_Data_Object (DcmDspData):
          DcmDspDataType = UINT8_N
          DcmDspDataUsePort = USE_DATA_SENDER_RECEIVER
          DcmDspDataByteSize = 16
          DcmDspDataEndianness = opaque
          DcmDspDataConditionCheckReadFncUsed = false
          DcmDspDiagnosisScaling
            DcmDspAlternativeDataType: DcmApplicationDataType=Dcm_ArrDataType_0xF119_New_Data_Object
        DID_0xF11A (DcmDspDid):
          DcmDspDidUsePort = USE_DATA_ELEMENT_SPECIFIC_INTERFACES
          DcmRbAtomicSenderReceiverCommunication = false
          DcmDspDidIdentifier = 61722
          DcmDspDidInfoRef = DID_0xF11A_info
          New_Data_Object (DcmDspDidSignal): DcmDspDidByteOffset=0, DcmDspDidDataRef=DID_0xF11A_New_Data_Object
        DID_0xF11A_info (DcmDspDidInfo): DcmDspDidDynamicallyDefined=false
          DcmDspDidRead
        DID_0xF11A_New_Data_Object (DcmDspData):
          DcmDspDataType = UINT8_N
          DcmDspDataUsePort = USE_DATA_SENDER_RECEIVER
          DcmDspDataByteSize = 16
          DcmDspDataEndianness = opaque
          DcmDspDataConditionCheckReadFncUsed = false
          DcmDspDiagnosisScaling
            DcmDspAlternativeDataType: DcmApplicationDataType=Dcm_ArrDataType_0xF11A_New_Data_Object
        DID_0xF11B (DcmDspDid):
          DcmDspDidUsePort = USE_DATA_ELEMENT_SPECIFIC_INTERFACES
          DcmRbAtomicSenderReceiverCommunication = false
          DcmDspDidIdentifier = 61723
          DcmDspDidInfoRef = DID_0xF11B_info
          New_Data_Object (DcmDspDidSignal): DcmDspDidByteOffset=0, DcmDspDidDataRef=DID_0xF11B_New_Data_Object
        DID_0xF11B_info (DcmDspDidInfo): DcmDspDidDynamicallyDefined=false
          DcmDspDidRead
        DID_0xF11B_New_Data_Object (DcmDspData):
          DcmDspDataType = UINT8_N
          DcmDspDataUsePort = USE_DATA_SENDER_RECEIVER
          DcmDspDataByteSize = 16
          DcmDspDataEndianness = opaque
          DcmDspDataConditionCheckReadFncUsed = false
          DcmDspDiagnosisScaling
            DcmDspAlternativeDataType: DcmApplicationDataType=Dcm_ArrDataType_0xF11B_New_Data_Object
        DID_0xF11C (DcmDspDid):
          DcmDspDidUsePort = USE_DATA_ELEMENT_SPECIFIC_INTERFACES
          DcmRbAtomicSenderReceiverCommunication = false
          DcmDspDidIdentifier = 61724
          DcmDspDidInfoRef = DID_0xF11C_info
          New_Data_Object (DcmDspDidSignal): DcmDspDidByteOffset=0, DcmDspDidDataRef=DID_0xF11C_New_Data_Object
        DID_0xF11C_info (DcmDspDidInfo): DcmDspDidDynamicallyDefined=false
          DcmDspDidRead
        DID_0xF11C_New_Data_Object (DcmDspData):
          DcmDspDataType = UINT8_N
          DcmDspDataUsePort = USE_DATA_SENDER_RECEIVER
          DcmDspDataByteSize = 16
          DcmDspDataEndianness = opaque
          DcmDspDataConditionCheckReadFncUsed = false
          DcmDspDiagnosisScaling
            DcmDspAlternativeDataType: DcmApplicationDataType=Dcm_ArrDataType_0xF11C_New_Data_Object
        DID_0xF11D (DcmDspDid):
          DcmDspDidUsePort = USE_DATA_ELEMENT_SPECIFIC_INTERFACES
          DcmRbAtomicSenderReceiverCommunication = false
          DcmDspDidIdentifier = 61725
          DcmDspDidInfoRef = DID_0xF11D_info
          New_Data_Object (DcmDspDidSignal): DcmDspDidByteOffset=0, DcmDspDidDataRef=DID_0xF11D_New_Data_Object
        DID_0xF11D_info (DcmDspDidInfo): DcmDspDidDynamicallyDefined=false
          DcmDspDidRead
        DID_0xF11D_New_Data_Object (DcmDspData):
          DcmDspDataType = UINT8_N
          DcmDspDataUsePort = USE_DATA_SENDER_RECEIVER
          DcmDspDataByteSize = 16
          DcmDspDataEndianness = opaque
          DcmDspDataConditionCheckReadFncUsed = false
          DcmDspDiagnosisScaling
            DcmDspAlternativeDataType: DcmApplicationDataType=Dcm_ArrDataType_0xF11D_New_Data_Object
        DID_0xF11E (DcmDspDid):
          DcmDspDidUsePort = USE_DATA_ELEMENT_SPECIFIC_INTERFACES
          DcmRbAtomicSenderReceiverCommunication = false
          DcmDspDidIdentifier = 61726
          DcmDspDidInfoRef = DID_0xF11E_info
          New_Data_Object (DcmDspDidSignal): DcmDspDidByteOffset=0, DcmDspDidDataRef=DID_0xF11E_New_Data_Object
        DID_0xF11E_info (DcmDspDidInfo): DcmDspDidDynamicallyDefined=false
          DcmDspDidRead
        DID_0xF11E_New_Data_Object (DcmDspData):
          DcmDspDataType = UINT8_N
          DcmDspDataUsePort = USE_DATA_SENDER_RECEIVER
          DcmDspDataByteSize = 16
          DcmDspDataEndianness = opaque
          DcmDspDataConditionCheckReadFncUsed = false
          DcmDspDiagnosisScaling
            DcmDspAlternativeDataType: DcmApplicationDataType=Dcm_ArrDataType_0xF11E_New_Data_Object
        DID_0xF11F (DcmDspDid):
          DcmDspDidUsePort = USE_DATA_ELEMENT_SPECIFIC_INTERFACES
          DcmRbAtomicSenderReceiverCommunication = false
          DcmDspDidIdentifier = 61727
          DcmDspDidInfoRef = DID_0xF11F_info
          New_Data_Object (DcmDspDidSignal): DcmDspDidByteOffset=0, DcmDspDidDataRef=DID_0xF11F_New_Data_Object
        DID_0xF11F_info (DcmDspDidInfo): DcmDspDidDynamicallyDefined=false
          DcmDspDidRead
        DID_0xF11F_New_Data_Object (DcmDspData):
          DcmDspDataType = UINT8_N
          DcmDspDataUsePort = USE_DATA_SENDER_RECEIVER
          DcmDspDataByteSize = 16
          DcmDspDataEndianness = opaque
          DcmDspDataConditionCheckReadFncUsed = false
          DcmDspDiagnosisScaling
            DcmDspAlternativeDataType: DcmApplicationDataType=Dcm_ArrDataType_0xF11F_New_Data_Object
        DID_0xF120 (DcmDspDid):
          DcmDspDidUsePort = USE_DATA_ELEMENT_SPECIFIC_INTERFACES
          DcmRbAtomicSenderReceiverCommunication = false
          DcmDspDidIdentifier = 61728
          DcmDspDidInfoRef = DID_0xF120_info
          New_Data_Object (DcmDspDidSignal): DcmDspDidByteOffset=0, DcmDspDidDataRef=DID_0xF120_New_Data_Object
        DID_0xF120_info (DcmDspDidInfo): DcmDspDidDynamicallyDefined=false
          DcmDspDidRead
        DID_0xF120_New_Data_Object (DcmDspData):
          DcmDspDataType = UINT8_N
          DcmDspDataUsePort = USE_DATA_SENDER_RECEIVER
          DcmDspDataByteSize = 16
          DcmDspDataEndianness = opaque
          DcmDspDataConditionCheckReadFncUsed = false
          DcmDspDiagnosisScaling
            DcmDspAlternativeDataType: DcmApplicationDataType=Dcm_ArrDataType_0xF120_New_Data_Object
        DID_0xF121 (DcmDspDid):
          DcmDspDidUsePort = USE_DATA_ELEMENT_SPECIFIC_INTERFACES
          DcmRbAtomicSenderReceiverCommunication = false
          DcmDspDidIdentifier = 61729
          DcmDspDidInfoRef = DID_0xF121_info
          New_Data_Object (DcmDspDidSignal): DcmDspDidByteOffset=0, DcmDspDidDataRef=DID_0xF121_New_Data_Object
        DID_0xF121_info (DcmDspDidInfo): DcmDspDidDynamicallyDefined=false
          DcmDspDidRead
          DcmDspDidWrite: DcmDspDidWriteSessionRef=Extended, DcmDspDidWriteSecurityLevelRef=UnlockedL1
        DID_0xF121_New_Data_Object (DcmDspData):
          DcmDspDataType = UINT8_N
          DcmDspDataUsePort = USE_DATA_SENDER_RECEIVER
          DcmDspDataByteSize = 16
          DcmDspDataEndianness = opaque
          DcmDspDataConditionCheckReadFncUsed = false
          DcmDspDiagnosisScaling
            DcmDspAlternativeDataType: DcmApplicationDataType=Dcm_ArrDataType_0xF121_New_Data_Object
        DID_0xF122 (DcmDspDid):
          DcmDspDidUsePort = USE_DATA_ELEMENT_SPECIFIC_INTERFACES
          DcmRbAtomicSenderReceiverCommunication = false
          DcmDspDidIdentifier = 61827
          DcmDspDidInfoRef = DID_0xF122_info
          New_Data_Object (DcmDspDidSignal): DcmDspDidByteOffset=0, DcmDspDidDataRef=DID_0xF122_New_Data_Object
          New_Data_Object_2 (DcmDspDidSignal): DcmDspDidByteOffset=5, DcmDspDidDataRef=DID_0xF122_New_Data_Object_2
        DID_0xF122_info (DcmDspDidInfo): DcmDspDidDynamicallyDefined=false
          DcmDspDidRead
        DID_0xF122_New_Data_Object (DcmDspData):
          DcmDspDataType = UINT8_N
          DcmDspDataUsePort = USE_DATA_SENDER_RECEIVER
          DcmDspDataByteSize = 5
          DcmDspDataEndianness = opaque
          DcmDspDataConditionCheckReadFncUsed = false
          DcmDspDiagnosisScaling
            DcmDspAlternativeDataType: DcmApplicationDataType=Dcm_ArrDataType_0xF183_New_Data_Object
        DID_0xF122_New_Data_Object_2 (DcmDspData):
          DcmDspDataType = UINT8_N
          DcmDspDataUsePort = USE_DATA_SENDER_RECEIVER
          DcmDspDataByteSize = 5
          DcmDspDataEndianness = opaque
          DcmDspDataConditionCheckReadFncUsed = false
          DcmDspDiagnosisScaling
            DcmDspAlternativeDataType: DcmApplicationDataType=Dcm_ArrDataType_0xF183_New_Data_Object_2
        DID_0xF187 (DcmDspDid):
          DcmDspDidUsePort = USE_DATA_ELEMENT_SPECIFIC_INTERFACES
          DcmRbAtomicSenderReceiverCommunication = false
          DcmDspDidIdentifier = 61831
          DcmDspDidInfoRef = DID_0xF187_info
          New_Data_Object (DcmDspDidSignal): DcmDspDidByteOffset=0, DcmDspDidDataRef=DID_0xF187_New_Data_Object
        DID_0xF187_info (DcmDspDidInfo): DcmDspDidDynamicallyDefined=false
          DcmDspDidRead
          DcmDspDidWrite: DcmDspDidWriteSessionRef=Extended, DcmDspDidWriteSecurityLevelRef=UnlockedL1
        DID_0xF187_New_Data_Object (DcmDspData):
          DcmDspDataType = UINT8_N
          DcmDspDataUsePort = USE_DATA_SENDER_RECEIVER
          DcmDspDataByteSize = 5
          DcmDspDataEndianness = opaque
          DcmDspDataConditionCheckReadFncUsed = false
          DcmDspDiagnosisScaling
            DcmDspAlternativeDataType: DcmApplicationDataType=Dcm_ArrDataType_0xF187_New_Data_Object
        DID_0xF18A (DcmDspDid):
          DcmDspDidUsePort = USE_DATA_ELEMENT_SPECIFIC_INTERFACES
          DcmRbAtomicSenderReceiverCommunication = false
          DcmDspDidIdentifier = 61834
          DcmDspDidInfoRef = DID_0xF18A_info
          New_Data_Object (DcmDspDidSignal): DcmDspDidByteOffset=0, DcmDspDidDataRef=DID_0xF18A_New_Data_Object
        DID_0xF18A_info (DcmDspDidInfo): DcmDspDidDynamicallyDefined=false
          DcmDspDidRead
        DID_0xF18A_New_Data_Object (DcmDspData):
          DcmDspDataType = UINT8_N
          DcmDspDataUsePort = USE_DATA_SENDER_RECEIVER
          DcmDspDataByteSize = 5
          DcmDspDataEndianness = opaque
          DcmDspDataConditionCheckReadFncUsed = false
          DcmDspDiagnosisScaling
            DcmDspAlternativeDataType: DcmApplicationDataType=Dcm_ArrDataType_0xF18A_New_Data_Object
        DID_0xF18B (DcmDspDid):
          DcmDspDidUsePort = USE_DATA_ELEMENT_SPECIFIC_INTERFACES
          DcmRbAtomicSenderReceiverCommunication = false
          DcmDspDidIdentifier = 61835
          DcmDspDidInfoRef = DID_0xF18B_info
          New_Data_Object (DcmDspDidSignal): DcmDspDidByteOffset=0, DcmDspDidDataRef=DID_0xF18B_New_Data_Object
        DID_0xF18B_info (DcmDspDidInfo): DcmDspDidDynamicallyDefined=false
          DcmDspDidRead
          DcmDspDidWrite: DcmDspDidWriteSessionRef=Extended, DcmDspDidWriteSecurityLevelRef=UnlockedL1
        DID_0xF18B_New_Data_Object (DcmDspData):
          DcmDspDataType = UINT8_N
          DcmDspDataUsePort = USE_DATA_SENDER_RECEIVER
          DcmDspDataByteSize = 3
          DcmDspDataEndianness = opaque
          DcmDspDataConditionCheckReadFncUsed = false
          DcmDspDiagnosisScaling
            DcmDspAlternativeDataType: DcmApplicationDataType=Dcm_ArrDataType_0xF18B_New_Data_Object
        DID_0xF18C (DcmDspDid):
          DcmDspDidUsePort = USE_DATA_ELEMENT_SPECIFIC_INTERFACES
          DcmRbAtomicSenderReceiverCommunication = false
          DcmDspDidIdentifier = 61836
          DcmDspDidInfoRef = DID_0xF18C_info
          New_Data_Object (DcmDspDidSignal): DcmDspDidByteOffset=0, DcmDspDidDataRef=DID_0xF18C_New_Data_Object
        DID_0xF18C_info (DcmDspDidInfo): DcmDspDidDynamicallyDefined=false
          DcmDspDidRead
          DcmDspDidWrite: DcmDspDidWriteSessionRef=Extended, DcmDspDidWriteSecurityLevelRef=UnlockedL1
        DID_0xF18C_New_Data_Object (DcmDspData):
          DcmDspDataType = UINT8_N
          DcmDspDataUsePort = USE_DATA_SENDER_RECEIVER
          DcmDspDataByteSize = 16
          DcmDspDataEndianness = opaque
          DcmDspDataConditionCheckReadFncUsed = false
          DcmDspDiagnosisScaling
            DcmDspAlternativeDataType: DcmApplicationDataType=Dcm_ArrDataType_0xF18C_New_Data_Object
        DID_0xF190 (DcmDspDid):
          DcmDspDidUsePort = USE_DATA_ELEMENT_SPECIFIC_INTERFACES
          DcmRbAtomicSenderReceiverCommunication = false
          DcmDspDidIdentifier = 61840
          DcmDspDidInfoRef = DID_0xF190_info
          New_Data_Object (DcmDspDidSignal): DcmDspDidByteOffset=0, DcmDspDidDataRef=DID_0xF190_New_Data_Object
        DID_0xF190_info (DcmDspDidInfo): DcmDspDidDynamicallyDefined=false
          DcmDspDidRead
          DcmDspDidWrite: DcmDspDidWriteSessionRef=Extended, DcmDspDidWriteSecurityLevelRef=UnlockedL1
        DID_0xF190_New_Data_Object (DcmDspData):
          DcmDspDataType = UINT8_N
          DcmDspDataUsePort = USE_DATA_SENDER_RECEIVER
          DcmDspDataByteSize = 17
          DcmDspDataEndianness = opaque
          DcmDspDataConditionCheckReadFncUsed = false
          DcmDspDiagnosisScaling
            DcmDspAlternativeDataType: DcmApplicationDataType=Dcm_ArrDataType_0xF190_New_Data_Object
        DID_0xF192 (DcmDspDid):
          DcmDspDidUsePort = USE_DATA_ELEMENT_SPECIFIC_INTERFACES
          DcmRbAtomicSenderReceiverCommunication = false
          DcmDspDidIdentifier = 61842
          DcmDspDidInfoRef = DID_0xF192_info
          New_Data_Object (DcmDspDidSignal): DcmDspDidByteOffset=0, DcmDspDidDataRef=DID_0xF192_New_Data_Object
          New_Data_Object_3 (DcmDspDidSignal): DcmDspDidByteOffset=5, DcmDspDidDataRef=DID_0xF192_New_Data_Object_3
        DID_0xF192_info (DcmDspDidInfo): DcmDspDidDynamicallyDefined=false
          DcmDspDidRead
        DID_0xF192_New_Data_Object (DcmDspData):
          DcmDspDataType = UINT8_N
          DcmDspDataUsePort = USE_DATA_SENDER_RECEIVER
          DcmDspDataByteSize = 5
          DcmDspDataEndianness = opaque
          DcmDspDataConditionCheckReadFncUsed = false
          DcmDspDiagnosisScaling
            DcmDspAlternativeDataType: DcmApplicationDataType=Dcm_ArrDataType_0xF192_New_Data_Object
        DID_0xF192_New_Data_Object_3 (DcmDspData):
          DcmDspDataType = UINT8_N
          DcmDspDataUsePort = USE_DATA_SENDER_RECEIVER
          DcmDspDataByteSize = 5
          DcmDspDataEndianness = opaque
          DcmDspDataConditionCheckReadFncUsed = false
          DcmDspDiagnosisScaling
            DcmDspAlternativeDataType: DcmApplicationDataType=Dcm_ArrDataType_0xF192_New_Data_Object_3
        DID_0xF194 (DcmDspDid):
          DcmDspDidUsePort = USE_DATA_ELEMENT_SPECIFIC_INTERFACES
          DcmRbAtomicSenderReceiverCommunication = false
          DcmDspDidIdentifier = 61844
          DcmDspDidInfoRef = DID_0xF194_info
          New_Data_Object (DcmDspDidSignal): DcmDspDidByteOffset=0, DcmDspDidDataRef=DID_0xF194_New_Data_Object
          New_Data_Object_4 (DcmDspDidSignal): DcmDspDidByteOffset=5, DcmDspDidDataRef=DID_0xF194_New_Data_Object_4
        DID_0xF194_info (DcmDspDidInfo): DcmDspDidDynamicallyDefined=false
          DcmDspDidRead
        DID_0xF194_New_Data_Object (DcmDspData):
          DcmDspDataType = UINT8_N
          DcmDspDataUsePort = USE_DATA_SENDER_RECEIVER
          DcmDspDataByteSize = 5
          DcmDspDataEndianness = opaque
          DcmDspDataConditionCheckReadFncUsed = false
          DcmDspDiagnosisScaling
            DcmDspAlternativeDataType: DcmApplicationDataType=Dcm_ArrDataType_0xF194_New_Data_Object
        DID_0xF194_New_Data_Object_4 (DcmDspData):
          DcmDspDataType = UINT8_N
          DcmDspDataUsePort = USE_DATA_SENDER_RECEIVER
          DcmDspDataByteSize = 5
          DcmDspDataEndianness = opaque
          DcmDspDataConditionCheckReadFncUsed = false
          DcmDspDiagnosisScaling
            DcmDspAlternativeDataType: DcmApplicationDataType=Dcm_ArrDataType_0xF194_New_Data_Object_4
        DID_0xF198 (DcmDspDid):
          DcmDspDidUsePort = USE_DATA_ELEMENT_SPECIFIC_INTERFACES
          DcmRbAtomicSenderReceiverCommunication = false
          DcmDspDidIdentifier = 61848
          DcmDspDidInfoRef = DID_0xF198_info
          New_Data_Object (DcmDspDidSignal): DcmDspDidByteOffset=0, DcmDspDidDataRef=DID_0xF198_New_Data_Object
          New_Data_Object_5 (DcmDspDidSignal): DcmDspDidByteOffset=5, DcmDspDidDataRef=DID_0xF198_New_Data_Object_5
        DID_0xF198_info (DcmDspDidInfo): DcmDspDidDynamicallyDefined=false
          DcmDspDidRead
          DcmDspDidWrite: DcmDspDidWriteSessionRef=Extended, DcmDspDidWriteSecurityLevelRef=UnlockedL1
        DID_0xF198_New_Data_Object (DcmDspData):
          DcmDspDataType = UINT8_N
          DcmDspDataUsePort = USE_DATA_SENDER_RECEIVER
          DcmDspDataByteSize = 5
          DcmDspDataEndianness = opaque
          DcmDspDataConditionCheckReadFncUsed = false
          DcmDspDiagnosisScaling
            DcmDspAlternativeDataType: DcmApplicationDataType=Dcm_ArrDataType_0xF198_New_Data_Object
        DID_0xF198_New_Data_Object_5 (DcmDspData):
          DcmDspDataType = UINT8_N
          DcmDspDataUsePort = USE_DATA_SENDER_RECEIVER
          DcmDspDataByteSize = 6
          DcmDspDataEndianness = opaque
          DcmDspDataConditionCheckReadFncUsed = false
          DcmDspDiagnosisScaling
            DcmDspAlternativeDataType: DcmApplicationDataType=Dcm_ArrDataType_0xF198_New_Data_Object_5
        DID_0xF1A0 (DcmDspDid):
          DcmDspDidUsePort = USE_DATA_ELEMENT_SPECIFIC_INTERFACES
          DcmRbAtomicSenderReceiverCommunication = false
          DcmDspDidIdentifier = 61856
          DcmDspDidInfoRef = DID_0xF1A0_info
          New_Data_Object (DcmDspDidSignal): DcmDspDidByteOffset=0, DcmDspDidDataRef=DID_0xF1A0_New_Data_Object
        DID_0xF1A0_info (DcmDspDidInfo): DcmDspDidDynamicallyDefined=false
          DcmDspDidRead
        DID_0xF1A0_New_Data_Object (DcmDspData):
          DcmDspDataType = UINT8_N
          DcmDspDataUsePort = USE_DATA_SENDER_RECEIVER
          DcmDspDataByteSize = 5
          DcmDspDataEndianness = opaque
          DcmDspDataConditionCheckReadFncUsed = false
          DcmDspDiagnosisScaling
            DcmDspAlternativeDataType: DcmApplicationDataType=Dcm_ArrDataType_0xF1A0_New_Data_Object
        DID_0xF1A1 (DcmDspDid):
          DcmDspDidUsePort = USE_DATA_ELEMENT_SPECIFIC_INTERFACES
          DcmRbAtomicSenderReceiverCommunication = false
          DcmDspDidIdentifier = 61857
          DcmDspDidInfoRef = DID_0xF1A1_info
          New_Data_Object (DcmDspDidSignal): DcmDspDidByteOffset=0, DcmDspDidDataRef=DID_0xF1A1_New_Data_Object
        DID_0xF1A1_info (DcmDspDidInfo): DcmDspDidDynamicallyDefined=false
          DcmDspDidRead
        DID_0xF1A1_New_Data_Object (DcmDspData):
          DcmDspDataType = UINT8_N
          DcmDspDataUsePort = USE_DATA_SENDER_RECEIVER
          DcmDspDataByteSize = 5
          DcmDspDataEndianness = opaque
          DcmDspDataConditionCheckReadFncUsed = false
          DcmDspDiagnosisScaling
            DcmDspAlternativeDataType: DcmApplicationDataType=Dcm_ArrDataType_0xF1A1_New_Data_Object
        DID_0xF1A2 (DcmDspDid):
          DcmDspDidUsePort = USE_DATA_ELEMENT_SPECIFIC_INTERFACES
          DcmRbAtomicSenderReceiverCommunication = false
          DcmDspDidIdentifier = 61858
          DcmDspDidInfoRef = DID_0xF1A2_info
          New_Data_Object (DcmDspDidSignal): DcmDspDidByteOffset=0, DcmDspDidDataRef=DID_0xF1A2_New_Data_Object
        DID_0xF1A2_info (DcmDspDidInfo): DcmDspDidDynamicallyDefined=false
          DcmDspDidRead
        DID_0xF1A2_New_Data_Object (DcmDspData):
          DcmDspDataType = UINT8_N
          DcmDspDataUsePort = USE_DATA_SENDER_RECEIVER
          DcmDspDataByteSize = 8
          DcmDspDataEndianness = opaque
          DcmDspDataConditionCheckReadFncUsed = false
          DcmDspDiagnosisScaling
            DcmDspAlternativeDataType: DcmApplicationDataType=Dcm_ArrDataType_0xF1A2_New_Data_Object
        DID_0xF1A5 (DcmDspDid):
          DcmDspDidUsePort = USE_DATA_ELEMENT_SPECIFIC_INTERFACES
          DcmRbAtomicSenderReceiverCommunication = false
          DcmDspDidIdentifier = 61861
          DcmDspDidInfoRef = DID_0xF1A5_info
          New_Data_Object (DcmDspDidSignal): DcmDspDidByteOffset=0, DcmDspDidDataRef=DID_0xF1A5_New_Data_Object
        DID_0xF1A5_info (DcmDspDidInfo): DcmDspDidDynamicallyDefined=false
          DcmDspDidRead
        DID_0xF1A5_New_Data_Object (DcmDspData):
          DcmDspDataType = UINT8_N
          DcmDspDataUsePort = USE_DATA_SENDER_RECEIVER
          DcmDspDataByteSize = 3
          DcmDspDataEndianness = opaque
          DcmDspDataConditionCheckReadFncUsed = false
          DcmDspDiagnosisScaling
            DcmDspAlternativeDataType: DcmApplicationDataType=Dcm_ArrDataType_0xF1A5_New_Data_Object
        DID_0xF1A8 (DcmDspDid):
          DcmDspDidUsePort = USE_DATA_ELEMENT_SPECIFIC_INTERFACES
          DcmRbAtomicSenderReceiverCommunication = false
          DcmDspDidIdentifier = 61864
          DcmDspDidInfoRef = DID_0xF1A8_info
          New_Data_Object (DcmDspDidSignal): DcmDspDidByteOffset=0, DcmDspDidDataRef=DID_0xF1A8_New_Data_Object
        DID_0xF1A8_info (DcmDspDidInfo): DcmDspDidDynamicallyDefined=false
          DcmDspDidRead
          DcmDspDidWrite: DcmDspDidWriteSessionRef=Extended, DcmDspDidWriteSecurityLevelRef=UnlockedL1
        DID_0xF1A8_New_Data_Object (DcmDspData):
          DcmDspDataType = UINT8_N
          DcmDspDataUsePort = USE_DATA_SENDER_RECEIVER
          DcmDspDataByteSize = 20
          DcmDspDataEndianness = opaque
          DcmDspDataConditionCheckReadFncUsed = false
          DcmDspDiagnosisScaling
            DcmDspAlternativeDataType: DcmApplicationDataType=Dcm_ArrDataType_0xF1A8_New_Data_Object
        DID_0xF1A9 (DcmDspDid):
          DcmDspDidUsePort = USE_DATA_ELEMENT_SPECIFIC_INTERFACES
          DcmRbAtomicSenderReceiverCommunication = false
          DcmDspDidIdentifier = 61865
          DcmDspDidInfoRef = DID_0xF1A9_info
          New_Data_Object (DcmDspDidSignal): DcmDspDidByteOffset=0, DcmDspDidDataRef=DID_0xF1A9_New_Data_Object
        DID_0xF1A9_info (DcmDspDidInfo): DcmDspDidDynamicallyDefined=false
          DcmDspDidRead
          DcmDspDidWrite: DcmDspDidWriteSessionRef=Extended, DcmDspDidWriteSecurityLevelRef=UnlockedL1
        DID_0xF1A9_New_Data_Object (DcmDspData):
          DcmDspDataType = UINT8_N
          DcmDspDataUsePort = USE_DATA_SENDER_RECEIVER
          DcmDspDataByteSize = 5
          DcmDspDataEndianness = opaque
          DcmDspDataConditionCheckReadFncUsed = false
          DcmDspDiagnosisScaling
            DcmDspAlternativeDataType: DcmApplicationDataType=Dcm_ArrDataType_0xF1A9_New_Data_Object
        DID_0xF1AA (DcmDspDid):
          DcmDspDidUsePort = USE_DATA_ELEMENT_SPECIFIC_INTERFACES
          DcmRbAtomicSenderReceiverCommunication = false
          DcmDspDidIdentifier = 61866
          DcmDspDidInfoRef = DID_0xF1AA_info
          New_Data_Object (DcmDspDidSignal): DcmDspDidByteOffset=0, DcmDspDidDataRef=DID_0xF1AA_New_Data_Object
        DID_0xF1AA_info (DcmDspDidInfo): DcmDspDidDynamicallyDefined=false
          DcmDspDidRead
          DcmDspDidWrite: DcmDspDidWriteSessionRef=Extended, DcmDspDidWriteSecurityLevelRef=UnlockedL1
        DID_0xF1AA_New_Data_Object (DcmDspData):
          DcmDspDataType = UINT8_N
          DcmDspDataUsePort = USE_DATA_SENDER_RECEIVER
          DcmDspDataByteSize = 5
          DcmDspDataEndianness = opaque
          DcmDspDataConditionCheckReadFncUsed = false
          DcmDspDiagnosisScaling
            DcmDspAlternativeDataType: DcmApplicationDataType=Dcm_ArrDataType_0xF1AA_New_Data_Object
        DcmDspComControl
          DcmDspComControlAllChannel: DcmDspAllComMChannelRef=Can_Network_ETAS_Channel_Can_Network_ETAS
        Routine_Control_203 (DcmDspRoutine): DcmDspRoutineUsePort=true, DcmDspRoutineIdentifier=515
          DcmDspStartRoutine: DcmDspStartRoutineCommonAuthorizationRef=AP_Extended
            DcmDspStartRoutineOut
              DcmDspStartRoutineOutSignal_0 (DcmDspStartRoutineOutSignal): DcmDspRoutineSignalLength=8, DcmDspRoutineSignalPos=0, DcmDspRoutineSignalType=UINT8, DcmDspRoutineSignalEndianness=opaque
                DcmDspArgumentScaling
                  DcmDspAlternativeDataType: DcmApplicationDataType=Dcm_DataType_StartOut_515_Out_New_Data_Object
        AP_Extended (DcmDspCommonAuthorization): DcmDspCommonAuthorizationSessionRef=Extended
        X_Routine_Control_ABFE (DcmDspRoutine): DcmDspRoutineUsePort=true, DcmDspRoutineIdentifier=44030
          DcmDspStartRoutine: DcmDspStartRoutineCommonAuthorizationRef=AP_Extended
        Routine_Control_ABFF (DcmDspRoutine): DcmDspRoutineUsePort=true, DcmDspRoutineIdentifier=44031
          DcmDspRequestRoutineResults: DcmDspRequestRoutineResultsCommonAuthorizationRef=AP_Extended
            DcmDspRequestRoutineResultsOut
              DcmDspRequestRoutineResultsOutSignal_0 (DcmDspRequestRoutineResultsOutSignal): DcmDspRoutineSignalLength=8, DcmDspRoutineSignalPos=0, DcmDspRoutineSignalType=UINT8, DcmDspRoutineSignalEndianness=opaque
                DcmDspArgumentScaling
                  DcmDspAlternativeDataType: DcmApplicationDataType=Dcm_DataType_RequestOut_44031_Out_New_Data_Object
          DcmDspStartRoutine: DcmDspStartRoutineCommonAuthorizationRef=AP_Extended
        DcmRbDspReadDTC: DcmRbDspReadDTCMaxNumDTCRead=1, DcmRbDspReadDTCMaxNumRecordRead=1
      DcmDsl
        DcmDslProtocol
          DcmDslProtocolRow:
            DcmSendRespPendOnTransToBoot = false
            DcmDslProtocolPriority = 0
            DcmTimStrP2StarServerAdjust = 0.01
            DcmDslProtocolID = DCM_UDS_ON_CAN
            DcmTimStrP2ServerAdjust = 0.01
            DcmDemClientRef = DemClient
            DcmDslProtocolSIDTable = ETAS_ServiceTable
            DcmDslProtocolTxBufferRef = DcmDslProtocolRowTxBuffer
            DcmDslProtocolRxBufferRef = DcmDslProtocolRowRxBuffer
            DcmDslConnection
              DcmDslMainConnection: DcmDslProtocolRxTesterSourceAddr=0, DcmDslProtocolComMChannelRef=Can_Network_ETAS_Channel_Can_Network_ETAS
                DcmDslProtocolTx: DcmDslProtocolTxPduRef=UdsTxPhy_Dcm2PduR_Can_Network_ETAS_Channel_CAN
                DcmDslProtocolRx: DcmDslProtocolRxAddrType=DCM_PHYSICAL_TYPE, DcmDslProtocolRxPduRef=UdsRxPhy_PduR2Dcm_Can_Network_ETAS_Channel_CAN
                DcmDslProtocolRx_0 (DcmDslProtocolRx): DcmDslProtocolRxAddrType=DCM_FUNCTIONAL_TYPE, DcmDslProtocolRxPduRef=UdsRxFnc_PduR2Dcm_Can_Network_ETAS_Channel_CAN
        DcmDslDiagResp: DcmDslDiagRespMaxNumRespPend=5
        DcmDslProtocolRowRxBuffer (DcmDslBuffer): DcmDslBufferSize=255
        DcmDslProtocolRowTxBuffer (DcmDslBuffer): DcmDslBufferSize=255
      DcmPageBufferCfg: DcmPagedBufferEnabled=false
    DcmGeneral: DcmDevErrorDetect=true, DcmVersionInfoApi=false, DcmRespondAllRequest=true, DcmTaskTime=0.01
      DcmRbGeneral:
        DcmRbRTEsupportsPRportFunctionality = false
        DcmRbConfirmForDSDGeneratedNegRes = false
        DcmRbRTEsupport = true
        DcmRbOSTimerUse = CyclicCount
        DcmRbStoringEnabled = true

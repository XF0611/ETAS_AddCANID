AUTOSAR XML (schema 4-2-2)
package /AUTOSAR_Nm/TimingExtensions
  bsw module timing Nm_BswModuleTiming: behavior=BswInternalBehavior
    timing-requirements:
      execution order constraint EOC_EcuM_Init: execution-order-constraint-type=ORDINARY-EOC, is-event=false, permit-multiple-references-to-ee=false
        ordered-elements:
          eoc executable entity ref EOCEERef_CE_Nm_Init: bsw-module-instance=Nm, executable=CE_Init, successor=EOCEERef_CE_ComM_Init
          eoc executable entity ref EOCEERef_CE_ComM_Init: bsw-module-instance=ComM, executable=CE_Init

AUTOSAR XML (schema 00047)
package /ETAS_BIP/EcucModuleConfigurationValuess
  module config Xcp: implementation-config-variant=VARIANT-PRE-COMPILE
    XcpConfig
      Can_Network_ETAS_Channel (XcpTransportLayer):
        XcpMaxDto = 8
        XcpTransportLayerType = CAN
        XcpTransportLayerName = Transport
        XcpMaxCto = 8
        XcpDaqOverloadIndication = OVERLOAD_INDICATION_EVENT
        XcpTimestampType = TWO_BYTE
        XcpIdentificationFieldType = ABSOLUTE
        XcpTx_0x333 (XcpTxPdu): XcpTxPacketType=RES_ERR_EV_SERV_DAQ, XcpTxPduRef=XcpTx_0x333_Xcp2CanIf_Can_Network_ETAS_Channel_CAN
        XcpRx_0x332 (XcpRxPdu): XcpRxPacketType=CMD_STIM, XcpRxPduRef=XcpRx_0x332_CanIf2Xcp_Can_Network_ETAS_Channel_CAN
    XcpGeneral:
      XcpVersionInfoApi = false
      XcpEthMainFunctionPeriod = 0.01
      XcpMainFunctionPeriod = 0.01
      XcpDevErrorDetect = true
      XcpBlockTransferDownload = true
      XcpBlockTransferUpload = true
      XcpCalibrationCal = true
      XcpCommandChecksum = true
      XcpCommandReadDaq = true
      XcpCommandsGetDaqInfo = true
      XcpDaqMemoryLimit = 1024
      XcpEventChannelScheduling = true
      XcpProductLine = CSMOSAR
      XcpSeedAndKey = true
      XcpSeedAndKeyExternalFunction = XcpSeedNKey.dll
      XcpSynchronousDataAcquisitionDaq = true
      XcpTimestampTicks = 1
      XcpTimestampUnit = TIMESTAMP_UNIT_1MS
      XcpUploadDownloadMemoryAccessByAppl = true
      XcpVersion = VERSION_1_2
      XcpPageSwitchingPag = false

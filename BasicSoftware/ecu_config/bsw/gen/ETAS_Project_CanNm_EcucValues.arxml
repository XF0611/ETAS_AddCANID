AUTOSAR XML (schema 00047)
package /ETAS_BIP/EcucModuleConfigurationValuess
  module config CanNm: implementation-config-variant=VARIANT-PRE-COMPILE
    CanNmGlobalConfig:
      CanNmVersionInfoApi = false
      CanNmCoordinatorSyncSupport = false
      CanNmComControlEnabled = true
      CanNmRepeatMsgIndEnabled = false
      CanNmStateChangeIndEnabled = true
      CanNmBusLoadReductionEnabled = false
      CanNmPnEiraCalcEnabled = false
      CanNmUserDataEnabled = true
      CanNmNodeDetectionEnabled = true
      CanNmMainFunctionPeriod = 0.01
      CanNmNodeIdEnabled = true
      CanNmRemoteSleepIndEnabled = false
      CanNmComUserDataSupport = true
      CanNmPduRxIndicationEnabled = true
      CanNmImmediateTxconfEnabled = false
      CanNmBusSynchronizationEnabled = false
      CanNmPassiveModeEnabled = false
      CanNmImmediateRestartEnabled = false
      CanNmDevErrorDetect = true
      CanNmCC_CanNmCluster_ETAS_CAN_1 (CanNmChannelConfig):
        CanNmBusLoadReductionActive = false
        CanNmWaitBusSleepTime = 4.0
        CanNmImmediateNmTransmissions = 20
        CanNmMsgCycleOffset = 0.1
        CanNmImmediateNmCycleTime = 0.02
        CanNmRepeatMessageTime = 1.0
        CanNmTimeoutTime = 3.0
        CanNmRetryFirstMessageRequest = false
        CanNmMsgReducedTime = 0.5
        CanNmMsgTimeoutTime = 0.5
        CanNmCarWakeUpRxEnabled = false
        CanNmNodeId = 0
        CanNmPduCbvPosition = CANNM_PDU_BYTE_1
        CanNmPduNidPosition = CANNM_PDU_BYTE_0
        CanNmPnEnabled = false
        CanNmMsgCycleTime = 1.0
        CanNmRemoteSleepIndTime = 0.01
        CanNmActiveWakeupBitEnabled = true
        CanNmComMNetworkHandleRef = Can_Network_ETAS_Channel_Can_Network_ETAS
        NM_Rx_0x677_Can_Network_ETAS_Channel (CanNmRxPdu): CanNmRxPduRef=NM_Rx_0x677_CanIf2CanNm_Can_Network_ETAS_Channel_CAN
        NM_Tx_0x600_Can_Network_ETAS_Channel (CanNmTxPdu): CanNmTxPduRef=NM_Tx_0x600_CanNm2CanIf_Can_Network_ETAS_Channel_CAN
        NM_Tx_0x600_UserData_Can_Network_ETAS_Channel (CanNmUserDataTxPdu): CanNmTxUserDataPduRef=NM_Tx_0x600_PduR2CanNm_Can_Network_ETAS_Channel_CAN

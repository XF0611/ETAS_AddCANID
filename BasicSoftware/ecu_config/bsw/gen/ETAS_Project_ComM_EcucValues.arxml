AUTOSAR XML (schema 00047)
package /ETAS_BIP/EcucModuleConfigurationValuess
  module config ComM: implementation-config-variant=VARIANT-PRE-COMPILE
    ComMConfigSet
      Can_Network_ETAS_Channel_Can_Network_ETAS (ComMChannel):
        ComMNoCom = true
        ComMFullCommRequestNotificationEnabled = false
        ComMMainFunctionPeriod = 0.01
        ComMBusType = COMM_BUS_TYPE_CAN
        ComMNoWakeUpInhibitionNvmStorage = false
        ComMNoWakeup = true
        ComMNetworkManagement: ComMNmVariant=FULL, ComMNmLightTimeout=10, ComMPncNmRequest=false
        ComMUserPerChannel_Can_Network_ETAS_Channel_Can_Network_ETAS (ComMUserPerChannel): ComMUserChannel=ComMUser_Can_Network_ETAS_Channel_Can_Network_ETAS
      ComMUser_Can_Network_ETAS_Channel_Can_Network_ETAS (ComMUser)
    ComMGeneral:
      ComMResetAfterForcingNoComm = false
      ComMPncGatewayEnabled = false
      ComMNmPassiveModeEnable = false
      ComMEcuGroupClassification = 0
      ComMWakeupInhibitionEnabled = false
      ComMPncSupport = false
      ComMTMinFullComModeDuration = 0.01
      ComMVersionInfoApi = false
      ComMSynchronousWakeUp = false
      ComMDevErrorDetect = true
      ComMRteEnabled = true
      ComMModeLimitationEnabled = true

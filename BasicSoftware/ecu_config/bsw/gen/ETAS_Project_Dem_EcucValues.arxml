AUTOSAR XML (schema 00047)
package /ETAS_BIP/EcucModuleConfigurationValuess
  module config Dem: implementation-config-variant=VARIANT-PRE-COMPILE
    DemGeneral:
      DemDataElementDefaultEndianness = BIG_ENDIAN
      DemGeneralInterfaceSupport = false
      DemDtcStatusAvailabilityMask = 255
      DemEventDisplacementStrategy = DEM_DISPLACEMENT_FULL
      DemMaxNumberPrestoredFF = 5
      DemDevErrorDetect = true
      DemClearDTCBehavior = DEM_CLRRESP_NONVOLATILE_FINISH
      DemTriggerDltReports = false
      DemTypeOfDTCSupported = DEM_DTC_TRANSLATION_ISO14229_1
      DemStatusBitStorageTestFailed = true
      DemDebounceTimeBasedSupport = false
      DemOccurrenceCounterProcessing = DEM_PROCESS_OCCCTR_TF
      DemSuppressionSupport = DEM_NO_SUPPRESSION
      DemEventMemoryEntryStorageTrigger = DEM_TRIGGER_ON_TEST_FAILED
      DemTypeOfFreezeFrameRecordNumeration = DEM_FF_RECNUM_CONFIGURED
      DemOBDSupport = DEM_OBD_NO_OBD_SUPPORT
      DemResetConfirmedBitOnOverflow = false
      DemEventCombinationSupport = DEM_EVCOMB_DISABLED
      DemAgingRequieresTestedCycle = false
      DemTriggerMonitorInitBeforeClearOk = false
      DemClearDTCLimitation = DEM_ONLY_CLEAR_ALL_DTCS
      DemStatusBitHandlingTestFailedSinceLastClear = DEM_STATUS_BIT_NORMAL
      DemTriggerFiMReports = false
      DemMaxNumberEventEntryPermanent = 0
      DemOperationCycleStatusStorage = true
      DemDebounceCounterBasedSupport = true
      DemEnvironmentDataCapture = DEM_CAPTURE_SYNCHRONOUS_TO_REPORTING
      DemVersionInfoApi = false
      DemTriggerDcmReports = false
      DemTaskTime = 0.01
      DemAvailabilitySupport = DEM_EVENT_AVAILABILITY
      DemBswErrorBufferSize = 10
      DemEventMemorySet
        DemPrimaryMemory: DemMaxNumberEventEntryPrimary=10
      FreezeFrame_DTC_0x000001_DidSet (DemFreezeFrameClass):
        DemDidClassRef = DidClass_DID_0x010B
        DemDidClassRef = DidClass_DID_0x0112
        DemDidClassRef = DidClass_DID_0xD001
        DemDidClassRef = DidClass_DID_0xD901
        DemDidClassRef = DidClass_DID_0xE101
      DidClass_DID_0x010B (DemDidClass):
        DemDidIdentifier = 267
        DemDidDataElementClassRef = SR_FF_267_Year
        DemDidDataElementClassRef = SR_FF_267_Month
        DemDidDataElementClassRef = SR_FF_267_Day
        DemDidDataElementClassRef = SR_FF_267_Hour
        DemDidDataElementClassRef = SR_FF_267_Minute
        DemDidDataElementClassRef = SR_FF_267_Second
      6 x DemDataElementClass:
        SR_FF_267_Year
          DemExternalSRDataElementClass: DemDataElementEndianness=opaque, DemDataElementDataType=UINT8
            DemDiagnosisScaling
              DemAlternativeDataType: DemApplicationDataType=Dem_DataType_Year
        SR_FF_267_Month
          DemExternalSRDataElementClass: DemDataElementEndianness=opaque, DemDataElementDataType=UINT8
            DemDiagnosisScaling
              DemAlternativeDataType: DemApplicationDataType=Dem_DataType_Month
        SR_FF_267_Day
          DemExternalSRDataElementClass: DemDataElementEndianness=opaque, DemDataElementDataType=UINT8
            DemDiagnosisScaling
              DemAlternativeDataType: DemApplicationDataType=Dem_DataType_Day
        SR_FF_267_Hour
          DemExternalSRDataElementClass: DemDataElementEndianness=opaque, DemDataElementDataType=UINT8
            DemDiagnosisScaling
              DemAlternativeDataType: DemApplicationDataType=Dem_DataType_Hour
        SR_FF_267_Minute
          DemExternalSRDataElementClass: DemDataElementEndianness=opaque, DemDataElementDataType=UINT8
            DemDiagnosisScaling
              DemAlternativeDataType: DemApplicationDataType=Dem_DataType_Minute
        SR_FF_267_Second
          DemExternalSRDataElementClass: DemDataElementEndianness=opaque, DemDataElementDataType=UINT8
            DemDiagnosisScaling
              DemAlternativeDataType: DemApplicationDataType=Dem_DataType_Second
      DidClass_DID_0x0112 (DemDidClass): DemDidIdentifier=274, DemDidDataElementClassRef=SR_FF_274_New_Data_Object
      SR_FF_274_New_Data_Object (DemDataElementClass)
        DemExternalSRDataElementClass: DemDataElementEndianness=opaque, DemDataElementDataType=UINT8
          DemDiagnosisScaling
            DemAlternativeDataType: DemApplicationDataType=Dem_DataType_New_Data_Object
      DidClass_DID_0xD001 (DemDidClass): DemDidIdentifier=53249, DemDidDataElementClassRef=SR_FF_53249_New_Data_Object
      SR_FF_53249_New_Data_Object (DemDataElementClass)
        DemExternalSRDataElementClass: DemDataElementEndianness=opaque, DemDataElementDataType=UINT8
          DemDiagnosisScaling
            DemAlternativeDataType: DemApplicationDataType=Dem_DataType_New_Data_Object
      DidClass_DID_0xD901 (DemDidClass): DemDidIdentifier=55553, DemDidDataElementClassRef=SR_FF_55553_New_Data_Object
      SR_FF_55553_New_Data_Object (DemDataElementClass)
        DemExternalSRDataElementClass: DemDataElementEndianness=opaque, DemDataElementDataType=UINT8
          DemDiagnosisScaling
            DemAlternativeDataType: DemApplicationDataType=Dem_DataType_New_Data_Object
      DidClass_DID_0xE101 (DemDidClass): DemDidIdentifier=57601, DemDidDataElementClassRef=SR_FF_57601_New_Data_Object
      SR_FF_57601_New_Data_Object (DemDataElementClass)
        DemExternalCSDataElementClass: DemDataElementDataSize=3, DemDataElementUsePort=false, DemDataElementReadFnc=Dcm_DemGetCSData_CS_FF_57601_Odometer_reading
        DemExternalSRDataElementClass: DemDataElementEndianness=opaque, DemDataElementDataType=UINT8
          DemDiagnosisScaling
            DemAlternativeDataType: DemApplicationDataType=(unset)
      ExtendedDataClass_DTC_0x000001_Properties (DemExtendedDataClass): DemExtendedDataRecordClassRef=Record_ExtendedDataRecord0x01
      Record_ExtendedDataRecord0x01 (DemExtendedDataRecordClass):
        DemExtendedDataRecordUpdate = DEM_UPDATE_RECORD_YES
        DemExtendedDataRecordNumber = 1
        DemExtendedDataRecordTrigger = DEM_TRIGGER_ON_CONFIRMED
        DemDataElementClassRef = SR_EDR_Record_ExtendedDataRecord0x01_Fault_occurrence_counter
        DemDataElementClassRef = SR_EDR_Record_ExtendedDataRecord0x01_Fault_pending_counter
        DemDataElementClassRef = SR_EDR_Record_ExtendedDataRecord0x01_Aged_counter
        DemDataElementClassRef = SR_EDR_Record_ExtendedDataRecord0x01_Ageing_counter
      4 x DemDataElementClass:
        SR_EDR_Record_ExtendedDataRecord0x01_Fault_occurrence_counter
          DemExternalSRDataElementClass: DemDataElementEndianness=opaque, DemDataElementDataType=UINT8
            DemDiagnosisScaling
              DemAlternativeDataType: DemApplicationDataType=Dem_DataType_Fault_occurrence_counter
        SR_EDR_Record_ExtendedDataRecord0x01_Fault_pending_counter
          DemExternalSRDataElementClass: DemDataElementEndianness=opaque, DemDataElementDataType=UINT8
            DemDiagnosisScaling
              DemAlternativeDataType: DemApplicationDataType=Dem_DataType_Fault_pending_counter
        SR_EDR_Record_ExtendedDataRecord0x01_Aged_counter
          DemExternalSRDataElementClass: DemDataElementEndianness=opaque, DemDataElementDataType=UINT8
            DemDiagnosisScaling
              DemAlternativeDataType: DemApplicationDataType=Dem_DataType_Aged_counter
        SR_EDR_Record_ExtendedDataRecord0x01_Ageing_counter
          DemExternalSRDataElementClass: DemDataElementEndianness=opaque, DemDataElementDataType=UINT8
            DemDiagnosisScaling
              DemAlternativeDataType: DemApplicationDataType=Dem_DataType_Ageing_counter
      DTC_0x000001_Properties_FFRecNumClass (DemFreezeFrameRecNumClass): DemFreezeFrameRecordClassRef=Rec_SnapshotRec_1, DemFreezeFrameRecordClassRef=Rec_SnapshotRec_2
      Rec_SnapshotRec_1 (DemFreezeFrameRecordClass): DemFreezeFrameRecordUpdate=DEM_UPDATE_RECORD_YES, DemFreezeFrameRecordNumber=1, DemFreezeFrameRecordTrigger=DEM_TRIGGER_ON_CONFIRMED
      Rec_SnapshotRec_2 (DemFreezeFrameRecordClass): DemFreezeFrameRecordUpdate=DEM_UPDATE_RECORD_YES, DemFreezeFrameRecordNumber=2, DemFreezeFrameRecordTrigger=DEM_TRIGGER_ON_CONFIRMED
      DemPrimaryMemory: DemMaxNumberEventEntryPrimary=10
      DemOpCycle_DEM_POWER (DemOperationCycle)
      ExtendedDataClass_DTC_0x0d0400_CAN_Network_ETAS_BusOff_Properties (DemExtendedDataClass): DemExtendedDataRecordClassRef=Record_ExtendedDataRecord0x01
      DTC_0x0d0400_CAN_Network_ETAS_BusOff_Properties_FFRecNumClass (DemFreezeFrameRecNumClass): DemFreezeFrameRecordClassRef=Rec_SnapshotRec_1, DemFreezeFrameRecordClassRef=Rec_SnapshotRec_2
      ExtendedDataClass_DTC_0xc22a87_Properties (DemExtendedDataClass): DemExtendedDataRecordClassRef=Record_ExtendedDataRecord0x01
      DTC_0xc22a87_Properties_FFRecNumClass (DemFreezeFrameRecNumClass): DemFreezeFrameRecordClassRef=Rec_SnapshotRec_1, DemFreezeFrameRecordClassRef=Rec_SnapshotRec_2
      DemRbGDoc
        CAN_Communication_Bus_Off (DemRbGDocMonitoredComponent)
        other_strategy (DemRbGDocMonitoringStrategy)
      DemClient: DemRbClientPriority=1, DemClientFunctionality=DEM_CLIENT_USES_FULL_FUNCTIONALITY, DemClientUsesRte=false, DemEventMemorySetRef=DemEventMemorySet
      DemRbGeneral:
        DemRbDebugData = OFF
        DemRbDebugDataBeforeInit = false
        DemRbSupportSuspicious = false
        DemRbSupportEventMemoryEntryOnFDCThreshold = false
        DemRbEnableDemNvmBlocksAutoConfiguration = true
        DemRbAgingCounterType = COUNT_UP
        DemRbDebounceTimeBasedTaskTime = 0.001
        DemRbOccurrenceCounterType = AUTOSAR
        DemRbOptimization
      DemStorageCondition: DemStorageConditionStatus=true
    DemConfigSet
      DTC_0x000001_Event (DemEventParameter):
        DemEventAvailable = true
        DemEventKind = DEM_EVENT_KIND_SWC
        DemEventFailureCycleCounterThreshold = 1
        DemDTCRef = DemDTC_DTC_0x000001
        DemOperationCycleRef = DemOpCycle_DEM_POWER
        DemCallbackClearEventAllowed: DemClearEventAllowedBehavior=DEM_NO_STATUS_BYTE_CHANGE
        DemDebounceAlgorithmClass
          DemDebounceCounterBased: DemDebounceCounterBasedClassRef=DebCntBas_DTC_0x000001_CounterBasedAlgorithm
        DemRbEventClass_DTC_0x000001_Event (DemRbEventClass)
      DemDTC_DTC_0x000001 (DemDTC): DemDTCSeverity=DEM_SEVERITY_NO_SEVERITY, DemDtcValue=1, DemDTCAttributesRef=DTCAttribute_DTC_0x000001
      DTCAttribute_DTC_0x000001 (DemDTCAttributes):
        DemImmediateNvStorage = true
        DemAgingAllowed = true
        DemDTCSignificance = DEM_EVENT_SIGNIFICANCE_FAULT
        DemMaxNumberFreezeFrameRecords = 2
        DemAgingCycleCounterThreshold = 3
        DemDTCPriority = 2
        DemFreezeFrameRecNumClassRef = DTC_0x000001_Properties_FFRecNumClass
        DemAgingCycleRef = DemOpCycle_DEM_POWER
        DemFreezeFrameClassRef = FreezeFrame_DTC_0x000001_DidSet
        DemExtendedDataClassRef = ExtendedDataClass_DTC_0x000001_Properties
        DemMemoryDestinationRef = DemGeneral/DemPrimaryMemory
      DebCntBas_DTC_0x000001_CounterBasedAlgorithm (DemDebounceCounterBasedClass):
        DemDebounceCounterIncrementStepSize = 1
        DemDebounceCounterPassedThreshold = -1
        DemDebounceCounterJumpDown = false
        DemDebounceCounterJumpUp = true
        DemDebounceCounterStorage = false
        DemDebounceCounterFailedThreshold = 1
        DemDebounceCounterDecrementStepSize = 1
        DemDebounceBehavior = DEM_DEBOUNCE_FREEZE
      DTC_0x0d0400_CAN_Network_ETAS_BusOff_Event (DemEventParameter):
        DemEventAvailable = true
        DemEventKind = DEM_EVENT_KIND_BSW
        DemEventFailureCycleCounterThreshold = 1
        DemDTCRef = DemDTC_DTC_0x0d0400_CAN_Network_ETAS_BusOff
        DemOperationCycleRef = DemOpCycle_DEM_POWER
        DemCallbackClearEventAllowed: DemClearEventAllowedBehavior=DEM_NO_STATUS_BYTE_CHANGE
        DemDebounceAlgorithmClass
          DemDebounceCounterBased: DemDebounceCounterBasedClassRef=DebCntBas_DTC_0x0d0400_CAN_Network_ETAS_BusOff_CounterBasedAlgorithm
        DemRbEventClass_DTC_0x0d0400_CAN_Network_ETAS_BusOff_Event (DemRbEventClass)
      DemDTC_DTC_0x0d0400_CAN_Network_ETAS_BusOff (DemDTC): DemDTCSeverity=DEM_SEVERITY_NO_SEVERITY, DemDtcValue=852992, DemDTCAttributesRef=DTCAttribute_DTC_0x0d0400_CAN_Network_ETAS_BusOff
      DTCAttribute_DTC_0x0d0400_CAN_Network_ETAS_BusOff (DemDTCAttributes):
        DemImmediateNvStorage = true
        DemAgingAllowed = true
        DemDTCSignificance = DEM_EVENT_SIGNIFICANCE_FAULT
        DemMaxNumberFreezeFrameRecords = 2
        DemAgingCycleCounterThreshold = 40
        DemDTCPriority = 4
        DemFreezeFrameRecNumClassRef = DTC_0x0d0400_CAN_Network_ETAS_BusOff_Properties_FFRecNumClass
        DemAgingCycleRef = DemOpCycle_DEM_POWER
        DemFreezeFrameClassRef = FreezeFrame_DTC_0x000001_DidSet
        DemExtendedDataClassRef = ExtendedDataClass_DTC_0x0d0400_CAN_Network_ETAS_BusOff_Properties
        DemMemoryDestinationRef = DemGeneral/DemPrimaryMemory
      DebCntBas_DTC_0x0d0400_CAN_Network_ETAS_BusOff_CounterBasedAlgorithm (DemDebounceCounterBasedClass):
        DemDebounceCounterIncrementStepSize = 1
        DemDebounceCounterPassedThreshold = -1
        DemDebounceCounterJumpDown = false
        DemDebounceCounterJumpUp = true
        DemDebounceCounterStorage = false
        DemDebounceCounterFailedThreshold = 1
        DemDebounceCounterDecrementStepSize = 1
        DemDebounceBehavior = DEM_DEBOUNCE_FREEZE
      DTC_0xc07388_Event (DemEventParameter):
        DemEventAvailable = true
        DemEventKind = DEM_EVENT_KIND_SWC
        DemEventFailureCycleCounterThreshold = 1
        DemDTCRef = DemDTC_DTC_0xc07388
        DemOperationCycleRef = DemOpCycle_DEM_POWER
        DemCallbackClearEventAllowed: DemClearEventAllowedBehavior=DEM_NO_STATUS_BYTE_CHANGE
        DemDebounceAlgorithmClass
          DemDebounceCounterBased: DemDebounceCounterBasedClassRef=DebCntBas_DTC_0xc07388_CounterBasedAlgorithm
        DemRbEventClass_DTC_0xc07388_Event (DemRbEventClass)
      DemDTC_DTC_0xc07388 (DemDTC): DemDTCSeverity=DEM_SEVERITY_NO_SEVERITY, DemDtcValue=12612488, DemDTCAttributesRef=DTCAttribute_DTC_0xc07388
      DTCAttribute_DTC_0xc07388 (DemDTCAttributes):
        DemImmediateNvStorage = true
        DemAgingAllowed = true
        DemDTCSignificance = DEM_EVENT_SIGNIFICANCE_FAULT
        DemMaxNumberFreezeFrameRecords = 2
        DemAgingCycleCounterThreshold = 3
        DemDTCPriority = 2
        DemAgingCycleRef = DemOpCycle_DEM_POWER
        DemFreezeFrameClassRef = FreezeFrame_DTC_0x000001_DidSet
        DemExtendedDataClassRef = ExtendedDataClass_DTC_0x000001_Properties
        DemMemoryDestinationRef = DemGeneral/DemPrimaryMemory
        DemFreezeFrameRecNumClassRef = DTC_0x000001_Properties_FFRecNumClass
      DebCntBas_DTC_0xc07388_CounterBasedAlgorithm (DemDebounceCounterBasedClass):
        DemDebounceCounterIncrementStepSize = 1
        DemDebounceCounterPassedThreshold = -1
        DemDebounceCounterJumpDown = false
        DemDebounceCounterJumpUp = true
        DemDebounceCounterStorage = false
        DemDebounceCounterFailedThreshold = 1
        DemDebounceCounterDecrementStepSize = 1
        DemDebounceBehavior = DEM_DEBOUNCE_FREEZE
      DTC_0xc12687_Event (DemEventParameter):
        DemEventAvailable = true
        DemEventKind = DEM_EVENT_KIND_SWC
        DemEventFailureCycleCounterThreshold = 1
        DemDTCRef = DemDTC_DTC_0xc12687
        DemOperationCycleRef = DemOpCycle_DEM_POWER
        DemCallbackClearEventAllowed: DemClearEventAllowedBehavior=DEM_NO_STATUS_BYTE_CHANGE
        DemDebounceAlgorithmClass
          DemDebounceCounterBased: DemDebounceCounterBasedClassRef=DebCntBas_DTC_0xc12687_CounterBasedAlgorithm
        DemRbEventClass_DTC_0xc12687_Event (DemRbEventClass)
      DemDTC_DTC_0xc12687 (DemDTC): DemDTCSeverity=DEM_SEVERITY_NO_SEVERITY, DemDtcValue=12658311, DemDTCAttributesRef=DTCAttribute_DTC_0xc12687
      DTCAttribute_DTC_0xc12687 (DemDTCAttributes):
        DemImmediateNvStorage = true
        DemAgingAllowed = true
        DemDTCSignificance = DEM_EVENT_SIGNIFICANCE_FAULT
        DemMaxNumberFreezeFrameRecords = 2
        DemAgingCycleCounterThreshold = 3
        DemDTCPriority = 2
        DemAgingCycleRef = DemOpCycle_DEM_POWER
        DemFreezeFrameClassRef = FreezeFrame_DTC_0x000001_DidSet
        DemExtendedDataClassRef = ExtendedDataClass_DTC_0x000001_Properties
        DemMemoryDestinationRef = DemGeneral/DemPrimaryMemory
        DemFreezeFrameRecNumClassRef = DTC_0x000001_Properties_FFRecNumClass
      DebCntBas_DTC_0xc12687_CounterBasedAlgorithm (DemDebounceCounterBasedClass):
        DemDebounceCounterIncrementStepSize = 1
        DemDebounceCounterPassedThreshold = -1
        DemDebounceCounterJumpDown = false
        DemDebounceCounterJumpUp = true
        DemDebounceCounterStorage = false
        DemDebounceCounterFailedThreshold = 1
        DemDebounceCounterDecrementStepSize = 1
        DemDebounceBehavior = DEM_DEBOUNCE_FREEZE
      DTC_0xc14587_Event (DemEventParameter):
        DemEventAvailable = true
        DemEventKind = DEM_EVENT_KIND_SWC
        DemEventFailureCycleCounterThreshold = 1
        DemDTCRef = DemDTC_DTC_0xc14587
        DemOperationCycleRef = DemOpCycle_DEM_POWER
        DemCallbackClearEventAllowed: DemClearEventAllowedBehavior=DEM_NO_STATUS_BYTE_CHANGE
        DemDebounceAlgorithmClass
          DemDebounceCounterBased: DemDebounceCounterBasedClassRef=DebCntBas_DTC_0xc14587_CounterBasedAlgorithm
        DemRbEventClass_DTC_0xc14587_Event (DemRbEventClass)
      DemDTC_DTC_0xc14587 (DemDTC): DemDTCSeverity=DEM_SEVERITY_NO_SEVERITY, DemDtcValue=12666247, DemDTCAttributesRef=DTCAttribute_DTC_0xc14587
      DTCAttribute_DTC_0xc14587 (DemDTCAttributes):
        DemImmediateNvStorage = true
        DemAgingAllowed = true
        DemDTCSignificance = DEM_EVENT_SIGNIFICANCE_FAULT
        DemMaxNumberFreezeFrameRecords = 2
        DemAgingCycleCounterThreshold = 3
        DemDTCPriority = 2
        DemAgingCycleRef = DemOpCycle_DEM_POWER
        DemFreezeFrameClassRef = FreezeFrame_DTC_0x000001_DidSet
        DemExtendedDataClassRef = ExtendedDataClass_DTC_0x000001_Properties
        DemMemoryDestinationRef = DemGeneral/DemPrimaryMemory
        DemFreezeFrameRecNumClassRef = DTC_0x000001_Properties_FFRecNumClass
      DebCntBas_DTC_0xc14587_CounterBasedAlgorithm (DemDebounceCounterBasedClass):
        DemDebounceCounterIncrementStepSize = 1
        DemDebounceCounterPassedThreshold = -1
        DemDebounceCounterJumpDown = false
        DemDebounceCounterJumpUp = true
        DemDebounceCounterStorage = false
        DemDebounceCounterFailedThreshold = 1
        DemDebounceCounterDecrementStepSize = 1
        DemDebounceBehavior = DEM_DEBOUNCE_FREEZE
      DTC_0xc22a87_Event (DemEventParameter):
        DemEventAvailable = true
        DemEventKind = DEM_EVENT_KIND_SWC
        DemEventFailureCycleCounterThreshold = 1
        DemDTCRef = DemDTC_DTC_0xc22a87
        DemOperationCycleRef = DemOpCycle_DEM_POWER
        DemCallbackClearEventAllowed: DemClearEventAllowedBehavior=DEM_NO_STATUS_BYTE_CHANGE
        DemDebounceAlgorithmClass
          DemDebounceCounterBased: DemDebounceCounterBasedClassRef=DebCntBas_DTC_0xc22a87_CounterBasedAlgorithm
        DemRbEventClass_DTC_0xc22a87_Event (DemRbEventClass)
      DemDTC_DTC_0xc22a87 (DemDTC): DemDTCSeverity=DEM_SEVERITY_NO_SEVERITY, DemDtcValue=12724871, DemDTCAttributesRef=DTCAttribute_DTC_0xc22a87
      DTCAttribute_DTC_0xc22a87 (DemDTCAttributes):
        DemImmediateNvStorage = true
        DemAgingAllowed = true
        DemDTCSignificance = DEM_EVENT_SIGNIFICANCE_FAULT
        DemMaxNumberFreezeFrameRecords = 2
        DemAgingCycleCounterThreshold = 3
        DemDTCPriority = 1
        DemFreezeFrameRecNumClassRef = DTC_0xc22a87_Properties_FFRecNumClass
        DemAgingCycleRef = DemOpCycle_DEM_POWER
        DemFreezeFrameClassRef = FreezeFrame_DTC_0x000001_DidSet
        DemExtendedDataClassRef = ExtendedDataClass_DTC_0xc22a87_Properties
        DemMemoryDestinationRef = DemGeneral/DemPrimaryMemory
      DebCntBas_DTC_0xc22a87_CounterBasedAlgorithm (DemDebounceCounterBasedClass):
        DemDebounceCounterIncrementStepSize = 1
        DemDebounceCounterPassedThreshold = -1
        DemDebounceCounterJumpDown = false
        DemDebounceCounterJumpUp = true
        DemDebounceCounterStorage = false
        DemDebounceCounterFailedThreshold = 1
        DemDebounceCounterDecrementStepSize = 1
        DemDebounceBehavior = DEM_DEBOUNCE_FREEZE
      DTC_0xc41487_Event (DemEventParameter):
        DemEventAvailable = true
        DemEventKind = DEM_EVENT_KIND_SWC
        DemEventFailureCycleCounterThreshold = 1
        DemDTCRef = DemDTC_DTC_0xc41487
        DemOperationCycleRef = DemOpCycle_DEM_POWER
        DemCallbackClearEventAllowed: DemClearEventAllowedBehavior=DEM_NO_STATUS_BYTE_CHANGE
        DemDebounceAlgorithmClass
          DemDebounceCounterBased: DemDebounceCounterBasedClassRef=DebCntBas_DTC_0xc41487_CounterBasedAlgorithm
        DemRbEventClass_DTC_0xc41487_Event (DemRbEventClass)
      DemDTC_DTC_0xc41487 (DemDTC): DemDTCSeverity=DEM_SEVERITY_NO_SEVERITY, DemDtcValue=12850311, DemDTCAttributesRef=DTCAttribute_DTC_0xc41487
      DTCAttribute_DTC_0xc41487 (DemDTCAttributes):
        DemImmediateNvStorage = true
        DemAgingAllowed = true
        DemDTCSignificance = DEM_EVENT_SIGNIFICANCE_FAULT
        DemMaxNumberFreezeFrameRecords = 2
        DemAgingCycleCounterThreshold = 3
        DemDTCPriority = 1
        DemAgingCycleRef = DemOpCycle_DEM_POWER
        DemFreezeFrameClassRef = FreezeFrame_DTC_0x000001_DidSet
        DemExtendedDataClassRef = ExtendedDataClass_DTC_0xc22a87_Properties
        DemMemoryDestinationRef = DemGeneral/DemPrimaryMemory
        DemFreezeFrameRecNumClassRef = DTC_0xc22a87_Properties_FFRecNumClass
      DebCntBas_DTC_0xc41487_CounterBasedAlgorithm (DemDebounceCounterBasedClass):
        DemDebounceCounterIncrementStepSize = 1
        DemDebounceCounterPassedThreshold = -1
        DemDebounceCounterJumpDown = false
        DemDebounceCounterJumpUp = true
        DemDebounceCounterStorage = false
        DemDebounceCounterFailedThreshold = 1
        DemDebounceCounterDecrementStepSize = 1
        DemDebounceBehavior = DEM_DEBOUNCE_FREEZE
      DTC_0xd56217_Event (DemEventParameter):
        DemEventAvailable = true
        DemEventKind = DEM_EVENT_KIND_SWC
        DemEventFailureCycleCounterThreshold = 1
        DemDTCRef = DemDTC_DTC_0xd56217
        DemOperationCycleRef = DemOpCycle_DEM_POWER
        DemCallbackClearEventAllowed: DemClearEventAllowedBehavior=DEM_NO_STATUS_BYTE_CHANGE
        DemDebounceAlgorithmClass
          DemDebounceCounterBased: DemDebounceCounterBasedClassRef=DebCntBas_DTC_0xd56217_CounterBasedAlgorithm
        DemRbEventClass_DTC_0xd56217_Event (DemRbEventClass)
      DemDTC_DTC_0xd56217 (DemDTC): DemDTCSeverity=DEM_SEVERITY_NO_SEVERITY, DemDtcValue=13984279, DemDTCAttributesRef=DTCAttribute_DTC_0xd56217
      DTCAttribute_DTC_0xd56217 (DemDTCAttributes):
        DemImmediateNvStorage = true
        DemAgingAllowed = true
        DemDTCSignificance = DEM_EVENT_SIGNIFICANCE_FAULT
        DemMaxNumberFreezeFrameRecords = 2
        DemAgingCycleCounterThreshold = 3
        DemDTCPriority = 1
        DemAgingCycleRef = DemOpCycle_DEM_POWER
        DemFreezeFrameClassRef = FreezeFrame_DTC_0x000001_DidSet
        DemExtendedDataClassRef = ExtendedDataClass_DTC_0xc22a87_Properties
        DemMemoryDestinationRef = DemGeneral/DemPrimaryMemory
        DemFreezeFrameRecNumClassRef = DTC_0xc22a87_Properties_FFRecNumClass
      DebCntBas_DTC_0xd56217_CounterBasedAlgorithm (DemDebounceCounterBasedClass):
        DemDebounceCounterIncrementStepSize = 1
        DemDebounceCounterPassedThreshold = -1
        DemDebounceCounterJumpDown = false
        DemDebounceCounterJumpUp = true
        DemDebounceCounterStorage = false
        DemDebounceCounterFailedThreshold = 1
        DemDebounceCounterDecrementStepSize = 1
        DemDebounceBehavior = DEM_DEBOUNCE_FREEZE
      DTC_0xd56316_Event (DemEventParameter):
        DemEventAvailable = true
        DemEventKind = DEM_EVENT_KIND_SWC
        DemEventFailureCycleCounterThreshold = 1
        DemDTCRef = DemDTC_DTC_0xd56316
        DemOperationCycleRef = DemOpCycle_DEM_POWER
        DemCallbackClearEventAllowed: DemClearEventAllowedBehavior=DEM_NO_STATUS_BYTE_CHANGE
        DemDebounceAlgorithmClass
          DemDebounceCounterBased: DemDebounceCounterBasedClassRef=DebCntBas_DTC_0xd56316_CounterBasedAlgorithm
        DemRbEventClass_DTC_0xd56316_Event (DemRbEventClass)
      DemDTC_DTC_0xd56316 (DemDTC): DemDTCSeverity=DEM_SEVERITY_NO_SEVERITY, DemDtcValue=13984534, DemDTCAttributesRef=DTCAttribute_DTC_0xd56316
      DTCAttribute_DTC_0xd56316 (DemDTCAttributes):
        DemImmediateNvStorage = true
        DemAgingAllowed = true
        DemDTCSignificance = DEM_EVENT_SIGNIFICANCE_FAULT
        DemMaxNumberFreezeFrameRecords = 2
        DemAgingCycleCounterThreshold = 3
        DemDTCPriority = 1
        DemAgingCycleRef = DemOpCycle_DEM_POWER
        DemFreezeFrameClassRef = FreezeFrame_DTC_0x000001_DidSet
        DemExtendedDataClassRef = ExtendedDataClass_DTC_0xc22a87_Properties
        DemMemoryDestinationRef = DemGeneral/DemPrimaryMemory
        DemFreezeFrameRecNumClassRef = DTC_0xc22a87_Properties_FFRecNumClass
      DebCntBas_DTC_0xd56316_CounterBasedAlgorithm (DemDebounceCounterBasedClass):
        DemDebounceCounterIncrementStepSize = 1
        DemDebounceCounterPassedThreshold = -1
        DemDebounceCounterJumpDown = false
        DemDebounceCounterJumpUp = true
        DemDebounceCounterStorage = false
        DemDebounceCounterFailedThreshold = 1
        DemDebounceCounterDecrementStepSize = 1
        DemDebounceBehavior = DEM_DEBOUNCE_FREEZE
      DTC_0xe00141_Event (DemEventParameter):
        DemEventAvailable = true
        DemEventKind = DEM_EVENT_KIND_SWC
        DemEventFailureCycleCounterThreshold = 1
        DemDTCRef = DemDTC_DTC_0xe00141
        DemOperationCycleRef = DemOpCycle_DEM_POWER
        DemCallbackClearEventAllowed: DemClearEventAllowedBehavior=DEM_NO_STATUS_BYTE_CHANGE
        DemDebounceAlgorithmClass
          DemDebounceCounterBased: DemDebounceCounterBasedClassRef=DebCntBas_DTC_0xe00141_CounterBasedAlgorithm
        DemRbEventClass_DTC_0xe00141_Event (DemRbEventClass)
      DemDTC_DTC_0xe00141 (DemDTC): DemDTCSeverity=DEM_SEVERITY_NO_SEVERITY, DemDtcValue=14680385, DemDTCAttributesRef=DTCAttribute_DTC_0xe00141
      DTCAttribute_DTC_0xe00141 (DemDTCAttributes):
        DemImmediateNvStorage = true
        DemAgingAllowed = true
        DemDTCSignificance = DEM_EVENT_SIGNIFICANCE_FAULT
        DemMaxNumberFreezeFrameRecords = 2
        DemAgingCycleCounterThreshold = 3
        DemDTCPriority = 1
        DemAgingCycleRef = DemOpCycle_DEM_POWER
        DemFreezeFrameClassRef = FreezeFrame_DTC_0x000001_DidSet
        DemExtendedDataClassRef = ExtendedDataClass_DTC_0xc22a87_Properties
        DemMemoryDestinationRef = DemGeneral/DemPrimaryMemory
        DemFreezeFrameRecNumClassRef = DTC_0xc22a87_Properties_FFRecNumClass
      DebCntBas_DTC_0xe00141_CounterBasedAlgorithm (DemDebounceCounterBasedClass):
        DemDebounceCounterIncrementStepSize = 1
        DemDebounceCounterPassedThreshold = -1
        DemDebounceCounterJumpDown = false
        DemDebounceCounterJumpUp = true
        DemDebounceCounterStorage = false
        DemDebounceCounterFailedThreshold = 1
        DemDebounceCounterDecrementStepSize = 1
        DemDebounceBehavior = DEM_DEBOUNCE_FREEZE
      DTC_0xe00142_Event (DemEventParameter):
        DemEventAvailable = true
        DemEventKind = DEM_EVENT_KIND_SWC
        DemEventFailureCycleCounterThreshold = 1
        DemDTCRef = DemDTC_DTC_0xe00142
        DemOperationCycleRef = DemOpCycle_DEM_POWER
        DemCallbackClearEventAllowed: DemClearEventAllowedBehavior=DEM_NO_STATUS_BYTE_CHANGE
        DemDebounceAlgorithmClass
          DemDebounceCounterBased: DemDebounceCounterBasedClassRef=DebCntBas_DTC_0xe00142_CounterBasedAlgorithm
        DemRbEventClass_DTC_0xe00142_Event (DemRbEventClass)
      DemDTC_DTC_0xe00142 (DemDTC): DemDTCSeverity=DEM_SEVERITY_NO_SEVERITY, DemDtcValue=14680386, DemDTCAttributesRef=DTCAttribute_DTC_0xe00142
      DTCAttribute_DTC_0xe00142 (DemDTCAttributes):
        DemImmediateNvStorage = true
        DemAgingAllowed = true
        DemDTCSignificance = DEM_EVENT_SIGNIFICANCE_FAULT
        DemMaxNumberFreezeFrameRecords = 2
        DemAgingCycleCounterThreshold = 3
        DemDTCPriority = 1
        DemAgingCycleRef = DemOpCycle_DEM_POWER
        DemFreezeFrameClassRef = FreezeFrame_DTC_0x000001_DidSet
        DemExtendedDataClassRef = ExtendedDataClass_DTC_0xc22a87_Properties
        DemMemoryDestinationRef = DemGeneral/DemPrimaryMemory
        DemFreezeFrameRecNumClassRef = DTC_0xc22a87_Properties_FFRecNumClass
      DebCntBas_DTC_0xe00142_CounterBasedAlgorithm (DemDebounceCounterBasedClass):
        DemDebounceCounterIncrementStepSize = 1
        DemDebounceCounterPassedThreshold = -1
        DemDebounceCounterJumpDown = false
        DemDebounceCounterJumpUp = true
        DemDebounceCounterStorage = false
        DemDebounceCounterFailedThreshold = 1
        DemDebounceCounterDecrementStepSize = 1
        DemDebounceBehavior = DEM_DEBOUNCE_FREEZE
      DTC_0xe26200_Event (DemEventParameter):
        DemEventAvailable = true
        DemEventKind = DEM_EVENT_KIND_SWC
        DemEventFailureCycleCounterThreshold = 1
        DemDTCRef = DemDTC_DTC_0xe26200
        DemOperationCycleRef = DemOpCycle_DEM_POWER
        DemCallbackClearEventAllowed: DemClearEventAllowedBehavior=DEM_NO_STATUS_BYTE_CHANGE
        DemDebounceAlgorithmClass
          DemDebounceCounterBased: DemDebounceCounterBasedClassRef=DebCntBas_DTC_0xe26200_CounterBasedAlgorithm
        DemRbEventClass_DTC_0xe26200_Event (DemRbEventClass)
      DemDTC_DTC_0xe26200 (DemDTC): DemDTCSeverity=DEM_SEVERITY_NO_SEVERITY, DemDtcValue=14836224, DemDTCAttributesRef=DTCAttribute_DTC_0xe26200
      DTCAttribute_DTC_0xe26200 (DemDTCAttributes):
        DemImmediateNvStorage = true
        DemAgingAllowed = true
        DemDTCSignificance = DEM_EVENT_SIGNIFICANCE_FAULT
        DemMaxNumberFreezeFrameRecords = 2
        DemAgingCycleCounterThreshold = 3
        DemDTCPriority = 1
        DemAgingCycleRef = DemOpCycle_DEM_POWER
        DemFreezeFrameClassRef = FreezeFrame_DTC_0x000001_DidSet
        DemExtendedDataClassRef = ExtendedDataClass_DTC_0xc22a87_Properties
        DemMemoryDestinationRef = DemGeneral/DemPrimaryMemory
        DemFreezeFrameRecNumClassRef = DTC_0xc22a87_Properties_FFRecNumClass
      DebCntBas_DTC_0xe26200_CounterBasedAlgorithm (DemDebounceCounterBasedClass):
        DemDebounceCounterIncrementStepSize = 1
        DemDebounceCounterPassedThreshold = -1
        DemDebounceCounterJumpDown = false
        DemDebounceCounterJumpUp = true
        DemDebounceCounterStorage = false
        DemDebounceCounterFailedThreshold = 1
        DemDebounceCounterDecrementStepSize = 1
        DemDebounceBehavior = DEM_DEBOUNCE_FREEZE

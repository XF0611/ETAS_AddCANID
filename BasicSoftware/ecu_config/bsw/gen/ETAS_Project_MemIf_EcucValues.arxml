AUTOSAR XML (schema 00047)
package /ETAS_BIP/EcucModuleConfigurationValuess
  module config MemIf: implementation-config-variant=VARIANT-PRE-COMPILE
    MemIfGeneral: MemIfVersionInfoApi=false, MemIfDevErrorDetect=true

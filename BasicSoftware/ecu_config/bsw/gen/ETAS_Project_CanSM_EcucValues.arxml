AUTOSAR XML (schema 00047)
package /ETAS_BIP/EcucModuleConfigurationValuess
  module config CanSM: implementation-config-variant=VARIANT-PRE-COMPILE
    CanSMConfiguration: CanSMModeRequestRepetitionMax=5, CanSMModeRequestRepetitionTime=0.07
      ETAS_CAN (CanSMManagerNetwork):
        CanSMBorCounterL1ToL2 = 32
        CanSMBorTimeL1 = 0.01
        CanSMBorTimeL2 = 60.0
        CanSMBorTimeTxEnsured = 1.0
        CanSMBorTxConfirmationPolling = false
        CanSMComMNetworkHandleRef = Can_Network_ETAS_Channel_Can_Network_ETAS
        ETAS_CAN (CanSMController): CanSMControllerId=ETAS_CAN
        CanSMDemEventParameterRefs: CanSMRbDynCreate_CANSM_E_BUS_OFF=Disabled, CANSM_E_BUS_OFF=DTC_0x0d0400_CAN_Network_ETAS_BusOff_Event
    CanSMGeneral: CanSMMainFunctionTimePeriod=0.001, CanSMVersionInfoApi=false, CanSMDevErrorDetect=true

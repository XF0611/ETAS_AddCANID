AUTOSAR XML (schema 00047)
package /ETAS_BIP/EcucModuleConfigurationValuess
  module config CanIf: implementation-config-variant=VARIANT-PRE-COMPILE
    CanIfCtrlDrvCfg: CanIfRbCtrlDrvPrefix=CanConf, CanIfCtrlDrvNameRef=CanGeneral, CanIfCtrlDrvInitHohConfigRef=CanIfInitHohCfg
      ETAS_CAN (CanIfCtrlCfg): CanIfCtrlWakeupSupport=false, CanIfCtrlCanCtrlRef=ETAS_CAN
    CanIfInitCfg: CanIfInitCfgSet=0
      CanIfInitHohCfg
        ETAS_CAN_Tx_Std_MailBox_1 (CanIfHthCfg): CanIfHthCanCtrlIdRef=ETAS_CAN, CanIfHthIdSymRef=ETAS_CAN_Tx_Std_MailBox_1
        ETAS_CAN_Tx_Std_MailBox_2 (CanIfHthCfg): CanIfHthCanCtrlIdRef=ETAS_CAN, CanIfHthIdSymRef=ETAS_CAN_Tx_Std_MailBox_2
        3 x CanIfHrhCfg, all with CanIfHrhCanCtrlIdRef=ETAS_CAN:
          ETAS_CAN_Rx_Std_MailBox_{1..3}: CanIfHrhIdSymRef=ETAS_CAN_Rx_Std_MailBox_{1..3}
        ETAS_CAN_Tx_Std_MailBox_3 (CanIfHthCfg): CanIfHthCanCtrlIdRef=ETAS_CAN, CanIfHthIdSymRef=ETAS_CAN_Tx_Std_MailBox_3
        ETAS_CAN_Tx_Std_MailBox_4 (CanIfHthCfg): CanIfHthCanCtrlIdRef=ETAS_CAN, CanIfHthIdSymRef=ETAS_CAN_Tx_Std_MailBox_4
        3 x CanIfHrhCfg, all with CanIfHrhCanCtrlIdRef=ETAS_CAN:
          ETAS_CAN_Rx_Std_MailBox_{4..6}: CanIfHrhIdSymRef=ETAS_CAN_Rx_Std_MailBox_{4..6}
        ETAS_CAN_Tx_Std_MailBox_5 (CanIfHthCfg): CanIfHthCanCtrlIdRef=ETAS_CAN, CanIfHthIdSymRef=ETAS_CAN_Tx_Std_MailBox_5
        ETAS_CAN_Rx_Std_MailBox_7 (CanIfHrhCfg): CanIfHrhIdSymRef=ETAS_CAN_Rx_Std_MailBox_7, CanIfHrhCanCtrlIdRef=ETAS_CAN
        ETAS_CAN_Tx_Std_MailBox_6 (CanIfHthCfg): CanIfHthCanCtrlIdRef=ETAS_CAN, CanIfHthIdSymRef=ETAS_CAN_Tx_Std_MailBox_6
      Bu_ETAS_CAN_Tx_Std_MailBox_1 (CanIfBufferCfg): CanIfBufferSize=0, CanIfBufferHthRef=ETAS_CAN_Tx_Std_MailBox_1
      ComTx_0x55_ETAS_CAN_OUT (CanIfTxPduCfg):
        CanIfTxPduUserTxConfirmationName = PduR_CanIfTxConfirmation
        CanIfTxPduReadNotifyStatus = false
        CanIfTxPduUserTxConfirmationUL = PDUR
        CanIfTxPduCanIdType = STANDARD_CAN
        CanIfTxPduCanId = 85
        CanIfTxPduTruncation = false
        CanIfTxPduType = STATIC
        CanIfTxPduRef = ComTx_0x55_PduR2CanIf_Can_Network_ETAS_Channel_CAN
        CanIfTxPduBufferRef = Bu_ETAS_CAN_Tx_Std_MailBox_2
      Bu_ETAS_CAN_Tx_Std_MailBox_2 (CanIfBufferCfg): CanIfBufferSize=0, CanIfBufferHthRef=ETAS_CAN_Tx_Std_MailBox_2
      3 x CanIfRxPduCfg, all with CanIfRxPduCanIdType=STANDARD_CAN, CanIfRxPduReadData=false, CanIfRxPduReadNotifyStatus=true:
        ComRx_0x261_ETAS_CAN_IN: CanIfRxPduUserRxIndicationUL=PDUR, CanIfRxPduDlc=1, CanIfRxPduCanId=609, CanIfRxPduUserRxIndicationName=PduR_CanIfRxIndication, CanIfRxPduRef=ComRx_0x261_CanIf2PduR_Can_Network_ETAS_Channel_CAN, CanIfRxPduHrhIdRef=ETAS_CAN_Rx_Std_MailBox_1
        ComRx_0x81_ETAS_CAN_IN: CanIfRxPduUserRxIndicationUL=PDUR, CanIfRxPduDlc=8, CanIfRxPduCanId=129, CanIfRxPduUserRxIndicationName=PduR_CanIfRxIndication, CanIfRxPduRef=ComRx_0x81_CanIf2PduR_Can_Network_ETAS_Channel_CAN, CanIfRxPduHrhIdRef=ETAS_CAN_Rx_Std_MailBox_2
        NM_Rx_0x677_ETAS_CAN_IN: CanIfRxPduUserRxIndicationUL=CAN_NM, CanIfRxPduDlc=8, CanIfRxPduCanId=1655, CanIfRxPduUserRxIndicationName=CanNm_RxIndication, CanIfRxPduRef=NM_Rx_0x677_CanIf2CanNm_Can_Network_ETAS_Channel_CAN, CanIfRxPduHrhIdRef=ETAS_CAN_Rx_Std_MailBox_3
      NM_Tx_0x600_ETAS_CAN_OUT (CanIfTxPduCfg):
        CanIfTxPduUserTxConfirmationName = CanNm_TxConfirmation
        CanIfTxPduReadNotifyStatus = false
        CanIfTxPduUserTxConfirmationUL = CAN_NM
        CanIfTxPduCanIdType = STANDARD_CAN
        CanIfTxPduCanId = 1536
        CanIfTxPduTruncation = false
        CanIfTxPduType = STATIC
        CanIfTxPduRef = NM_Tx_0x600_CanNm2CanIf_Can_Network_ETAS_Channel_CAN
        CanIfTxPduBufferRef = Bu_ETAS_CAN_Tx_Std_MailBox_4
      Bu_ETAS_CAN_Tx_Std_MailBox_3 (CanIfBufferCfg): CanIfBufferSize=0, CanIfBufferHthRef=ETAS_CAN_Tx_Std_MailBox_3
      XcpTx_0x333_ETAS_CAN_OUT (CanIfTxPduCfg):
        CanIfTxPduUserTxConfirmationName = Xcp_CanIfTxConfirmation
        CanIfTxPduReadNotifyStatus = false
        CanIfTxPduUserTxConfirmationUL = XCP
        CanIfTxPduCanIdType = STANDARD_CAN
        CanIfTxPduCanId = 819
        CanIfTxPduTruncation = false
        CanIfTxPduType = STATIC
        CanIfTxPduRef = XcpTx_0x333_Xcp2CanIf_Can_Network_ETAS_Channel_CAN
        CanIfTxPduBufferRef = Bu_ETAS_CAN_Tx_Std_MailBox_6
      Bu_ETAS_CAN_Tx_Std_MailBox_4 (CanIfBufferCfg): CanIfBufferSize=0, CanIfBufferHthRef=ETAS_CAN_Tx_Std_MailBox_4
      3 x CanIfRxPduCfg, all with CanIfRxPduDlc=0, CanIfRxPduReadData=false, CanIfRxPduReadNotifyStatus=true:
        XcpRx_0x332_ETAS_CAN_IN: CanIfRxPduUserRxIndicationUL=XCP, CanIfRxPduCanId=818, CanIfRxPduCanIdType=STANDARD_NO_FD_CAN, CanIfRxPduUserRxIndicationName=Xcp_CanIfRxIndication, CanIfRxPduRef=XcpRx_0x332_CanIf2Xcp_Can_Network_ETAS_Channel_CAN, CanIfRxPduHrhIdRef=ETAS_CAN_Rx_Std_MailBox_4
        NPdu_UdsRxFnc_ETAS_CAN_IN: CanIfRxPduUserRxIndicationUL=CAN_TP, CanIfRxPduCanId=2015, CanIfRxPduCanIdType=STANDARD_CAN, CanIfRxPduUserRxIndicationName=CanTp_RxIndication, CanIfRxPduRef=NPdu_UdsRxFnc_CanIf2CanTp_Can_Network_ETAS_Channel_CAN, CanIfRxPduHrhIdRef=ETAS_CAN_Rx_Std_MailBox_5
        NPdu_UdsRxPhy_ETAS_CAN_IN: CanIfRxPduUserRxIndicationUL=CAN_TP, CanIfRxPduCanId=1856, CanIfRxPduCanIdType=STANDARD_CAN, CanIfRxPduUserRxIndicationName=CanTp_RxIndication, CanIfRxPduRef=NPdu_UdsRxPhy_CanIf2CanTp_Can_Network_ETAS_Channel_CAN, CanIfRxPduHrhIdRef=ETAS_CAN_Rx_Std_MailBox_6
      NPdu_UdsTxPhy_ETAS_CAN_OUT (CanIfTxPduCfg):
        CanIfTxPduUserTxConfirmationName = CanTp_TxConfirmation
        CanIfTxPduReadNotifyStatus = false
        CanIfTxPduUserTxConfirmationUL = CAN_TP
        CanIfTxPduCanIdType = STANDARD_CAN
        CanIfTxPduCanId = 1864
        CanIfTxPduTruncation = false
        CanIfTxPduType = STATIC
        CanIfTxPduRef = NPdu_UdsTxPhy_CanTp2CanIf_Can_Network_ETAS_Channel_CAN
        CanIfTxPduBufferRef = Bu_ETAS_CAN_Tx_Std_MailBox_5
      Bu_ETAS_CAN_Tx_Std_MailBox_5 (CanIfBufferCfg): CanIfBufferSize=0, CanIfBufferHthRef=ETAS_CAN_Tx_Std_MailBox_5
      ComRx_0x456_ETAS_CAN_IN (CanIfRxPduCfg):
        CanIfRxPduUserRxIndicationUL = PDUR
        CanIfRxPduDlc = 8
        CanIfRxPduCanId = 1110
        CanIfRxPduCanIdType = STANDARD_CAN
        CanIfRxPduReadData = false
        CanIfRxPduReadNotifyStatus = true
        CanIfRxPduUserRxIndicationName = PduR_CanIfRxIndication
        CanIfRxPduRef = ComRx_0x456_CanIf2PduR_Can_Network_ETAS_Channel_CAN
        CanIfRxPduHrhIdRef = ETAS_CAN_Rx_Std_MailBox_7
      ComTx_0x123_ETAS_CAN_OUT (CanIfTxPduCfg):
        CanIfTxPduUserTxConfirmationName = PduR_CanIfTxConfirmation
        CanIfTxPduReadNotifyStatus = false
        CanIfTxPduUserTxConfirmationUL = PDUR
        CanIfTxPduCanIdType = STANDARD_CAN
        CanIfTxPduCanId = 291
        CanIfTxPduTruncation = false
        CanIfTxPduType = STATIC
        CanIfTxPduRef = ComTx_0x123_PduR2CanIf_Can_Network_ETAS_Channel_CAN
        CanIfTxPduBufferRef = Bu_ETAS_CAN_Tx_Std_MailBox_1
      ComTx_0x98_ETAS_CAN_OUT (CanIfTxPduCfg):
        CanIfTxPduUserTxConfirmationName = PduR_CanIfTxConfirmation
        CanIfTxPduReadNotifyStatus = false
        CanIfTxPduUserTxConfirmationUL = PDUR
        CanIfTxPduCanIdType = STANDARD_CAN
        CanIfTxPduCanId = 152
        CanIfTxPduTruncation = false
        CanIfTxPduType = STATIC
        CanIfTxPduRef = ComTx_0x98_PduR2CanIf_Can_Network_ETAS_Channel_CAN
        CanIfTxPduBufferRef = Bu_ETAS_CAN_Tx_Std_MailBox_3
      Bu_ETAS_CAN_Tx_Std_MailBox_6 (CanIfBufferCfg): CanIfBufferSize=0, CanIfBufferHthRef=ETAS_CAN_Tx_Std_MailBox_6
    CanIfPublicCfg:
      CanIfPublicWakeupCheckValidSupport = false
      CanIfPublicErrorPassiveSupport = false
      CanIfPublicBusoffRecoveryfromRxIndication = false
      CanIfPublicTxBuffering = false
      CanIfPublicReadTxPduNotifyStatusApi = true
      CanIfPublicVersionInfoApi = false
      CanIfPublicCanIfLiteConfiguration = false
      CanIfPublicTxConfirmPollingSupport = false
      CanIfTxOfflineActiveSupport = false
      CanIfPublicCancelTransmitSupport = false
      CanIfPublicReadRxPduNotifyStatusApi = true
      CanIfWakeupSupport = false
      CanIfTriggerTransmitSupport = false
      CanIfPublicSetDynamicTxIdApi = false
      CanIfPublicMultipleDrvSupport = false
      CanIfPublicPnSupport = false
      CanIfPublicReadRxPduDataApi = false
      CanIfPublicUserTpTxInOfflineMode = false
      CanIfPublicDevErrorDetect = true
      CanIfMetaDataSupport = true
      CanIfReadMsgIdApi = true
      CanIfRbCalibrationSupport: CanIfRbCalibration=false
    CanIfDispatchCfg: CanIfDispatchUserTrcvModeIndicationName=CAN_SM, CanIfDispatchUserCtrlBusOffUL=CAN_SM, CanIfDispatchUserCtrlModeIndicationUL=CAN_SM
    CanIfPrivateCfg: CanIfPrivateDlcCheck=false

AUTOSAR XML (schema 00047)
package /ETAS_BIP/EcucModuleConfigurationValuess
  module config Fee: implementation-config-variant=VARIANT-PRE-COMPILE
    FeeGeneral:
      FeeVirtualPageSize = 8
      FeeSetModeSupported = false
      FeeVersionInfoApi = false
      FeePollingMode = true
      FeeIndex = 0
      FeeRbConfirmSingleStorageBlockloss = true
      FeeDevErrorDetect = true
      FeeRbMachineType = MCU_RB_MANUAL_CFG
    FeePublishedInformation

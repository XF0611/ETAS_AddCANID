AUTOSAR XML (schema 00047)
package /ETAS_BIP/EcucModuleConfigurationValuess
  module config NvM: implementation-config-variant=VARIANT-PRE-COMPILE
    NvMCommon:
      NvMJobPrioritization = false
      NvMBswMMultiBlockJobStatusInformation = true
      NvMDynamicConfiguration = false
      NvMCrcNumOfBytes = 65535
      NvMDrvModeSwitch = false
      NvMMultiBlockCallback = NULL_PTR
      NvMVersionInfoApi = false
      NvMSetRamBlockStatusApi = true
      NvMRbSetWriteAllTriggerApi = true
      NvMPollingMode = true
      NvMCompiledConfigId = 2
      NvMApiConfigClass = NVM_API_CONFIG_CLASS_3
      NvMDevErrorDetect = true
      NvMSizeStandardJobQueue = 255
      NvMMainFunctionPeriod = 0.01
    5 x NvMBlockDescriptor, all with NvMStaticBlockIDCheck=false, NvMWriteVerification=false, NvMMaxNumOfReadRetries=0, NvMBlockUseSyncMechanism=false, NvMBlockWriteProt=false, NvMNvBlockNum=1, NvMBlockManagementType=NVM_BLOCK_NATIVE, NvMWriteBlockOnce=false, NvMBlockJobPriority=1, NvMInitBlockCallback=NULL_PTR, NvMBlockCrcType=NVM_CRC16, NvMMaxNumOfWriteRetries=0, NvMNvramDeviceId=0, NvMWriteVerificationDataSize=0:
      NvM_MultiBlock: NvMCalcRamBlockCrc=false, NvMRomBlockNum=0, NvMResistantToChangedSw=false, NvMBlockUseCrc=true, NvMNvBlockLength=1
      NvM_ConfigId: NvMSelectBlockForReadAll=true, NvMCalcRamBlockCrc=false, NvMRomBlockNum=0, NvMResistantToChangedSw=false, NvMBlockUseCrc=true, NvMNvBlockLength=2, NvMRamBlockDataAddress=NvM_Prv_idConfigStored_u16, NvMSelectBlockForWriteAll=true
      NvBlock_NvBlockDescriptor_StoreCyclicBlock: NvMBlockUseAutoValidation=false, NvMSelectBlockForReadAll=true, NvMCalcRamBlockCrc=true, NvMRomBlockNum=1, NvMRomBlockDataAddress=Rte_RomBlk_NvBlock_NvBlockDescriptor_StoreCyclicBlock_CyclicRomBlock, NvMResistantToChangedSw=true, NvMBlockUseCrc=false, NvMNvBlockLength=1024, NvMRamBlockDataAddress=Rte_RamBlk_NvBlock_NvBlockDescriptor_StoreCyclicBlock_CyclicRamBlock, NvMSelectBlockForWriteAll=false, NvMRbGenRteServicePort=false, NvMSingleBlockCallback=Rte_NvMNotifyJobFinished_CPT_NvBlock_NvBlockDescriptor_StoreCyclicBlock
      NvBlock_NvBlockDescriptor_StoreImmediateBlock: NvMBlockUseAutoValidation=false, NvMSelectBlockForReadAll=true, NvMCalcRamBlockCrc=true, NvMRomBlockNum=1, NvMRomBlockDataAddress=Rte_RomBlk_NvBlock_NvBlockDescriptor_StoreImmediateBlock_ImmediateRomBlock, NvMResistantToChangedSw=true, NvMBlockUseCrc=false, NvMNvBlockLength=384, NvMRamBlockDataAddress=Rte_RamBlk_NvBlock_NvBlockDescriptor_StoreImmediateBlock_ImmediateRamBlock, NvMSelectBlockForWriteAll=false, NvMRbGenRteServicePort=false, NvMSingleBlockCallback=Rte_NvMNotifyJobFinished_CPT_NvBlock_NvBlockDescriptor_StoreImmediateBlock
      NvBlock_NvBlockDescriptor_StoreAtShutdownBlock: NvMBlockUseAutoValidation=false, NvMSelectBlockForReadAll=true, NvMCalcRamBlockCrc=true, NvMRomBlockNum=1, NvMRomBlockDataAddress=Rte_RomBlk_NvBlock_NvBlockDescriptor_StoreAtShutdownBlock_ShutdownRomBlock, NvMResistantToChangedSw=true, NvMBlockUseCrc=false, NvMNvBlockLength=96, NvMRamBlockDataAddress=Rte_RamBlk_NvBlock_NvBlockDescriptor_StoreAtShutdownBlock_ShutdownRamBlock, NvMSelectBlockForWriteAll=true, NvMRbGenRteServicePort=false, NvMSingleBlockCallback=Rte_NvMNotifyJobFinished_CPT_NvBlock_NvBlockDescriptor_StoreAtShutdownBlock

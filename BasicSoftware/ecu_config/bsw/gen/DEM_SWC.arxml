AUTOSAR XML (schema 00047)
package /AUTOSAR_Dem/ApplicationDataTypes
  11 x app type, all with category=VALUE, compu {identical}, range raw 0..255:
    Dem_DataType_Year
    Dem_DataType_Month
    Dem_DataType_Day
    Dem_DataType_Hour
    Dem_DataType_Minute
    Dem_DataType_Second
    Dem_DataType_New_Data_Object
    Dem_DataType_Fault_occurrence_counter
    Dem_DataType_Fault_pending_counter
    Dem_DataType_Aged_counter
    Dem_DataType_Ageing_counter
package /AUTOSAR_Dem/CompuMethods
  compu method Dem_CompuMethod_New_Data_Object_HEX3: identical

AUTOSAR XML (schema 00047)
package /ETAS_BIP/EcucModuleConfigurationValuess
  module config Com: implementation-config-variant=VARIANT-PRE-COMPILE
    ComConfig
      ComTimeBase: ComTxTimeBase=0.01, ComRxTimeBase=0.01, ComGwTimeBase=0.005
      IP_ComTx_0x55_Can_Network_ETAS_Channel_CAN_Tx (ComIPdu):
        ComIPduDirection = SEND
        ComTimeout = 0.01
        ComIPduSignalProcessing = IMMEDIATE
        ComIPduType = NORMAL
        ComFirstTimeout = 0.01
        ComIPduSignalRef = S_ETAS03_Sig18_ComTx_0x55_Can_Network_ETAS_Channel_CAN_Tx
        ComIPduSignalRef = S_ETAS03_Sig16_ComTx_0x55_Can_Network_ETAS_Channel_CAN_Tx
        ComIPduSignalRef = S_ETAS03_Sig14_ComTx_0x55_Can_Network_ETAS_Channel_CAN_Tx
        ComIPduSignalRef = S_ETAS03_Sig19_ComTx_0x55_Can_Network_ETAS_Channel_CAN_Tx
        ComIPduSignalRef = S_ETAS03_Sig12_ComTx_0x55_Can_Network_ETAS_Channel_CAN_Tx
        ComIPduSignalRef = S_ETAS03_Sig17_ComTx_0x55_Can_Network_ETAS_Channel_CAN_Tx
        ComIPduSignalRef = S_ETAS03_Sig11_ComTx_0x55_Can_Network_ETAS_Channel_CAN_Tx
        ComIPduSignalRef = S_ETAS03_Sig13_ComTx_0x55_Can_Network_ETAS_Channel_CAN_Tx
        ComIPduSignalRef = S_ETAS03_Sig15_ComTx_0x55_Can_Network_ETAS_Channel_CAN_Tx
        ComIPduSignalRef = S_ETAS03_Sig10_ComTx_0x55_Can_Network_ETAS_Channel_CAN_Tx
        ComIPduGroupRef = ComIPduGroup_Tx
        ComPduIdRef = ComTx_0x55_Com2PduR_Can_Network_ETAS_Channel_CAN
        ComTxIPdu: ComTxIPduUnusedAreasDefault=255
          ComTxModeTrue
            ComTxMode: ComTxModeNumberOfRepetitions=0, ComTxModeMode=PERIODIC, ComTxModeTimeOffset=0.0, ComTxModeTimePeriod=0.01, ComTxModeRepetitionPeriod=0
          ComTxModeFalse
            ComTxMode: ComTxModeNumberOfRepetitions=0, ComTxModeMode=PERIODIC, ComTxModeTimeOffset=0.0, ComTxModeTimePeriod=0.01, ComTxModeRepetitionPeriod=0
      10 x ComSignal, all with ComSignalEndianness=BIG_ENDIAN, ComUpdateBitPosition=-1, ComTransferProperty=TRIGGERED, ComInitialValueOnly=false:
        S_ETAS03_Sig18_ComTx_0x55_Can_Network_ETAS_Channel_CAN_Tx: ComSignalType=UINT8, ComBitSize=1, ComBitPosition=13, ComSignalInitValue=0, ComSystemTemplateSystemSignalRef=ETAS03_Sig18
          ComFilter: ComFilterAlgorithm=ALWAYS, ComFilterMin=0, ComFilterMax=1, ComFilterOffset=0
        S_ETAS03_Sig16_ComTx_0x55_Can_Network_ETAS_Channel_CAN_Tx: ComSignalType=UINT8, ComBitSize=1, ComBitPosition=14, ComSignalInitValue=0, ComSystemTemplateSystemSignalRef=ETAS03_Sig16
          ComFilter: ComFilterAlgorithm=ALWAYS, ComFilterMin=0, ComFilterMax=1, ComFilterOffset=0
        S_ETAS03_Sig14_ComTx_0x55_Can_Network_ETAS_Channel_CAN_Tx: ComSignalType=UINT8, ComBitSize=1, ComBitPosition=15, ComSignalInitValue=0, ComSystemTemplateSystemSignalRef=ETAS03_Sig14
          ComFilter: ComFilterAlgorithm=ALWAYS, ComFilterMin=0, ComFilterMax=1, ComFilterOffset=0
        S_ETAS03_Sig19_ComTx_0x55_Can_Network_ETAS_Channel_CAN_Tx: ComSignalType=UINT8, ComBitSize=2, ComBitPosition=1, ComSignalInitValue=0, ComSystemTemplateSystemSignalRef=ETAS03_Sig19
          ComFilter: ComFilterAlgorithm=ALWAYS, ComFilterMin=0, ComFilterMax=3, ComFilterOffset=0
        S_ETAS03_Sig12_ComTx_0x55_Can_Network_ETAS_Channel_CAN_Tx: ComSignalType=UINT8, ComBitSize=2, ComBitPosition=3, ComSignalInitValue=0, ComSystemTemplateSystemSignalRef=ETAS03_Sig12
          ComFilter: ComFilterAlgorithm=ALWAYS, ComFilterMin=0, ComFilterMax=3, ComFilterOffset=0
        S_ETAS03_Sig17_ComTx_0x55_Can_Network_ETAS_Channel_CAN_Tx: ComSignalType=UINT8, ComBitSize=2, ComBitPosition=12, ComSignalInitValue=0, ComSystemTemplateSystemSignalRef=ETAS03_Sig17
          ComFilter: ComFilterAlgorithm=ALWAYS, ComFilterMin=0, ComFilterMax=3, ComFilterOffset=0
        S_ETAS03_Sig11_ComTx_0x55_Can_Network_ETAS_Channel_CAN_Tx: ComSignalType=UINT8, ComBitSize=4, ComBitPosition=7, ComSignalInitValue=0, ComSystemTemplateSystemSignalRef=ETAS03_Sig11
          ComFilter: ComFilterAlgorithm=ALWAYS, ComFilterMin=0, ComFilterMax=3, ComFilterOffset=0
        S_ETAS03_Sig13_ComTx_0x55_Can_Network_ETAS_Channel_CAN_Tx: ComSignalType=UINT16, ComBitSize=13, ComBitPosition=39, ComSignalInitValue=4094, ComSystemTemplateSystemSignalRef=ETAS03_Sig13
          ComFilter: ComFilterAlgorithm=NEW_IS_WITHIN, ComFilterMin=0, ComFilterMax=8189, ComFilterOffset=0
        S_ETAS03_Sig15_ComTx_0x55_Can_Network_ETAS_Channel_CAN_Tx: ComSignalType=UINT16, ComBitSize=16, ComBitPosition=23, ComSignalInitValue=32767, ComSystemTemplateSystemSignalRef=ETAS03_Sig15
          ComFilter: ComFilterAlgorithm=NEW_IS_WITHIN, ComFilterMin=0, ComFilterMax=65534, ComFilterOffset=0
        S_ETAS03_Sig10_ComTx_0x55_Can_Network_ETAS_Channel_CAN_Tx: ComSignalType=UINT8, ComBitSize=1, ComBitPosition=10, ComSignalInitValue=0, ComSystemTemplateSystemSignalRef=ETAS03_Sig10
          ComFilter: ComFilterAlgorithm=ALWAYS, ComFilterMin=0, ComFilterMax=1, ComFilterOffset=0
      IP_ComRx_0x261_Can_Network_ETAS_Channel_CAN_Rx (ComIPdu):
        ComIPduDirection = RECEIVE
        ComIPduSignalProcessing = IMMEDIATE
        ComIPduType = NORMAL
        ComIPduSignalRef = S_ETAS02_Sig09_ComRx_0x261_Can_Network_ETAS_Channel_CAN_Rx
        ComIPduGroupRef = ComIPduGroup_Rx
        ComPduIdRef = ComRx_0x261_PduR2Com_Can_Network_ETAS_Channel_CAN
      S_ETAS02_Sig09_ComRx_0x261_Can_Network_ETAS_Channel_CAN_Rx (ComSignal):
        ComNotification = Rte_COMCbk_S_ETAS02_Sig09_ComRx_0x261_Can_Network_ETAS_Channel_CAN_Rx
        ComSignalType = UINT8
        ComSignalEndianness = BIG_ENDIAN
        ComBitSize = 1
        ComUpdateBitPosition = -1
        ComTransferProperty = TRIGGERED
        ComBitPosition = 0
        ComSignalInitValue = 0
        ComTimeoutNotification = Rte_COMCbkTOut_S_ETAS02_Sig09_ComRx_0x261_Can_Network_ETAS_Channel_CAN_Rx
        ComSystemTemplateSystemSignalRef = ETAS02_Sig09
      IP_ComRx_0x81_Can_Network_ETAS_Channel_CAN_Rx (ComIPdu):
        ComIPduDirection = RECEIVE
        ComIPduSignalProcessing = IMMEDIATE
        ComIPduType = NORMAL
        ComIPduSignalRef = S_ETAS01_Sig04_ComRx_0x81_Can_Network_ETAS_Channel_CAN_Rx
        ComIPduSignalRef = S_ETAS01_Sig02_ComRx_0x81_Can_Network_ETAS_Channel_CAN_Rx
        ComIPduSignalRef = S_ETAS01_Sig03_ComRx_0x81_Can_Network_ETAS_Channel_CAN_Rx
        ComIPduSignalRef = S_ETAS01_Sig01_ComRx_0x81_Can_Network_ETAS_Channel_CAN_Rx
        ComIPduSignalRef = S_ETAS01_Sig06_ComRx_0x81_Can_Network_ETAS_Channel_CAN_Rx
        ComIPduSignalRef = S_ETAS01_Sig05_ComRx_0x81_Can_Network_ETAS_Channel_CAN_Rx
        ComIPduSignalRef = S_ETAS01_Sig07_ComRx_0x81_Can_Network_ETAS_Channel_CAN_Rx
        ComIPduSignalRef = S_ETAS01_Sig00_ComRx_0x81_Can_Network_ETAS_Channel_CAN_Rx
        ComIPduSignalRef = S_ETAS01_Sig08_ComRx_0x81_Can_Network_ETAS_Channel_CAN_Rx
        ComIPduGroupRef = ComIPduGroup_Rx
        ComPduIdRef = ComRx_0x81_PduR2Com_Can_Network_ETAS_Channel_CAN
      9 x ComSignal, all with ComSignalEndianness=BIG_ENDIAN, ComUpdateBitPosition=-1, ComTransferProperty=TRIGGERED:
        S_ETAS01_Sig04_ComRx_0x81_Can_Network_ETAS_Channel_CAN_Rx: ComNotification=Rte_COMCbk_S_ETAS01_Sig04_ComRx_0x81_Can_Network_ETAS_Channel_CAN_Rx, ComSignalType=UINT8, ComBitSize=1, ComBitPosition=36, ComSignalInitValue=0, ComTimeoutNotification=Rte_COMCbkTOut_S_ETAS01_Sig04_ComRx_0x81_Can_Network_ETAS_Channel_CAN_Rx, ComSystemTemplateSystemSignalRef=ETAS01_Sig04
        S_ETAS01_Sig02_ComRx_0x81_Can_Network_ETAS_Channel_CAN_Rx: ComNotification=Rte_COMCbk_S_ETAS01_Sig02_ComRx_0x81_Can_Network_ETAS_Channel_CAN_Rx, ComSignalType=UINT8, ComBitSize=8, ComBitPosition=63, ComSignalInitValue=0, ComTimeoutNotification=Rte_COMCbkTOut_S_ETAS01_Sig02_ComRx_0x81_Can_Network_ETAS_Channel_CAN_Rx, ComSystemTemplateSystemSignalRef=ETAS01_Sig02
        S_ETAS01_Sig03_ComRx_0x81_Can_Network_ETAS_Channel_CAN_Rx: ComNotification=Rte_COMCbk_S_ETAS01_Sig03_ComRx_0x81_Can_Network_ETAS_Channel_CAN_Rx, ComSignalType=UINT8, ComBitSize=4, ComBitPosition=51, ComSignalInitValue=0, ComTimeoutNotification=Rte_COMCbkTOut_S_ETAS01_Sig03_ComRx_0x81_Can_Network_ETAS_Channel_CAN_Rx, ComSystemTemplateSystemSignalRef=ETAS01_Sig03
        S_ETAS01_Sig01_ComRx_0x81_Can_Network_ETAS_Channel_CAN_Rx: ComNotification=Rte_COMCbk_S_ETAS01_Sig01_ComRx_0x81_Can_Network_ETAS_Channel_CAN_Rx, ComSignalType=UINT8, ComBitSize=1, ComBitPosition=37, ComSignalInitValue=0, ComTimeoutNotification=Rte_COMCbkTOut_S_ETAS01_Sig01_ComRx_0x81_Can_Network_ETAS_Channel_CAN_Rx, ComSystemTemplateSystemSignalRef=ETAS01_Sig01
        S_ETAS01_Sig06_ComRx_0x81_Can_Network_ETAS_Channel_CAN_Rx: ComNotification=Rte_COMCbk_S_ETAS01_Sig06_ComRx_0x81_Can_Network_ETAS_Channel_CAN_Rx, ComSignalType=UINT8, ComBitSize=2, ComBitPosition=39, ComSignalInitValue=0, ComTimeoutNotification=Rte_COMCbkTOut_S_ETAS01_Sig06_ComRx_0x81_Can_Network_ETAS_Channel_CAN_Rx, ComSystemTemplateSystemSignalRef=ETAS01_Sig06
        S_ETAS01_Sig05_ComRx_0x81_Can_Network_ETAS_Channel_CAN_Rx: ComNotification=Rte_COMCbk_S_ETAS01_Sig05_ComRx_0x81_Can_Network_ETAS_Channel_CAN_Rx, ComSignalType=UINT8, ComBitSize=1, ComBitPosition=24, ComSignalInitValue=0, ComTimeoutNotification=Rte_COMCbkTOut_S_ETAS01_Sig05_ComRx_0x81_Can_Network_ETAS_Channel_CAN_Rx, ComSystemTemplateSystemSignalRef=ETAS01_Sig05
        S_ETAS01_Sig07_ComRx_0x81_Can_Network_ETAS_Channel_CAN_Rx: ComNotification=Rte_COMCbk_S_ETAS01_Sig07_ComRx_0x81_Can_Network_ETAS_Channel_CAN_Rx, ComSignalType=UINT16, ComBitSize=15, ComBitPosition=23, ComSignalInitValue=16384, ComTimeoutNotification=Rte_COMCbkTOut_S_ETAS01_Sig07_ComRx_0x81_Can_Network_ETAS_Channel_CAN_Rx, ComSystemTemplateSystemSignalRef=ETAS01_Sig07
        S_ETAS01_Sig00_ComRx_0x81_Can_Network_ETAS_Channel_CAN_Rx: ComNotification=Rte_COMCbk_S_ETAS01_Sig00_ComRx_0x81_Can_Network_ETAS_Channel_CAN_Rx, ComSignalType=UINT8, ComBitSize=2, ComBitPosition=9, ComSignalInitValue=0, ComTimeoutNotification=Rte_COMCbkTOut_S_ETAS01_Sig00_ComRx_0x81_Can_Network_ETAS_Channel_CAN_Rx, ComSystemTemplateSystemSignalRef=ETAS01_Sig00
        S_ETAS01_Sig08_ComRx_0x81_Can_Network_ETAS_Channel_CAN_Rx: ComNotification=Rte_COMCbk_S_ETAS01_Sig08_ComRx_0x81_Can_Network_ETAS_Channel_CAN_Rx, ComSignalType=UINT16, ComBitSize=14, ComBitPosition=7, ComSignalInitValue=8192, ComTimeoutNotification=Rte_COMCbkTOut_S_ETAS01_Sig08_ComRx_0x81_Can_Network_ETAS_Channel_CAN_Rx, ComSystemTemplateSystemSignalRef=ETAS01_Sig08
      IP_NM_Tx_0x600_Can_Network_ETAS_Channel_CAN_Tx (ComIPdu):
        ComIPduDirection = SEND
        ComIPduSignalProcessing = IMMEDIATE
        ComIPduType = NORMAL
        ComIPduSignalRef = S_NM_Tx_Sig_NM_Tx_0x600_Can_Network_ETAS_Channel_CAN_Tx
        ComIPduGroupRef = ComIPduGroup_Tx
        ComPduIdRef = NM_Tx_0x600_Com2PduR_Can_Network_ETAS_Channel_CAN
        ComTxIPdu: ComTxIPduUnusedAreasDefault=255
          ComTxModeTrue
            ComTxMode: ComTxModeNumberOfRepetitions=0, ComTxModeMode=NONE, ComTxModeTimeOffset=0.0, ComTxModeRepetitionPeriod=0, ComTxModeTimePeriod=0.1
      S_NM_Tx_Sig_NM_Tx_0x600_Can_Network_ETAS_Channel_CAN_Tx (ComSignal):
        ComSignalType = UINT8
        ComSignalEndianness = BIG_ENDIAN
        ComBitSize = 8
        ComTransferProperty = TRIGGERED
        ComInitialValueOnly = false
        ComSignalInitValue = 0
        ComUpdateBitPosition = -1
        ComBitPosition = 23
        ComSystemTemplateSystemSignalRef = NM_Tx_Sig
      ComIPduGroup_Rx (ComIPduGroup)
      ComIPduGroup_Tx (ComIPduGroup)
      IP_ComRx_0x456_Can_Network_ETAS_Channel_CAN_Rx (ComIPdu):
        ComIPduDirection = RECEIVE
        ComIPduSignalProcessing = IMMEDIATE
        ComIPduType = NORMAL
        ComIPduSignalRef = S_ETAS06_Sig41_ComRx_0x456_Can_Network_ETAS_Channel_CAN_Rx
        ComIPduSignalRef = S_ETAS06_Sig40_ComRx_0x456_Can_Network_ETAS_Channel_CAN_Rx
        ComIPduSignalRef = S_ETAS06_Sig39_ComRx_0x456_Can_Network_ETAS_Channel_CAN_Rx
        ComIPduSignalRef = S_ETAS06_Sig38_ComRx_0x456_Can_Network_ETAS_Channel_CAN_Rx
        ComIPduSignalRef = S_ETAS06_Sig37_ComRx_0x456_Can_Network_ETAS_Channel_CAN_Rx
        ComIPduSignalRef = S_ETAS06_Sig36_ComRx_0x456_Can_Network_ETAS_Channel_CAN_Rx
        ComIPduSignalRef = S_ETAS06_Sig35_ComRx_0x456_Can_Network_ETAS_Channel_CAN_Rx
        ComIPduSignalRef = S_ETAS06_Sig34_ComRx_0x456_Can_Network_ETAS_Channel_CAN_Rx
        ComIPduGroupRef = ComIPduGroup_Rx
        ComPduIdRef = ComRx_0x456_PduR2Com_Can_Network_ETAS_Channel_CAN
      8 x ComSignal, all with ComSignalType=UINT8, ComSignalEndianness=BIG_ENDIAN, ComBitSize=8, ComUpdateBitPosition=-1, ComTransferProperty=TRIGGERED, ComSignalInitValue=0:
        S_ETAS06_Sig41_ComRx_0x456_Can_Network_ETAS_Channel_CAN_Rx: ComBitPosition=63, ComNotification=Rte_COMCbk_S_ETAS06_Sig41_ComRx_0x456_Can_Network_ETAS_Channel_CAN_Rx, ComSystemTemplateSystemSignalRef=ETAS06_Sig41
        S_ETAS06_Sig40_ComRx_0x456_Can_Network_ETAS_Channel_CAN_Rx: ComBitPosition=55, ComNotification=Rte_COMCbk_S_ETAS06_Sig40_ComRx_0x456_Can_Network_ETAS_Channel_CAN_Rx, ComSystemTemplateSystemSignalRef=ETAS06_Sig40
        S_ETAS06_Sig39_ComRx_0x456_Can_Network_ETAS_Channel_CAN_Rx: ComBitPosition=47, ComNotification=Rte_COMCbk_S_ETAS06_Sig39_ComRx_0x456_Can_Network_ETAS_Channel_CAN_Rx, ComSystemTemplateSystemSignalRef=ETAS06_Sig39
        S_ETAS06_Sig38_ComRx_0x456_Can_Network_ETAS_Channel_CAN_Rx: ComBitPosition=39, ComNotification=Rte_COMCbk_S_ETAS06_Sig38_ComRx_0x456_Can_Network_ETAS_Channel_CAN_Rx, ComSystemTemplateSystemSignalRef=ETAS06_Sig38
        S_ETAS06_Sig37_ComRx_0x456_Can_Network_ETAS_Channel_CAN_Rx: ComBitPosition=31, ComNotification=Rte_COMCbk_S_ETAS06_Sig37_ComRx_0x456_Can_Network_ETAS_Channel_CAN_Rx, ComSystemTemplateSystemSignalRef=ETAS06_Sig37
        S_ETAS06_Sig36_ComRx_0x456_Can_Network_ETAS_Channel_CAN_Rx: ComBitPosition=23, ComNotification=Rte_COMCbk_S_ETAS06_Sig36_ComRx_0x456_Can_Network_ETAS_Channel_CAN_Rx, ComSystemTemplateSystemSignalRef=ETAS06_Sig36
        S_ETAS06_Sig35_ComRx_0x456_Can_Network_ETAS_Channel_CAN_Rx: ComBitPosition=15, ComNotification=Rte_COMCbk_S_ETAS06_Sig35_ComRx_0x456_Can_Network_ETAS_Channel_CAN_Rx, ComSystemTemplateSystemSignalRef=ETAS06_Sig35
        S_ETAS06_Sig34_ComRx_0x456_Can_Network_ETAS_Channel_CAN_Rx: ComBitPosition=7, ComNotification=Rte_COMCbk_S_ETAS06_Sig34_ComRx_0x456_Can_Network_ETAS_Channel_CAN_Rx, ComSystemTemplateSystemSignalRef=ETAS06_Sig34
      IP_ComTx_0x123_Can_Network_ETAS_Channel_CAN_Tx (ComIPdu):
        ComIPduDirection = SEND
        ComTimeout = 0.1
        ComIPduSignalProcessing = IMMEDIATE
        ComIPduType = NORMAL
        ComFirstTimeout = 0.1
        ComIPduSignalRef = S_ETAS05_Sig33_ComTx_0x123_Can_Network_ETAS_Channel_CAN_Tx
        ComIPduSignalRef = S_ETAS05_Sig32_ComTx_0x123_Can_Network_ETAS_Channel_CAN_Tx
        ComIPduSignalRef = S_ETAS05_Sig31_ComTx_0x123_Can_Network_ETAS_Channel_CAN_Tx
        ComIPduSignalRef = S_ETAS05_Sig30_ComTx_0x123_Can_Network_ETAS_Channel_CAN_Tx
        ComIPduSignalRef = S_ETAS05_Sig29_ComTx_0x123_Can_Network_ETAS_Channel_CAN_Tx
        ComIPduSignalRef = S_ETAS05_Sig28_ComTx_0x123_Can_Network_ETAS_Channel_CAN_Tx
        ComIPduSignalRef = S_ETAS05_Sig27_ComTx_0x123_Can_Network_ETAS_Channel_CAN_Tx
        ComIPduSignalRef = S_ETAS05_Sig26_ComTx_0x123_Can_Network_ETAS_Channel_CAN_Tx
        ComIPduGroupRef = ComIPduGroup_Tx
        ComPduIdRef = ComTx_0x123_Com2PduR_Can_Network_ETAS_Channel_CAN
        ComTxIPdu: ComTxIPduUnusedAreasDefault=255
          ComTxModeTrue
            ComTxMode: ComTxModeNumberOfRepetitions=0, ComTxModeMode=PERIODIC, ComTxModeTimeOffset=0.0, ComTxModeTimePeriod=0.1, ComTxModeRepetitionPeriod=0
          ComTxModeFalse
            ComTxMode: ComTxModeNumberOfRepetitions=0, ComTxModeMode=PERIODIC, ComTxModeTimeOffset=0.0, ComTxModeTimePeriod=0.1, ComTxModeRepetitionPeriod=0
      8 x ComSignal, all with ComSignalType=UINT8, ComSignalEndianness=BIG_ENDIAN, ComBitSize=8, ComUpdateBitPosition=-1, ComTransferProperty=TRIGGERED, ComInitialValueOnly=false, ComSignalInitValue=0:
        S_ETAS05_Sig33_ComTx_0x123_Can_Network_ETAS_Channel_CAN_Tx: ComBitPosition=63, ComSystemTemplateSystemSignalRef=ETAS05_Sig33
          ComFilter: ComFilterAlgorithm=ALWAYS, ComFilterMin=0, ComFilterMax=0, ComFilterOffset=0
        S_ETAS05_Sig32_ComTx_0x123_Can_Network_ETAS_Channel_CAN_Tx: ComBitPosition=55, ComSystemTemplateSystemSignalRef=ETAS05_Sig32
          ComFilter: ComFilterAlgorithm=ALWAYS, ComFilterMin=0, ComFilterMax=0, ComFilterOffset=0
        S_ETAS05_Sig31_ComTx_0x123_Can_Network_ETAS_Channel_CAN_Tx: ComBitPosition=47, ComSystemTemplateSystemSignalRef=ETAS05_Sig31
          ComFilter: ComFilterAlgorithm=ALWAYS, ComFilterMin=0, ComFilterMax=0, ComFilterOffset=0
        S_ETAS05_Sig30_ComTx_0x123_Can_Network_ETAS_Channel_CAN_Tx: ComBitPosition=39, ComSystemTemplateSystemSignalRef=ETAS05_Sig30
          ComFilter: ComFilterAlgorithm=ALWAYS, ComFilterMin=0, ComFilterMax=0, ComFilterOffset=0
        S_ETAS05_Sig29_ComTx_0x123_Can_Network_ETAS_Channel_CAN_Tx: ComBitPosition=31, ComSystemTemplateSystemSignalRef=ETAS05_Sig29
          ComFilter: ComFilterAlgorithm=ALWAYS, ComFilterMin=0, ComFilterMax=0, ComFilterOffset=0
        S_ETAS05_Sig28_ComTx_0x123_Can_Network_ETAS_Channel_CAN_Tx: ComBitPosition=23, ComSystemTemplateSystemSignalRef=ETAS05_Sig28
          ComFilter: ComFilterAlgorithm=ALWAYS, ComFilterMin=0, ComFilterMax=0, ComFilterOffset=0
        S_ETAS05_Sig27_ComTx_0x123_Can_Network_ETAS_Channel_CAN_Tx: ComBitPosition=15, ComSystemTemplateSystemSignalRef=ETAS05_Sig27
          ComFilter: ComFilterAlgorithm=ALWAYS, ComFilterMin=0, ComFilterMax=0, ComFilterOffset=0
        S_ETAS05_Sig26_ComTx_0x123_Can_Network_ETAS_Channel_CAN_Tx: ComBitPosition=7, ComSystemTemplateSystemSignalRef=ETAS05_Sig26
          ComFilter: ComFilterAlgorithm=ALWAYS, ComFilterMin=0, ComFilterMax=0, ComFilterOffset=0
      IP_ComTx_0x98_Can_Network_ETAS_Channel_CAN_Tx (ComIPdu):
        ComIPduDirection = SEND
        ComTimeout = 0.05
        ComIPduSignalProcessing = IMMEDIATE
        ComIPduType = NORMAL
        ComFirstTimeout = 0.05
        ComIPduSignalRef = S_ETAS04_Sig21_ComTx_0x98_Can_Network_ETAS_Channel_CAN_Tx
        ComIPduSignalRef = S_ETAS04_Sig24_ComTx_0x98_Can_Network_ETAS_Channel_CAN_Tx
        ComIPduSignalRef = S_ETAS04_Sig25_ComTx_0x98_Can_Network_ETAS_Channel_CAN_Tx
        ComIPduSignalRef = S_ETAS04_Sig20_ComTx_0x98_Can_Network_ETAS_Channel_CAN_Tx
        ComIPduSignalRef = S_ETAS04_Sig23_ComTx_0x98_Can_Network_ETAS_Channel_CAN_Tx
        ComIPduSignalRef = S_ETAS04_Sig22_ComTx_0x98_Can_Network_ETAS_Channel_CAN_Tx
        ComIPduGroupRef = ComIPduGroup_Tx
        ComPduIdRef = ComTx_0x98_Com2PduR_Can_Network_ETAS_Channel_CAN
        ComTxIPdu: ComTxIPduUnusedAreasDefault=255
          ComTxModeTrue
            ComTxMode: ComTxModeNumberOfRepetitions=0, ComTxModeMode=PERIODIC, ComTxModeTimeOffset=0.0, ComTxModeTimePeriod=0.05, ComTxModeRepetitionPeriod=0
          ComTxModeFalse
            ComTxMode: ComTxModeNumberOfRepetitions=0, ComTxModeMode=PERIODIC, ComTxModeTimeOffset=0.0, ComTxModeTimePeriod=0.05, ComTxModeRepetitionPeriod=0
      6 x ComSignal, all with ComSignalEndianness=BIG_ENDIAN, ComUpdateBitPosition=-1, ComTransferProperty=TRIGGERED, ComInitialValueOnly=false:
        S_ETAS04_Sig21_ComTx_0x98_Can_Network_ETAS_Channel_CAN_Tx: ComSignalType=UINT8, ComBitSize=8, ComBitPosition=47, ComSignalInitValue=40, ComSystemTemplateSystemSignalRef=ETAS04_Sig21
          ComFilter: ComFilterAlgorithm=NEW_IS_WITHIN, ComFilterMin=0, ComFilterMax=254, ComFilterOffset=0
        S_ETAS04_Sig24_ComTx_0x98_Can_Network_ETAS_Channel_CAN_Tx: ComSignalType=UINT8, ComBitSize=8, ComBitPosition=55, ComSignalInitValue=40, ComSystemTemplateSystemSignalRef=ETAS04_Sig24
          ComFilter: ComFilterAlgorithm=NEW_IS_WITHIN, ComFilterMin=0, ComFilterMax=254, ComFilterOffset=0
        S_ETAS04_Sig25_ComTx_0x98_Can_Network_ETAS_Channel_CAN_Tx: ComSignalType=UINT16, ComBitSize=10, ComBitPosition=19, ComSignalInitValue=0, ComSystemTemplateSystemSignalRef=ETAS04_Sig25
          ComFilter: ComFilterAlgorithm=NEW_IS_WITHIN, ComFilterMin=0, ComFilterMax=1022, ComFilterOffset=0
        S_ETAS04_Sig20_ComTx_0x98_Can_Network_ETAS_Channel_CAN_Tx: ComSignalType=UINT16, ComBitSize=10, ComBitPosition=25, ComSignalInitValue=511, ComSystemTemplateSystemSignalRef=ETAS04_Sig20
          ComFilter: ComFilterAlgorithm=NEW_IS_WITHIN, ComFilterMin=0, ComFilterMax=1022, ComFilterOffset=0
        S_ETAS04_Sig23_ComTx_0x98_Can_Network_ETAS_Channel_CAN_Tx: ComSignalType=UINT16, ComBitSize=9, ComBitPosition=12, ComSignalInitValue=0, ComSystemTemplateSystemSignalRef=ETAS04_Sig23
          ComFilter: ComFilterAlgorithm=NEW_IS_WITHIN, ComFilterMin=0, ComFilterMax=510, ComFilterOffset=0
        S_ETAS04_Sig22_ComTx_0x98_Can_Network_ETAS_Channel_CAN_Tx: ComSignalType=UINT16, ComBitSize=11, ComBitPosition=7, ComSignalInitValue=0, ComSystemTemplateSystemSignalRef=ETAS04_Sig22
          ComFilter: ComFilterAlgorithm=NEW_IS_WITHIN, ComFilterMin=0, ComFilterMax=2046, ComFilterOffset=0
    ComGeneral:
      ComCancellationSupport = false
      ComEnableJitterFilter = false
      ComCommonIPduTxPeriodFeature = false
      ComVersionInfoApi = false
      ComEnableSignalGroupArrayApi = false
      ComConfigurationUseDet = false

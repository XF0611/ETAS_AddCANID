AUTOSAR XML (schema 00047)
package /ETAS_BIP/EcucModuleConfigurationValuess
  module config CanTp: implementation-config-variant=VARIANT-PRE-COMPILE
    CanTpConfig: CanTpMainFunctionPeriod=0.001
      CanTpChannel: CanTpChannelMode=CANTP_MODE_FULL_DUPLEX
        RX_UdsRxFnc (CanTpRxNSdu):
          CanTpRxTaType = CANTP_FUNCTIONAL
          CanTpRxAddressingFormat = CANTP_STANDARD
          CanTpSTmin = 0.002
          CanTpNcr = 1.0
          CanTpRxPaddingActivation = CANTP_ON
          CanTpRxWftMax = 0
          CanTpBs = 8
          CanTpNar = 1.0
          CanTpNbr = 0.0
          CanTpRxNSduRef = UdsRxFnc_CanTp2PduR_Can_Network_ETAS_Channel_CAN
          NPdu_UdsRxFnc_CanIf2CanTp_Can_Network_ETAS_Channel_CAN (CanTpRxNPdu): CanTpRxNPduRef=NPdu_UdsRxFnc_CanIf2CanTp_Can_Network_ETAS_Channel_CAN
        RX_UdsRxPhy (CanTpRxNSdu):
          CanTpRxTaType = CANTP_PHYSICAL
          CanTpRxAddressingFormat = CANTP_STANDARD
          CanTpSTmin = 0.002
          CanTpNcr = 1.0
          CanTpRxPaddingActivation = CANTP_ON
          CanTpRxWftMax = 0
          CanTpBs = 8
          CanTpNar = 1.0
          CanTpNbr = 0.0
          CanTpRxNSduRef = UdsRxPhy_CanTp2PduR_Can_Network_ETAS_Channel_CAN
          NPdu_UdsRxPhy_CanIf2CanTp_Can_Network_ETAS_Channel_CAN (CanTpRxNPdu): CanTpRxNPduRef=NPdu_UdsRxPhy_CanIf2CanTp_Can_Network_ETAS_Channel_CAN
          NPdu_UdsTxPhy_CanTp2CanIf_Can_Network_ETAS_Channel_CAN (CanTpTxFcNPdu): CanTpTxFcNPduRef=NPdu_UdsTxPhy_CanTp2CanIf_Can_Network_ETAS_Channel_CAN
        TX_UdsTxPhy (CanTpTxNSdu):
          CanTpTc = true
          CanTpNas = 1.0
          CanTpTxPaddingActivation = CANTP_ON
          CanTpTxAddressingFormat = CANTP_STANDARD
          CanTpTxTaType = CANTP_PHYSICAL
          CanTpNbs = 1.0
          CanTpNcs = 0.002
          CanTpTxNSduRef = UdsTxPhy_PduR2CanTp_Can_Network_ETAS_Channel_CAN
          NPdu_UdsTxPhy_CanTp2CanIf_Can_Network_ETAS_Channel_CAN (CanTpTxNPdu): CanTpTxNPduRef=NPdu_UdsTxPhy_CanTp2CanIf_Can_Network_ETAS_Channel_CAN
          NPdu_UdsRxPhy_CanIf2CanTp_Can_Network_ETAS_Channel_CAN (CanTpRxFcNPdu): CanTpRxFcNPduRef=NPdu_UdsRxPhy_CanIf2CanTp_Can_Network_ETAS_Channel_CAN
    CanTpGeneral:
      CanTpRbPageConfirmation = false
      CanTpChangeParameterApi = false
      CanTpReadParameterApi = false
      CanTpVersionInfoApi = true
      CanTpRbStrictDlcCheck = false
      CanTpPaddingByte = 0
      CanTpDevErrorDetect = true

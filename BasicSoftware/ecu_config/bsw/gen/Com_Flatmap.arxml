AUTOSAR XML (schema 4-2-2)
package /Com_FlatView
  flat map Com_FlatMap

AUTOSAR XML (schema 00047)
package /ETAS_BIP/EcucModuleConfigurationValuess
  module config Can: implementation-config-variant=VARIANT-PRE-COMPILE
    CanConfigSet
      ETAS_CAN (CanController):
        CanRxProcessing = POLLING
        CanControllerId = 0
        CanWakeupProcessing = POLLING
        CanControllerBaseAddress = 0
        CanTxProcessing = POLLING
        CanBusoffProcessing = POLLING
        CanControllerActivation = true
        CanWakeupFunctionalityAPI = false
        CanWakeupSupport = false
        CanControllerDefaultBaudrate = ETAS_CAN_BR_0
        ETAS_CAN_BR_0 (CanControllerBaudrateConfig):
          CanControllerBaudRate = 500
          CanControllerBaudRateConfigID = 1
          CanControllerSeg1 = 10
          CanControllerSyncJumpWidth = 0
          CanControllerSeg2 = 0
          CanControllerPropSeg = 0
      13 x CanHardwareObject, all with CanHandleType=FULL, CanHwObjectCount=1, CanIdType=STANDARD, CanControllerRef=ETAS_CAN:
        ETAS_CAN_Rx_Std_MailBox_1: CanObjectId=0, CanObjectType=RECEIVE
          CanHwFilter: CanHwFilterMask=2047, CanHwFilterCode=609
        ETAS_CAN_Rx_Std_MailBox_2: CanObjectId=1, CanObjectType=RECEIVE
          CanHwFilter: CanHwFilterMask=2047, CanHwFilterCode=129
        ETAS_CAN_Rx_Std_MailBox_3: CanObjectId=2, CanObjectType=RECEIVE
          CanHwFilter: CanHwFilterMask=2047, CanHwFilterCode=1655
        ETAS_CAN_Rx_Std_MailBox_4: CanObjectId=3, CanObjectType=RECEIVE
          CanHwFilter: CanHwFilterMask=2047, CanHwFilterCode=818
        ETAS_CAN_Rx_Std_MailBox_5: CanObjectId=4, CanObjectType=RECEIVE
          CanHwFilter: CanHwFilterMask=2047, CanHwFilterCode=2015
        ETAS_CAN_Rx_Std_MailBox_6: CanObjectId=5, CanObjectType=RECEIVE
          CanHwFilter: CanHwFilterMask=2047, CanHwFilterCode=1856
        ETAS_CAN_Tx_Std_MailBox_1: CanObjectType=TRANSMIT, CanObjectId=7
        ETAS_CAN_Tx_Std_MailBox_2: CanObjectType=TRANSMIT, CanObjectId=8
        ETAS_CAN_Tx_Std_MailBox_3: CanObjectType=TRANSMIT, CanObjectId=9
        ETAS_CAN_Tx_Std_MailBox_4: CanObjectType=TRANSMIT, CanObjectId=10
        ETAS_CAN_Tx_Std_MailBox_5: CanObjectType=TRANSMIT, CanObjectId=11
        ETAS_CAN_Rx_Std_MailBox_7: CanObjectId=6, CanObjectType=RECEIVE
          CanHwFilter: CanHwFilterMask=2047, CanHwFilterCode=1110
        ETAS_CAN_Tx_Std_MailBox_6: CanObjectId=12, CanObjectType=TRANSMIT
    CanGeneral:
      CanIndex = 0
      CanMultiplexedTransmission = false
      CanMainFunctionModePeriod = 0.001
      CanVersionInfoApi = false
      CanMainFunctionBusoffPeriod = 0.001
      CanPublicIcomSupport = false
      CanTimeoutDuration = 1
      CanDevErrorDetection = true

AUTOSAR XML (schema 00047)
package /ETAS_BIP/EcucModuleConfigurationValuess
  module config Nm: implementation-config-variant=VARIANT-PRE-COMPILE
    NmGlobalConfig
      NmGlobalFeatures:
        NmCoordinatorSyncSupport = false
        NmBusSynchronizationEnabled = false
        NmComControlEnabled = true
        NmComUserDataSupport = true
        NmUserDataEnabled = true
        NmNodeDetectionEnabled = true
        NmNodeIdEnabled = true
        NmCarWakeUpRxEnabled = false
        NmRemoteSleepIndEnabled = false
        NmStateChangeIndEnabled = true
        NmPassiveModeEnabled = false
        NmPduRxIndicationEnabled = true
        NmRepeatMsgIndEnabled = false
        NmCoordinatorSupportEnabled = false
      NmGlobalProperties: NmCycletimeMainFunction=0.01, NmVersionInfoApi=true, NmDevErrorDetect=true
      NmGlobalConstants:
        NmNumberOfChannels = 1
        NmRemoteSleepCancelCallback = TestNm_RemoteSleepCancellation
        NmRemoteSleepIndCallback = TestNm_RemoteSleepIndication
        NmRxIndicationCallback = Nm_RxIndicationCallback
        NmStateChangeIndCallback = Nm_StateChangeIndication
    NmChannelConfig_CanNmCluster_ETAS_CAN_1 (NmChannelConfig):
      NmActiveCoordinator = false
      NmChannelSleepMaster = false
      NmStateReportEnabled = false
      NmShutdownDelayTimer = 0.0
      NmSynchronizingNetwork = false
      NmComMChannelRef = Can_Network_ETAS_Channel_Can_Network_ETAS
      NmBusType
        NmStandardBusNmConfig: NmStandardBusType=NM_BUSNM_CANNM

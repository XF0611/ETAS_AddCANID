AUTOSAR XML (schema 4-2-2)
package /AUTOSAR_Xcp/TimingExtensions
  bsw module timing Xcp_BswModuleTiming: behavior=BswInternalBehavior
    timing-requirements:
      execution order constraint EOC_EcuM_Init: execution-order-constraint-type=ORDINARY-EOC, is-event=false, permit-multiple-references-to-ee=false
        ordered-elements:
          eoc executable entity ref EOCEERef_CE_CanIf_Init: bsw-module-instance=CanIf, executable=CE_Init, successor=EOCEERef_CE_Xcp_Init
          eoc executable entity ref EOCEERef_CE_Xcp_Init: bsw-module-instance=Xcp, executable=CE_Init

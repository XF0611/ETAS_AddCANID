[part 2 of 2: packages /AUTOSAR_Dem/SwComponentTypes to /AUTOSAR_Dem/SwcBswMappings]
AUTOSAR XML (schema 4-2-2)
package /AUTOSAR_Dem/SwComponentTypes  (continued)
  service sw component type Dem  (continued)
    behavior IntBeh_Dem: handle-termination-and-restart=NO-SUPPORT, included-data-type-set=data-type=[Dem_DTCFormatType, Dem_DTCOriginType, Dem_EventIdType, Dem_UdsStatusByteType, Dem_EventStatusType, Dem_DebugDataType, Dem_IndicatorIdType, Dem_IndicatorStatusType, Dem_InitMonitorReasonType, Dem_MaxDataValueType, Dem_OperationCycleIdType, Dem_OperationCycleStateType, Dem_DebouncingStateType, Dem_DebounceResetStatusType]
      875 x operation invoked event:
        Ev_SES_DTC_0x000001_Event: start-on-event=SetEventStatus, operation=Event_DTC_0x000001_Event.SetEventStatus
        Ev_SESWE_DTC_0x000001_Event: start-on-event=SetEventStatusWithEnvdata, operation=Event_DTC_0x000001_Event.SetEventStatusWithEnvdata
        Ev_RES_DTC_0x000001_Event: start-on-event=ResetEventStatus, operation=Event_DTC_0x000001_Event.ResetEventStatus
        Ev_CPFF_DTC_0x000001_Event: start-on-event=ClearPrestoredFreezeFrame, operation=Event_DTC_0x000001_Event.ClearPrestoredFreezeFrame
        Ev_PFF_DTC_0x000001_Event: start-on-event=PrestoreFreezeFrame, operation=Event_DTC_0x000001_Event.PrestoreFreezeFrame
        Ev_RDS_DTC_0x000001_Event: start-on-event=ResetEventDebounceStatus, operation=Event_DTC_0x000001_Event.ResetEventDebounceStatus
        Ev_SES_DTC_0xc07388_Event: start-on-event=SetEventStatus, operation=Event_DTC_0xc07388_Event.SetEventStatus
        Ev_SESWE_DTC_0xc07388_Event: start-on-event=SetEventStatusWithEnvdata, operation=Event_DTC_0xc07388_Event.SetEventStatusWithEnvdata
        Ev_RES_DTC_0xc07388_Event: start-on-event=ResetEventStatus, operation=Event_DTC_0xc07388_Event.ResetEventStatus
        Ev_CPFF_DTC_0xc07388_Event: start-on-event=ClearPrestoredFreezeFrame, operation=Event_DTC_0xc07388_Event.ClearPrestoredFreezeFrame
        Ev_PFF_DTC_0xc07388_Event: start-on-event=PrestoreFreezeFrame, operation=Event_DTC_0xc07388_Event.PrestoreFreezeFrame
        Ev_RDS_DTC_0xc07388_Event: start-on-event=ResetEventDebounceStatus, operation=Event_DTC_0xc07388_Event.ResetEventDebounceStatus
        Ev_SES_DTC_0xc12687_Event: start-on-event=SetEventStatus, operation=Event_DTC_0xc12687_Event.SetEventStatus
        Ev_SESWE_DTC_0xc12687_Event: start-on-event=SetEventStatusWithEnvdata, operation=Event_DTC_0xc12687_Event.SetEventStatusWithEnvdata
        Ev_RES_DTC_0xc12687_Event: start-on-event=ResetEventStatus, operation=Event_DTC_0xc12687_Event.ResetEventStatus
        Ev_CPFF_DTC_0xc12687_Event: start-on-event=ClearPrestoredFreezeFrame, operation=Event_DTC_0xc12687_Event.ClearPrestoredFreezeFrame
        Ev_PFF_DTC_0xc12687_Event: start-on-event=PrestoreFreezeFrame, operation=Event_DTC_0xc12687_Event.PrestoreFreezeFrame
        Ev_RDS_DTC_0xc12687_Event: start-on-event=ResetEventDebounceStatus, operation=Event_DTC_0xc12687_Event.ResetEventDebounceStatus
        Ev_SES_DTC_0xc14587_Event: start-on-event=SetEventStatus, operation=Event_DTC_0xc14587_Event.SetEventStatus
        Ev_SESWE_DTC_0xc14587_Event: start-on-event=SetEventStatusWithEnvdata, operation=Event_DTC_0xc14587_Event.SetEventStatusWithEnvdata
        Ev_RES_DTC_0xc14587_Event: start-on-event=ResetEventStatus, operation=Event_DTC_0xc14587_Event.ResetEventStatus
        Ev_CPFF_DTC_0xc14587_Event: start-on-event=ClearPrestoredFreezeFrame, operation=Event_DTC_0xc14587_Event.ClearPrestoredFreezeFrame
        Ev_PFF_DTC_0xc14587_Event: start-on-event=PrestoreFreezeFrame, operation=Event_DTC_0xc14587_Event.PrestoreFreezeFrame
        Ev_RDS_DTC_0xc14587_Event: start-on-event=ResetEventDebounceStatus, operation=Event_DTC_0xc14587_Event.ResetEventDebounceStatus
        Ev_SES_DTC_0xc22a87_Event: start-on-event=SetEventStatus, operation=Event_DTC_0xc22a87_Event.SetEventStatus
        Ev_SESWE_DTC_0xc22a87_Event: start-on-event=SetEventStatusWithEnvdata, operation=Event_DTC_0xc22a87_Event.SetEventStatusWithEnvdata
        Ev_RES_DTC_0xc22a87_Event: start-on-event=ResetEventStatus, operation=Event_DTC_0xc22a87_Event.ResetEventStatus
        Ev_CPFF_DTC_0xc22a87_Event: start-on-event=ClearPrestoredFreezeFrame, operation=Event_DTC_0xc22a87_Event.ClearPrestoredFreezeFrame
        Ev_PFF_DTC_0xc22a87_Event: start-on-event=PrestoreFreezeFrame, operation=Event_DTC_0xc22a87_Event.PrestoreFreezeFrame
        Ev_RDS_DTC_0xc22a87_Event: start-on-event=ResetEventDebounceStatus, operation=Event_DTC_0xc22a87_Event.ResetEventDebounceStatus
        Ev_SES_DTC_0xc41487_Event: start-on-event=SetEventStatus, operation=Event_DTC_0xc41487_Event.SetEventStatus
        Ev_SESWE_DTC_0xc41487_Event: start-on-event=SetEventStatusWithEnvdata, operation=Event_DTC_0xc41487_Event.SetEventStatusWithEnvdata
        Ev_RES_DTC_0xc41487_Event: start-on-event=ResetEventStatus, operation=Event_DTC_0xc41487_Event.ResetEventStatus
        Ev_CPFF_DTC_0xc41487_Event: start-on-event=ClearPrestoredFreezeFrame, operation=Event_DTC_0xc41487_Event.ClearPrestoredFreezeFrame
        Ev_PFF_DTC_0xc41487_Event: start-on-event=PrestoreFreezeFrame, operation=Event_DTC_0xc41487_Event.PrestoreFreezeFrame
        Ev_RDS_DTC_0xc41487_Event: start-on-event=ResetEventDebounceStatus, operation=Event_DTC_0xc41487_Event.ResetEventDebounceStatus
        Ev_SES_DTC_0xd56217_Event: start-on-event=SetEventStatus, operation=Event_DTC_0xd56217_Event.SetEventStatus
        Ev_SESWE_DTC_0xd56217_Event: start-on-event=SetEventStatusWithEnvdata, operation=Event_DTC_0xd56217_Event.SetEventStatusWithEnvdata
        Ev_RES_DTC_0xd56217_Event: start-on-event=ResetEventStatus, operation=Event_DTC_0xd56217_Event.ResetEventStatus
        Ev_CPFF_DTC_0xd56217_Event: start-on-event=ClearPrestoredFreezeFrame, operation=Event_DTC_0xd56217_Event.ClearPrestoredFreezeFrame
        Ev_PFF_DTC_0xd56217_Event: start-on-event=PrestoreFreezeFrame, operation=Event_DTC_0xd56217_Event.PrestoreFreezeFrame
        Ev_RDS_DTC_0xd56217_Event: start-on-event=ResetEventDebounceStatus, operation=Event_DTC_0xd56217_Event.ResetEventDebounceStatus
        Ev_SES_DTC_0xd56316_Event: start-on-event=SetEventStatus, operation=Event_DTC_0xd56316_Event.SetEventStatus
        Ev_SESWE_DTC_0xd56316_Event: start-on-event=SetEventStatusWithEnvdata, operation=Event_DTC_0xd56316_Event.SetEventStatusWithEnvdata
        Ev_RES_DTC_0xd56316_Event: start-on-event=ResetEventStatus, operation=Event_DTC_0xd56316_Event.ResetEventStatus
        Ev_CPFF_DTC_0xd56316_Event: start-on-event=ClearPrestoredFreezeFrame, operation=Event_DTC_0xd56316_Event.ClearPrestoredFreezeFrame
        Ev_PFF_DTC_0xd56316_Event: start-on-event=PrestoreFreezeFrame, operation=Event_DTC_0xd56316_Event.PrestoreFreezeFrame
        Ev_RDS_DTC_0xd56316_Event: start-on-event=ResetEventDebounceStatus, operation=Event_DTC_0xd56316_Event.ResetEventDebounceStatus
        Ev_SES_DTC_0xe00141_Event: start-on-event=SetEventStatus, operation=Event_DTC_0xe00141_Event.SetEventStatus
        Ev_SESWE_DTC_0xe00141_Event: start-on-event=SetEventStatusWithEnvdata, operation=Event_DTC_0xe00141_Event.SetEventStatusWithEnvdata
        Ev_RES_DTC_0xe00141_Event: start-on-event=ResetEventStatus, operation=Event_DTC_0xe00141_Event.ResetEventStatus
        Ev_CPFF_DTC_0xe00141_Event: start-on-event=ClearPrestoredFreezeFrame, operation=Event_DTC_0xe00141_Event.ClearPrestoredFreezeFrame
        Ev_PFF_DTC_0xe00141_Event: start-on-event=PrestoreFreezeFrame, operation=Event_DTC_0xe00141_Event.PrestoreFreezeFrame
        Ev_RDS_DTC_0xe00141_Event: start-on-event=ResetEventDebounceStatus, operation=Event_DTC_0xe00141_Event.ResetEventDebounceStatus
        Ev_SES_DTC_0xe00142_Event: start-on-event=SetEventStatus, operation=Event_DTC_0xe00142_Event.SetEventStatus
        Ev_SESWE_DTC_0xe00142_Event: start-on-event=SetEventStatusWithEnvdata, operation=Event_DTC_0xe00142_Event.SetEventStatusWithEnvdata
        Ev_RES_DTC_0xe00142_Event: start-on-event=ResetEventStatus, operation=Event_DTC_0xe00142_Event.ResetEventStatus
        Ev_CPFF_DTC_0xe00142_Event: start-on-event=ClearPrestoredFreezeFrame, operation=Event_DTC_0xe00142_Event.ClearPrestoredFreezeFrame
        Ev_PFF_DTC_0xe00142_Event: start-on-event=PrestoreFreezeFrame, operation=Event_DTC_0xe00142_Event.PrestoreFreezeFrame
        Ev_RDS_DTC_0xe00142_Event: start-on-event=ResetEventDebounceStatus, operation=Event_DTC_0xe00142_Event.ResetEventDebounceStatus
        Ev_SES_DTC_0xe26200_Event: start-on-event=SetEventStatus, operation=Event_DTC_0xe26200_Event.SetEventStatus
        Ev_SESWE_DTC_0xe26200_Event: start-on-event=SetEventStatusWithEnvdata, operation=Event_DTC_0xe26200_Event.SetEventStatusWithEnvdata
        Ev_RES_DTC_0xe26200_Event: start-on-event=ResetEventStatus, operation=Event_DTC_0xe26200_Event.ResetEventStatus
        Ev_CPFF_DTC_0xe26200_Event: start-on-event=ClearPrestoredFreezeFrame, operation=Event_DTC_0xe26200_Event.ClearPrestoredFreezeFrame
        Ev_PFF_DTC_0xe26200_Event: start-on-event=PrestoreFreezeFrame, operation=Event_DTC_0xe26200_Event.PrestoreFreezeFrame
        Ev_RDS_DTC_0xe26200_Event: start-on-event=ResetEventDebounceStatus, operation=Event_DTC_0xe26200_Event.ResetEventDebounceStatus
        Ev_GES_ADC_E_WRITEVERIFY_FAILURE: start-on-event=GetEventStatus, operation=EvtInfo_ADC_E_WRITEVERIFY_FAILURE.GetEventStatus
        Ev_GEF_ADC_E_WRITEVERIFY_FAILURE: start-on-event=GetEventFailed, operation=EvtInfo_ADC_E_WRITEVERIFY_FAILURE.GetEventFailed
        Ev_GET_ADC_E_WRITEVERIFY_FAILURE: start-on-event=GetEventTested, operation=EvtInfo_ADC_E_WRITEVERIFY_FAILURE.GetEventTested
        Ev_GDOE_ADC_E_WRITEVERIFY_FAILURE: start-on-event=GetDTCOfEvent, operation=EvtInfo_ADC_E_WRITEVERIFY_FAILURE.GetDTCOfEvent
        Ev_GETDOE_ADC_E_WRITEVERIFY_FAILURE: start-on-event=GetDebouncingOfEvent, operation=EvtInfo_ADC_E_WRITEVERIFY_FAILURE.GetDebouncingOfEvent
        Ev_GFDC_ADC_E_WRITEVERIFY_FAILURE: start-on-event=GetFaultDetectionCounter, operation=EvtInfo_ADC_E_WRITEVERIFY_FAILURE.GetFaultDetectionCounter
        Ev_GEED_ADC_E_WRITEVERIFY_FAILURE: start-on-event=GetEventExtendedDataRecord, operation=EvtInfo_ADC_E_WRITEVERIFY_FAILURE.GetEventExtendedDataRecord
        Ev_GEEDR_ADC_E_WRITEVERIFY_FAILURE: start-on-event=GetEventExtendedDataRecordEx, operation=EvtInfo_ADC_E_WRITEVERIFY_FAILURE.GetEventExtendedDataRecordEx
        Ev_GEFFD_ADC_E_WRITEVERIFY_FAILURE: start-on-event=GetEventFreezeFrameData, operation=EvtInfo_ADC_E_WRITEVERIFY_FAILURE.GetEventFreezeFrameData
        Ev_GEFFDE_ADC_E_WRITEVERIFY_FAILURE: start-on-event=GetEventFreezeFrameDataEx, operation=EvtInfo_ADC_E_WRITEVERIFY_FAILURE.GetEventFreezeFrameDataEx
        Ev_GES_CAN_E_TIMEOUT_FAILURE: start-on-event=GetEventStatus, operation=EvtInfo_CAN_E_TIMEOUT_FAILURE.GetEventStatus
        Ev_GEF_CAN_E_TIMEOUT_FAILURE: start-on-event=GetEventFailed, operation=EvtInfo_CAN_E_TIMEOUT_FAILURE.GetEventFailed
        Ev_GET_CAN_E_TIMEOUT_FAILURE: start-on-event=GetEventTested, operation=EvtInfo_CAN_E_TIMEOUT_FAILURE.GetEventTested
        Ev_GDOE_CAN_E_TIMEOUT_FAILURE: start-on-event=GetDTCOfEvent, operation=EvtInfo_CAN_E_TIMEOUT_FAILURE.GetDTCOfEvent
        Ev_GETDOE_CAN_E_TIMEOUT_FAILURE: start-on-event=GetDebouncingOfEvent, operation=EvtInfo_CAN_E_TIMEOUT_FAILURE.GetDebouncingOfEvent
        Ev_GFDC_CAN_E_TIMEOUT_FAILURE: start-on-event=GetFaultDetectionCounter, operation=EvtInfo_CAN_E_TIMEOUT_FAILURE.GetFaultDetectionCounter
        Ev_GEED_CAN_E_TIMEOUT_FAILURE: start-on-event=GetEventExtendedDataRecord, operation=EvtInfo_CAN_E_TIMEOUT_FAILURE.GetEventExtendedDataRecord
        Ev_GEEDR_CAN_E_TIMEOUT_FAILURE: start-on-event=GetEventExtendedDataRecordEx, operation=EvtInfo_CAN_E_TIMEOUT_FAILURE.GetEventExtendedDataRecordEx
        Ev_GEFFD_CAN_E_TIMEOUT_FAILURE: start-on-event=GetEventFreezeFrameData, operation=EvtInfo_CAN_E_TIMEOUT_FAILURE.GetEventFreezeFrameData
        Ev_GEFFDE_CAN_E_TIMEOUT_FAILURE: start-on-event=GetEventFreezeFrameDataEx, operation=EvtInfo_CAN_E_TIMEOUT_FAILURE.GetEventFreezeFrameDataEx
        Ev_GES_CAN_E_UNINTENDED_INTERRUPT: start-on-event=GetEventStatus, operation=EvtInfo_CAN_E_UNINTENDED_INTERRUPT.GetEventStatus
        Ev_GEF_CAN_E_UNINTENDED_INTERRUPT: start-on-event=GetEventFailed, operation=EvtInfo_CAN_E_UNINTENDED_INTERRUPT.GetEventFailed
        Ev_GET_CAN_E_UNINTENDED_INTERRUPT: start-on-event=GetEventTested, operation=EvtInfo_CAN_E_UNINTENDED_INTERRUPT.GetEventTested
        Ev_GDOE_CAN_E_UNINTENDED_INTERRUPT: start-on-event=GetDTCOfEvent, operation=EvtInfo_CAN_E_UNINTENDED_INTERRUPT.GetDTCOfEvent
        Ev_GETDOE_CAN_E_UNINTENDED_INTERRUPT: start-on-event=GetDebouncingOfEvent, operation=EvtInfo_CAN_E_UNINTENDED_INTERRUPT.GetDebouncingOfEvent
        Ev_GFDC_CAN_E_UNINTENDED_INTERRUPT: start-on-event=GetFaultDetectionCounter, operation=EvtInfo_CAN_E_UNINTENDED_INTERRUPT.GetFaultDetectionCounter
        Ev_GEED_CAN_E_UNINTENDED_INTERRUPT: start-on-event=GetEventExtendedDataRecord, operation=EvtInfo_CAN_E_UNINTENDED_INTERRUPT.GetEventExtendedDataRecord
        Ev_GEEDR_CAN_E_UNINTENDED_INTERRUPT: start-on-event=GetEventExtendedDataRecordEx, operation=EvtInfo_CAN_E_UNINTENDED_INTERRUPT.GetEventExtendedDataRecordEx
        Ev_GEFFD_CAN_E_UNINTENDED_INTERRUPT: start-on-event=GetEventFreezeFrameData, operation=EvtInfo_CAN_E_UNINTENDED_INTERRUPT.GetEventFreezeFrameData
        Ev_GEFFDE_CAN_E_UNINTENDED_INTERRUPT: start-on-event=GetEventFreezeFrameDataEx, operation=EvtInfo_CAN_E_UNINTENDED_INTERRUPT.GetEventFreezeFrameDataEx
        Ev_GES_DIO_E_GET_CONTROL_FAILURE: start-on-event=GetEventStatus, operation=EvtInfo_DIO_E_GET_CONTROL_FAILURE.GetEventStatus
        Ev_GEF_DIO_E_GET_CONTROL_FAILURE: start-on-event=GetEventFailed, operation=EvtInfo_DIO_E_GET_CONTROL_FAILURE.GetEventFailed
        Ev_GET_DIO_E_GET_CONTROL_FAILURE: start-on-event=GetEventTested, operation=EvtInfo_DIO_E_GET_CONTROL_FAILURE.GetEventTested
        Ev_GDOE_DIO_E_GET_CONTROL_FAILURE: start-on-event=GetDTCOfEvent, operation=EvtInfo_DIO_E_GET_CONTROL_FAILURE.GetDTCOfEvent
        Ev_GETDOE_DIO_E_GET_CONTROL_FAILURE: start-on-event=GetDebouncingOfEvent, operation=EvtInfo_DIO_E_GET_CONTROL_FAILURE.GetDebouncingOfEvent
        Ev_GFDC_DIO_E_GET_CONTROL_FAILURE: start-on-event=GetFaultDetectionCounter, operation=EvtInfo_DIO_E_GET_CONTROL_FAILURE.GetFaultDetectionCounter
        Ev_GEED_DIO_E_GET_CONTROL_FAILURE: start-on-event=GetEventExtendedDataRecord, operation=EvtInfo_DIO_E_GET_CONTROL_FAILURE.GetEventExtendedDataRecord
        Ev_GEEDR_DIO_E_GET_CONTROL_FAILURE: start-on-event=GetEventExtendedDataRecordEx, operation=EvtInfo_DIO_E_GET_CONTROL_FAILURE.GetEventExtendedDataRecordEx
        Ev_GEFFD_DIO_E_GET_CONTROL_FAILURE: start-on-event=GetEventFreezeFrameData, operation=EvtInfo_DIO_E_GET_CONTROL_FAILURE.GetEventFreezeFrameData
        Ev_GEFFDE_DIO_E_GET_CONTROL_FAILURE: start-on-event=GetEventFreezeFrameDataEx, operation=EvtInfo_DIO_E_GET_CONTROL_FAILURE.GetEventFreezeFrameDataEx
        Ev_GES_DTC_0x000001_Event: start-on-event=GetEventStatus, operation=EvtInfo_DTC_0x000001_Event.GetEventStatus
        Ev_GEF_DTC_0x000001_Event: start-on-event=GetEventFailed, operation=EvtInfo_DTC_0x000001_Event.GetEventFailed
        Ev_GET_DTC_0x000001_Event: start-on-event=GetEventTested, operation=EvtInfo_DTC_0x000001_Event.GetEventTested
        Ev_GDOE_DTC_0x000001_Event: start-on-event=GetDTCOfEvent, operation=EvtInfo_DTC_0x000001_Event.GetDTCOfEvent
        Ev_GETDOE_DTC_0x000001_Event: start-on-event=GetDebouncingOfEvent, operation=EvtInfo_DTC_0x000001_Event.GetDebouncingOfEvent
        Ev_GFDC_DTC_0x000001_Event: start-on-event=GetFaultDetectionCounter, operation=EvtInfo_DTC_0x000001_Event.GetFaultDetectionCounter
        Ev_GEED_DTC_0x000001_Event: start-on-event=GetEventExtendedDataRecord, operation=EvtInfo_DTC_0x000001_Event.GetEventExtendedDataRecord
        Ev_GEEDR_DTC_0x000001_Event: start-on-event=GetEventExtendedDataRecordEx, operation=EvtInfo_DTC_0x000001_Event.GetEventExtendedDataRecordEx
        Ev_GEFFD_DTC_0x000001_Event: start-on-event=GetEventFreezeFrameData, operation=EvtInfo_DTC_0x000001_Event.GetEventFreezeFrameData
        Ev_GEFFDE_DTC_0x000001_Event: start-on-event=GetEventFreezeFrameDataEx, operation=EvtInfo_DTC_0x000001_Event.GetEventFreezeFrameDataEx
        Ev_GES_DTC_0x0d0400_CAN_Network_ETAS_BusOff_Event: start-on-event=GetEventStatus, operation=EvtInfo_DTC_0x0d0400_CAN_Network_ETAS_BusOff_Event.GetEventStatus
        Ev_GEF_DTC_0x0d0400_CAN_Network_ETAS_BusOff_Event: start-on-event=GetEventFailed, operation=EvtInfo_DTC_0x0d0400_CAN_Network_ETAS_BusOff_Event.GetEventFailed
        Ev_GET_DTC_0x0d0400_CAN_Network_ETAS_BusOff_Event: start-on-event=GetEventTested, operation=EvtInfo_DTC_0x0d0400_CAN_Network_ETAS_BusOff_Event.GetEventTested
        Ev_GDOE_DTC_0x0d0400_CAN_Network_ETAS_BusOff_Event: start-on-event=GetDTCOfEvent, operation=EvtInfo_DTC_0x0d0400_CAN_Network_ETAS_BusOff_Event.GetDTCOfEvent
        Ev_GETDOE_DTC_0x0d0400_CAN_Network_ETAS_BusOff_Event: start-on-event=GetDebouncingOfEvent, operation=EvtInfo_DTC_0x0d0400_CAN_Network_ETAS_BusOff_Event.GetDebouncingOfEvent
        Ev_GFDC_DTC_0x0d0400_CAN_Network_ETAS_BusOff_Event: start-on-event=GetFaultDetectionCounter, operation=EvtInfo_DTC_0x0d0400_CAN_Network_ETAS_BusOff_Event.GetFaultDetectionCounter
        Ev_GEED_DTC_0x0d0400_CAN_Network_ETAS_BusOff_Event: start-on-event=GetEventExtendedDataRecord, operation=EvtInfo_DTC_0x0d0400_CAN_Network_ETAS_BusOff_Event.GetEventExtendedDataRecord
        Ev_GEEDR_DTC_0x0d0400_CAN_Network_ETAS_BusOff_Event: start-on-event=GetEventExtendedDataRecordEx, operation=EvtInfo_DTC_0x0d0400_CAN_Network_ETAS_BusOff_Event.GetEventExtendedDataRecordEx
        Ev_GEFFD_DTC_0x0d0400_CAN_Network_ETAS_BusOff_Event: start-on-event=GetEventFreezeFrameData, operation=EvtInfo_DTC_0x0d0400_CAN_Network_ETAS_BusOff_Event.GetEventFreezeFrameData
        Ev_GEFFDE_DTC_0x0d0400_CAN_Network_ETAS_BusOff_Event: start-on-event=GetEventFreezeFrameDataEx, operation=EvtInfo_DTC_0x0d0400_CAN_Network_ETAS_BusOff_Event.GetEventFreezeFrameDataEx
        Ev_GES_DTC_0xc07388_Event: start-on-event=GetEventStatus, operation=EvtInfo_DTC_0xc07388_Event.GetEventStatus
        Ev_GEF_DTC_0xc07388_Event: start-on-event=GetEventFailed, operation=EvtInfo_DTC_0xc07388_Event.GetEventFailed
        Ev_GET_DTC_0xc07388_Event: start-on-event=GetEventTested, operation=EvtInfo_DTC_0xc07388_Event.GetEventTested
        Ev_GDOE_DTC_0xc07388_Event: start-on-event=GetDTCOfEvent, operation=EvtInfo_DTC_0xc07388_Event.GetDTCOfEvent
        Ev_GETDOE_DTC_0xc07388_Event: start-on-event=GetDebouncingOfEvent, operation=EvtInfo_DTC_0xc07388_Event.GetDebouncingOfEvent
        Ev_GFDC_DTC_0xc07388_Event: start-on-event=GetFaultDetectionCounter, operation=EvtInfo_DTC_0xc07388_Event.GetFaultDetectionCounter
        Ev_GEED_DTC_0xc07388_Event: start-on-event=GetEventExtendedDataRecord, operation=EvtInfo_DTC_0xc07388_Event.GetEventExtendedDataRecord
        Ev_GEEDR_DTC_0xc07388_Event: start-on-event=GetEventExtendedDataRecordEx, operation=EvtInfo_DTC_0xc07388_Event.GetEventExtendedDataRecordEx
        Ev_GEFFD_DTC_0xc07388_Event: start-on-event=GetEventFreezeFrameData, operation=EvtInfo_DTC_0xc07388_Event.GetEventFreezeFrameData
        Ev_GEFFDE_DTC_0xc07388_Event: start-on-event=GetEventFreezeFrameDataEx, operation=EvtInfo_DTC_0xc07388_Event.GetEventFreezeFrameDataEx
        Ev_GES_DTC_0xc12687_Event: start-on-event=GetEventStatus, operation=EvtInfo_DTC_0xc12687_Event.GetEventStatus
        Ev_GEF_DTC_0xc12687_Event: start-on-event=GetEventFailed, operation=EvtInfo_DTC_0xc12687_Event.GetEventFailed
        Ev_GET_DTC_0xc12687_Event: start-on-event=GetEventTested, operation=EvtInfo_DTC_0xc12687_Event.GetEventTested
        Ev_GDOE_DTC_0xc12687_Event: start-on-event=GetDTCOfEvent, operation=EvtInfo_DTC_0xc12687_Event.GetDTCOfEvent
        Ev_GETDOE_DTC_0xc12687_Event: start-on-event=GetDebouncingOfEvent, operation=EvtInfo_DTC_0xc12687_Event.GetDebouncingOfEvent
        Ev_GFDC_DTC_0xc12687_Event: start-on-event=GetFaultDetectionCounter, operation=EvtInfo_DTC_0xc12687_Event.GetFaultDetectionCounter
        Ev_GEED_DTC_0xc12687_Event: start-on-event=GetEventExtendedDataRecord, operation=EvtInfo_DTC_0xc12687_Event.GetEventExtendedDataRecord
        Ev_GEEDR_DTC_0xc12687_Event: start-on-event=GetEventExtendedDataRecordEx, operation=EvtInfo_DTC_0xc12687_Event.GetEventExtendedDataRecordEx
        Ev_GEFFD_DTC_0xc12687_Event: start-on-event=GetEventFreezeFrameData, operation=EvtInfo_DTC_0xc12687_Event.GetEventFreezeFrameData
        Ev_GEFFDE_DTC_0xc12687_Event: start-on-event=GetEventFreezeFrameDataEx, operation=EvtInfo_DTC_0xc12687_Event.GetEventFreezeFrameDataEx
        Ev_GES_DTC_0xc14587_Event: start-on-event=GetEventStatus, operation=EvtInfo_DTC_0xc14587_Event.GetEventStatus
        Ev_GEF_DTC_0xc14587_Event: start-on-event=GetEventFailed, operation=EvtInfo_DTC_0xc14587_Event.GetEventFailed
        Ev_GET_DTC_0xc14587_Event: start-on-event=GetEventTested, operation=EvtInfo_DTC_0xc14587_Event.GetEventTested
        Ev_GDOE_DTC_0xc14587_Event: start-on-event=GetDTCOfEvent, operation=EvtInfo_DTC_0xc14587_Event.GetDTCOfEvent
        Ev_GETDOE_DTC_0xc14587_Event: start-on-event=GetDebouncingOfEvent, operation=EvtInfo_DTC_0xc14587_Event.GetDebouncingOfEvent
        Ev_GFDC_DTC_0xc14587_Event: start-on-event=GetFaultDetectionCounter, operation=EvtInfo_DTC_0xc14587_Event.GetFaultDetectionCounter
        Ev_GEED_DTC_0xc14587_Event: start-on-event=GetEventExtendedDataRecord, operation=EvtInfo_DTC_0xc14587_Event.GetEventExtendedDataRecord
        Ev_GEEDR_DTC_0xc14587_Event: start-on-event=GetEventExtendedDataRecordEx, operation=EvtInfo_DTC_0xc14587_Event.GetEventExtendedDataRecordEx
        Ev_GEFFD_DTC_0xc14587_Event: start-on-event=GetEventFreezeFrameData, operation=EvtInfo_DTC_0xc14587_Event.GetEventFreezeFrameData
        Ev_GEFFDE_DTC_0xc14587_Event: start-on-event=GetEventFreezeFrameDataEx, operation=EvtInfo_DTC_0xc14587_Event.GetEventFreezeFrameDataEx
        Ev_GES_DTC_0xc22a87_Event: start-on-event=GetEventStatus, operation=EvtInfo_DTC_0xc22a87_Event.GetEventStatus
        Ev_GEF_DTC_0xc22a87_Event: start-on-event=GetEventFailed, operation=EvtInfo_DTC_0xc22a87_Event.GetEventFailed
        Ev_GET_DTC_0xc22a87_Event: start-on-event=GetEventTested, operation=EvtInfo_DTC_0xc22a87_Event.GetEventTested
        Ev_GDOE_DTC_0xc22a87_Event: start-on-event=GetDTCOfEvent, operation=EvtInfo_DTC_0xc22a87_Event.GetDTCOfEvent
        Ev_GETDOE_DTC_0xc22a87_Event: start-on-event=GetDebouncingOfEvent, operation=EvtInfo_DTC_0xc22a87_Event.GetDebouncingOfEvent
        Ev_GFDC_DTC_0xc22a87_Event: start-on-event=GetFaultDetectionCounter, operation=EvtInfo_DTC_0xc22a87_Event.GetFaultDetectionCounter
        Ev_GEED_DTC_0xc22a87_Event: start-on-event=GetEventExtendedDataRecord, operation=EvtInfo_DTC_0xc22a87_Event.GetEventExtendedDataRecord
        Ev_GEEDR_DTC_0xc22a87_Event: start-on-event=GetEventExtendedDataRecordEx, operation=EvtInfo_DTC_0xc22a87_Event.GetEventExtendedDataRecordEx
        Ev_GEFFD_DTC_0xc22a87_Event: start-on-event=GetEventFreezeFrameData, operation=EvtInfo_DTC_0xc22a87_Event.GetEventFreezeFrameData
        Ev_GEFFDE_DTC_0xc22a87_Event: start-on-event=GetEventFreezeFrameDataEx, operation=EvtInfo_DTC_0xc22a87_Event.GetEventFreezeFrameDataEx
        Ev_GES_DTC_0xc41487_Event: start-on-event=GetEventStatus, operation=EvtInfo_DTC_0xc41487_Event.GetEventStatus
        Ev_GEF_DTC_0xc41487_Event: start-on-event=GetEventFailed, operation=EvtInfo_DTC_0xc41487_Event.GetEventFailed
        Ev_GET_DTC_0xc41487_Event: start-on-event=GetEventTested, operation=EvtInfo_DTC_0xc41487_Event.GetEventTested
        Ev_GDOE_DTC_0xc41487_Event: start-on-event=GetDTCOfEvent, operation=EvtInfo_DTC_0xc41487_Event.GetDTCOfEvent
        Ev_GETDOE_DTC_0xc41487_Event: start-on-event=GetDebouncingOfEvent, operation=EvtInfo_DTC_0xc41487_Event.GetDebouncingOfEvent
        Ev_GFDC_DTC_0xc41487_Event: start-on-event=GetFaultDetectionCounter, operation=EvtInfo_DTC_0xc41487_Event.GetFaultDetectionCounter
        Ev_GEED_DTC_0xc41487_Event: start-on-event=GetEventExtendedDataRecord, operation=EvtInfo_DTC_0xc41487_Event.GetEventExtendedDataRecord
        Ev_GEEDR_DTC_0xc41487_Event: start-on-event=GetEventExtendedDataRecordEx, operation=EvtInfo_DTC_0xc41487_Event.GetEventExtendedDataRecordEx
        Ev_GEFFD_DTC_0xc41487_Event: start-on-event=GetEventFreezeFrameData, operation=EvtInfo_DTC_0xc41487_Event.GetEventFreezeFrameData
        Ev_GEFFDE_DTC_0xc41487_Event: start-on-event=GetEventFreezeFrameDataEx, operation=EvtInfo_DTC_0xc41487_Event.GetEventFreezeFrameDataEx
        Ev_GES_DTC_0xd56217_Event: start-on-event=GetEventStatus, operation=EvtInfo_DTC_0xd56217_Event.GetEventStatus
        Ev_GEF_DTC_0xd56217_Event: start-on-event=GetEventFailed, operation=EvtInfo_DTC_0xd56217_Event.GetEventFailed
        Ev_GET_DTC_0xd56217_Event: start-on-event=GetEventTested, operation=EvtInfo_DTC_0xd56217_Event.GetEventTested
        Ev_GDOE_DTC_0xd56217_Event: start-on-event=GetDTCOfEvent, operation=EvtInfo_DTC_0xd56217_Event.GetDTCOfEvent
        Ev_GETDOE_DTC_0xd56217_Event: start-on-event=GetDebouncingOfEvent, operation=EvtInfo_DTC_0xd56217_Event.GetDebouncingOfEvent
        Ev_GFDC_DTC_0xd56217_Event: start-on-event=GetFaultDetectionCounter, operation=EvtInfo_DTC_0xd56217_Event.GetFaultDetectionCounter
        Ev_GEED_DTC_0xd56217_Event: start-on-event=GetEventExtendedDataRecord, operation=EvtInfo_DTC_0xd56217_Event.GetEventExtendedDataRecord
        Ev_GEEDR_DTC_0xd56217_Event: start-on-event=GetEventExtendedDataRecordEx, operation=EvtInfo_DTC_0xd56217_Event.GetEventExtendedDataRecordEx
        Ev_GEFFD_DTC_0xd56217_Event: start-on-event=GetEventFreezeFrameData, operation=EvtInfo_DTC_0xd56217_Event.GetEventFreezeFrameData
        Ev_GEFFDE_DTC_0xd56217_Event: start-on-event=GetEventFreezeFrameDataEx, operation=EvtInfo_DTC_0xd56217_Event.GetEventFreezeFrameDataEx
        Ev_GES_DTC_0xd56316_Event: start-on-event=GetEventStatus, operation=EvtInfo_DTC_0xd56316_Event.GetEventStatus
        Ev_GEF_DTC_0xd56316_Event: start-on-event=GetEventFailed, operation=EvtInfo_DTC_0xd56316_Event.GetEventFailed
        Ev_GET_DTC_0xd56316_Event: start-on-event=GetEventTested, operation=EvtInfo_DTC_0xd56316_Event.GetEventTested
        Ev_GDOE_DTC_0xd56316_Event: start-on-event=GetDTCOfEvent, operation=EvtInfo_DTC_0xd56316_Event.GetDTCOfEvent
        Ev_GETDOE_DTC_0xd56316_Event: start-on-event=GetDebouncingOfEvent, operation=EvtInfo_DTC_0xd56316_Event.GetDebouncingOfEvent
        Ev_GFDC_DTC_0xd56316_Event: start-on-event=GetFaultDetectionCounter, operation=EvtInfo_DTC_0xd56316_Event.GetFaultDetectionCounter
        Ev_GEED_DTC_0xd56316_Event: start-on-event=GetEventExtendedDataRecord, operation=EvtInfo_DTC_0xd56316_Event.GetEventExtendedDataRecord
        Ev_GEEDR_DTC_0xd56316_Event: start-on-event=GetEventExtendedDataRecordEx, operation=EvtInfo_DTC_0xd56316_Event.GetEventExtendedDataRecordEx
        Ev_GEFFD_DTC_0xd56316_Event: start-on-event=GetEventFreezeFrameData, operation=EvtInfo_DTC_0xd56316_Event.GetEventFreezeFrameData
        Ev_GEFFDE_DTC_0xd56316_Event: start-on-event=GetEventFreezeFrameDataEx, operation=EvtInfo_DTC_0xd56316_Event.GetEventFreezeFrameDataEx
        Ev_GES_DTC_0xe00141_Event: start-on-event=GetEventStatus, operation=EvtInfo_DTC_0xe00141_Event.GetEventStatus
        Ev_GEF_DTC_0xe00141_Event: start-on-event=GetEventFailed, operation=EvtInfo_DTC_0xe00141_Event.GetEventFailed
        Ev_GET_DTC_0xe00141_Event: start-on-event=GetEventTested, operation=EvtInfo_DTC_0xe00141_Event.GetEventTested
        Ev_GDOE_DTC_0xe00141_Event: start-on-event=GetDTCOfEvent, operation=EvtInfo_DTC_0xe00141_Event.GetDTCOfEvent
        Ev_GETDOE_DTC_0xe00141_Event: start-on-event=GetDebouncingOfEvent, operation=EvtInfo_DTC_0xe00141_Event.GetDebouncingOfEvent
        Ev_GFDC_DTC_0xe00141_Event: start-on-event=GetFaultDetectionCounter, operation=EvtInfo_DTC_0xe00141_Event.GetFaultDetectionCounter
        Ev_GEED_DTC_0xe00141_Event: start-on-event=GetEventExtendedDataRecord, operation=EvtInfo_DTC_0xe00141_Event.GetEventExtendedDataRecord
        Ev_GEEDR_DTC_0xe00141_Event: start-on-event=GetEventExtendedDataRecordEx, operation=EvtInfo_DTC_0xe00141_Event.GetEventExtendedDataRecordEx
        Ev_GEFFD_DTC_0xe00141_Event: start-on-event=GetEventFreezeFrameData, operation=EvtInfo_DTC_0xe00141_Event.GetEventFreezeFrameData
        Ev_GEFFDE_DTC_0xe00141_Event: start-on-event=GetEventFreezeFrameDataEx, operation=EvtInfo_DTC_0xe00141_Event.GetEventFreezeFrameDataEx
        Ev_GES_DTC_0xe00142_Event: start-on-event=GetEventStatus, operation=EvtInfo_DTC_0xe00142_Event.GetEventStatus
        Ev_GEF_DTC_0xe00142_Event: start-on-event=GetEventFailed, operation=EvtInfo_DTC_0xe00142_Event.GetEventFailed
        Ev_GET_DTC_0xe00142_Event: start-on-event=GetEventTested, operation=EvtInfo_DTC_0xe00142_Event.GetEventTested
        Ev_GDOE_DTC_0xe00142_Event: start-on-event=GetDTCOfEvent, operation=EvtInfo_DTC_0xe00142_Event.GetDTCOfEvent
        Ev_GETDOE_DTC_0xe00142_Event: start-on-event=GetDebouncingOfEvent, operation=EvtInfo_DTC_0xe00142_Event.GetDebouncingOfEvent
        Ev_GFDC_DTC_0xe00142_Event: start-on-event=GetFaultDetectionCounter, operation=EvtInfo_DTC_0xe00142_Event.GetFaultDetectionCounter
        Ev_GEED_DTC_0xe00142_Event: start-on-event=GetEventExtendedDataRecord, operation=EvtInfo_DTC_0xe00142_Event.GetEventExtendedDataRecord
        Ev_GEEDR_DTC_0xe00142_Event: start-on-event=GetEventExtendedDataRecordEx, operation=EvtInfo_DTC_0xe00142_Event.GetEventExtendedDataRecordEx
        Ev_GEFFD_DTC_0xe00142_Event: start-on-event=GetEventFreezeFrameData, operation=EvtInfo_DTC_0xe00142_Event.GetEventFreezeFrameData
        Ev_GEFFDE_DTC_0xe00142_Event: start-on-event=GetEventFreezeFrameDataEx, operation=EvtInfo_DTC_0xe00142_Event.GetEventFreezeFrameDataEx
        Ev_GES_DTC_0xe26200_Event: start-on-event=GetEventStatus, operation=EvtInfo_DTC_0xe26200_Event.GetEventStatus
        Ev_GEF_DTC_0xe26200_Event: start-on-event=GetEventFailed, operation=EvtInfo_DTC_0xe26200_Event.GetEventFailed
        Ev_GET_DTC_0xe26200_Event: start-on-event=GetEventTested, operation=EvtInfo_DTC_0xe26200_Event.GetEventTested
        Ev_GDOE_DTC_0xe26200_Event: start-on-event=GetDTCOfEvent, operation=EvtInfo_DTC_0xe26200_Event.GetDTCOfEvent
        Ev_GETDOE_DTC_0xe26200_Event: start-on-event=GetDebouncingOfEvent, operation=EvtInfo_DTC_0xe26200_Event.GetDebouncingOfEvent
        Ev_GFDC_DTC_0xe26200_Event: start-on-event=GetFaultDetectionCounter, operation=EvtInfo_DTC_0xe26200_Event.GetFaultDetectionCounter
        Ev_GEED_DTC_0xe26200_Event: start-on-event=GetEventExtendedDataRecord, operation=EvtInfo_DTC_0xe26200_Event.GetEventExtendedDataRecord
        Ev_GEEDR_DTC_0xe26200_Event: start-on-event=GetEventExtendedDataRecordEx, operation=EvtInfo_DTC_0xe26200_Event.GetEventExtendedDataRecordEx
        Ev_GEFFD_DTC_0xe26200_Event: start-on-event=GetEventFreezeFrameData, operation=EvtInfo_DTC_0xe26200_Event.GetEventFreezeFrameData
        Ev_GEFFDE_DTC_0xe26200_Event: start-on-event=GetEventFreezeFrameDataEx, operation=EvtInfo_DTC_0xe26200_Event.GetEventFreezeFrameDataEx
        Ev_GES_ETH_E_ACCESS: start-on-event=GetEventStatus, operation=EvtInfo_ETH_E_ACCESS.GetEventStatus
        Ev_GEF_ETH_E_ACCESS: start-on-event=GetEventFailed, operation=EvtInfo_ETH_E_ACCESS.GetEventFailed
        Ev_GET_ETH_E_ACCESS: start-on-event=GetEventTested, operation=EvtInfo_ETH_E_ACCESS.GetEventTested
        Ev_GDOE_ETH_E_ACCESS: start-on-event=GetDTCOfEvent, operation=EvtInfo_ETH_E_ACCESS.GetDTCOfEvent
        Ev_GETDOE_ETH_E_ACCESS: start-on-event=GetDebouncingOfEvent, operation=EvtInfo_ETH_E_ACCESS.GetDebouncingOfEvent
        Ev_GFDC_ETH_E_ACCESS: start-on-event=GetFaultDetectionCounter, operation=EvtInfo_ETH_E_ACCESS.GetFaultDetectionCounter
        Ev_GEED_ETH_E_ACCESS: start-on-event=GetEventExtendedDataRecord, operation=EvtInfo_ETH_E_ACCESS.GetEventExtendedDataRecord
        Ev_GEEDR_ETH_E_ACCESS: start-on-event=GetEventExtendedDataRecordEx, operation=EvtInfo_ETH_E_ACCESS.GetEventExtendedDataRecordEx
        Ev_GEFFD_ETH_E_ACCESS: start-on-event=GetEventFreezeFrameData, operation=EvtInfo_ETH_E_ACCESS.GetEventFreezeFrameData
        Ev_GEFFDE_ETH_E_ACCESS: start-on-event=GetEventFreezeFrameDataEx, operation=EvtInfo_ETH_E_ACCESS.GetEventFreezeFrameDataEx
        Ev_GES_ETH_E_ALIGNMENT: start-on-event=GetEventStatus, operation=EvtInfo_ETH_E_ALIGNMENT.GetEventStatus
        Ev_GEF_ETH_E_ALIGNMENT: start-on-event=GetEventFailed, operation=EvtInfo_ETH_E_ALIGNMENT.GetEventFailed
        Ev_GET_ETH_E_ALIGNMENT: start-on-event=GetEventTested, operation=EvtInfo_ETH_E_ALIGNMENT.GetEventTested
        Ev_GDOE_ETH_E_ALIGNMENT: start-on-event=GetDTCOfEvent, operation=EvtInfo_ETH_E_ALIGNMENT.GetDTCOfEvent
        Ev_GETDOE_ETH_E_ALIGNMENT: start-on-event=GetDebouncingOfEvent, operation=EvtInfo_ETH_E_ALIGNMENT.GetDebouncingOfEvent
        Ev_GFDC_ETH_E_ALIGNMENT: start-on-event=GetFaultDetectionCounter, operation=EvtInfo_ETH_E_ALIGNMENT.GetFaultDetectionCounter
        Ev_GEED_ETH_E_ALIGNMENT: start-on-event=GetEventExtendedDataRecord, operation=EvtInfo_ETH_E_ALIGNMENT.GetEventExtendedDataRecord
        Ev_GEEDR_ETH_E_ALIGNMENT: start-on-event=GetEventExtendedDataRecordEx, operation=EvtInfo_ETH_E_ALIGNMENT.GetEventExtendedDataRecordEx
        Ev_GEFFD_ETH_E_ALIGNMENT: start-on-event=GetEventFreezeFrameData, operation=EvtInfo_ETH_E_ALIGNMENT.GetEventFreezeFrameData
        Ev_GEFFDE_ETH_E_ALIGNMENT: start-on-event=GetEventFreezeFrameDataEx, operation=EvtInfo_ETH_E_ALIGNMENT.GetEventFreezeFrameDataEx
        Ev_GES_ETH_E_AVB_DMAC: start-on-event=GetEventStatus, operation=EvtInfo_ETH_E_AVB_DMAC.GetEventStatus
        Ev_GEF_ETH_E_AVB_DMAC: start-on-event=GetEventFailed, operation=EvtInfo_ETH_E_AVB_DMAC.GetEventFailed
        Ev_GET_ETH_E_AVB_DMAC: start-on-event=GetEventTested, operation=EvtInfo_ETH_E_AVB_DMAC.GetEventTested
        Ev_GDOE_ETH_E_AVB_DMAC: start-on-event=GetDTCOfEvent, operation=EvtInfo_ETH_E_AVB_DMAC.GetDTCOfEvent
        Ev_GETDOE_ETH_E_AVB_DMAC: start-on-event=GetDebouncingOfEvent, operation=EvtInfo_ETH_E_AVB_DMAC.GetDebouncingOfEvent
        Ev_GFDC_ETH_E_AVB_DMAC: start-on-event=GetFaultDetectionCounter, operation=EvtInfo_ETH_E_AVB_DMAC.GetFaultDetectionCounter
        Ev_GEED_ETH_E_AVB_DMAC: start-on-event=GetEventExtendedDataRecord, operation=EvtInfo_ETH_E_AVB_DMAC.GetEventExtendedDataRecord
        Ev_GEEDR_ETH_E_AVB_DMAC: start-on-event=GetEventExtendedDataRecordEx, operation=EvtInfo_ETH_E_AVB_DMAC.GetEventExtendedDataRecordEx
        Ev_GEFFD_ETH_E_AVB_DMAC: start-on-event=GetEventFreezeFrameData, operation=EvtInfo_ETH_E_AVB_DMAC.GetEventFreezeFrameData
        Ev_GEFFDE_ETH_E_AVB_DMAC: start-on-event=GetEventFreezeFrameDataEx, operation=EvtInfo_ETH_E_AVB_DMAC.GetEventFreezeFrameDataEx
        Ev_GES_ETH_E_CRC: start-on-event=GetEventStatus, operation=EvtInfo_ETH_E_CRC.GetEventStatus
        Ev_GEF_ETH_E_CRC: start-on-event=GetEventFailed, operation=EvtInfo_ETH_E_CRC.GetEventFailed
        Ev_GET_ETH_E_CRC: start-on-event=GetEventTested, operation=EvtInfo_ETH_E_CRC.GetEventTested
        Ev_GDOE_ETH_E_CRC: start-on-event=GetDTCOfEvent, operation=EvtInfo_ETH_E_CRC.GetDTCOfEvent
        Ev_GETDOE_ETH_E_CRC: start-on-event=GetDebouncingOfEvent, operation=EvtInfo_ETH_E_CRC.GetDebouncingOfEvent
        Ev_GFDC_ETH_E_CRC: start-on-event=GetFaultDetectionCounter, operation=EvtInfo_ETH_E_CRC.GetFaultDetectionCounter
        Ev_GEED_ETH_E_CRC: start-on-event=GetEventExtendedDataRecord, operation=EvtInfo_ETH_E_CRC.GetEventExtendedDataRecord
        Ev_GEEDR_ETH_E_CRC: start-on-event=GetEventExtendedDataRecordEx, operation=EvtInfo_ETH_E_CRC.GetEventExtendedDataRecordEx
        Ev_GEFFD_ETH_E_CRC: start-on-event=GetEventFreezeFrameData, operation=EvtInfo_ETH_E_CRC.GetEventFreezeFrameData
        Ev_GEFFDE_ETH_E_CRC: start-on-event=GetEventFreezeFrameDataEx, operation=EvtInfo_ETH_E_CRC.GetEventFreezeFrameDataEx
        Ev_GES_ETH_E_DESC_DATA: start-on-event=GetEventStatus, operation=EvtInfo_ETH_E_DESC_DATA.GetEventStatus
        Ev_GEF_ETH_E_DESC_DATA: start-on-event=GetEventFailed, operation=EvtInfo_ETH_E_DESC_DATA.GetEventFailed
        Ev_GET_ETH_E_DESC_DATA: start-on-event=GetEventTested, operation=EvtInfo_ETH_E_DESC_DATA.GetEventTested
        Ev_GDOE_ETH_E_DESC_DATA: start-on-event=GetDTCOfEvent, operation=EvtInfo_ETH_E_DESC_DATA.GetDTCOfEvent
        Ev_GETDOE_ETH_E_DESC_DATA: start-on-event=GetDebouncingOfEvent, operation=EvtInfo_ETH_E_DESC_DATA.GetDebouncingOfEvent
        Ev_GFDC_ETH_E_DESC_DATA: start-on-event=GetFaultDetectionCounter, operation=EvtInfo_ETH_E_DESC_DATA.GetFaultDetectionCounter
        Ev_GEED_ETH_E_DESC_DATA: start-on-event=GetEventExtendedDataRecord, operation=EvtInfo_ETH_E_DESC_DATA.GetEventExtendedDataRecord
        Ev_GEEDR_ETH_E_DESC_DATA: start-on-event=GetEventExtendedDataRecordEx, operation=EvtInfo_ETH_E_DESC_DATA.GetEventExtendedDataRecordEx
        Ev_GEFFD_ETH_E_DESC_DATA: start-on-event=GetEventFreezeFrameData, operation=EvtInfo_ETH_E_DESC_DATA.GetEventFreezeFrameData
        Ev_GEFFDE_ETH_E_DESC_DATA: start-on-event=GetEventFreezeFrameDataEx, operation=EvtInfo_ETH_E_DESC_DATA.GetEventFreezeFrameDataEx
        Ev_GES_ETH_E_FRAME_RECEIVE: start-on-event=GetEventStatus, operation=EvtInfo_ETH_E_FRAME_RECEIVE.GetEventStatus
        Ev_GEF_ETH_E_FRAME_RECEIVE: start-on-event=GetEventFailed, operation=EvtInfo_ETH_E_FRAME_RECEIVE.GetEventFailed
        Ev_GET_ETH_E_FRAME_RECEIVE: start-on-event=GetEventTested, operation=EvtInfo_ETH_E_FRAME_RECEIVE.GetEventTested
        Ev_GDOE_ETH_E_FRAME_RECEIVE: start-on-event=GetDTCOfEvent, operation=EvtInfo_ETH_E_FRAME_RECEIVE.GetDTCOfEvent
        Ev_GETDOE_ETH_E_FRAME_RECEIVE: start-on-event=GetDebouncingOfEvent, operation=EvtInfo_ETH_E_FRAME_RECEIVE.GetDebouncingOfEvent
        Ev_GFDC_ETH_E_FRAME_RECEIVE: start-on-event=GetFaultDetectionCounter, operation=EvtInfo_ETH_E_FRAME_RECEIVE.GetFaultDetectionCounter
        Ev_GEED_ETH_E_FRAME_RECEIVE: start-on-event=GetEventExtendedDataRecord, operation=EvtInfo_ETH_E_FRAME_RECEIVE.GetEventExtendedDataRecord
        Ev_GEEDR_ETH_E_FRAME_RECEIVE: start-on-event=GetEventExtendedDataRecordEx, operation=EvtInfo_ETH_E_FRAME_RECEIVE.GetEventExtendedDataRecordEx
        Ev_GEFFD_ETH_E_FRAME_RECEIVE: start-on-event=GetEventFreezeFrameData, operation=EvtInfo_ETH_E_FRAME_RECEIVE.GetEventFreezeFrameData
        Ev_GEFFDE_ETH_E_FRAME_RECEIVE: start-on-event=GetEventFreezeFrameDataEx, operation=EvtInfo_ETH_E_FRAME_RECEIVE.GetEventFreezeFrameDataEx
        Ev_GES_ETH_E_INTERRUPT_CTL_CHECK: start-on-event=GetEventStatus, operation=EvtInfo_ETH_E_INTERRUPT_CTL_CHECK.GetEventStatus
        Ev_GEF_ETH_E_INTERRUPT_CTL_CHECK: start-on-event=GetEventFailed, operation=EvtInfo_ETH_E_INTERRUPT_CTL_CHECK.GetEventFailed
        Ev_GET_ETH_E_INTERRUPT_CTL_CHECK: start-on-event=GetEventTested, operation=EvtInfo_ETH_E_INTERRUPT_CTL_CHECK.GetEventTested
        Ev_GDOE_ETH_E_INTERRUPT_CTL_CHECK: start-on-event=GetDTCOfEvent, operation=EvtInfo_ETH_E_INTERRUPT_CTL_CHECK.GetDTCOfEvent
        Ev_GETDOE_ETH_E_INTERRUPT_CTL_CHECK: start-on-event=GetDebouncingOfEvent, operation=EvtInfo_ETH_E_INTERRUPT_CTL_CHECK.GetDebouncingOfEvent
        Ev_GFDC_ETH_E_INTERRUPT_CTL_CHECK: start-on-event=GetFaultDetectionCounter, operation=EvtInfo_ETH_E_INTERRUPT_CTL_CHECK.GetFaultDetectionCounter
        Ev_GEED_ETH_E_INTERRUPT_CTL_CHECK: start-on-event=GetEventExtendedDataRecord, operation=EvtInfo_ETH_E_INTERRUPT_CTL_CHECK.GetEventExtendedDataRecord
        Ev_GEEDR_ETH_E_INTERRUPT_CTL_CHECK: start-on-event=GetEventExtendedDataRecordEx, operation=EvtInfo_ETH_E_INTERRUPT_CTL_CHECK.GetEventExtendedDataRecordEx
        Ev_GEFFD_ETH_E_INTERRUPT_CTL_CHECK: start-on-event=GetEventFreezeFrameData, operation=EvtInfo_ETH_E_INTERRUPT_CTL_CHECK.GetEventFreezeFrameData
        Ev_GEFFDE_ETH_E_INTERRUPT_CTL_CHECK: start-on-event=GetEventFreezeFrameDataEx, operation=EvtInfo_ETH_E_INTERRUPT_CTL_CHECK.GetEventFreezeFrameDataEx
        Ev_GES_ETH_E_LATECOLLISION: start-on-event=GetEventStatus, operation=EvtInfo_ETH_E_LATECOLLISION.GetEventStatus
        Ev_GEF_ETH_E_LATECOLLISION: start-on-event=GetEventFailed, operation=EvtInfo_ETH_E_LATECOLLISION.GetEventFailed
        Ev_GET_ETH_E_LATECOLLISION: start-on-event=GetEventTested, operation=EvtInfo_ETH_E_LATECOLLISION.GetEventTested
        Ev_GDOE_ETH_E_LATECOLLISION: start-on-event=GetDTCOfEvent, operation=EvtInfo_ETH_E_LATECOLLISION.GetDTCOfEvent
        Ev_GETDOE_ETH_E_LATECOLLISION: start-on-event=GetDebouncingOfEvent, operation=EvtInfo_ETH_E_LATECOLLISION.GetDebouncingOfEvent
        Ev_GFDC_ETH_E_LATECOLLISION: start-on-event=GetFaultDetectionCounter, operation=EvtInfo_ETH_E_LATECOLLISION.GetFaultDetectionCounter
        Ev_GEED_ETH_E_LATECOLLISION: start-on-event=GetEventExtendedDataRecord, operation=EvtInfo_ETH_E_LATECOLLISION.GetEventExtendedDataRecord
        Ev_GEEDR_ETH_E_LATECOLLISION: start-on-event=GetEventExtendedDataRecordEx, operation=EvtInfo_ETH_E_LATECOLLISION.GetEventExtendedDataRecordEx
        Ev_GEFFD_ETH_E_LATECOLLISION: start-on-event=GetEventFreezeFrameData, operation=EvtInfo_ETH_E_LATECOLLISION.GetEventFreezeFrameData
        Ev_GEFFDE_ETH_E_LATECOLLISION: start-on-event=GetEventFreezeFrameDataEx, operation=EvtInfo_ETH_E_LATECOLLISION.GetEventFreezeFrameDataEx
        Ev_GES_ETH_E_MODULE_STOP_CHECK: start-on-event=GetEventStatus, operation=EvtInfo_ETH_E_MODULE_STOP_CHECK.GetEventStatus
        Ev_GEF_ETH_E_MODULE_STOP_CHECK: start-on-event=GetEventFailed, operation=EvtInfo_ETH_E_MODULE_STOP_CHECK.GetEventFailed
        Ev_GET_ETH_E_MODULE_STOP_CHECK: start-on-event=GetEventTested, operation=EvtInfo_ETH_E_MODULE_STOP_CHECK.GetEventTested
        Ev_GDOE_ETH_E_MODULE_STOP_CHECK: start-on-event=GetDTCOfEvent, operation=EvtInfo_ETH_E_MODULE_STOP_CHECK.GetDTCOfEvent
        Ev_GETDOE_ETH_E_MODULE_STOP_CHECK: start-on-event=GetDebouncingOfEvent, operation=EvtInfo_ETH_E_MODULE_STOP_CHECK.GetDebouncingOfEvent
        Ev_GFDC_ETH_E_MODULE_STOP_CHECK: start-on-event=GetFaultDetectionCounter, operation=EvtInfo_ETH_E_MODULE_STOP_CHECK.GetFaultDetectionCounter
        Ev_GEED_ETH_E_MODULE_STOP_CHECK: start-on-event=GetEventExtendedDataRecord, operation=EvtInfo_ETH_E_MODULE_STOP_CHECK.GetEventExtendedDataRecord
        Ev_GEEDR_ETH_E_MODULE_STOP_CHECK: start-on-event=GetEventExtendedDataRecordEx, operation=EvtInfo_ETH_E_MODULE_STOP_CHECK.GetEventExtendedDataRecordEx
        Ev_GEFFD_ETH_E_MODULE_STOP_CHECK: start-on-event=GetEventFreezeFrameData, operation=EvtInfo_ETH_E_MODULE_STOP_CHECK.GetEventFreezeFrameData
        Ev_GEFFDE_ETH_E_MODULE_STOP_CHECK: start-on-event=GetEventFreezeFrameDataEx, operation=EvtInfo_ETH_E_MODULE_STOP_CHECK.GetEventFreezeFrameDataEx
        Ev_GES_ETH_E_MULTIPLECOLLISION: start-on-event=GetEventStatus, operation=EvtInfo_ETH_E_MULTIPLECOLLISION.GetEventStatus
        Ev_GEF_ETH_E_MULTIPLECOLLISION: start-on-event=GetEventFailed, operation=EvtInfo_ETH_E_MULTIPLECOLLISION.GetEventFailed
        Ev_GET_ETH_E_MULTIPLECOLLISION: start-on-event=GetEventTested, operation=EvtInfo_ETH_E_MULTIPLECOLLISION.GetEventTested
        Ev_GDOE_ETH_E_MULTIPLECOLLISION: start-on-event=GetDTCOfEvent, operation=EvtInfo_ETH_E_MULTIPLECOLLISION.GetDTCOfEvent
        Ev_GETDOE_ETH_E_MULTIPLECOLLISION: start-on-event=GetDebouncingOfEvent, operation=EvtInfo_ETH_E_MULTIPLECOLLISION.GetDebouncingOfEvent
        Ev_GFDC_ETH_E_MULTIPLECOLLISION: start-on-event=GetFaultDetectionCounter, operation=EvtInfo_ETH_E_MULTIPLECOLLISION.GetFaultDetectionCounter
        Ev_GEED_ETH_E_MULTIPLECOLLISION: start-on-event=GetEventExtendedDataRecord, operation=EvtInfo_ETH_E_MULTIPLECOLLISION.GetEventExtendedDataRecord
        Ev_GEEDR_ETH_E_MULTIPLECOLLISION: start-on-event=GetEventExtendedDataRecordEx, operation=EvtInfo_ETH_E_MULTIPLECOLLISION.GetEventExtendedDataRecordEx
        Ev_GEFFD_ETH_E_MULTIPLECOLLISION: start-on-event=GetEventFreezeFrameData, operation=EvtInfo_ETH_E_MULTIPLECOLLISION.GetEventFreezeFrameData
        Ev_GEFFDE_ETH_E_MULTIPLECOLLISION: start-on-event=GetEventFreezeFrameDataEx, operation=EvtInfo_ETH_E_MULTIPLECOLLISION.GetEventFreezeFrameDataEx
        Ev_GES_ETH_E_OPMODE: start-on-event=GetEventStatus, operation=EvtInfo_ETH_E_OPMODE.GetEventStatus
        Ev_GEF_ETH_E_OPMODE: start-on-event=GetEventFailed, operation=EvtInfo_ETH_E_OPMODE.GetEventFailed
        Ev_GET_ETH_E_OPMODE: start-on-event=GetEventTested, operation=EvtInfo_ETH_E_OPMODE.GetEventTested
        Ev_GDOE_ETH_E_OPMODE: start-on-event=GetDTCOfEvent, operation=EvtInfo_ETH_E_OPMODE.GetDTCOfEvent
        Ev_GETDOE_ETH_E_OPMODE: start-on-event=GetDebouncingOfEvent, operation=EvtInfo_ETH_E_OPMODE.GetDebouncingOfEvent
        Ev_GFDC_ETH_E_OPMODE: start-on-event=GetFaultDetectionCounter, operation=EvtInfo_ETH_E_OPMODE.GetFaultDetectionCounter
        Ev_GEED_ETH_E_OPMODE: start-on-event=GetEventExtendedDataRecord, operation=EvtInfo_ETH_E_OPMODE.GetEventExtendedDataRecord
        Ev_GEEDR_ETH_E_OPMODE: start-on-event=GetEventExtendedDataRecordEx, operation=EvtInfo_ETH_E_OPMODE.GetEventExtendedDataRecordEx
        Ev_GEFFD_ETH_E_OPMODE: start-on-event=GetEventFreezeFrameData, operation=EvtInfo_ETH_E_OPMODE.GetEventFreezeFrameData
        Ev_GEFFDE_ETH_E_OPMODE: start-on-event=GetEventFreezeFrameDataEx, operation=EvtInfo_ETH_E_OPMODE.GetEventFreezeFrameDataEx
        Ev_GES_ETH_E_OVERSIZEFRAME: start-on-event=GetEventStatus, operation=EvtInfo_ETH_E_OVERSIZEFRAME.GetEventStatus
        Ev_GEF_ETH_E_OVERSIZEFRAME: start-on-event=GetEventFailed, operation=EvtInfo_ETH_E_OVERSIZEFRAME.GetEventFailed
        Ev_GET_ETH_E_OVERSIZEFRAME: start-on-event=GetEventTested, operation=EvtInfo_ETH_E_OVERSIZEFRAME.GetEventTested
        Ev_GDOE_ETH_E_OVERSIZEFRAME: start-on-event=GetDTCOfEvent, operation=EvtInfo_ETH_E_OVERSIZEFRAME.GetDTCOfEvent
        Ev_GETDOE_ETH_E_OVERSIZEFRAME: start-on-event=GetDebouncingOfEvent, operation=EvtInfo_ETH_E_OVERSIZEFRAME.GetDebouncingOfEvent
        Ev_GFDC_ETH_E_OVERSIZEFRAME: start-on-event=GetFaultDetectionCounter, operation=EvtInfo_ETH_E_OVERSIZEFRAME.GetFaultDetectionCounter
        Ev_GEED_ETH_E_OVERSIZEFRAME: start-on-event=GetEventExtendedDataRecord, operation=EvtInfo_ETH_E_OVERSIZEFRAME.GetEventExtendedDataRecord
        Ev_GEEDR_ETH_E_OVERSIZEFRAME: start-on-event=GetEventExtendedDataRecordEx, operation=EvtInfo_ETH_E_OVERSIZEFRAME.GetEventExtendedDataRecordEx
        Ev_GEFFD_ETH_E_OVERSIZEFRAME: start-on-event=GetEventFreezeFrameData, operation=EvtInfo_ETH_E_OVERSIZEFRAME.GetEventFreezeFrameData
        Ev_GEFFDE_ETH_E_OVERSIZEFRAME: start-on-event=GetEventFreezeFrameDataEx, operation=EvtInfo_ETH_E_OVERSIZEFRAME.GetEventFreezeFrameDataEx
        Ev_GES_ETH_E_PAYLOAD_CRC: start-on-event=GetEventStatus, operation=EvtInfo_ETH_E_PAYLOAD_CRC.GetEventStatus
        Ev_GEF_ETH_E_PAYLOAD_CRC: start-on-event=GetEventFailed, operation=EvtInfo_ETH_E_PAYLOAD_CRC.GetEventFailed
        Ev_GET_ETH_E_PAYLOAD_CRC: start-on-event=GetEventTested, operation=EvtInfo_ETH_E_PAYLOAD_CRC.GetEventTested
        Ev_GDOE_ETH_E_PAYLOAD_CRC: start-on-event=GetDTCOfEvent, operation=EvtInfo_ETH_E_PAYLOAD_CRC.GetDTCOfEvent
        Ev_GETDOE_ETH_E_PAYLOAD_CRC: start-on-event=GetDebouncingOfEvent, operation=EvtInfo_ETH_E_PAYLOAD_CRC.GetDebouncingOfEvent
        Ev_GFDC_ETH_E_PAYLOAD_CRC: start-on-event=GetFaultDetectionCounter, operation=EvtInfo_ETH_E_PAYLOAD_CRC.GetFaultDetectionCounter
        Ev_GEED_ETH_E_PAYLOAD_CRC: start-on-event=GetEventExtendedDataRecord, operation=EvtInfo_ETH_E_PAYLOAD_CRC.GetEventExtendedDataRecord
        Ev_GEEDR_ETH_E_PAYLOAD_CRC: start-on-event=GetEventExtendedDataRecordEx, operation=EvtInfo_ETH_E_PAYLOAD_CRC.GetEventExtendedDataRecordEx
        Ev_GEFFD_ETH_E_PAYLOAD_CRC: start-on-event=GetEventFreezeFrameData, operation=EvtInfo_ETH_E_PAYLOAD_CRC.GetEventFreezeFrameData
        Ev_GEFFDE_ETH_E_PAYLOAD_CRC: start-on-event=GetEventFreezeFrameDataEx, operation=EvtInfo_ETH_E_PAYLOAD_CRC.GetEventFreezeFrameDataEx
        Ev_GES_ETH_E_REG_READ_VERIFY: start-on-event=GetEventStatus, operation=EvtInfo_ETH_E_REG_READ_VERIFY.GetEventStatus
        Ev_GEF_ETH_E_REG_READ_VERIFY: start-on-event=GetEventFailed, operation=EvtInfo_ETH_E_REG_READ_VERIFY.GetEventFailed
        Ev_GET_ETH_E_REG_READ_VERIFY: start-on-event=GetEventTested, operation=EvtInfo_ETH_E_REG_READ_VERIFY.GetEventTested
        Ev_GDOE_ETH_E_REG_READ_VERIFY: start-on-event=GetDTCOfEvent, operation=EvtInfo_ETH_E_REG_READ_VERIFY.GetDTCOfEvent
        Ev_GETDOE_ETH_E_REG_READ_VERIFY: start-on-event=GetDebouncingOfEvent, operation=EvtInfo_ETH_E_REG_READ_VERIFY.GetDebouncingOfEvent
        Ev_GFDC_ETH_E_REG_READ_VERIFY: start-on-event=GetFaultDetectionCounter, operation=EvtInfo_ETH_E_REG_READ_VERIFY.GetFaultDetectionCounter
        Ev_GEED_ETH_E_REG_READ_VERIFY: start-on-event=GetEventExtendedDataRecord, operation=EvtInfo_ETH_E_REG_READ_VERIFY.GetEventExtendedDataRecord
        Ev_GEEDR_ETH_E_REG_READ_VERIFY: start-on-event=GetEventExtendedDataRecordEx, operation=EvtInfo_ETH_E_REG_READ_VERIFY.GetEventExtendedDataRecordEx
        Ev_GEFFD_ETH_E_REG_READ_VERIFY: start-on-event=GetEventFreezeFrameData, operation=EvtInfo_ETH_E_REG_READ_VERIFY.GetEventFreezeFrameData
        Ev_GEFFDE_ETH_E_REG_READ_VERIFY: start-on-event=GetEventFreezeFrameDataEx, operation=EvtInfo_ETH_E_REG_READ_VERIFY.GetEventFreezeFrameDataEx
        Ev_GES_ETH_E_REG_WRITE_VERIFY: start-on-event=GetEventStatus, operation=EvtInfo_ETH_E_REG_WRITE_VERIFY.GetEventStatus
        Ev_GEF_ETH_E_REG_WRITE_VERIFY: start-on-event=GetEventFailed, operation=EvtInfo_ETH_E_REG_WRITE_VERIFY.GetEventFailed
        Ev_GET_ETH_E_REG_WRITE_VERIFY: start-on-event=GetEventTested, operation=EvtInfo_ETH_E_REG_WRITE_VERIFY.GetEventTested
        Ev_GDOE_ETH_E_REG_WRITE_VERIFY: start-on-event=GetDTCOfEvent, operation=EvtInfo_ETH_E_REG_WRITE_VERIFY.GetDTCOfEvent
        Ev_GETDOE_ETH_E_REG_WRITE_VERIFY: start-on-event=GetDebouncingOfEvent, operation=EvtInfo_ETH_E_REG_WRITE_VERIFY.GetDebouncingOfEvent
        Ev_GFDC_ETH_E_REG_WRITE_VERIFY: start-on-event=GetFaultDetectionCounter, operation=EvtInfo_ETH_E_REG_WRITE_VERIFY.GetFaultDetectionCounter
        Ev_GEED_ETH_E_REG_WRITE_VERIFY: start-on-event=GetEventExtendedDataRecord, operation=EvtInfo_ETH_E_REG_WRITE_VERIFY.GetEventExtendedDataRecord
        Ev_GEEDR_ETH_E_REG_WRITE_VERIFY: start-on-event=GetEventExtendedDataRecordEx, operation=EvtInfo_ETH_E_REG_WRITE_VERIFY.GetEventExtendedDataRecordEx
        Ev_GEFFD_ETH_E_REG_WRITE_VERIFY: start-on-event=GetEventFreezeFrameData, operation=EvtInfo_ETH_E_REG_WRITE_VERIFY.GetEventFreezeFrameData
        Ev_GEFFDE_ETH_E_REG_WRITE_VERIFY: start-on-event=GetEventFreezeFrameDataEx, operation=EvtInfo_ETH_E_REG_WRITE_VERIFY.GetEventFreezeFrameDataEx
        Ev_GES_ETH_E_RESIDUAL_BIT_FRAME: start-on-event=GetEventStatus, operation=EvtInfo_ETH_E_RESIDUAL_BIT_FRAME.GetEventStatus
        Ev_GEF_ETH_E_RESIDUAL_BIT_FRAME: start-on-event=GetEventFailed, operation=EvtInfo_ETH_E_RESIDUAL_BIT_FRAME.GetEventFailed
        Ev_GET_ETH_E_RESIDUAL_BIT_FRAME: start-on-event=GetEventTested, operation=EvtInfo_ETH_E_RESIDUAL_BIT_FRAME.GetEventTested
        Ev_GDOE_ETH_E_RESIDUAL_BIT_FRAME: start-on-event=GetDTCOfEvent, operation=EvtInfo_ETH_E_RESIDUAL_BIT_FRAME.GetDTCOfEvent
        Ev_GETDOE_ETH_E_RESIDUAL_BIT_FRAME: start-on-event=GetDebouncingOfEvent, operation=EvtInfo_ETH_E_RESIDUAL_BIT_FRAME.GetDebouncingOfEvent
        Ev_GFDC_ETH_E_RESIDUAL_BIT_FRAME: start-on-event=GetFaultDetectionCounter, operation=EvtInfo_ETH_E_RESIDUAL_BIT_FRAME.GetFaultDetectionCounter
        Ev_GEED_ETH_E_RESIDUAL_BIT_FRAME: start-on-event=GetEventExtendedDataRecord, operation=EvtInfo_ETH_E_RESIDUAL_BIT_FRAME.GetEventExtendedDataRecord
        Ev_GEEDR_ETH_E_RESIDUAL_BIT_FRAME: start-on-event=GetEventExtendedDataRecordEx, operation=EvtInfo_ETH_E_RESIDUAL_BIT_FRAME.GetEventExtendedDataRecordEx
        Ev_GEFFD_ETH_E_RESIDUAL_BIT_FRAME: start-on-event=GetEventFreezeFrameData, operation=EvtInfo_ETH_E_RESIDUAL_BIT_FRAME.GetEventFreezeFrameData
        Ev_GEFFDE_ETH_E_RESIDUAL_BIT_FRAME: start-on-event=GetEventFreezeFrameDataEx, operation=EvtInfo_ETH_E_RESIDUAL_BIT_FRAME.GetEventFreezeFrameDataEx
        Ev_GES_ETH_E_RX_FRAMES_LOST: start-on-event=GetEventStatus, operation=EvtInfo_ETH_E_RX_FRAMES_LOST.GetEventStatus
        Ev_GEF_ETH_E_RX_FRAMES_LOST: start-on-event=GetEventFailed, operation=EvtInfo_ETH_E_RX_FRAMES_LOST.GetEventFailed
        Ev_GET_ETH_E_RX_FRAMES_LOST: start-on-event=GetEventTested, operation=EvtInfo_ETH_E_RX_FRAMES_LOST.GetEventTested
        Ev_GDOE_ETH_E_RX_FRAMES_LOST: start-on-event=GetDTCOfEvent, operation=EvtInfo_ETH_E_RX_FRAMES_LOST.GetDTCOfEvent
        Ev_GETDOE_ETH_E_RX_FRAMES_LOST: start-on-event=GetDebouncingOfEvent, operation=EvtInfo_ETH_E_RX_FRAMES_LOST.GetDebouncingOfEvent
        Ev_GFDC_ETH_E_RX_FRAMES_LOST: start-on-event=GetFaultDetectionCounter, operation=EvtInfo_ETH_E_RX_FRAMES_LOST.GetFaultDetectionCounter
        Ev_GEED_ETH_E_RX_FRAMES_LOST: start-on-event=GetEventExtendedDataRecord, operation=EvtInfo_ETH_E_RX_FRAMES_LOST.GetEventExtendedDataRecord
        Ev_GEEDR_ETH_E_RX_FRAMES_LOST: start-on-event=GetEventExtendedDataRecordEx, operation=EvtInfo_ETH_E_RX_FRAMES_LOST.GetEventExtendedDataRecordEx
        Ev_GEFFD_ETH_E_RX_FRAMES_LOST: start-on-event=GetEventFreezeFrameData, operation=EvtInfo_ETH_E_RX_FRAMES_LOST.GetEventFreezeFrameData
        Ev_GEFFDE_ETH_E_RX_FRAMES_LOST: start-on-event=GetEventFreezeFrameDataEx, operation=EvtInfo_ETH_E_RX_FRAMES_LOST.GetEventFreezeFrameDataEx
        Ev_GES_ETH_E_SINGLECOLLISION: start-on-event=GetEventStatus, operation=EvtInfo_ETH_E_SINGLECOLLISION.GetEventStatus
        Ev_GEF_ETH_E_SINGLECOLLISION: start-on-event=GetEventFailed, operation=EvtInfo_ETH_E_SINGLECOLLISION.GetEventFailed
        Ev_GET_ETH_E_SINGLECOLLISION: start-on-event=GetEventTested, operation=EvtInfo_ETH_E_SINGLECOLLISION.GetEventTested
        Ev_GDOE_ETH_E_SINGLECOLLISION: start-on-event=GetDTCOfEvent, operation=EvtInfo_ETH_E_SINGLECOLLISION.GetDTCOfEvent
        Ev_GETDOE_ETH_E_SINGLECOLLISION: start-on-event=GetDebouncingOfEvent, operation=EvtInfo_ETH_E_SINGLECOLLISION.GetDebouncingOfEvent
        Ev_GFDC_ETH_E_SINGLECOLLISION: start-on-event=GetFaultDetectionCounter, operation=EvtInfo_ETH_E_SINGLECOLLISION.GetFaultDetectionCounter
        Ev_GEED_ETH_E_SINGLECOLLISION: start-on-event=GetEventExtendedDataRecord, operation=EvtInfo_ETH_E_SINGLECOLLISION.GetEventExtendedDataRecord
        Ev_GEEDR_ETH_E_SINGLECOLLISION: start-on-event=GetEventExtendedDataRecordEx, operation=EvtInfo_ETH_E_SINGLECOLLISION.GetEventExtendedDataRecordEx
        Ev_GEFFD_ETH_E_SINGLECOLLISION: start-on-event=GetEventFreezeFrameData, operation=EvtInfo_ETH_E_SINGLECOLLISION.GetEventFreezeFrameData
        Ev_GEFFDE_ETH_E_SINGLECOLLISION: start-on-event=GetEventFreezeFrameDataEx, operation=EvtInfo_ETH_E_SINGLECOLLISION.GetEventFreezeFrameDataEx
        Ev_GES_ETH_E_TIMEOUT: start-on-event=GetEventStatus, operation=EvtInfo_ETH_E_TIMEOUT.GetEventStatus
        Ev_GEF_ETH_E_TIMEOUT: start-on-event=GetEventFailed, operation=EvtInfo_ETH_E_TIMEOUT.GetEventFailed
        Ev_GET_ETH_E_TIMEOUT: start-on-event=GetEventTested, operation=EvtInfo_ETH_E_TIMEOUT.GetEventTested
        Ev_GDOE_ETH_E_TIMEOUT: start-on-event=GetDTCOfEvent, operation=EvtInfo_ETH_E_TIMEOUT.GetDTCOfEvent
        Ev_GETDOE_ETH_E_TIMEOUT: start-on-event=GetDebouncingOfEvent, operation=EvtInfo_ETH_E_TIMEOUT.GetDebouncingOfEvent
        Ev_GFDC_ETH_E_TIMEOUT: start-on-event=GetFaultDetectionCounter, operation=EvtInfo_ETH_E_TIMEOUT.GetFaultDetectionCounter
        Ev_GEED_ETH_E_TIMEOUT: start-on-event=GetEventExtendedDataRecord, operation=EvtInfo_ETH_E_TIMEOUT.GetEventExtendedDataRecord
        Ev_GEEDR_ETH_E_TIMEOUT: start-on-event=GetEventExtendedDataRecordEx, operation=EvtInfo_ETH_E_TIMEOUT.GetEventExtendedDataRecordEx
        Ev_GEFFD_ETH_E_TIMEOUT: start-on-event=GetEventFreezeFrameData, operation=EvtInfo_ETH_E_TIMEOUT.GetEventFreezeFrameData
        Ev_GEFFDE_ETH_E_TIMEOUT: start-on-event=GetEventFreezeFrameDataEx, operation=EvtInfo_ETH_E_TIMEOUT.GetEventFreezeFrameDataEx
        Ev_GES_ETH_E_TIMERINC_FAILED: start-on-event=GetEventStatus, operation=EvtInfo_ETH_E_TIMERINC_FAILED.GetEventStatus
        Ev_GEF_ETH_E_TIMERINC_FAILED: start-on-event=GetEventFailed, operation=EvtInfo_ETH_E_TIMERINC_FAILED.GetEventFailed
        Ev_GET_ETH_E_TIMERINC_FAILED: start-on-event=GetEventTested, operation=EvtInfo_ETH_E_TIMERINC_FAILED.GetEventTested
        Ev_GDOE_ETH_E_TIMERINC_FAILED: start-on-event=GetDTCOfEvent, operation=EvtInfo_ETH_E_TIMERINC_FAILED.GetDTCOfEvent
        Ev_GETDOE_ETH_E_TIMERINC_FAILED: start-on-event=GetDebouncingOfEvent, operation=EvtInfo_ETH_E_TIMERINC_FAILED.GetDebouncingOfEvent
        Ev_GFDC_ETH_E_TIMERINC_FAILED: start-on-event=GetFaultDetectionCounter, operation=EvtInfo_ETH_E_TIMERINC_FAILED.GetFaultDetectionCounter
        Ev_GEED_ETH_E_TIMERINC_FAILED: start-on-event=GetEventExtendedDataRecord, operation=EvtInfo_ETH_E_TIMERINC_FAILED.GetEventExtendedDataRecord
        Ev_GEEDR_ETH_E_TIMERINC_FAILED: start-on-event=GetEventExtendedDataRecordEx, operation=EvtInfo_ETH_E_TIMERINC_FAILED.GetEventExtendedDataRecordEx
        Ev_GEFFD_ETH_E_TIMERINC_FAILED: start-on-event=GetEventFreezeFrameData, operation=EvtInfo_ETH_E_TIMERINC_FAILED.GetEventFreezeFrameData
        Ev_GEFFDE_ETH_E_TIMERINC_FAILED: start-on-event=GetEventFreezeFrameDataEx, operation=EvtInfo_ETH_E_TIMERINC_FAILED.GetEventFreezeFrameDataEx
        Ev_GES_ETH_E_TRANSMIT_RETRY_OVER: start-on-event=GetEventStatus, operation=EvtInfo_ETH_E_TRANSMIT_RETRY_OVER.GetEventStatus
        Ev_GEF_ETH_E_TRANSMIT_RETRY_OVER: start-on-event=GetEventFailed, operation=EvtInfo_ETH_E_TRANSMIT_RETRY_OVER.GetEventFailed
        Ev_GET_ETH_E_TRANSMIT_RETRY_OVER: start-on-event=GetEventTested, operation=EvtInfo_ETH_E_TRANSMIT_RETRY_OVER.GetEventTested
        Ev_GDOE_ETH_E_TRANSMIT_RETRY_OVER: start-on-event=GetDTCOfEvent, operation=EvtInfo_ETH_E_TRANSMIT_RETRY_OVER.GetDTCOfEvent
        Ev_GETDOE_ETH_E_TRANSMIT_RETRY_OVER: start-on-event=GetDebouncingOfEvent, operation=EvtInfo_ETH_E_TRANSMIT_RETRY_OVER.GetDebouncingOfEvent
        Ev_GFDC_ETH_E_TRANSMIT_RETRY_OVER: start-on-event=GetFaultDetectionCounter, operation=EvtInfo_ETH_E_TRANSMIT_RETRY_OVER.GetFaultDetectionCounter
        Ev_GEED_ETH_E_TRANSMIT_RETRY_OVER: start-on-event=GetEventExtendedDataRecord, operation=EvtInfo_ETH_E_TRANSMIT_RETRY_OVER.GetEventExtendedDataRecord
        Ev_GEEDR_ETH_E_TRANSMIT_RETRY_OVER: start-on-event=GetEventExtendedDataRecordEx, operation=EvtInfo_ETH_E_TRANSMIT_RETRY_OVER.GetEventExtendedDataRecordEx
        Ev_GEFFD_ETH_E_TRANSMIT_RETRY_OVER: start-on-event=GetEventFreezeFrameData, operation=EvtInfo_ETH_E_TRANSMIT_RETRY_OVER.GetEventFreezeFrameData
        Ev_GEFFDE_ETH_E_TRANSMIT_RETRY_OVER: start-on-event=GetEventFreezeFrameDataEx, operation=EvtInfo_ETH_E_TRANSMIT_RETRY_OVER.GetEventFreezeFrameDataEx
        Ev_GES_ETH_E_UNDERSIZEFRAME: start-on-event=GetEventStatus, operation=EvtInfo_ETH_E_UNDERSIZEFRAME.GetEventStatus
        Ev_GEF_ETH_E_UNDERSIZEFRAME: start-on-event=GetEventFailed, operation=EvtInfo_ETH_E_UNDERSIZEFRAME.GetEventFailed
        Ev_GET_ETH_E_UNDERSIZEFRAME: start-on-event=GetEventTested, operation=EvtInfo_ETH_E_UNDERSIZEFRAME.GetEventTested
        Ev_GDOE_ETH_E_UNDERSIZEFRAME: start-on-event=GetDTCOfEvent, operation=EvtInfo_ETH_E_UNDERSIZEFRAME.GetDTCOfEvent
        Ev_GETDOE_ETH_E_UNDERSIZEFRAME: start-on-event=GetDebouncingOfEvent, operation=EvtInfo_ETH_E_UNDERSIZEFRAME.GetDebouncingOfEvent
        Ev_GFDC_ETH_E_UNDERSIZEFRAME: start-on-event=GetFaultDetectionCounter, operation=EvtInfo_ETH_E_UNDERSIZEFRAME.GetFaultDetectionCounter
        Ev_GEED_ETH_E_UNDERSIZEFRAME: start-on-event=GetEventExtendedDataRecord, operation=EvtInfo_ETH_E_UNDERSIZEFRAME.GetEventExtendedDataRecord
        Ev_GEEDR_ETH_E_UNDERSIZEFRAME: start-on-event=GetEventExtendedDataRecordEx, operation=EvtInfo_ETH_E_UNDERSIZEFRAME.GetEventExtendedDataRecordEx
        Ev_GEFFD_ETH_E_UNDERSIZEFRAME: start-on-event=GetEventFreezeFrameData, operation=EvtInfo_ETH_E_UNDERSIZEFRAME.GetEventFreezeFrameData
        Ev_GEFFDE_ETH_E_UNDERSIZEFRAME: start-on-event=GetEventFreezeFrameDataEx, operation=EvtInfo_ETH_E_UNDERSIZEFRAME.GetEventFreezeFrameDataEx
        Ev_GES_FLS_E_COMPARE_FAILED: start-on-event=GetEventStatus, operation=EvtInfo_FLS_E_COMPARE_FAILED.GetEventStatus
        Ev_GEF_FLS_E_COMPARE_FAILED: start-on-event=GetEventFailed, operation=EvtInfo_FLS_E_COMPARE_FAILED.GetEventFailed
        Ev_GET_FLS_E_COMPARE_FAILED: start-on-event=GetEventTested, operation=EvtInfo_FLS_E_COMPARE_FAILED.GetEventTested
        Ev_GDOE_FLS_E_COMPARE_FAILED: start-on-event=GetDTCOfEvent, operation=EvtInfo_FLS_E_COMPARE_FAILED.GetDTCOfEvent
        Ev_GETDOE_FLS_E_COMPARE_FAILED: start-on-event=GetDebouncingOfEvent, operation=EvtInfo_FLS_E_COMPARE_FAILED.GetDebouncingOfEvent
        Ev_GFDC_FLS_E_COMPARE_FAILED: start-on-event=GetFaultDetectionCounter, operation=EvtInfo_FLS_E_COMPARE_FAILED.GetFaultDetectionCounter
        Ev_GEED_FLS_E_COMPARE_FAILED: start-on-event=GetEventExtendedDataRecord, operation=EvtInfo_FLS_E_COMPARE_FAILED.GetEventExtendedDataRecord
        Ev_GEEDR_FLS_E_COMPARE_FAILED: start-on-event=GetEventExtendedDataRecordEx, operation=EvtInfo_FLS_E_COMPARE_FAILED.GetEventExtendedDataRecordEx
        Ev_GEFFD_FLS_E_COMPARE_FAILED: start-on-event=GetEventFreezeFrameData, operation=EvtInfo_FLS_E_COMPARE_FAILED.GetEventFreezeFrameData
        Ev_GEFFDE_FLS_E_COMPARE_FAILED: start-on-event=GetEventFreezeFrameDataEx, operation=EvtInfo_FLS_E_COMPARE_FAILED.GetEventFreezeFrameDataEx
        Ev_GES_FLS_E_ERASE_FAILED: start-on-event=GetEventStatus, operation=EvtInfo_FLS_E_ERASE_FAILED.GetEventStatus
        Ev_GEF_FLS_E_ERASE_FAILED: start-on-event=GetEventFailed, operation=EvtInfo_FLS_E_ERASE_FAILED.GetEventFailed
        Ev_GET_FLS_E_ERASE_FAILED: start-on-event=GetEventTested, operation=EvtInfo_FLS_E_ERASE_FAILED.GetEventTested
        Ev_GDOE_FLS_E_ERASE_FAILED: start-on-event=GetDTCOfEvent, operation=EvtInfo_FLS_E_ERASE_FAILED.GetDTCOfEvent
        Ev_GETDOE_FLS_E_ERASE_FAILED: start-on-event=GetDebouncingOfEvent, operation=EvtInfo_FLS_E_ERASE_FAILED.GetDebouncingOfEvent
        Ev_GFDC_FLS_E_ERASE_FAILED: start-on-event=GetFaultDetectionCounter, operation=EvtInfo_FLS_E_ERASE_FAILED.GetFaultDetectionCounter
        Ev_GEED_FLS_E_ERASE_FAILED: start-on-event=GetEventExtendedDataRecord, operation=EvtInfo_FLS_E_ERASE_FAILED.GetEventExtendedDataRecord
        Ev_GEEDR_FLS_E_ERASE_FAILED: start-on-event=GetEventExtendedDataRecordEx, operation=EvtInfo_FLS_E_ERASE_FAILED.GetEventExtendedDataRecordEx
        Ev_GEFFD_FLS_E_ERASE_FAILED: start-on-event=GetEventFreezeFrameData, operation=EvtInfo_FLS_E_ERASE_FAILED.GetEventFreezeFrameData
        Ev_GEFFDE_FLS_E_ERASE_FAILED: start-on-event=GetEventFreezeFrameDataEx, operation=EvtInfo_FLS_E_ERASE_FAILED.GetEventFreezeFrameDataEx
        Ev_GES_FLS_E_GET_CONTROL_FAILURE: start-on-event=GetEventStatus, operation=EvtInfo_FLS_E_GET_CONTROL_FAILURE.GetEventStatus
        Ev_GEF_FLS_E_GET_CONTROL_FAILURE: start-on-event=GetEventFailed, operation=EvtInfo_FLS_E_GET_CONTROL_FAILURE.GetEventFailed
        Ev_GET_FLS_E_GET_CONTROL_FAILURE: start-on-event=GetEventTested, operation=EvtInfo_FLS_E_GET_CONTROL_FAILURE.GetEventTested
        Ev_GDOE_FLS_E_GET_CONTROL_FAILURE: start-on-event=GetDTCOfEvent, operation=EvtInfo_FLS_E_GET_CONTROL_FAILURE.GetDTCOfEvent
        Ev_GETDOE_FLS_E_GET_CONTROL_FAILURE: start-on-event=GetDebouncingOfEvent, operation=EvtInfo_FLS_E_GET_CONTROL_FAILURE.GetDebouncingOfEvent
        Ev_GFDC_FLS_E_GET_CONTROL_FAILURE: start-on-event=GetFaultDetectionCounter, operation=EvtInfo_FLS_E_GET_CONTROL_FAILURE.GetFaultDetectionCounter
        Ev_GEED_FLS_E_GET_CONTROL_FAILURE: start-on-event=GetEventExtendedDataRecord, operation=EvtInfo_FLS_E_GET_CONTROL_FAILURE.GetEventExtendedDataRecord
        Ev_GEEDR_FLS_E_GET_CONTROL_FAILURE: start-on-event=GetEventExtendedDataRecordEx, operation=EvtInfo_FLS_E_GET_CONTROL_FAILURE.GetEventExtendedDataRecordEx
        Ev_GEFFD_FLS_E_GET_CONTROL_FAILURE: start-on-event=GetEventFreezeFrameData, operation=EvtInfo_FLS_E_GET_CONTROL_FAILURE.GetEventFreezeFrameData
        Ev_GEFFDE_FLS_E_GET_CONTROL_FAILURE: start-on-event=GetEventFreezeFrameDataEx, operation=EvtInfo_FLS_E_GET_CONTROL_FAILURE.GetEventFreezeFrameDataEx
        Ev_GES_FLS_E_GET_SEMAPHORE_FAILURE: start-on-event=GetEventStatus, operation=EvtInfo_FLS_E_GET_SEMAPHORE_FAILURE.GetEventStatus
        Ev_GEF_FLS_E_GET_SEMAPHORE_FAILURE: start-on-event=GetEventFailed, operation=EvtInfo_FLS_E_GET_SEMAPHORE_FAILURE.GetEventFailed
        Ev_GET_FLS_E_GET_SEMAPHORE_FAILURE: start-on-event=GetEventTested, operation=EvtInfo_FLS_E_GET_SEMAPHORE_FAILURE.GetEventTested
        Ev_GDOE_FLS_E_GET_SEMAPHORE_FAILURE: start-on-event=GetDTCOfEvent, operation=EvtInfo_FLS_E_GET_SEMAPHORE_FAILURE.GetDTCOfEvent
        Ev_GETDOE_FLS_E_GET_SEMAPHORE_FAILURE: start-on-event=GetDebouncingOfEvent, operation=EvtInfo_FLS_E_GET_SEMAPHORE_FAILURE.GetDebouncingOfEvent
        Ev_GFDC_FLS_E_GET_SEMAPHORE_FAILURE: start-on-event=GetFaultDetectionCounter, operation=EvtInfo_FLS_E_GET_SEMAPHORE_FAILURE.GetFaultDetectionCounter
        Ev_GEED_FLS_E_GET_SEMAPHORE_FAILURE: start-on-event=GetEventExtendedDataRecord, operation=EvtInfo_FLS_E_GET_SEMAPHORE_FAILURE.GetEventExtendedDataRecord
        Ev_GEEDR_FLS_E_GET_SEMAPHORE_FAILURE: start-on-event=GetEventExtendedDataRecordEx, operation=EvtInfo_FLS_E_GET_SEMAPHORE_FAILURE.GetEventExtendedDataRecordEx
        Ev_GEFFD_FLS_E_GET_SEMAPHORE_FAILURE: start-on-event=GetEventFreezeFrameData, operation=EvtInfo_FLS_E_GET_SEMAPHORE_FAILURE.GetEventFreezeFrameData
        Ev_GEFFDE_FLS_E_GET_SEMAPHORE_FAILURE: start-on-event=GetEventFreezeFrameDataEx, operation=EvtInfo_FLS_E_GET_SEMAPHORE_FAILURE.GetEventFreezeFrameDataEx
        Ev_GES_FLS_E_READ_FAILED: start-on-event=GetEventStatus, operation=EvtInfo_FLS_E_READ_FAILED.GetEventStatus
        Ev_GEF_FLS_E_READ_FAILED: start-on-event=GetEventFailed, operation=EvtInfo_FLS_E_READ_FAILED.GetEventFailed
        Ev_GET_FLS_E_READ_FAILED: start-on-event=GetEventTested, operation=EvtInfo_FLS_E_READ_FAILED.GetEventTested
        Ev_GDOE_FLS_E_READ_FAILED: start-on-event=GetDTCOfEvent, operation=EvtInfo_FLS_E_READ_FAILED.GetDTCOfEvent
        Ev_GETDOE_FLS_E_READ_FAILED: start-on-event=GetDebouncingOfEvent, operation=EvtInfo_FLS_E_READ_FAILED.GetDebouncingOfEvent
        Ev_GFDC_FLS_E_READ_FAILED: start-on-event=GetFaultDetectionCounter, operation=EvtInfo_FLS_E_READ_FAILED.GetFaultDetectionCounter
        Ev_GEED_FLS_E_READ_FAILED: start-on-event=GetEventExtendedDataRecord, operation=EvtInfo_FLS_E_READ_FAILED.GetEventExtendedDataRecord
        Ev_GEEDR_FLS_E_READ_FAILED: start-on-event=GetEventExtendedDataRecordEx, operation=EvtInfo_FLS_E_READ_FAILED.GetEventExtendedDataRecordEx
        Ev_GEFFD_FLS_E_READ_FAILED: start-on-event=GetEventFreezeFrameData, operation=EvtInfo_FLS_E_READ_FAILED.GetEventFreezeFrameData
        Ev_GEFFDE_FLS_E_READ_FAILED: start-on-event=GetEventFreezeFrameDataEx, operation=EvtInfo_FLS_E_READ_FAILED.GetEventFreezeFrameDataEx
        Ev_GES_FLS_E_RELEASE_SEMAPHORE_FAILURE: start-on-event=GetEventStatus, operation=EvtInfo_FLS_E_RELEASE_SEMAPHORE_FAILURE.GetEventStatus
        Ev_GEF_FLS_E_RELEASE_SEMAPHORE_FAILURE: start-on-event=GetEventFailed, operation=EvtInfo_FLS_E_RELEASE_SEMAPHORE_FAILURE.GetEventFailed
        Ev_GET_FLS_E_RELEASE_SEMAPHORE_FAILURE: start-on-event=GetEventTested, operation=EvtInfo_FLS_E_RELEASE_SEMAPHORE_FAILURE.GetEventTested
        Ev_GDOE_FLS_E_RELEASE_SEMAPHORE_FAILURE: start-on-event=GetDTCOfEvent, operation=EvtInfo_FLS_E_RELEASE_SEMAPHORE_FAILURE.GetDTCOfEvent
        Ev_GETDOE_FLS_E_RELEASE_SEMAPHORE_FAILURE: start-on-event=GetDebouncingOfEvent, operation=EvtInfo_FLS_E_RELEASE_SEMAPHORE_FAILURE.GetDebouncingOfEvent
        Ev_GFDC_FLS_E_RELEASE_SEMAPHORE_FAILURE: start-on-event=GetFaultDetectionCounter, operation=EvtInfo_FLS_E_RELEASE_SEMAPHORE_FAILURE.GetFaultDetectionCounter
        Ev_GEED_FLS_E_RELEASE_SEMAPHORE_FAILURE: start-on-event=GetEventExtendedDataRecord, operation=EvtInfo_FLS_E_RELEASE_SEMAPHORE_FAILURE.GetEventExtendedDataRecord
        Ev_GEEDR_FLS_E_RELEASE_SEMAPHORE_FAILURE: start-on-event=GetEventExtendedDataRecordEx, operation=EvtInfo_FLS_E_RELEASE_SEMAPHORE_FAILURE.GetEventExtendedDataRecordEx
        Ev_GEFFD_FLS_E_RELEASE_SEMAPHORE_FAILURE: start-on-event=GetEventFreezeFrameData, operation=EvtInfo_FLS_E_RELEASE_SEMAPHORE_FAILURE.GetEventFreezeFrameData
        Ev_GEFFDE_FLS_E_RELEASE_SEMAPHORE_FAILURE: start-on-event=GetEventFreezeFrameDataEx, operation=EvtInfo_FLS_E_RELEASE_SEMAPHORE_FAILURE.GetEventFreezeFrameDataEx
        Ev_GES_FLS_E_UNEXPECTED_FLASH_ID: start-on-event=GetEventStatus, operation=EvtInfo_FLS_E_UNEXPECTED_FLASH_ID.GetEventStatus
        Ev_GEF_FLS_E_UNEXPECTED_FLASH_ID: start-on-event=GetEventFailed, operation=EvtInfo_FLS_E_UNEXPECTED_FLASH_ID.GetEventFailed
        Ev_GET_FLS_E_UNEXPECTED_FLASH_ID: start-on-event=GetEventTested, operation=EvtInfo_FLS_E_UNEXPECTED_FLASH_ID.GetEventTested
        Ev_GDOE_FLS_E_UNEXPECTED_FLASH_ID: start-on-event=GetDTCOfEvent, operation=EvtInfo_FLS_E_UNEXPECTED_FLASH_ID.GetDTCOfEvent
        Ev_GETDOE_FLS_E_UNEXPECTED_FLASH_ID: start-on-event=GetDebouncingOfEvent, operation=EvtInfo_FLS_E_UNEXPECTED_FLASH_ID.GetDebouncingOfEvent
        Ev_GFDC_FLS_E_UNEXPECTED_FLASH_ID: start-on-event=GetFaultDetectionCounter, operation=EvtInfo_FLS_E_UNEXPECTED_FLASH_ID.GetFaultDetectionCounter
        Ev_GEED_FLS_E_UNEXPECTED_FLASH_ID: start-on-event=GetEventExtendedDataRecord, operation=EvtInfo_FLS_E_UNEXPECTED_FLASH_ID.GetEventExtendedDataRecord
        Ev_GEEDR_FLS_E_UNEXPECTED_FLASH_ID: start-on-event=GetEventExtendedDataRecordEx, operation=EvtInfo_FLS_E_UNEXPECTED_FLASH_ID.GetEventExtendedDataRecordEx
        Ev_GEFFD_FLS_E_UNEXPECTED_FLASH_ID: start-on-event=GetEventFreezeFrameData, operation=EvtInfo_FLS_E_UNEXPECTED_FLASH_ID.GetEventFreezeFrameData
        Ev_GEFFDE_FLS_E_UNEXPECTED_FLASH_ID: start-on-event=GetEventFreezeFrameDataEx, operation=EvtInfo_FLS_E_UNEXPECTED_FLASH_ID.GetEventFreezeFrameDataEx
        Ev_GES_FLS_E_WRITE_FAILED: start-on-event=GetEventStatus, operation=EvtInfo_FLS_E_WRITE_FAILED.GetEventStatus
        Ev_GEF_FLS_E_WRITE_FAILED: start-on-event=GetEventFailed, operation=EvtInfo_FLS_E_WRITE_FAILED.GetEventFailed
        Ev_GET_FLS_E_WRITE_FAILED: start-on-event=GetEventTested, operation=EvtInfo_FLS_E_WRITE_FAILED.GetEventTested
        Ev_GDOE_FLS_E_WRITE_FAILED: start-on-event=GetDTCOfEvent, operation=EvtInfo_FLS_E_WRITE_FAILED.GetDTCOfEvent
        Ev_GETDOE_FLS_E_WRITE_FAILED: start-on-event=GetDebouncingOfEvent, operation=EvtInfo_FLS_E_WRITE_FAILED.GetDebouncingOfEvent
        Ev_GFDC_FLS_E_WRITE_FAILED: start-on-event=GetFaultDetectionCounter, operation=EvtInfo_FLS_E_WRITE_FAILED.GetFaultDetectionCounter
        Ev_GEED_FLS_E_WRITE_FAILED: start-on-event=GetEventExtendedDataRecord, operation=EvtInfo_FLS_E_WRITE_FAILED.GetEventExtendedDataRecord
        Ev_GEEDR_FLS_E_WRITE_FAILED: start-on-event=GetEventExtendedDataRecordEx, operation=EvtInfo_FLS_E_WRITE_FAILED.GetEventExtendedDataRecordEx
        Ev_GEFFD_FLS_E_WRITE_FAILED: start-on-event=GetEventFreezeFrameData, operation=EvtInfo_FLS_E_WRITE_FAILED.GetEventFreezeFrameData
        Ev_GEFFDE_FLS_E_WRITE_FAILED: start-on-event=GetEventFreezeFrameDataEx, operation=EvtInfo_FLS_E_WRITE_FAILED.GetEventFreezeFrameDataEx
        Ev_GES_FLS_E_WRITE_VERIFY_FAILURE: start-on-event=GetEventStatus, operation=EvtInfo_FLS_E_WRITE_VERIFY_FAILURE.GetEventStatus
        Ev_GEF_FLS_E_WRITE_VERIFY_FAILURE: start-on-event=GetEventFailed, operation=EvtInfo_FLS_E_WRITE_VERIFY_FAILURE.GetEventFailed
        Ev_GET_FLS_E_WRITE_VERIFY_FAILURE: start-on-event=GetEventTested, operation=EvtInfo_FLS_E_WRITE_VERIFY_FAILURE.GetEventTested
        Ev_GDOE_FLS_E_WRITE_VERIFY_FAILURE: start-on-event=GetDTCOfEvent, operation=EvtInfo_FLS_E_WRITE_VERIFY_FAILURE.GetDTCOfEvent
        Ev_GETDOE_FLS_E_WRITE_VERIFY_FAILURE: start-on-event=GetDebouncingOfEvent, operation=EvtInfo_FLS_E_WRITE_VERIFY_FAILURE.GetDebouncingOfEvent
        Ev_GFDC_FLS_E_WRITE_VERIFY_FAILURE: start-on-event=GetFaultDetectionCounter, operation=EvtInfo_FLS_E_WRITE_VERIFY_FAILURE.GetFaultDetectionCounter
        Ev_GEED_FLS_E_WRITE_VERIFY_FAILURE: start-on-event=GetEventExtendedDataRecord, operation=EvtInfo_FLS_E_WRITE_VERIFY_FAILURE.GetEventExtendedDataRecord
        Ev_GEEDR_FLS_E_WRITE_VERIFY_FAILURE: start-on-event=GetEventExtendedDataRecordEx, operation=EvtInfo_FLS_E_WRITE_VERIFY_FAILURE.GetEventExtendedDataRecordEx
        Ev_GEFFD_FLS_E_WRITE_VERIFY_FAILURE: start-on-event=GetEventFreezeFrameData, operation=EvtInfo_FLS_E_WRITE_VERIFY_FAILURE.GetEventFreezeFrameData
        Ev_GEFFDE_FLS_E_WRITE_VERIFY_FAILURE: start-on-event=GetEventFreezeFrameDataEx, operation=EvtInfo_FLS_E_WRITE_VERIFY_FAILURE.GetEventFreezeFrameDataEx
        Ev_GES_GPT_E_CONFIGURATION_CHECK_PERMANENT_FAILURE: start-on-event=GetEventStatus, operation=EvtInfo_GPT_E_CONFIGURATION_CHECK_PERMANENT_FAILURE.GetEventStatus
        Ev_GEF_GPT_E_CONFIGURATION_CHECK_PERMANENT_FAILURE: start-on-event=GetEventFailed, operation=EvtInfo_GPT_E_CONFIGURATION_CHECK_PERMANENT_FAILURE.GetEventFailed
        Ev_GET_GPT_E_CONFIGURATION_CHECK_PERMANENT_FAILURE: start-on-event=GetEventTested, operation=EvtInfo_GPT_E_CONFIGURATION_CHECK_PERMANENT_FAILURE.GetEventTested
        Ev_GDOE_GPT_E_CONFIGURATION_CHECK_PERMANENT_FAILURE: start-on-event=GetDTCOfEvent, operation=EvtInfo_GPT_E_CONFIGURATION_CHECK_PERMANENT_FAILURE.GetDTCOfEvent
        Ev_GETDOE_GPT_E_CONFIGURATION_CHECK_PERMANENT_FAILURE: start-on-event=GetDebouncingOfEvent, operation=EvtInfo_GPT_E_CONFIGURATION_CHECK_PERMANENT_FAILURE.GetDebouncingOfEvent
        Ev_GFDC_GPT_E_CONFIGURATION_CHECK_PERMANENT_FAILURE: start-on-event=GetFaultDetectionCounter, operation=EvtInfo_GPT_E_CONFIGURATION_CHECK_PERMANENT_FAILURE.GetFaultDetectionCounter
        Ev_GEED_GPT_E_CONFIGURATION_CHECK_PERMANENT_FAILURE: start-on-event=GetEventExtendedDataRecord, operation=EvtInfo_GPT_E_CONFIGURATION_CHECK_PERMANENT_FAILURE.GetEventExtendedDataRecord
        Ev_GEEDR_GPT_E_CONFIGURATION_CHECK_PERMANENT_FAILURE: start-on-event=GetEventExtendedDataRecordEx, operation=EvtInfo_GPT_E_CONFIGURATION_CHECK_PERMANENT_FAILURE.GetEventExtendedDataRecordEx
        Ev_GEFFD_GPT_E_CONFIGURATION_CHECK_PERMANENT_FAILURE: start-on-event=GetEventFreezeFrameData, operation=EvtInfo_GPT_E_CONFIGURATION_CHECK_PERMANENT_FAILURE.GetEventFreezeFrameData
        Ev_GEFFDE_GPT_E_CONFIGURATION_CHECK_PERMANENT_FAILURE: start-on-event=GetEventFreezeFrameDataEx, operation=EvtInfo_GPT_E_CONFIGURATION_CHECK_PERMANENT_FAILURE.GetEventFreezeFrameDataEx
        Ev_GES_GPT_E_CONFIGURATION_CHECK_TRANSIENT_FAILURE: start-on-event=GetEventStatus, operation=EvtInfo_GPT_E_CONFIGURATION_CHECK_TRANSIENT_FAILURE.GetEventStatus
        Ev_GEF_GPT_E_CONFIGURATION_CHECK_TRANSIENT_FAILURE: start-on-event=GetEventFailed, operation=EvtInfo_GPT_E_CONFIGURATION_CHECK_TRANSIENT_FAILURE.GetEventFailed
        Ev_GET_GPT_E_CONFIGURATION_CHECK_TRANSIENT_FAILURE: start-on-event=GetEventTested, operation=EvtInfo_GPT_E_CONFIGURATION_CHECK_TRANSIENT_FAILURE.GetEventTested
        Ev_GDOE_GPT_E_CONFIGURATION_CHECK_TRANSIENT_FAILURE: start-on-event=GetDTCOfEvent, operation=EvtInfo_GPT_E_CONFIGURATION_CHECK_TRANSIENT_FAILURE.GetDTCOfEvent
        Ev_GETDOE_GPT_E_CONFIGURATION_CHECK_TRANSIENT_FAILURE: start-on-event=GetDebouncingOfEvent, operation=EvtInfo_GPT_E_CONFIGURATION_CHECK_TRANSIENT_FAILURE.GetDebouncingOfEvent
        Ev_GFDC_GPT_E_CONFIGURATION_CHECK_TRANSIENT_FAILURE: start-on-event=GetFaultDetectionCounter, operation=EvtInfo_GPT_E_CONFIGURATION_CHECK_TRANSIENT_FAILURE.GetFaultDetectionCounter
        Ev_GEED_GPT_E_CONFIGURATION_CHECK_TRANSIENT_FAILURE: start-on-event=GetEventExtendedDataRecord, operation=EvtInfo_GPT_E_CONFIGURATION_CHECK_TRANSIENT_FAILURE.GetEventExtendedDataRecord
        Ev_GEEDR_GPT_E_CONFIGURATION_CHECK_TRANSIENT_FAILURE: start-on-event=GetEventExtendedDataRecordEx, operation=EvtInfo_GPT_E_CONFIGURATION_CHECK_TRANSIENT_FAILURE.GetEventExtendedDataRecordEx
        Ev_GEFFD_GPT_E_CONFIGURATION_CHECK_TRANSIENT_FAILURE: start-on-event=GetEventFreezeFrameData, operation=EvtInfo_GPT_E_CONFIGURATION_CHECK_TRANSIENT_FAILURE.GetEventFreezeFrameData
        Ev_GEFFDE_GPT_E_CONFIGURATION_CHECK_TRANSIENT_FAILURE: start-on-event=GetEventFreezeFrameDataEx, operation=EvtInfo_GPT_E_CONFIGURATION_CHECK_TRANSIENT_FAILURE.GetEventFreezeFrameDataEx
        Ev_GES_GPT_E_INTERRUPT_CONTROLLER_FAILURE: start-on-event=GetEventStatus, operation=EvtInfo_GPT_E_INTERRUPT_CONTROLLER_FAILURE.GetEventStatus
        Ev_GEF_GPT_E_INTERRUPT_CONTROLLER_FAILURE: start-on-event=GetEventFailed, operation=EvtInfo_GPT_E_INTERRUPT_CONTROLLER_FAILURE.GetEventFailed
        Ev_GET_GPT_E_INTERRUPT_CONTROLLER_FAILURE: start-on-event=GetEventTested, operation=EvtInfo_GPT_E_INTERRUPT_CONTROLLER_FAILURE.GetEventTested
        Ev_GDOE_GPT_E_INTERRUPT_CONTROLLER_FAILURE: start-on-event=GetDTCOfEvent, operation=EvtInfo_GPT_E_INTERRUPT_CONTROLLER_FAILURE.GetDTCOfEvent
        Ev_GETDOE_GPT_E_INTERRUPT_CONTROLLER_FAILURE: start-on-event=GetDebouncingOfEvent, operation=EvtInfo_GPT_E_INTERRUPT_CONTROLLER_FAILURE.GetDebouncingOfEvent
        Ev_GFDC_GPT_E_INTERRUPT_CONTROLLER_FAILURE: start-on-event=GetFaultDetectionCounter, operation=EvtInfo_GPT_E_INTERRUPT_CONTROLLER_FAILURE.GetFaultDetectionCounter
        Ev_GEED_GPT_E_INTERRUPT_CONTROLLER_FAILURE: start-on-event=GetEventExtendedDataRecord, operation=EvtInfo_GPT_E_INTERRUPT_CONTROLLER_FAILURE.GetEventExtendedDataRecord
        Ev_GEEDR_GPT_E_INTERRUPT_CONTROLLER_FAILURE: start-on-event=GetEventExtendedDataRecordEx, operation=EvtInfo_GPT_E_INTERRUPT_CONTROLLER_FAILURE.GetEventExtendedDataRecordEx
        Ev_GEFFD_GPT_E_INTERRUPT_CONTROLLER_FAILURE: start-on-event=GetEventFreezeFrameData, operation=EvtInfo_GPT_E_INTERRUPT_CONTROLLER_FAILURE.GetEventFreezeFrameData
        Ev_GEFFDE_GPT_E_INTERRUPT_CONTROLLER_FAILURE: start-on-event=GetEventFreezeFrameDataEx, operation=EvtInfo_GPT_E_INTERRUPT_CONTROLLER_FAILURE.GetEventFreezeFrameDataEx
        Ev_GES_GPT_E_WRITEVERIFY_FAILURE: start-on-event=GetEventStatus, operation=EvtInfo_GPT_E_WRITEVERIFY_FAILURE.GetEventStatus
        Ev_GEF_GPT_E_WRITEVERIFY_FAILURE: start-on-event=GetEventFailed, operation=EvtInfo_GPT_E_WRITEVERIFY_FAILURE.GetEventFailed
        Ev_GET_GPT_E_WRITEVERIFY_FAILURE: start-on-event=GetEventTested, operation=EvtInfo_GPT_E_WRITEVERIFY_FAILURE.GetEventTested
        Ev_GDOE_GPT_E_WRITEVERIFY_FAILURE: start-on-event=GetDTCOfEvent, operation=EvtInfo_GPT_E_WRITEVERIFY_FAILURE.GetDTCOfEvent
        Ev_GETDOE_GPT_E_WRITEVERIFY_FAILURE: start-on-event=GetDebouncingOfEvent, operation=EvtInfo_GPT_E_WRITEVERIFY_FAILURE.GetDebouncingOfEvent
        Ev_GFDC_GPT_E_WRITEVERIFY_FAILURE: start-on-event=GetFaultDetectionCounter, operation=EvtInfo_GPT_E_WRITEVERIFY_FAILURE.GetFaultDetectionCounter
        Ev_GEED_GPT_E_WRITEVERIFY_FAILURE: start-on-event=GetEventExtendedDataRecord, operation=EvtInfo_GPT_E_WRITEVERIFY_FAILURE.GetEventExtendedDataRecord
        Ev_GEEDR_GPT_E_WRITEVERIFY_FAILURE: start-on-event=GetEventExtendedDataRecordEx, operation=EvtInfo_GPT_E_WRITEVERIFY_FAILURE.GetEventExtendedDataRecordEx
        Ev_GEFFD_GPT_E_WRITEVERIFY_FAILURE: start-on-event=GetEventFreezeFrameData, operation=EvtInfo_GPT_E_WRITEVERIFY_FAILURE.GetEventFreezeFrameData
        Ev_GEFFDE_GPT_E_WRITEVERIFY_FAILURE: start-on-event=GetEventFreezeFrameDataEx, operation=EvtInfo_GPT_E_WRITEVERIFY_FAILURE.GetEventFreezeFrameDataEx
        Ev_GES_MCU_E_CHECK_FAILURE: start-on-event=GetEventStatus, operation=EvtInfo_MCU_E_CHECK_FAILURE.GetEventStatus
        Ev_GEF_MCU_E_CHECK_FAILURE: start-on-event=GetEventFailed, operation=EvtInfo_MCU_E_CHECK_FAILURE.GetEventFailed
        Ev_GET_MCU_E_CHECK_FAILURE: start-on-event=GetEventTested, operation=EvtInfo_MCU_E_CHECK_FAILURE.GetEventTested
        Ev_GDOE_MCU_E_CHECK_FAILURE: start-on-event=GetDTCOfEvent, operation=EvtInfo_MCU_E_CHECK_FAILURE.GetDTCOfEvent
        Ev_GETDOE_MCU_E_CHECK_FAILURE: start-on-event=GetDebouncingOfEvent, operation=EvtInfo_MCU_E_CHECK_FAILURE.GetDebouncingOfEvent
        Ev_GFDC_MCU_E_CHECK_FAILURE: start-on-event=GetFaultDetectionCounter, operation=EvtInfo_MCU_E_CHECK_FAILURE.GetFaultDetectionCounter
        Ev_GEED_MCU_E_CHECK_FAILURE: start-on-event=GetEventExtendedDataRecord, operation=EvtInfo_MCU_E_CHECK_FAILURE.GetEventExtendedDataRecord
        Ev_GEEDR_MCU_E_CHECK_FAILURE: start-on-event=GetEventExtendedDataRecordEx, operation=EvtInfo_MCU_E_CHECK_FAILURE.GetEventExtendedDataRecordEx
        Ev_GEFFD_MCU_E_CHECK_FAILURE: start-on-event=GetEventFreezeFrameData, operation=EvtInfo_MCU_E_CHECK_FAILURE.GetEventFreezeFrameData
        Ev_GEFFDE_MCU_E_CHECK_FAILURE: start-on-event=GetEventFreezeFrameDataEx, operation=EvtInfo_MCU_E_CHECK_FAILURE.GetEventFreezeFrameDataEx
        Ev_GES_MCU_E_CLOCK_FAILURE: start-on-event=GetEventStatus, operation=EvtInfo_MCU_E_CLOCK_FAILURE.GetEventStatus
        Ev_GEF_MCU_E_CLOCK_FAILURE: start-on-event=GetEventFailed, operation=EvtInfo_MCU_E_CLOCK_FAILURE.GetEventFailed
        Ev_GET_MCU_E_CLOCK_FAILURE: start-on-event=GetEventTested, operation=EvtInfo_MCU_E_CLOCK_FAILURE.GetEventTested
        Ev_GDOE_MCU_E_CLOCK_FAILURE: start-on-event=GetDTCOfEvent, operation=EvtInfo_MCU_E_CLOCK_FAILURE.GetDTCOfEvent
        Ev_GETDOE_MCU_E_CLOCK_FAILURE: start-on-event=GetDebouncingOfEvent, operation=EvtInfo_MCU_E_CLOCK_FAILURE.GetDebouncingOfEvent
        Ev_GFDC_MCU_E_CLOCK_FAILURE: start-on-event=GetFaultDetectionCounter, operation=EvtInfo_MCU_E_CLOCK_FAILURE.GetFaultDetectionCounter
        Ev_GEED_MCU_E_CLOCK_FAILURE: start-on-event=GetEventExtendedDataRecord, operation=EvtInfo_MCU_E_CLOCK_FAILURE.GetEventExtendedDataRecord
        Ev_GEEDR_MCU_E_CLOCK_FAILURE: start-on-event=GetEventExtendedDataRecordEx, operation=EvtInfo_MCU_E_CLOCK_FAILURE.GetEventExtendedDataRecordEx
        Ev_GEFFD_MCU_E_CLOCK_FAILURE: start-on-event=GetEventFreezeFrameData, operation=EvtInfo_MCU_E_CLOCK_FAILURE.GetEventFreezeFrameData
        Ev_GEFFDE_MCU_E_CLOCK_FAILURE: start-on-event=GetEventFreezeFrameDataEx, operation=EvtInfo_MCU_E_CLOCK_FAILURE.GetEventFreezeFrameDataEx
        Ev_GES_MCU_E_CONFIGURATION_CHECK_PERMANENT_FAILURE: start-on-event=GetEventStatus, operation=EvtInfo_MCU_E_CONFIGURATION_CHECK_PERMANENT_FAILURE.GetEventStatus
        Ev_GEF_MCU_E_CONFIGURATION_CHECK_PERMANENT_FAILURE: start-on-event=GetEventFailed, operation=EvtInfo_MCU_E_CONFIGURATION_CHECK_PERMANENT_FAILURE.GetEventFailed
        Ev_GET_MCU_E_CONFIGURATION_CHECK_PERMANENT_FAILURE: start-on-event=GetEventTested, operation=EvtInfo_MCU_E_CONFIGURATION_CHECK_PERMANENT_FAILURE.GetEventTested
        Ev_GDOE_MCU_E_CONFIGURATION_CHECK_PERMANENT_FAILURE: start-on-event=GetDTCOfEvent, operation=EvtInfo_MCU_E_CONFIGURATION_CHECK_PERMANENT_FAILURE.GetDTCOfEvent
        Ev_GETDOE_MCU_E_CONFIGURATION_CHECK_PERMANENT_FAILURE: start-on-event=GetDebouncingOfEvent, operation=EvtInfo_MCU_E_CONFIGURATION_CHECK_PERMANENT_FAILURE.GetDebouncingOfEvent
        Ev_GFDC_MCU_E_CONFIGURATION_CHECK_PERMANENT_FAILURE: start-on-event=GetFaultDetectionCounter, operation=EvtInfo_MCU_E_CONFIGURATION_CHECK_PERMANENT_FAILURE.GetFaultDetectionCounter
        Ev_GEED_MCU_E_CONFIGURATION_CHECK_PERMANENT_FAILURE: start-on-event=GetEventExtendedDataRecord, operation=EvtInfo_MCU_E_CONFIGURATION_CHECK_PERMANENT_FAILURE.GetEventExtendedDataRecord
        Ev_GEEDR_MCU_E_CONFIGURATION_CHECK_PERMANENT_FAILURE: start-on-event=GetEventExtendedDataRecordEx, operation=EvtInfo_MCU_E_CONFIGURATION_CHECK_PERMANENT_FAILURE.GetEventExtendedDataRecordEx
        Ev_GEFFD_MCU_E_CONFIGURATION_CHECK_PERMANENT_FAILURE: start-on-event=GetEventFreezeFrameData, operation=EvtInfo_MCU_E_CONFIGURATION_CHECK_PERMANENT_FAILURE.GetEventFreezeFrameData
        Ev_GEFFDE_MCU_E_CONFIGURATION_CHECK_PERMANENT_FAILURE: start-on-event=GetEventFreezeFrameDataEx, operation=EvtInfo_MCU_E_CONFIGURATION_CHECK_PERMANENT_FAILURE.GetEventFreezeFrameDataEx
        Ev_GES_MCU_E_CONFIGURATION_CHECK_TRANSIENT_FAILURE: start-on-event=GetEventStatus, operation=EvtInfo_MCU_E_CONFIGURATION_CHECK_TRANSIENT_FAILURE.GetEventStatus
        Ev_GEF_MCU_E_CONFIGURATION_CHECK_TRANSIENT_FAILURE: start-on-event=GetEventFailed, operation=EvtInfo_MCU_E_CONFIGURATION_CHECK_TRANSIENT_FAILURE.GetEventFailed
        Ev_GET_MCU_E_CONFIGURATION_CHECK_TRANSIENT_FAILURE: start-on-event=GetEventTested, operation=EvtInfo_MCU_E_CONFIGURATION_CHECK_TRANSIENT_FAILURE.GetEventTested
        Ev_GDOE_MCU_E_CONFIGURATION_CHECK_TRANSIENT_FAILURE: start-on-event=GetDTCOfEvent, operation=EvtInfo_MCU_E_CONFIGURATION_CHECK_TRANSIENT_FAILURE.GetDTCOfEvent
        Ev_GETDOE_MCU_E_CONFIGURATION_CHECK_TRANSIENT_FAILURE: start-on-event=GetDebouncingOfEvent, operation=EvtInfo_MCU_E_CONFIGURATION_CHECK_TRANSIENT_FAILURE.GetDebouncingOfEvent
        Ev_GFDC_MCU_E_CONFIGURATION_CHECK_TRANSIENT_FAILURE: start-on-event=GetFaultDetectionCounter, operation=EvtInfo_MCU_E_CONFIGURATION_CHECK_TRANSIENT_FAILURE.GetFaultDetectionCounter
        Ev_GEED_MCU_E_CONFIGURATION_CHECK_TRANSIENT_FAILURE: start-on-event=GetEventExtendedDataRecord, operation=EvtInfo_MCU_E_CONFIGURATION_CHECK_TRANSIENT_FAILURE.GetEventExtendedDataRecord
        Ev_GEEDR_MCU_E_CONFIGURATION_CHECK_TRANSIENT_FAILURE: start-on-event=GetEventExtendedDataRecordEx, operation=EvtInfo_MCU_E_CONFIGURATION_CHECK_TRANSIENT_FAILURE.GetEventExtendedDataRecordEx
        Ev_GEFFD_MCU_E_CONFIGURATION_CHECK_TRANSIENT_FAILURE: start-on-event=GetEventFreezeFrameData, operation=EvtInfo_MCU_E_CONFIGURATION_CHECK_TRANSIENT_FAILURE.GetEventFreezeFrameData
        Ev_GEFFDE_MCU_E_CONFIGURATION_CHECK_TRANSIENT_FAILURE: start-on-event=GetEventFreezeFrameDataEx, operation=EvtInfo_MCU_E_CONFIGURATION_CHECK_TRANSIENT_FAILURE.GetEventFreezeFrameDataEx
        Ev_GES_MCU_E_CONFIGURATION_CHECK_TRANSITION_FAILURE: start-on-event=GetEventStatus, operation=EvtInfo_MCU_E_CONFIGURATION_CHECK_TRANSITION_FAILURE.GetEventStatus
        Ev_GEF_MCU_E_CONFIGURATION_CHECK_TRANSITION_FAILURE: start-on-event=GetEventFailed, operation=EvtInfo_MCU_E_CONFIGURATION_CHECK_TRANSITION_FAILURE.GetEventFailed
        Ev_GET_MCU_E_CONFIGURATION_CHECK_TRANSITION_FAILURE: start-on-event=GetEventTested, operation=EvtInfo_MCU_E_CONFIGURATION_CHECK_TRANSITION_FAILURE.GetEventTested
        Ev_GDOE_MCU_E_CONFIGURATION_CHECK_TRANSITION_FAILURE: start-on-event=GetDTCOfEvent, operation=EvtInfo_MCU_E_CONFIGURATION_CHECK_TRANSITION_FAILURE.GetDTCOfEvent
        Ev_GETDOE_MCU_E_CONFIGURATION_CHECK_TRANSITION_FAILURE: start-on-event=GetDebouncingOfEvent, operation=EvtInfo_MCU_E_CONFIGURATION_CHECK_TRANSITION_FAILURE.GetDebouncingOfEvent
        Ev_GFDC_MCU_E_CONFIGURATION_CHECK_TRANSITION_FAILURE: start-on-event=GetFaultDetectionCounter, operation=EvtInfo_MCU_E_CONFIGURATION_CHECK_TRANSITION_FAILURE.GetFaultDetectionCounter
        Ev_GEED_MCU_E_CONFIGURATION_CHECK_TRANSITION_FAILURE: start-on-event=GetEventExtendedDataRecord, operation=EvtInfo_MCU_E_CONFIGURATION_CHECK_TRANSITION_FAILURE.GetEventExtendedDataRecord
        Ev_GEEDR_MCU_E_CONFIGURATION_CHECK_TRANSITION_FAILURE: start-on-event=GetEventExtendedDataRecordEx, operation=EvtInfo_MCU_E_CONFIGURATION_CHECK_TRANSITION_FAILURE.GetEventExtendedDataRecordEx
        Ev_GEFFD_MCU_E_CONFIGURATION_CHECK_TRANSITION_FAILURE: start-on-event=GetEventFreezeFrameData, operation=EvtInfo_MCU_E_CONFIGURATION_CHECK_TRANSITION_FAILURE.GetEventFreezeFrameData
        Ev_GEFFDE_MCU_E_CONFIGURATION_CHECK_TRANSITION_FAILURE: start-on-event=GetEventFreezeFrameDataEx, operation=EvtInfo_MCU_E_CONFIGURATION_CHECK_TRANSITION_FAILURE.GetEventFreezeFrameDataEx
        Ev_GES_MCU_E_GET_CONTROL_FAILURE: start-on-event=GetEventStatus, operation=EvtInfo_MCU_E_GET_CONTROL_FAILURE.GetEventStatus
        Ev_GEF_MCU_E_GET_CONTROL_FAILURE: start-on-event=GetEventFailed, operation=EvtInfo_MCU_E_GET_CONTROL_FAILURE.GetEventFailed
        Ev_GET_MCU_E_GET_CONTROL_FAILURE: start-on-event=GetEventTested, operation=EvtInfo_MCU_E_GET_CONTROL_FAILURE.GetEventTested
        Ev_GDOE_MCU_E_GET_CONTROL_FAILURE: start-on-event=GetDTCOfEvent, operation=EvtInfo_MCU_E_GET_CONTROL_FAILURE.GetDTCOfEvent
        Ev_GETDOE_MCU_E_GET_CONTROL_FAILURE: start-on-event=GetDebouncingOfEvent, operation=EvtInfo_MCU_E_GET_CONTROL_FAILURE.GetDebouncingOfEvent
        Ev_GFDC_MCU_E_GET_CONTROL_FAILURE: start-on-event=GetFaultDetectionCounter, operation=EvtInfo_MCU_E_GET_CONTROL_FAILURE.GetFaultDetectionCounter
        Ev_GEED_MCU_E_GET_CONTROL_FAILURE: start-on-event=GetEventExtendedDataRecord, operation=EvtInfo_MCU_E_GET_CONTROL_FAILURE.GetEventExtendedDataRecord
        Ev_GEEDR_MCU_E_GET_CONTROL_FAILURE: start-on-event=GetEventExtendedDataRecordEx, operation=EvtInfo_MCU_E_GET_CONTROL_FAILURE.GetEventExtendedDataRecordEx
        Ev_GEFFD_MCU_E_GET_CONTROL_FAILURE: start-on-event=GetEventFreezeFrameData, operation=EvtInfo_MCU_E_GET_CONTROL_FAILURE.GetEventFreezeFrameData
        Ev_GEFFDE_MCU_E_GET_CONTROL_FAILURE: start-on-event=GetEventFreezeFrameDataEx, operation=EvtInfo_MCU_E_GET_CONTROL_FAILURE.GetEventFreezeFrameDataEx
        Ev_GES_MCU_E_INTERNAL_BUS_FAILURE: start-on-event=GetEventStatus, operation=EvtInfo_MCU_E_INTERNAL_BUS_FAILURE.GetEventStatus
        Ev_GEF_MCU_E_INTERNAL_BUS_FAILURE: start-on-event=GetEventFailed, operation=EvtInfo_MCU_E_INTERNAL_BUS_FAILURE.GetEventFailed
        Ev_GET_MCU_E_INTERNAL_BUS_FAILURE: start-on-event=GetEventTested, operation=EvtInfo_MCU_E_INTERNAL_BUS_FAILURE.GetEventTested
        Ev_GDOE_MCU_E_INTERNAL_BUS_FAILURE: start-on-event=GetDTCOfEvent, operation=EvtInfo_MCU_E_INTERNAL_BUS_FAILURE.GetDTCOfEvent
        Ev_GETDOE_MCU_E_INTERNAL_BUS_FAILURE: start-on-event=GetDebouncingOfEvent, operation=EvtInfo_MCU_E_INTERNAL_BUS_FAILURE.GetDebouncingOfEvent
        Ev_GFDC_MCU_E_INTERNAL_BUS_FAILURE: start-on-event=GetFaultDetectionCounter, operation=EvtInfo_MCU_E_INTERNAL_BUS_FAILURE.GetFaultDetectionCounter
        Ev_GEED_MCU_E_INTERNAL_BUS_FAILURE: start-on-event=GetEventExtendedDataRecord, operation=EvtInfo_MCU_E_INTERNAL_BUS_FAILURE.GetEventExtendedDataRecord
        Ev_GEEDR_MCU_E_INTERNAL_BUS_FAILURE: start-on-event=GetEventExtendedDataRecordEx, operation=EvtInfo_MCU_E_INTERNAL_BUS_FAILURE.GetEventExtendedDataRecordEx
        Ev_GEFFD_MCU_E_INTERNAL_BUS_FAILURE: start-on-event=GetEventFreezeFrameData, operation=EvtInfo_MCU_E_INTERNAL_BUS_FAILURE.GetEventFreezeFrameData
        Ev_GEFFDE_MCU_E_INTERNAL_BUS_FAILURE: start-on-event=GetEventFreezeFrameDataEx, operation=EvtInfo_MCU_E_INTERNAL_BUS_FAILURE.GetEventFreezeFrameDataEx
        Ev_GES_MCU_E_READ_BACK_FAILURE: start-on-event=GetEventStatus, operation=EvtInfo_MCU_E_READ_BACK_FAILURE.GetEventStatus
        Ev_GEF_MCU_E_READ_BACK_FAILURE: start-on-event=GetEventFailed, operation=EvtInfo_MCU_E_READ_BACK_FAILURE.GetEventFailed
        Ev_GET_MCU_E_READ_BACK_FAILURE: start-on-event=GetEventTested, operation=EvtInfo_MCU_E_READ_BACK_FAILURE.GetEventTested
        Ev_GDOE_MCU_E_READ_BACK_FAILURE: start-on-event=GetDTCOfEvent, operation=EvtInfo_MCU_E_READ_BACK_FAILURE.GetDTCOfEvent
        Ev_GETDOE_MCU_E_READ_BACK_FAILURE: start-on-event=GetDebouncingOfEvent, operation=EvtInfo_MCU_E_READ_BACK_FAILURE.GetDebouncingOfEvent
        Ev_GFDC_MCU_E_READ_BACK_FAILURE: start-on-event=GetFaultDetectionCounter, operation=EvtInfo_MCU_E_READ_BACK_FAILURE.GetFaultDetectionCounter
        Ev_GEED_MCU_E_READ_BACK_FAILURE: start-on-event=GetEventExtendedDataRecord, operation=EvtInfo_MCU_E_READ_BACK_FAILURE.GetEventExtendedDataRecord
        Ev_GEEDR_MCU_E_READ_BACK_FAILURE: start-on-event=GetEventExtendedDataRecordEx, operation=EvtInfo_MCU_E_READ_BACK_FAILURE.GetEventExtendedDataRecordEx
        Ev_GEFFD_MCU_E_READ_BACK_FAILURE: start-on-event=GetEventFreezeFrameData, operation=EvtInfo_MCU_E_READ_BACK_FAILURE.GetEventFreezeFrameData
        Ev_GEFFDE_MCU_E_READ_BACK_FAILURE: start-on-event=GetEventFreezeFrameDataEx, operation=EvtInfo_MCU_E_READ_BACK_FAILURE.GetEventFreezeFrameDataEx
        Ev_GES_MCU_E_TIMEOUT_FAILURE: start-on-event=GetEventStatus, operation=EvtInfo_MCU_E_TIMEOUT_FAILURE.GetEventStatus
        Ev_GEF_MCU_E_TIMEOUT_FAILURE: start-on-event=GetEventFailed, operation=EvtInfo_MCU_E_TIMEOUT_FAILURE.GetEventFailed
        Ev_GET_MCU_E_TIMEOUT_FAILURE: start-on-event=GetEventTested, operation=EvtInfo_MCU_E_TIMEOUT_FAILURE.GetEventTested
        Ev_GDOE_MCU_E_TIMEOUT_FAILURE: start-on-event=GetDTCOfEvent, operation=EvtInfo_MCU_E_TIMEOUT_FAILURE.GetDTCOfEvent
        Ev_GETDOE_MCU_E_TIMEOUT_FAILURE: start-on-event=GetDebouncingOfEvent, operation=EvtInfo_MCU_E_TIMEOUT_FAILURE.GetDebouncingOfEvent
        Ev_GFDC_MCU_E_TIMEOUT_FAILURE: start-on-event=GetFaultDetectionCounter, operation=EvtInfo_MCU_E_TIMEOUT_FAILURE.GetFaultDetectionCounter
        Ev_GEED_MCU_E_TIMEOUT_FAILURE: start-on-event=GetEventExtendedDataRecord, operation=EvtInfo_MCU_E_TIMEOUT_FAILURE.GetEventExtendedDataRecord
        Ev_GEEDR_MCU_E_TIMEOUT_FAILURE: start-on-event=GetEventExtendedDataRecordEx, operation=EvtInfo_MCU_E_TIMEOUT_FAILURE.GetEventExtendedDataRecordEx
        Ev_GEFFD_MCU_E_TIMEOUT_FAILURE: start-on-event=GetEventFreezeFrameData, operation=EvtInfo_MCU_E_TIMEOUT_FAILURE.GetEventFreezeFrameData
        Ev_GEFFDE_MCU_E_TIMEOUT_FAILURE: start-on-event=GetEventFreezeFrameDataEx, operation=EvtInfo_MCU_E_TIMEOUT_FAILURE.GetEventFreezeFrameDataEx
        Ev_GES_MCU_E_WRITE_TIMEOUT_FAILURE: start-on-event=GetEventStatus, operation=EvtInfo_MCU_E_WRITE_TIMEOUT_FAILURE.GetEventStatus
        Ev_GEF_MCU_E_WRITE_TIMEOUT_FAILURE: start-on-event=GetEventFailed, operation=EvtInfo_MCU_E_WRITE_TIMEOUT_FAILURE.GetEventFailed
        Ev_GET_MCU_E_WRITE_TIMEOUT_FAILURE: start-on-event=GetEventTested, operation=EvtInfo_MCU_E_WRITE_TIMEOUT_FAILURE.GetEventTested
        Ev_GDOE_MCU_E_WRITE_TIMEOUT_FAILURE: start-on-event=GetDTCOfEvent, operation=EvtInfo_MCU_E_WRITE_TIMEOUT_FAILURE.GetDTCOfEvent
        Ev_GETDOE_MCU_E_WRITE_TIMEOUT_FAILURE: start-on-event=GetDebouncingOfEvent, operation=EvtInfo_MCU_E_WRITE_TIMEOUT_FAILURE.GetDebouncingOfEvent
        Ev_GFDC_MCU_E_WRITE_TIMEOUT_FAILURE: start-on-event=GetFaultDetectionCounter, operation=EvtInfo_MCU_E_WRITE_TIMEOUT_FAILURE.GetFaultDetectionCounter
        Ev_GEED_MCU_E_WRITE_TIMEOUT_FAILURE: start-on-event=GetEventExtendedDataRecord, operation=EvtInfo_MCU_E_WRITE_TIMEOUT_FAILURE.GetEventExtendedDataRecord
        Ev_GEEDR_MCU_E_WRITE_TIMEOUT_FAILURE: start-on-event=GetEventExtendedDataRecordEx, operation=EvtInfo_MCU_E_WRITE_TIMEOUT_FAILURE.GetEventExtendedDataRecordEx
        Ev_GEFFD_MCU_E_WRITE_TIMEOUT_FAILURE: start-on-event=GetEventFreezeFrameData, operation=EvtInfo_MCU_E_WRITE_TIMEOUT_FAILURE.GetEventFreezeFrameData
        Ev_GEFFDE_MCU_E_WRITE_TIMEOUT_FAILURE: start-on-event=GetEventFreezeFrameDataEx, operation=EvtInfo_MCU_E_WRITE_TIMEOUT_FAILURE.GetEventFreezeFrameDataEx
        Ev_GES_PORT_E_CONFIGURATION_CHECK_PERMANENT_FAILURE: start-on-event=GetEventStatus, operation=EvtInfo_PORT_E_CONFIGURATION_CHECK_PERMANENT_FAILURE.GetEventStatus
        Ev_GEF_PORT_E_CONFIGURATION_CHECK_PERMANENT_FAILURE: start-on-event=GetEventFailed, operation=EvtInfo_PORT_E_CONFIGURATION_CHECK_PERMANENT_FAILURE.GetEventFailed
        Ev_GET_PORT_E_CONFIGURATION_CHECK_PERMANENT_FAILURE: start-on-event=GetEventTested, operation=EvtInfo_PORT_E_CONFIGURATION_CHECK_PERMANENT_FAILURE.GetEventTested
        Ev_GDOE_PORT_E_CONFIGURATION_CHECK_PERMANENT_FAILURE: start-on-event=GetDTCOfEvent, operation=EvtInfo_PORT_E_CONFIGURATION_CHECK_PERMANENT_FAILURE.GetDTCOfEvent
        Ev_GETDOE_PORT_E_CONFIGURATION_CHECK_PERMANENT_FAILURE: start-on-event=GetDebouncingOfEvent, operation=EvtInfo_PORT_E_CONFIGURATION_CHECK_PERMANENT_FAILURE.GetDebouncingOfEvent
        Ev_GFDC_PORT_E_CONFIGURATION_CHECK_PERMANENT_FAILURE: start-on-event=GetFaultDetectionCounter, operation=EvtInfo_PORT_E_CONFIGURATION_CHECK_PERMANENT_FAILURE.GetFaultDetectionCounter
        Ev_GEED_PORT_E_CONFIGURATION_CHECK_PERMANENT_FAILURE: start-on-event=GetEventExtendedDataRecord, operation=EvtInfo_PORT_E_CONFIGURATION_CHECK_PERMANENT_FAILURE.GetEventExtendedDataRecord
        Ev_GEEDR_PORT_E_CONFIGURATION_CHECK_PERMANENT_FAILURE: start-on-event=GetEventExtendedDataRecordEx, operation=EvtInfo_PORT_E_CONFIGURATION_CHECK_PERMANENT_FAILURE.GetEventExtendedDataRecordEx
        Ev_GEFFD_PORT_E_CONFIGURATION_CHECK_PERMANENT_FAILURE: start-on-event=GetEventFreezeFrameData, operation=EvtInfo_PORT_E_CONFIGURATION_CHECK_PERMANENT_FAILURE.GetEventFreezeFrameData
        Ev_GEFFDE_PORT_E_CONFIGURATION_CHECK_PERMANENT_FAILURE: start-on-event=GetEventFreezeFrameDataEx, operation=EvtInfo_PORT_E_CONFIGURATION_CHECK_PERMANENT_FAILURE.GetEventFreezeFrameDataEx
        Ev_GES_PORT_E_CONFIGURATION_CHECK_TRANSIENT_FAILURE: start-on-event=GetEventStatus, operation=EvtInfo_PORT_E_CONFIGURATION_CHECK_TRANSIENT_FAILURE.GetEventStatus
        Ev_GEF_PORT_E_CONFIGURATION_CHECK_TRANSIENT_FAILURE: start-on-event=GetEventFailed, operation=EvtInfo_PORT_E_CONFIGURATION_CHECK_TRANSIENT_FAILURE.GetEventFailed
        Ev_GET_PORT_E_CONFIGURATION_CHECK_TRANSIENT_FAILURE: start-on-event=GetEventTested, operation=EvtInfo_PORT_E_CONFIGURATION_CHECK_TRANSIENT_FAILURE.GetEventTested
        Ev_GDOE_PORT_E_CONFIGURATION_CHECK_TRANSIENT_FAILURE: start-on-event=GetDTCOfEvent, operation=EvtInfo_PORT_E_CONFIGURATION_CHECK_TRANSIENT_FAILURE.GetDTCOfEvent
        Ev_GETDOE_PORT_E_CONFIGURATION_CHECK_TRANSIENT_FAILURE: start-on-event=GetDebouncingOfEvent, operation=EvtInfo_PORT_E_CONFIGURATION_CHECK_TRANSIENT_FAILURE.GetDebouncingOfEvent
        Ev_GFDC_PORT_E_CONFIGURATION_CHECK_TRANSIENT_FAILURE: start-on-event=GetFaultDetectionCounter, operation=EvtInfo_PORT_E_CONFIGURATION_CHECK_TRANSIENT_FAILURE.GetFaultDetectionCounter
        Ev_GEED_PORT_E_CONFIGURATION_CHECK_TRANSIENT_FAILURE: start-on-event=GetEventExtendedDataRecord, operation=EvtInfo_PORT_E_CONFIGURATION_CHECK_TRANSIENT_FAILURE.GetEventExtendedDataRecord
        Ev_GEEDR_PORT_E_CONFIGURATION_CHECK_TRANSIENT_FAILURE: start-on-event=GetEventExtendedDataRecordEx, operation=EvtInfo_PORT_E_CONFIGURATION_CHECK_TRANSIENT_FAILURE.GetEventExtendedDataRecordEx
        Ev_GEFFD_PORT_E_CONFIGURATION_CHECK_TRANSIENT_FAILURE: start-on-event=GetEventFreezeFrameData, operation=EvtInfo_PORT_E_CONFIGURATION_CHECK_TRANSIENT_FAILURE.GetEventFreezeFrameData
        Ev_GEFFDE_PORT_E_CONFIGURATION_CHECK_TRANSIENT_FAILURE: start-on-event=GetEventFreezeFrameDataEx, operation=EvtInfo_PORT_E_CONFIGURATION_CHECK_TRANSIENT_FAILURE.GetEventFreezeFrameDataEx
        Ev_GES_PORT_E_FUSE_MONITORING_FAILURE: start-on-event=GetEventStatus, operation=EvtInfo_PORT_E_FUSE_MONITORING_FAILURE.GetEventStatus
        Ev_GEF_PORT_E_FUSE_MONITORING_FAILURE: start-on-event=GetEventFailed, operation=EvtInfo_PORT_E_FUSE_MONITORING_FAILURE.GetEventFailed
        Ev_GET_PORT_E_FUSE_MONITORING_FAILURE: start-on-event=GetEventTested, operation=EvtInfo_PORT_E_FUSE_MONITORING_FAILURE.GetEventTested
        Ev_GDOE_PORT_E_FUSE_MONITORING_FAILURE: start-on-event=GetDTCOfEvent, operation=EvtInfo_PORT_E_FUSE_MONITORING_FAILURE.GetDTCOfEvent
        Ev_GETDOE_PORT_E_FUSE_MONITORING_FAILURE: start-on-event=GetDebouncingOfEvent, operation=EvtInfo_PORT_E_FUSE_MONITORING_FAILURE.GetDebouncingOfEvent
        Ev_GFDC_PORT_E_FUSE_MONITORING_FAILURE: start-on-event=GetFaultDetectionCounter, operation=EvtInfo_PORT_E_FUSE_MONITORING_FAILURE.GetFaultDetectionCounter
        Ev_GEED_PORT_E_FUSE_MONITORING_FAILURE: start-on-event=GetEventExtendedDataRecord, operation=EvtInfo_PORT_E_FUSE_MONITORING_FAILURE.GetEventExtendedDataRecord
        Ev_GEEDR_PORT_E_FUSE_MONITORING_FAILURE: start-on-event=GetEventExtendedDataRecordEx, operation=EvtInfo_PORT_E_FUSE_MONITORING_FAILURE.GetEventExtendedDataRecordEx
        Ev_GEFFD_PORT_E_FUSE_MONITORING_FAILURE: start-on-event=GetEventFreezeFrameData, operation=EvtInfo_PORT_E_FUSE_MONITORING_FAILURE.GetEventFreezeFrameData
        Ev_GEFFDE_PORT_E_FUSE_MONITORING_FAILURE: start-on-event=GetEventFreezeFrameDataEx, operation=EvtInfo_PORT_E_FUSE_MONITORING_FAILURE.GetEventFreezeFrameDataEx
        Ev_GES_PORT_E_GET_CONTROL_FAILURE: start-on-event=GetEventStatus, operation=EvtInfo_PORT_E_GET_CONTROL_FAILURE.GetEventStatus
        Ev_GEF_PORT_E_GET_CONTROL_FAILURE: start-on-event=GetEventFailed, operation=EvtInfo_PORT_E_GET_CONTROL_FAILURE.GetEventFailed
        Ev_GET_PORT_E_GET_CONTROL_FAILURE: start-on-event=GetEventTested, operation=EvtInfo_PORT_E_GET_CONTROL_FAILURE.GetEventTested
        Ev_GDOE_PORT_E_GET_CONTROL_FAILURE: start-on-event=GetDTCOfEvent, operation=EvtInfo_PORT_E_GET_CONTROL_FAILURE.GetDTCOfEvent
        Ev_GETDOE_PORT_E_GET_CONTROL_FAILURE: start-on-event=GetDebouncingOfEvent, operation=EvtInfo_PORT_E_GET_CONTROL_FAILURE.GetDebouncingOfEvent
        Ev_GFDC_PORT_E_GET_CONTROL_FAILURE: start-on-event=GetFaultDetectionCounter, operation=EvtInfo_PORT_E_GET_CONTROL_FAILURE.GetFaultDetectionCounter
        Ev_GEED_PORT_E_GET_CONTROL_FAILURE: start-on-event=GetEventExtendedDataRecord, operation=EvtInfo_PORT_E_GET_CONTROL_FAILURE.GetEventExtendedDataRecord
        Ev_GEEDR_PORT_E_GET_CONTROL_FAILURE: start-on-event=GetEventExtendedDataRecordEx, operation=EvtInfo_PORT_E_GET_CONTROL_FAILURE.GetEventExtendedDataRecordEx
        Ev_GEFFD_PORT_E_GET_CONTROL_FAILURE: start-on-event=GetEventFreezeFrameData, operation=EvtInfo_PORT_E_GET_CONTROL_FAILURE.GetEventFreezeFrameData
        Ev_GEFFDE_PORT_E_GET_CONTROL_FAILURE: start-on-event=GetEventFreezeFrameDataEx, operation=EvtInfo_PORT_E_GET_CONTROL_FAILURE.GetEventFreezeFrameDataEx
        Ev_GES_PORT_E_WRITE_VERIFY_FAILURE: start-on-event=GetEventStatus, operation=EvtInfo_PORT_E_WRITE_VERIFY_FAILURE.GetEventStatus
        Ev_GEF_PORT_E_WRITE_VERIFY_FAILURE: start-on-event=GetEventFailed, operation=EvtInfo_PORT_E_WRITE_VERIFY_FAILURE.GetEventFailed
        Ev_GET_PORT_E_WRITE_VERIFY_FAILURE: start-on-event=GetEventTested, operation=EvtInfo_PORT_E_WRITE_VERIFY_FAILURE.GetEventTested
        Ev_GDOE_PORT_E_WRITE_VERIFY_FAILURE: start-on-event=GetDTCOfEvent, operation=EvtInfo_PORT_E_WRITE_VERIFY_FAILURE.GetDTCOfEvent
        Ev_GETDOE_PORT_E_WRITE_VERIFY_FAILURE: start-on-event=GetDebouncingOfEvent, operation=EvtInfo_PORT_E_WRITE_VERIFY_FAILURE.GetDebouncingOfEvent
        Ev_GFDC_PORT_E_WRITE_VERIFY_FAILURE: start-on-event=GetFaultDetectionCounter, operation=EvtInfo_PORT_E_WRITE_VERIFY_FAILURE.GetFaultDetectionCounter
        Ev_GEED_PORT_E_WRITE_VERIFY_FAILURE: start-on-event=GetEventExtendedDataRecord, operation=EvtInfo_PORT_E_WRITE_VERIFY_FAILURE.GetEventExtendedDataRecord
        Ev_GEEDR_PORT_E_WRITE_VERIFY_FAILURE: start-on-event=GetEventExtendedDataRecordEx, operation=EvtInfo_PORT_E_WRITE_VERIFY_FAILURE.GetEventExtendedDataRecordEx
        Ev_GEFFD_PORT_E_WRITE_VERIFY_FAILURE: start-on-event=GetEventFreezeFrameData, operation=EvtInfo_PORT_E_WRITE_VERIFY_FAILURE.GetEventFreezeFrameData
        Ev_GEFFDE_PORT_E_WRITE_VERIFY_FAILURE: start-on-event=GetEventFreezeFrameDataEx, operation=EvtInfo_PORT_E_WRITE_VERIFY_FAILURE.GetEventFreezeFrameDataEx
        Ev_GES_SPI_E_DATA_TX_TIMEOUT_FAILURE: start-on-event=GetEventStatus, operation=EvtInfo_SPI_E_DATA_TX_TIMEOUT_FAILURE.GetEventStatus
        Ev_GEF_SPI_E_DATA_TX_TIMEOUT_FAILURE: start-on-event=GetEventFailed, operation=EvtInfo_SPI_E_DATA_TX_TIMEOUT_FAILURE.GetEventFailed
        Ev_GET_SPI_E_DATA_TX_TIMEOUT_FAILURE: start-on-event=GetEventTested, operation=EvtInfo_SPI_E_DATA_TX_TIMEOUT_FAILURE.GetEventTested
        Ev_GDOE_SPI_E_DATA_TX_TIMEOUT_FAILURE: start-on-event=GetDTCOfEvent, operation=EvtInfo_SPI_E_DATA_TX_TIMEOUT_FAILURE.GetDTCOfEvent
        Ev_GETDOE_SPI_E_DATA_TX_TIMEOUT_FAILURE: start-on-event=GetDebouncingOfEvent, operation=EvtInfo_SPI_E_DATA_TX_TIMEOUT_FAILURE.GetDebouncingOfEvent
        Ev_GFDC_SPI_E_DATA_TX_TIMEOUT_FAILURE: start-on-event=GetFaultDetectionCounter, operation=EvtInfo_SPI_E_DATA_TX_TIMEOUT_FAILURE.GetFaultDetectionCounter
        Ev_GEED_SPI_E_DATA_TX_TIMEOUT_FAILURE: start-on-event=GetEventExtendedDataRecord, operation=EvtInfo_SPI_E_DATA_TX_TIMEOUT_FAILURE.GetEventExtendedDataRecord
        Ev_GEEDR_SPI_E_DATA_TX_TIMEOUT_FAILURE: start-on-event=GetEventExtendedDataRecordEx, operation=EvtInfo_SPI_E_DATA_TX_TIMEOUT_FAILURE.GetEventExtendedDataRecordEx
        Ev_GEFFD_SPI_E_DATA_TX_TIMEOUT_FAILURE: start-on-event=GetEventFreezeFrameData, operation=EvtInfo_SPI_E_DATA_TX_TIMEOUT_FAILURE.GetEventFreezeFrameData
        Ev_GEFFDE_SPI_E_DATA_TX_TIMEOUT_FAILURE: start-on-event=GetEventFreezeFrameDataEx, operation=EvtInfo_SPI_E_DATA_TX_TIMEOUT_FAILURE.GetEventFreezeFrameDataEx
        Ev_GES_SPI_E_HARDWARE_ERROR: start-on-event=GetEventStatus, operation=EvtInfo_SPI_E_HARDWARE_ERROR.GetEventStatus
        Ev_GEF_SPI_E_HARDWARE_ERROR: start-on-event=GetEventFailed, operation=EvtInfo_SPI_E_HARDWARE_ERROR.GetEventFailed
        Ev_GET_SPI_E_HARDWARE_ERROR: start-on-event=GetEventTested, operation=EvtInfo_SPI_E_HARDWARE_ERROR.GetEventTested
        Ev_GDOE_SPI_E_HARDWARE_ERROR: start-on-event=GetDTCOfEvent, operation=EvtInfo_SPI_E_HARDWARE_ERROR.GetDTCOfEvent
        Ev_GETDOE_SPI_E_HARDWARE_ERROR: start-on-event=GetDebouncingOfEvent, operation=EvtInfo_SPI_E_HARDWARE_ERROR.GetDebouncingOfEvent
        Ev_GFDC_SPI_E_HARDWARE_ERROR: start-on-event=GetFaultDetectionCounter, operation=EvtInfo_SPI_E_HARDWARE_ERROR.GetFaultDetectionCounter
        Ev_GEED_SPI_E_HARDWARE_ERROR: start-on-event=GetEventExtendedDataRecord, operation=EvtInfo_SPI_E_HARDWARE_ERROR.GetEventExtendedDataRecord
        Ev_GEEDR_SPI_E_HARDWARE_ERROR: start-on-event=GetEventExtendedDataRecordEx, operation=EvtInfo_SPI_E_HARDWARE_ERROR.GetEventExtendedDataRecordEx
        Ev_GEFFD_SPI_E_HARDWARE_ERROR: start-on-event=GetEventFreezeFrameData, operation=EvtInfo_SPI_E_HARDWARE_ERROR.GetEventFreezeFrameData
        Ev_GEFFDE_SPI_E_HARDWARE_ERROR: start-on-event=GetEventFreezeFrameDataEx, operation=EvtInfo_SPI_E_HARDWARE_ERROR.GetEventFreezeFrameDataEx
        Ev_GES_SPI_E_INTERRUPT_CONTROLLER_FAILURE: start-on-event=GetEventStatus, operation=EvtInfo_SPI_E_INTERRUPT_CONTROLLER_FAILURE.GetEventStatus
        Ev_GEF_SPI_E_INTERRUPT_CONTROLLER_FAILURE: start-on-event=GetEventFailed, operation=EvtInfo_SPI_E_INTERRUPT_CONTROLLER_FAILURE.GetEventFailed
        Ev_GET_SPI_E_INTERRUPT_CONTROLLER_FAILURE: start-on-event=GetEventTested, operation=EvtInfo_SPI_E_INTERRUPT_CONTROLLER_FAILURE.GetEventTested
        Ev_GDOE_SPI_E_INTERRUPT_CONTROLLER_FAILURE: start-on-event=GetDTCOfEvent, operation=EvtInfo_SPI_E_INTERRUPT_CONTROLLER_FAILURE.GetDTCOfEvent
        Ev_GETDOE_SPI_E_INTERRUPT_CONTROLLER_FAILURE: start-on-event=GetDebouncingOfEvent, operation=EvtInfo_SPI_E_INTERRUPT_CONTROLLER_FAILURE.GetDebouncingOfEvent
        Ev_GFDC_SPI_E_INTERRUPT_CONTROLLER_FAILURE: start-on-event=GetFaultDetectionCounter, operation=EvtInfo_SPI_E_INTERRUPT_CONTROLLER_FAILURE.GetFaultDetectionCounter
        Ev_GEED_SPI_E_INTERRUPT_CONTROLLER_FAILURE: start-on-event=GetEventExtendedDataRecord, operation=EvtInfo_SPI_E_INTERRUPT_CONTROLLER_FAILURE.GetEventExtendedDataRecord
        Ev_GEEDR_SPI_E_INTERRUPT_CONTROLLER_FAILURE: start-on-event=GetEventExtendedDataRecordEx, operation=EvtInfo_SPI_E_INTERRUPT_CONTROLLER_FAILURE.GetEventExtendedDataRecordEx
        Ev_GEFFD_SPI_E_INTERRUPT_CONTROLLER_FAILURE: start-on-event=GetEventFreezeFrameData, operation=EvtInfo_SPI_E_INTERRUPT_CONTROLLER_FAILURE.GetEventFreezeFrameData
        Ev_GEFFDE_SPI_E_INTERRUPT_CONTROLLER_FAILURE: start-on-event=GetEventFreezeFrameDataEx, operation=EvtInfo_SPI_E_INTERRUPT_CONTROLLER_FAILURE.GetEventFreezeFrameDataEx
        Ev_GES_SPI_E_UNINTENDED_EXECUTION_FAILURE: start-on-event=GetEventStatus, operation=EvtInfo_SPI_E_UNINTENDED_EXECUTION_FAILURE.GetEventStatus
        Ev_GEF_SPI_E_UNINTENDED_EXECUTION_FAILURE: start-on-event=GetEventFailed, operation=EvtInfo_SPI_E_UNINTENDED_EXECUTION_FAILURE.GetEventFailed
        Ev_GET_SPI_E_UNINTENDED_EXECUTION_FAILURE: start-on-event=GetEventTested, operation=EvtInfo_SPI_E_UNINTENDED_EXECUTION_FAILURE.GetEventTested
        Ev_GDOE_SPI_E_UNINTENDED_EXECUTION_FAILURE: start-on-event=GetDTCOfEvent, operation=EvtInfo_SPI_E_UNINTENDED_EXECUTION_FAILURE.GetDTCOfEvent
        Ev_GETDOE_SPI_E_UNINTENDED_EXECUTION_FAILURE: start-on-event=GetDebouncingOfEvent, operation=EvtInfo_SPI_E_UNINTENDED_EXECUTION_FAILURE.GetDebouncingOfEvent
        Ev_GFDC_SPI_E_UNINTENDED_EXECUTION_FAILURE: start-on-event=GetFaultDetectionCounter, operation=EvtInfo_SPI_E_UNINTENDED_EXECUTION_FAILURE.GetFaultDetectionCounter
        Ev_GEED_SPI_E_UNINTENDED_EXECUTION_FAILURE: start-on-event=GetEventExtendedDataRecord, operation=EvtInfo_SPI_E_UNINTENDED_EXECUTION_FAILURE.GetEventExtendedDataRecord
        Ev_GEEDR_SPI_E_UNINTENDED_EXECUTION_FAILURE: start-on-event=GetEventExtendedDataRecordEx, operation=EvtInfo_SPI_E_UNINTENDED_EXECUTION_FAILURE.GetEventExtendedDataRecordEx
        Ev_GEFFD_SPI_E_UNINTENDED_EXECUTION_FAILURE: start-on-event=GetEventFreezeFrameData, operation=EvtInfo_SPI_E_UNINTENDED_EXECUTION_FAILURE.GetEventFreezeFrameData
        Ev_GEFFDE_SPI_E_UNINTENDED_EXECUTION_FAILURE: start-on-event=GetEventFreezeFrameDataEx, operation=EvtInfo_SPI_E_UNINTENDED_EXECUTION_FAILURE.GetEventFreezeFrameDataEx
        Ev_GES_SPI_E_UNINTENDED_MODULE_STOP_FAILURE: start-on-event=GetEventStatus, operation=EvtInfo_SPI_E_UNINTENDED_MODULE_STOP_FAILURE.GetEventStatus
        Ev_GEF_SPI_E_UNINTENDED_MODULE_STOP_FAILURE: start-on-event=GetEventFailed, operation=EvtInfo_SPI_E_UNINTENDED_MODULE_STOP_FAILURE.GetEventFailed
        Ev_GET_SPI_E_UNINTENDED_MODULE_STOP_FAILURE: start-on-event=GetEventTested, operation=EvtInfo_SPI_E_UNINTENDED_MODULE_STOP_FAILURE.GetEventTested
        Ev_GDOE_SPI_E_UNINTENDED_MODULE_STOP_FAILURE: start-on-event=GetDTCOfEvent, operation=EvtInfo_SPI_E_UNINTENDED_MODULE_STOP_FAILURE.GetDTCOfEvent
        Ev_GETDOE_SPI_E_UNINTENDED_MODULE_STOP_FAILURE: start-on-event=GetDebouncingOfEvent, operation=EvtInfo_SPI_E_UNINTENDED_MODULE_STOP_FAILURE.GetDebouncingOfEvent
        Ev_GFDC_SPI_E_UNINTENDED_MODULE_STOP_FAILURE: start-on-event=GetFaultDetectionCounter, operation=EvtInfo_SPI_E_UNINTENDED_MODULE_STOP_FAILURE.GetFaultDetectionCounter
        Ev_GEED_SPI_E_UNINTENDED_MODULE_STOP_FAILURE: start-on-event=GetEventExtendedDataRecord, operation=EvtInfo_SPI_E_UNINTENDED_MODULE_STOP_FAILURE.GetEventExtendedDataRecord
        Ev_GEEDR_SPI_E_UNINTENDED_MODULE_STOP_FAILURE: start-on-event=GetEventExtendedDataRecordEx, operation=EvtInfo_SPI_E_UNINTENDED_MODULE_STOP_FAILURE.GetEventExtendedDataRecordEx
        Ev_GEFFD_SPI_E_UNINTENDED_MODULE_STOP_FAILURE: start-on-event=GetEventFreezeFrameData, operation=EvtInfo_SPI_E_UNINTENDED_MODULE_STOP_FAILURE.GetEventFreezeFrameData
        Ev_GEFFDE_SPI_E_UNINTENDED_MODULE_STOP_FAILURE: start-on-event=GetEventFreezeFrameDataEx, operation=EvtInfo_SPI_E_UNINTENDED_MODULE_STOP_FAILURE.GetEventFreezeFrameDataEx
        Ev_GES_SPI_E_WRITE_VERIFY_FAILURE: start-on-event=GetEventStatus, operation=EvtInfo_SPI_E_WRITE_VERIFY_FAILURE.GetEventStatus
        Ev_GEF_SPI_E_WRITE_VERIFY_FAILURE: start-on-event=GetEventFailed, operation=EvtInfo_SPI_E_WRITE_VERIFY_FAILURE.GetEventFailed
        Ev_GET_SPI_E_WRITE_VERIFY_FAILURE: start-on-event=GetEventTested, operation=EvtInfo_SPI_E_WRITE_VERIFY_FAILURE.GetEventTested
        Ev_GDOE_SPI_E_WRITE_VERIFY_FAILURE: start-on-event=GetDTCOfEvent, operation=EvtInfo_SPI_E_WRITE_VERIFY_FAILURE.GetDTCOfEvent
        Ev_GETDOE_SPI_E_WRITE_VERIFY_FAILURE: start-on-event=GetDebouncingOfEvent, operation=EvtInfo_SPI_E_WRITE_VERIFY_FAILURE.GetDebouncingOfEvent
        Ev_GFDC_SPI_E_WRITE_VERIFY_FAILURE: start-on-event=GetFaultDetectionCounter, operation=EvtInfo_SPI_E_WRITE_VERIFY_FAILURE.GetFaultDetectionCounter
        Ev_GEED_SPI_E_WRITE_VERIFY_FAILURE: start-on-event=GetEventExtendedDataRecord, operation=EvtInfo_SPI_E_WRITE_VERIFY_FAILURE.GetEventExtendedDataRecord
        Ev_GEEDR_SPI_E_WRITE_VERIFY_FAILURE: start-on-event=GetEventExtendedDataRecordEx, operation=EvtInfo_SPI_E_WRITE_VERIFY_FAILURE.GetEventExtendedDataRecordEx
        Ev_GEFFD_SPI_E_WRITE_VERIFY_FAILURE: start-on-event=GetEventFreezeFrameData, operation=EvtInfo_SPI_E_WRITE_VERIFY_FAILURE.GetEventFreezeFrameData
        Ev_GEFFDE_SPI_E_WRITE_VERIFY_FAILURE: start-on-event=GetEventFreezeFrameDataEx, operation=EvtInfo_SPI_E_WRITE_VERIFY_FAILURE.GetEventFreezeFrameDataEx
        Ev_GES_WDG_E_DISABLE_REJECTED: start-on-event=GetEventStatus, operation=EvtInfo_WDG_E_DISABLE_REJECTED.GetEventStatus
        Ev_GEF_WDG_E_DISABLE_REJECTED: start-on-event=GetEventFailed, operation=EvtInfo_WDG_E_DISABLE_REJECTED.GetEventFailed
        Ev_GET_WDG_E_DISABLE_REJECTED: start-on-event=GetEventTested, operation=EvtInfo_WDG_E_DISABLE_REJECTED.GetEventTested
        Ev_GDOE_WDG_E_DISABLE_REJECTED: start-on-event=GetDTCOfEvent, operation=EvtInfo_WDG_E_DISABLE_REJECTED.GetDTCOfEvent
        Ev_GETDOE_WDG_E_DISABLE_REJECTED: start-on-event=GetDebouncingOfEvent, operation=EvtInfo_WDG_E_DISABLE_REJECTED.GetDebouncingOfEvent
        Ev_GFDC_WDG_E_DISABLE_REJECTED: start-on-event=GetFaultDetectionCounter, operation=EvtInfo_WDG_E_DISABLE_REJECTED.GetFaultDetectionCounter
        Ev_GEED_WDG_E_DISABLE_REJECTED: start-on-event=GetEventExtendedDataRecord, operation=EvtInfo_WDG_E_DISABLE_REJECTED.GetEventExtendedDataRecord
        Ev_GEEDR_WDG_E_DISABLE_REJECTED: start-on-event=GetEventExtendedDataRecordEx, operation=EvtInfo_WDG_E_DISABLE_REJECTED.GetEventExtendedDataRecordEx
        Ev_GEFFD_WDG_E_DISABLE_REJECTED: start-on-event=GetEventFreezeFrameData, operation=EvtInfo_WDG_E_DISABLE_REJECTED.GetEventFreezeFrameData
        Ev_GEFFDE_WDG_E_DISABLE_REJECTED: start-on-event=GetEventFreezeFrameDataEx, operation=EvtInfo_WDG_E_DISABLE_REJECTED.GetEventFreezeFrameDataEx
        Ev_GES_WDG_E_MODE_FAILED: start-on-event=GetEventStatus, operation=EvtInfo_WDG_E_MODE_FAILED.GetEventStatus
        Ev_GEF_WDG_E_MODE_FAILED: start-on-event=GetEventFailed, operation=EvtInfo_WDG_E_MODE_FAILED.GetEventFailed
        Ev_GET_WDG_E_MODE_FAILED: start-on-event=GetEventTested, operation=EvtInfo_WDG_E_MODE_FAILED.GetEventTested
        Ev_GDOE_WDG_E_MODE_FAILED: start-on-event=GetDTCOfEvent, operation=EvtInfo_WDG_E_MODE_FAILED.GetDTCOfEvent
        Ev_GETDOE_WDG_E_MODE_FAILED: start-on-event=GetDebouncingOfEvent, operation=EvtInfo_WDG_E_MODE_FAILED.GetDebouncingOfEvent
        Ev_GFDC_WDG_E_MODE_FAILED: start-on-event=GetFaultDetectionCounter, operation=EvtInfo_WDG_E_MODE_FAILED.GetFaultDetectionCounter
        Ev_GEED_WDG_E_MODE_FAILED: start-on-event=GetEventExtendedDataRecord, operation=EvtInfo_WDG_E_MODE_FAILED.GetEventExtendedDataRecord
        Ev_GEEDR_WDG_E_MODE_FAILED: start-on-event=GetEventExtendedDataRecordEx, operation=EvtInfo_WDG_E_MODE_FAILED.GetEventExtendedDataRecordEx
        Ev_GEFFD_WDG_E_MODE_FAILED: start-on-event=GetEventFreezeFrameData, operation=EvtInfo_WDG_E_MODE_FAILED.GetEventFreezeFrameData
        Ev_GEFFDE_WDG_E_MODE_FAILED: start-on-event=GetEventFreezeFrameDataEx, operation=EvtInfo_WDG_E_MODE_FAILED.GetEventFreezeFrameDataEx
        Ev_GES_WDG_E_VALUE_COUNTER_FAILED: start-on-event=GetEventStatus, operation=EvtInfo_WDG_E_VALUE_COUNTER_FAILED.GetEventStatus
        Ev_GEF_WDG_E_VALUE_COUNTER_FAILED: start-on-event=GetEventFailed, operation=EvtInfo_WDG_E_VALUE_COUNTER_FAILED.GetEventFailed
        Ev_GET_WDG_E_VALUE_COUNTER_FAILED: start-on-event=GetEventTested, operation=EvtInfo_WDG_E_VALUE_COUNTER_FAILED.GetEventTested
        Ev_GDOE_WDG_E_VALUE_COUNTER_FAILED: start-on-event=GetDTCOfEvent, operation=EvtInfo_WDG_E_VALUE_COUNTER_FAILED.GetDTCOfEvent
        Ev_GETDOE_WDG_E_VALUE_COUNTER_FAILED: start-on-event=GetDebouncingOfEvent, operation=EvtInfo_WDG_E_VALUE_COUNTER_FAILED.GetDebouncingOfEvent
        Ev_GFDC_WDG_E_VALUE_COUNTER_FAILED: start-on-event=GetFaultDetectionCounter, operation=EvtInfo_WDG_E_VALUE_COUNTER_FAILED.GetFaultDetectionCounter
        Ev_GEED_WDG_E_VALUE_COUNTER_FAILED: start-on-event=GetEventExtendedDataRecord, operation=EvtInfo_WDG_E_VALUE_COUNTER_FAILED.GetEventExtendedDataRecord
        Ev_GEEDR_WDG_E_VALUE_COUNTER_FAILED: start-on-event=GetEventExtendedDataRecordEx, operation=EvtInfo_WDG_E_VALUE_COUNTER_FAILED.GetEventExtendedDataRecordEx
        Ev_GEFFD_WDG_E_VALUE_COUNTER_FAILED: start-on-event=GetEventFreezeFrameData, operation=EvtInfo_WDG_E_VALUE_COUNTER_FAILED.GetEventFreezeFrameData
        Ev_GEFFDE_WDG_E_VALUE_COUNTER_FAILED: start-on-event=GetEventFreezeFrameDataEx, operation=EvtInfo_WDG_E_VALUE_COUNTER_FAILED.GetEventFreezeFrameDataEx
        Ev_GES_WDG_E_WRITEVERIFY_FAILURE: start-on-event=GetEventStatus, operation=EvtInfo_WDG_E_WRITEVERIFY_FAILURE.GetEventStatus
        Ev_GEF_WDG_E_WRITEVERIFY_FAILURE: start-on-event=GetEventFailed, operation=EvtInfo_WDG_E_WRITEVERIFY_FAILURE.GetEventFailed
        Ev_GET_WDG_E_WRITEVERIFY_FAILURE: start-on-event=GetEventTested, operation=EvtInfo_WDG_E_WRITEVERIFY_FAILURE.GetEventTested
        Ev_GDOE_WDG_E_WRITEVERIFY_FAILURE: start-on-event=GetDTCOfEvent, operation=EvtInfo_WDG_E_WRITEVERIFY_FAILURE.GetDTCOfEvent
        Ev_GETDOE_WDG_E_WRITEVERIFY_FAILURE: start-on-event=GetDebouncingOfEvent, operation=EvtInfo_WDG_E_WRITEVERIFY_FAILURE.GetDebouncingOfEvent
        Ev_GFDC_WDG_E_WRITEVERIFY_FAILURE: start-on-event=GetFaultDetectionCounter, operation=EvtInfo_WDG_E_WRITEVERIFY_FAILURE.GetFaultDetectionCounter
        Ev_GEED_WDG_E_WRITEVERIFY_FAILURE: start-on-event=GetEventExtendedDataRecord, operation=EvtInfo_WDG_E_WRITEVERIFY_FAILURE.GetEventExtendedDataRecord
        Ev_GEEDR_WDG_E_WRITEVERIFY_FAILURE: start-on-event=GetEventExtendedDataRecordEx, operation=EvtInfo_WDG_E_WRITEVERIFY_FAILURE.GetEventExtendedDataRecordEx
        Ev_GEFFD_WDG_E_WRITEVERIFY_FAILURE: start-on-event=GetEventFreezeFrameData, operation=EvtInfo_WDG_E_WRITEVERIFY_FAILURE.GetEventFreezeFrameData
        Ev_GEFFDE_WDG_E_WRITEVERIFY_FAILURE: start-on-event=GetEventFreezeFrameDataEx, operation=EvtInfo_WDG_E_WRITEVERIFY_FAILURE.GetEventFreezeFrameDataEx
        Ev_GES_WDG_E_WRITE_REGISTER_FAILED: start-on-event=GetEventStatus, operation=EvtInfo_WDG_E_WRITE_REGISTER_FAILED.GetEventStatus
        Ev_GEF_WDG_E_WRITE_REGISTER_FAILED: start-on-event=GetEventFailed, operation=EvtInfo_WDG_E_WRITE_REGISTER_FAILED.GetEventFailed
        Ev_GET_WDG_E_WRITE_REGISTER_FAILED: start-on-event=GetEventTested, operation=EvtInfo_WDG_E_WRITE_REGISTER_FAILED.GetEventTested
        Ev_GDOE_WDG_E_WRITE_REGISTER_FAILED: start-on-event=GetDTCOfEvent, operation=EvtInfo_WDG_E_WRITE_REGISTER_FAILED.GetDTCOfEvent
        Ev_GETDOE_WDG_E_WRITE_REGISTER_FAILED: start-on-event=GetDebouncingOfEvent, operation=EvtInfo_WDG_E_WRITE_REGISTER_FAILED.GetDebouncingOfEvent
        Ev_GFDC_WDG_E_WRITE_REGISTER_FAILED: start-on-event=GetFaultDetectionCounter, operation=EvtInfo_WDG_E_WRITE_REGISTER_FAILED.GetFaultDetectionCounter
        Ev_GEED_WDG_E_WRITE_REGISTER_FAILED: start-on-event=GetEventExtendedDataRecord, operation=EvtInfo_WDG_E_WRITE_REGISTER_FAILED.GetEventExtendedDataRecord
        Ev_GEEDR_WDG_E_WRITE_REGISTER_FAILED: start-on-event=GetEventExtendedDataRecordEx, operation=EvtInfo_WDG_E_WRITE_REGISTER_FAILED.GetEventExtendedDataRecordEx
        Ev_GEFFD_WDG_E_WRITE_REGISTER_FAILED: start-on-event=GetEventFreezeFrameData, operation=EvtInfo_WDG_E_WRITE_REGISTER_FAILED.GetEventFreezeFrameData
        Ev_GEFFDE_WDG_E_WRITE_REGISTER_FAILED: start-on-event=GetEventFreezeFrameDataEx, operation=EvtInfo_WDG_E_WRITE_REGISTER_FAILED.GetEventFreezeFrameDataEx
        GDI_GDOE_GetDebouncingOfEvent: start-on-event=GetDebouncingOfEvent_GeneralEvtInfo, operation=GeneralEvtInfo.GetDebouncingOfEvent
        GDI_GES_GetEventStatus: start-on-event=Dem_GetEventStatus_GeneralEvtInfo, operation=GeneralEvtInfo.GetEventStatus
        GDI_GEF_GetEventFailed: start-on-event=Dem_GetEventFailed_GeneralEvtInfo, operation=GeneralEvtInfo.GetEventFailed
        GDI_GET_GetEventTested: start-on-event=Dem_GetEventTested_GeneralEvtInfo, operation=GeneralEvtInfo.GetEventTested
        GDI_GDE_GetDTCOfEvent: start-on-event=Dem_GetDTCOfEvent_GeneralEvtInfo, operation=GeneralEvtInfo.GetDTCOfEvent
        GDI_GFDC_GetFaultDetectionCounter: start-on-event=Dem_GetFaultDetectionCounter_GeneralEvtInfo, operation=GeneralEvtInfo.GetFaultDetectionCounter
        GDI_GEED_GetEventExtendedDataRecord: start-on-event=Dem_GetEventExtendedDataRecord_GeneralEvtInfo, operation=GeneralEvtInfo.GetEventExtendedDataRecord
        GDI_GEFFD_GetEventFreezeFrameData: start-on-event=Dem_GetEventFreezeFrameData_GeneralEvtInfo, operation=GeneralEvtInfo.GetEventFreezeFrameData
        GDI_GEED_GetEventExtendedDataRecordEx: start-on-event=Dem_GetEventExtendedDataRecordEx_GeneralEvtInfo, operation=GeneralEvtInfo.GetEventExtendedDataRecordEx
        GDI_GEFFD_GetEventFreezeFrameDataEx: start-on-event=Dem_GetEventFreezeFrameDataEx_GeneralEvtInfo, operation=GeneralEvtInfo.GetEventFreezeFrameDataEx
        Ev_GEICLDE_GetEventIdCausingLastDetError: start-on-event=Dem_GetEventIdCausingLastDetError, operation=GeneralEvtInfo.GetEventIdCausingLastDetError
        OpCycle_OCS_DemOpCycle_DEM_POWER: start-on-event=SetOperationCycleState, operation=OpCycle_DemOpCycle_DEM_POWER.SetOperationCycleState
        OpCycle_GOCS_DemOpCycle_DEM_POWER: start-on-event=GetOperationCycleState, operation=OpCycle_DemOpCycle_DEM_POWER.GetOperationCycleState
        OpCycle_GCQ_DemOpCycle_DEM_POWER: start-on-event=GetCycleQualified, operation=OpCycle_DemOpCycle_DEM_POWER.GetCycleQualified
        OpCycle_SCQ_DemOpCycle_DEM_POWER: start-on-event=SetCycleQualified, operation=OpCycle_DemOpCycle_DEM_POWER.SetCycleQualified
        StorageCond_SSC_DemStorageCondition: start-on-event=SetStorageCondition, operation=StorageCond_DemStorageCondition.SetStorageCondition
        StorageCond_GSC_DemStorageCondition: start-on-event=GetStorageCondition, operation=StorageCond_DemStorageCondition.GetStorageCondition
        Ev_SetWIRStatus_DTC_0x000001_Event: start-on-event=SetWIRStatus, operation=EventStatus_DTC_0x000001_Event.SetWIRStatus
        Ev_SetWIRStatus_DTC_0xc07388_Event: start-on-event=SetWIRStatus, operation=EventStatus_DTC_0xc07388_Event.SetWIRStatus
        Ev_SetWIRStatus_DTC_0xc12687_Event: start-on-event=SetWIRStatus, operation=EventStatus_DTC_0xc12687_Event.SetWIRStatus
        Ev_SetWIRStatus_DTC_0xc14587_Event: start-on-event=SetWIRStatus, operation=EventStatus_DTC_0xc14587_Event.SetWIRStatus
        Ev_SetWIRStatus_DTC_0xc22a87_Event: start-on-event=SetWIRStatus, operation=EventStatus_DTC_0xc22a87_Event.SetWIRStatus
        Ev_SetWIRStatus_DTC_0xc41487_Event: start-on-event=SetWIRStatus, operation=EventStatus_DTC_0xc41487_Event.SetWIRStatus
        Ev_SetWIRStatus_DTC_0xd56217_Event: start-on-event=SetWIRStatus, operation=EventStatus_DTC_0xd56217_Event.SetWIRStatus
        Ev_SetWIRStatus_DTC_0xd56316_Event: start-on-event=SetWIRStatus, operation=EventStatus_DTC_0xd56316_Event.SetWIRStatus
        Ev_SetWIRStatus_DTC_0xe00141_Event: start-on-event=SetWIRStatus, operation=EventStatus_DTC_0xe00141_Event.SetWIRStatus
        Ev_SetWIRStatus_DTC_0xe00142_Event: start-on-event=SetWIRStatus, operation=EventStatus_DTC_0xe00142_Event.SetWIRStatus
        Ev_SetWIRStatus_DTC_0xe26200_Event: start-on-event=SetWIRStatus, operation=EventStatus_DTC_0xe26200_Event.SetWIRStatus
        EventAvailable_SetEventAvailable_DTC_0x000001_Event: start-on-event=SetEventAvailable, operation=ControlEventAvailable_DTC_0x000001_Event.SetEventAvailable
        EventAvailable_SetEventAvailable_DTC_0xc07388_Event: start-on-event=SetEventAvailable, operation=ControlEventAvailable_DTC_0xc07388_Event.SetEventAvailable
        EventAvailable_SetEventAvailable_DTC_0xc12687_Event: start-on-event=SetEventAvailable, operation=ControlEventAvailable_DTC_0xc12687_Event.SetEventAvailable
        EventAvailable_SetEventAvailable_DTC_0xc14587_Event: start-on-event=SetEventAvailable, operation=ControlEventAvailable_DTC_0xc14587_Event.SetEventAvailable
        EventAvailable_SetEventAvailable_DTC_0xc22a87_Event: start-on-event=SetEventAvailable, operation=ControlEventAvailable_DTC_0xc22a87_Event.SetEventAvailable
        EventAvailable_SetEventAvailable_DTC_0xc41487_Event: start-on-event=SetEventAvailable, operation=ControlEventAvailable_DTC_0xc41487_Event.SetEventAvailable
        EventAvailable_SetEventAvailable_DTC_0xd56217_Event: start-on-event=SetEventAvailable, operation=ControlEventAvailable_DTC_0xd56217_Event.SetEventAvailable
        EventAvailable_SetEventAvailable_DTC_0xd56316_Event: start-on-event=SetEventAvailable, operation=ControlEventAvailable_DTC_0xd56316_Event.SetEventAvailable
        EventAvailable_SetEventAvailable_DTC_0xe00141_Event: start-on-event=SetEventAvailable, operation=ControlEventAvailable_DTC_0xe00141_Event.SetEventAvailable
        EventAvailable_SetEventAvailable_DTC_0xe00142_Event: start-on-event=SetEventAvailable, operation=ControlEventAvailable_DTC_0xe00142_Event.SetEventAvailable
        EventAvailable_SetEventAvailable_DTC_0xe26200_Event: start-on-event=SetEventAvailable, operation=ControlEventAvailable_DTC_0xe26200_Event.SetEventAvailable
      port-api-options:
        {enable-take-address=true, indirect-api=false, port-defined-argument-value{value=EvtInfo_ADC_E_WRITEVERIFY_FAILURE:1, value-type=Dem_EventIdType}, port=EvtInfo_ADC_E_WRITEVERIFY_FAILURE}
        {enable-take-address=true, indirect-api=false, port-defined-argument-value{value=EvtInfo_CAN_E_TIMEOUT_FAILURE:2, value-type=Dem_EventIdType}, port=EvtInfo_CAN_E_TIMEOUT_FAILURE}
        {enable-take-address=true, indirect-api=false, port-defined-argument-value{value=EvtInfo_CAN_E_UNINTENDED_INTERRUPT:3, value-type=Dem_EventIdType}, port=EvtInfo_CAN_E_UNINTENDED_INTERRUPT}
        {enable-take-address=true, indirect-api=false, port-defined-argument-value{value=EvtInfo_DIO_E_GET_CONTROL_FAILURE:4, value-type=Dem_EventIdType}, port=EvtInfo_DIO_E_GET_CONTROL_FAILURE}
        {enable-take-address=true, indirect-api=false, port-defined-argument-value{value=EvtInfo_DTC_0x000001_Event:5, value-type=Dem_EventIdType}, port=EvtInfo_DTC_0x000001_Event}
        {enable-take-address=true, indirect-api=false, port-defined-argument-value{value=EvtInfo_DTC_0x0d0400_CAN_Network_ETAS_BusOff_Event:6, value-type=Dem_EventIdType}, port=EvtInfo_DTC_0x0d0400_CAN_Network_ETAS_BusOff_Event}
        {enable-take-address=true, indirect-api=false, port-defined-argument-value{value=EvtInfo_DTC_0xc07388_Event:7, value-type=Dem_EventIdType}, port=EvtInfo_DTC_0xc07388_Event}
        {enable-take-address=true, indirect-api=false, port-defined-argument-value{value=EvtInfo_DTC_0xc12687_Event:8, value-type=Dem_EventIdType}, port=EvtInfo_DTC_0xc12687_Event}
        {enable-take-address=true, indirect-api=false, port-defined-argument-value{value=EvtInfo_DTC_0xc14587_Event:9, value-type=Dem_EventIdType}, port=EvtInfo_DTC_0xc14587_Event}
        {enable-take-address=true, indirect-api=false, port-defined-argument-value{value=EvtInfo_DTC_0xc22a87_Event:10, value-type=Dem_EventIdType}, port=EvtInfo_DTC_0xc22a87_Event}
        {enable-take-address=true, indirect-api=false, port-defined-argument-value{value=EvtInfo_DTC_0xc41487_Event:11, value-type=Dem_EventIdType}, port=EvtInfo_DTC_0xc41487_Event}
        {enable-take-address=true, indirect-api=false, port-defined-argument-value{value=EvtInfo_DTC_0xd56217_Event:12, value-type=Dem_EventIdType}, port=EvtInfo_DTC_0xd56217_Event}
        {enable-take-address=true, indirect-api=false, port-defined-argument-value{value=EvtInfo_DTC_0xd56316_Event:13, value-type=Dem_EventIdType}, port=EvtInfo_DTC_0xd56316_Event}
        {enable-take-address=true, indirect-api=false, port-defined-argument-value{value=EvtInfo_DTC_0xe00141_Event:14, value-type=Dem_EventIdType}, port=EvtInfo_DTC_0xe00141_Event}
        {enable-take-address=true, indirect-api=false, port-defined-argument-value{value=EvtInfo_DTC_0xe00142_Event:15, value-type=Dem_EventIdType}, port=EvtInfo_DTC_0xe00142_Event}
        {enable-take-address=true, indirect-api=false, port-defined-argument-value{value=EvtInfo_DTC_0xe26200_Event:16, value-type=Dem_EventIdType}, port=EvtInfo_DTC_0xe26200_Event}
        {enable-take-address=true, indirect-api=false, port-defined-argument-value{value=EvtInfo_ETH_E_ACCESS:17, value-type=Dem_EventIdType}, port=EvtInfo_ETH_E_ACCESS}
        {enable-take-address=true, indirect-api=false, port-defined-argument-value{value=EvtInfo_ETH_E_ALIGNMENT:18, value-type=Dem_EventIdType}, port=EvtInfo_ETH_E_ALIGNMENT}
        {enable-take-address=true, indirect-api=false, port-defined-argument-value{value=EvtInfo_ETH_E_AVB_DMAC:19, value-type=Dem_EventIdType}, port=EvtInfo_ETH_E_AVB_DMAC}
        {enable-take-address=true, indirect-api=false, port-defined-argument-value{value=EvtInfo_ETH_E_CRC:20, value-type=Dem_EventIdType}, port=EvtInfo_ETH_E_CRC}
        {enable-take-address=true, indirect-api=false, port-defined-argument-value{value=EvtInfo_ETH_E_DESC_DATA:21, value-type=Dem_EventIdType}, port=EvtInfo_ETH_E_DESC_DATA}
        {enable-take-address=true, indirect-api=false, port-defined-argument-value{value=EvtInfo_ETH_E_FRAME_RECEIVE:22, value-type=Dem_EventIdType}, port=EvtInfo_ETH_E_FRAME_RECEIVE}
        {enable-take-address=true, indirect-api=false, port-defined-argument-value{value=EvtInfo_ETH_E_INTERRUPT_CTL_CHECK:23, value-type=Dem_EventIdType}, port=EvtInfo_ETH_E_INTERRUPT_CTL_CHECK}
        {enable-take-address=true, indirect-api=false, port-defined-argument-value{value=EvtInfo_ETH_E_LATECOLLISION:24, value-type=Dem_EventIdType}, port=EvtInfo_ETH_E_LATECOLLISION}
        {enable-take-address=true, indirect-api=false, port-defined-argument-value{value=EvtInfo_ETH_E_MODULE_STOP_CHECK:25, value-type=Dem_EventIdType}, port=EvtInfo_ETH_E_MODULE_STOP_CHECK}
        {enable-take-address=true, indirect-api=false, port-defined-argument-value{value=EvtInfo_ETH_E_MULTIPLECOLLISION:26, value-type=Dem_EventIdType}, port=EvtInfo_ETH_E_MULTIPLECOLLISION}
        {enable-take-address=true, indirect-api=false, port-defined-argument-value{value=EvtInfo_ETH_E_OPMODE:27, value-type=Dem_EventIdType}, port=EvtInfo_ETH_E_OPMODE}
        {enable-take-address=true, indirect-api=false, port-defined-argument-value{value=EvtInfo_ETH_E_OVERSIZEFRAME:28, value-type=Dem_EventIdType}, port=EvtInfo_ETH_E_OVERSIZEFRAME}
        {enable-take-address=true, indirect-api=false, port-defined-argument-value{value=EvtInfo_ETH_E_PAYLOAD_CRC:29, value-type=Dem_EventIdType}, port=EvtInfo_ETH_E_PAYLOAD_CRC}
        {enable-take-address=true, indirect-api=false, port-defined-argument-value{value=EvtInfo_ETH_E_REG_READ_VERIFY:30, value-type=Dem_EventIdType}, port=EvtInfo_ETH_E_REG_READ_VERIFY}
        {enable-take-address=true, indirect-api=false, port-defined-argument-value{value=EvtInfo_ETH_E_REG_WRITE_VERIFY:31, value-type=Dem_EventIdType}, port=EvtInfo_ETH_E_REG_WRITE_VERIFY}
        {enable-take-address=true, indirect-api=false, port-defined-argument-value{value=EvtInfo_ETH_E_RESIDUAL_BIT_FRAME:32, value-type=Dem_EventIdType}, port=EvtInfo_ETH_E_RESIDUAL_BIT_FRAME}
        {enable-take-address=true, indirect-api=false, port-defined-argument-value{value=EvtInfo_ETH_E_RX_FRAMES_LOST:33, value-type=Dem_EventIdType}, port=EvtInfo_ETH_E_RX_FRAMES_LOST}
        {enable-take-address=true, indirect-api=false, port-defined-argument-value{value=EvtInfo_ETH_E_SINGLECOLLISION:34, value-type=Dem_EventIdType}, port=EvtInfo_ETH_E_SINGLECOLLISION}
        {enable-take-address=true, indirect-api=false, port-defined-argument-value{value=EvtInfo_ETH_E_TIMEOUT:35, value-type=Dem_EventIdType}, port=EvtInfo_ETH_E_TIMEOUT}
        {enable-take-address=true, indirect-api=false, port-defined-argument-value{value=EvtInfo_ETH_E_TIMERINC_FAILED:36, value-type=Dem_EventIdType}, port=EvtInfo_ETH_E_TIMERINC_FAILED}
        {enable-take-address=true, indirect-api=false, port-defined-argument-value{value=EvtInfo_ETH_E_TRANSMIT_RETRY_OVER:37, value-type=Dem_EventIdType}, port=EvtInfo_ETH_E_TRANSMIT_RETRY_OVER}
        {enable-take-address=true, indirect-api=false, port-defined-argument-value{value=EvtInfo_ETH_E_UNDERSIZEFRAME:38, value-type=Dem_EventIdType}, port=EvtInfo_ETH_E_UNDERSIZEFRAME}
        {enable-take-address=true, indirect-api=false, port-defined-argument-value{value=EvtInfo_FLS_E_COMPARE_FAILED:39, value-type=Dem_EventIdType}, port=EvtInfo_FLS_E_COMPARE_FAILED}
        {enable-take-address=true, indirect-api=false, port-defined-argument-value{value=EvtInfo_FLS_E_ERASE_FAILED:40, value-type=Dem_EventIdType}, port=EvtInfo_FLS_E_ERASE_FAILED}
        {enable-take-address=true, indirect-api=false, port-defined-argument-value{value=EvtInfo_FLS_E_GET_CONTROL_FAILURE:41, value-type=Dem_EventIdType}, port=EvtInfo_FLS_E_GET_CONTROL_FAILURE}
        {enable-take-address=true, indirect-api=false, port-defined-argument-value{value=EvtInfo_FLS_E_GET_SEMAPHORE_FAILURE:42, value-type=Dem_EventIdType}, port=EvtInfo_FLS_E_GET_SEMAPHORE_FAILURE}
        {enable-take-address=true, indirect-api=false, port-defined-argument-value{value=EvtInfo_FLS_E_READ_FAILED:43, value-type=Dem_EventIdType}, port=EvtInfo_FLS_E_READ_FAILED}
        {enable-take-address=true, indirect-api=false, port-defined-argument-value{value=EvtInfo_FLS_E_RELEASE_SEMAPHORE_FAILURE:44, value-type=Dem_EventIdType}, port=EvtInfo_FLS_E_RELEASE_SEMAPHORE_FAILURE}
        {enable-take-address=true, indirect-api=false, port-defined-argument-value{value=EvtInfo_FLS_E_UNEXPECTED_FLASH_ID:45, value-type=Dem_EventIdType}, port=EvtInfo_FLS_E_UNEXPECTED_FLASH_ID}
        {enable-take-address=true, indirect-api=false, port-defined-argument-value{value=EvtInfo_FLS_E_WRITE_FAILED:46, value-type=Dem_EventIdType}, port=EvtInfo_FLS_E_WRITE_FAILED}
        {enable-take-address=true, indirect-api=false, port-defined-argument-value{value=EvtInfo_FLS_E_WRITE_VERIFY_FAILURE:47, value-type=Dem_EventIdType}, port=EvtInfo_FLS_E_WRITE_VERIFY_FAILURE}
        {enable-take-address=true, indirect-api=false, port-defined-argument-value{value=EvtInfo_GPT_E_CONFIGURATION_CHECK_PERMANENT_FAILURE:48, value-type=Dem_EventIdType}, port=EvtInfo_GPT_E_CONFIGURATION_CHECK_PERMANENT_FAILURE}
        {enable-take-address=true, indirect-api=false, port-defined-argument-value{value=EvtInfo_GPT_E_CONFIGURATION_CHECK_TRANSIENT_FAILURE:49, value-type=Dem_EventIdType}, port=EvtInfo_GPT_E_CONFIGURATION_CHECK_TRANSIENT_FAILURE}
        {enable-take-address=true, indirect-api=false, port-defined-argument-value{value=EvtInfo_GPT_E_INTERRUPT_CONTROLLER_FAILURE:50, value-type=Dem_EventIdType}, port=EvtInfo_GPT_E_INTERRUPT_CONTROLLER_FAILURE}
        {enable-take-address=true, indirect-api=false, port-defined-argument-value{value=EvtInfo_GPT_E_WRITEVERIFY_FAILURE:51, value-type=Dem_EventIdType}, port=EvtInfo_GPT_E_WRITEVERIFY_FAILURE}
        {enable-take-address=true, indirect-api=false, port-defined-argument-value{value=EvtInfo_MCU_E_CHECK_FAILURE:52, value-type=Dem_EventIdType}, port=EvtInfo_MCU_E_CHECK_FAILURE}
        {enable-take-address=true, indirect-api=false, port-defined-argument-value{value=EvtInfo_MCU_E_CLOCK_FAILURE:53, value-type=Dem_EventIdType}, port=EvtInfo_MCU_E_CLOCK_FAILURE}
        {enable-take-address=true, indirect-api=false, port-defined-argument-value{value=EvtInfo_MCU_E_CONFIGURATION_CHECK_PERMANENT_FAILURE:54, value-type=Dem_EventIdType}, port=EvtInfo_MCU_E_CONFIGURATION_CHECK_PERMANENT_FAILURE}
        {enable-take-address=true, indirect-api=false, port-defined-argument-value{value=EvtInfo_MCU_E_CONFIGURATION_CHECK_TRANSIENT_FAILURE:55, value-type=Dem_EventIdType}, port=EvtInfo_MCU_E_CONFIGURATION_CHECK_TRANSIENT_FAILURE}
        {enable-take-address=true, indirect-api=false, port-defined-argument-value{value=EvtInfo_MCU_E_CONFIGURATION_CHECK_TRANSITION_FAILURE:56, value-type=Dem_EventIdType}, port=EvtInfo_MCU_E_CONFIGURATION_CHECK_TRANSITION_FAILURE}
        {enable-take-address=true, indirect-api=false, port-defined-argument-value{value=EvtInfo_MCU_E_GET_CONTROL_FAILURE:57, value-type=Dem_EventIdType}, port=EvtInfo_MCU_E_GET_CONTROL_FAILURE}
        {enable-take-address=true, indirect-api=false, port-defined-argument-value{value=EvtInfo_MCU_E_INTERNAL_BUS_FAILURE:58, value-type=Dem_EventIdType}, port=EvtInfo_MCU_E_INTERNAL_BUS_FAILURE}
        {enable-take-address=true, indirect-api=false, port-defined-argument-value{value=EvtInfo_MCU_E_READ_BACK_FAILURE:59, value-type=Dem_EventIdType}, port=EvtInfo_MCU_E_READ_BACK_FAILURE}
        {enable-take-address=true, indirect-api=false, port-defined-argument-value{value=EvtInfo_MCU_E_TIMEOUT_FAILURE:60, value-type=Dem_EventIdType}, port=EvtInfo_MCU_E_TIMEOUT_FAILURE}
        {enable-take-address=true, indirect-api=false, port-defined-argument-value{value=EvtInfo_MCU_E_WRITE_TIMEOUT_FAILURE:61, value-type=Dem_EventIdType}, port=EvtInfo_MCU_E_WRITE_TIMEOUT_FAILURE}
        {enable-take-address=true, indirect-api=false, port-defined-argument-value{value=EvtInfo_PORT_E_CONFIGURATION_CHECK_PERMANENT_FAILURE:62, value-type=Dem_EventIdType}, port=EvtInfo_PORT_E_CONFIGURATION_CHECK_PERMANENT_FAILURE}
        {enable-take-address=true, indirect-api=false, port-defined-argument-value{value=EvtInfo_PORT_E_CONFIGURATION_CHECK_TRANSIENT_FAILURE:63, value-type=Dem_EventIdType}, port=EvtInfo_PORT_E_CONFIGURATION_CHECK_TRANSIENT_FAILURE}
        {enable-take-address=true, indirect-api=false, port-defined-argument-value{value=EvtInfo_PORT_E_FUSE_MONITORING_FAILURE:64, value-type=Dem_EventIdType}, port=EvtInfo_PORT_E_FUSE_MONITORING_FAILURE}
        {enable-take-address=true, indirect-api=false, port-defined-argument-value{value=EvtInfo_PORT_E_GET_CONTROL_FAILURE:65, value-type=Dem_EventIdType}, port=EvtInfo_PORT_E_GET_CONTROL_FAILURE}
        {enable-take-address=true, indirect-api=false, port-defined-argument-value{value=EvtInfo_PORT_E_WRITE_VERIFY_FAILURE:66, value-type=Dem_EventIdType}, port=EvtInfo_PORT_E_WRITE_VERIFY_FAILURE}
        {enable-take-address=true, indirect-api=false, port-defined-argument-value{value=EvtInfo_SPI_E_DATA_TX_TIMEOUT_FAILURE:67, value-type=Dem_EventIdType}, port=EvtInfo_SPI_E_DATA_TX_TIMEOUT_FAILURE}
        {enable-take-address=true, indirect-api=false, port-defined-argument-value{value=EvtInfo_SPI_E_HARDWARE_ERROR:68, value-type=Dem_EventIdType}, port=EvtInfo_SPI_E_HARDWARE_ERROR}
        {enable-take-address=true, indirect-api=false, port-defined-argument-value{value=EvtInfo_SPI_E_INTERRUPT_CONTROLLER_FAILURE:69, value-type=Dem_EventIdType}, port=EvtInfo_SPI_E_INTERRUPT_CONTROLLER_FAILURE}
        {enable-take-address=true, indirect-api=false, port-defined-argument-value{value=EvtInfo_SPI_E_UNINTENDED_EXECUTION_FAILURE:70, value-type=Dem_EventIdType}, port=EvtInfo_SPI_E_UNINTENDED_EXECUTION_FAILURE}
        {enable-take-address=true, indirect-api=false, port-defined-argument-value{value=EvtInfo_SPI_E_UNINTENDED_MODULE_STOP_FAILURE:71, value-type=Dem_EventIdType}, port=EvtInfo_SPI_E_UNINTENDED_MODULE_STOP_FAILURE}
        {enable-take-address=true, indirect-api=false, port-defined-argument-value{value=EvtInfo_SPI_E_WRITE_VERIFY_FAILURE:72, value-type=Dem_EventIdType}, port=EvtInfo_SPI_E_WRITE_VERIFY_FAILURE}
        {enable-take-address=true, indirect-api=false, port-defined-argument-value{value=EvtInfo_WDG_E_DISABLE_REJECTED:73, value-type=Dem_EventIdType}, port=EvtInfo_WDG_E_DISABLE_REJECTED}
        {enable-take-address=true, indirect-api=false, port-defined-argument-value{value=EvtInfo_WDG_E_MODE_FAILED:74, value-type=Dem_EventIdType}, port=EvtInfo_WDG_E_MODE_FAILED}
        {enable-take-address=true, indirect-api=false, port-defined-argument-value{value=EvtInfo_WDG_E_VALUE_COUNTER_FAILED:75, value-type=Dem_EventIdType}, port=EvtInfo_WDG_E_VALUE_COUNTER_FAILED}
        {enable-take-address=true, indirect-api=false, port-defined-argument-value{value=EvtInfo_WDG_E_WRITEVERIFY_FAILURE:76, value-type=Dem_EventIdType}, port=EvtInfo_WDG_E_WRITEVERIFY_FAILURE}
        {enable-take-address=true, indirect-api=false, port-defined-argument-value{value=EvtInfo_WDG_E_WRITE_REGISTER_FAILED:77, value-type=Dem_EventIdType}, port=EvtInfo_WDG_E_WRITE_REGISTER_FAILED}
        {enable-take-address=true, indirect-api=false, port-defined-argument-value{value=Event_DTC_0x000001_Event:5, value-type=Dem_EventIdType}, port=Event_DTC_0x000001_Event}
        {enable-take-address=true, indirect-api=false, port-defined-argument-value{value=EventStatus_DTC_0x000001_Event:5, value-type=Dem_EventIdType}, port=EventStatus_DTC_0x000001_Event}
        {enable-take-address=true, indirect-api=false, port-defined-argument-value{value=Event_DTC_0xc07388_Event:7, value-type=Dem_EventIdType}, port=Event_DTC_0xc07388_Event}
        {enable-take-address=true, indirect-api=false, port-defined-argument-value{value=EventStatus_DTC_0xc07388_Event:7, value-type=Dem_EventIdType}, port=EventStatus_DTC_0xc07388_Event}
        {enable-take-address=true, indirect-api=false, port-defined-argument-value{value=Event_DTC_0xc12687_Event:8, value-type=Dem_EventIdType}, port=Event_DTC_0xc12687_Event}
        {enable-take-address=true, indirect-api=false, port-defined-argument-value{value=EventStatus_DTC_0xc12687_Event:8, value-type=Dem_EventIdType}, port=EventStatus_DTC_0xc12687_Event}
        {enable-take-address=true, indirect-api=false, port-defined-argument-value{value=Event_DTC_0xc14587_Event:9, value-type=Dem_EventIdType}, port=Event_DTC_0xc14587_Event}
        {enable-take-address=true, indirect-api=false, port-defined-argument-value{value=EventStatus_DTC_0xc14587_Event:9, value-type=Dem_EventIdType}, port=EventStatus_DTC_0xc14587_Event}
        {enable-take-address=true, indirect-api=false, port-defined-argument-value{value=Event_DTC_0xc22a87_Event:10, value-type=Dem_EventIdType}, port=Event_DTC_0xc22a87_Event}
        {enable-take-address=true, indirect-api=false, port-defined-argument-value{value=EventStatus_DTC_0xc22a87_Event:10, value-type=Dem_EventIdType}, port=EventStatus_DTC_0xc22a87_Event}
        {enable-take-address=true, indirect-api=false, port-defined-argument-value{value=Event_DTC_0xc41487_Event:11, value-type=Dem_EventIdType}, port=Event_DTC_0xc41487_Event}
        {enable-take-address=true, indirect-api=false, port-defined-argument-value{value=EventStatus_DTC_0xc41487_Event:11, value-type=Dem_EventIdType}, port=EventStatus_DTC_0xc41487_Event}
        {enable-take-address=true, indirect-api=false, port-defined-argument-value{value=Event_DTC_0xd56217_Event:12, value-type=Dem_EventIdType}, port=Event_DTC_0xd56217_Event}
        {enable-take-address=true, indirect-api=false, port-defined-argument-value{value=EventStatus_DTC_0xd56217_Event:12, value-type=Dem_EventIdType}, port=EventStatus_DTC_0xd56217_Event}
        {enable-take-address=true, indirect-api=false, port-defined-argument-value{value=Event_DTC_0xd56316_Event:13, value-type=Dem_EventIdType}, port=Event_DTC_0xd56316_Event}
        {enable-take-address=true, indirect-api=false, port-defined-argument-value{value=EventStatus_DTC_0xd56316_Event:13, value-type=Dem_EventIdType}, port=EventStatus_DTC_0xd56316_Event}
        {enable-take-address=true, indirect-api=false, port-defined-argument-value{value=Event_DTC_0xe00141_Event:14, value-type=Dem_EventIdType}, port=Event_DTC_0xe00141_Event}
        {enable-take-address=true, indirect-api=false, port-defined-argument-value{value=EventStatus_DTC_0xe00141_Event:14, value-type=Dem_EventIdType}, port=EventStatus_DTC_0xe00141_Event}
        {enable-take-address=true, indirect-api=false, port-defined-argument-value{value=Event_DTC_0xe00142_Event:15, value-type=Dem_EventIdType}, port=Event_DTC_0xe00142_Event}
        {enable-take-address=true, indirect-api=false, port-defined-argument-value{value=EventStatus_DTC_0xe00142_Event:15, value-type=Dem_EventIdType}, port=EventStatus_DTC_0xe00142_Event}
        {enable-take-address=true, indirect-api=false, port-defined-argument-value{value=Event_DTC_0xe26200_Event:16, value-type=Dem_EventIdType}, port=Event_DTC_0xe26200_Event}
        {enable-take-address=true, indirect-api=false, port-defined-argument-value{value=EventStatus_DTC_0xe26200_Event:16, value-type=Dem_EventIdType}, port=EventStatus_DTC_0xe26200_Event}
        {enable-take-address=true, indirect-api=false, port-defined-argument-value{value=OpCycle_DemOpCycle_DEM_POWER:0, value-type=Dem_OperationCycleIdType}, port=OpCycle_DemOpCycle_DEM_POWER}
        {enable-take-address=true, indirect-api=false, port-defined-argument-value{value=StorageCond_DemStorageCondition:0, value-type=uint8}, port=StorageCond_DemStorageCondition}
        enable-take-address=true, indirect-api=false, port=GeneralEvtInfo
        {enable-take-address=true, indirect-api=false, port-defined-argument-value{value=ControlEventAvailable_DTC_0x000001_Event:5, value-type=Dem_EventIdType}, port=ControlEventAvailable_DTC_0x000001_Event}
        {enable-take-address=true, indirect-api=false, port-defined-argument-value{value=ControlEventAvailable_DTC_0xc07388_Event:7, value-type=Dem_EventIdType}, port=ControlEventAvailable_DTC_0xc07388_Event}
        {enable-take-address=true, indirect-api=false, port-defined-argument-value{value=ControlEventAvailable_DTC_0xc12687_Event:8, value-type=Dem_EventIdType}, port=ControlEventAvailable_DTC_0xc12687_Event}
        {enable-take-address=true, indirect-api=false, port-defined-argument-value{value=ControlEventAvailable_DTC_0xc14587_Event:9, value-type=Dem_EventIdType}, port=ControlEventAvailable_DTC_0xc14587_Event}
        {enable-take-address=true, indirect-api=false, port-defined-argument-value{value=ControlEventAvailable_DTC_0xc22a87_Event:10, value-type=Dem_EventIdType}, port=ControlEventAvailable_DTC_0xc22a87_Event}
        {enable-take-address=true, indirect-api=false, port-defined-argument-value{value=ControlEventAvailable_DTC_0xc41487_Event:11, value-type=Dem_EventIdType}, port=ControlEventAvailable_DTC_0xc41487_Event}
        {enable-take-address=true, indirect-api=false, port-defined-argument-value{value=ControlEventAvailable_DTC_0xd56217_Event:12, value-type=Dem_EventIdType}, port=ControlEventAvailable_DTC_0xd56217_Event}
        {enable-take-address=true, indirect-api=false, port-defined-argument-value{value=ControlEventAvailable_DTC_0xd56316_Event:13, value-type=Dem_EventIdType}, port=ControlEventAvailable_DTC_0xd56316_Event}
        {enable-take-address=true, indirect-api=false, port-defined-argument-value{value=ControlEventAvailable_DTC_0xe00141_Event:14, value-type=Dem_EventIdType}, port=ControlEventAvailable_DTC_0xe00141_Event}
        {enable-take-address=true, indirect-api=false, port-defined-argument-value{value=ControlEventAvailable_DTC_0xe00142_Event:15, value-type=Dem_EventIdType}, port=ControlEventAvailable_DTC_0xe00142_Event}
        {enable-take-address=true, indirect-api=false, port-defined-argument-value{value=ControlEventAvailable_DTC_0xe26200_Event:16, value-type=Dem_EventIdType}, port=ControlEventAvailable_DTC_0xe26200_Event}
        enable-take-address=true, indirect-api=false, port=CBClrEvt_DTC_0x000001_Event
        enable-take-address=true, indirect-api=false, port=CBClrEvt_DTC_0x0d0400_CAN_Network_ETAS_BusOff_Event
        enable-take-address=true, indirect-api=false, port=CBClrEvt_DTC_0xc07388_Event
        enable-take-address=true, indirect-api=false, port=CBClrEvt_DTC_0xc12687_Event
        enable-take-address=true, indirect-api=false, port=CBClrEvt_DTC_0xc14587_Event
        enable-take-address=true, indirect-api=false, port=CBClrEvt_DTC_0xc22a87_Event
        enable-take-address=true, indirect-api=false, port=CBClrEvt_DTC_0xc41487_Event
        enable-take-address=true, indirect-api=false, port=CBClrEvt_DTC_0xd56217_Event
        enable-take-address=true, indirect-api=false, port=CBClrEvt_DTC_0xd56316_Event
        enable-take-address=true, indirect-api=false, port=CBClrEvt_DTC_0xe00141_Event
        enable-take-address=true, indirect-api=false, port=CBClrEvt_DTC_0xe00142_Event
        enable-take-address=true, indirect-api=false, port=CBClrEvt_DTC_0xe26200_Event
      45 x runnable:
        Dem_MainFunction
          12 x sync call, all with timeout=0.0:
            SSC_CBClrEvt_DTC_0x000001_Event: operation=CBClrEvt_DTC_0x000001_Event.ClearEventAllowed
            SSC_CBClrEvt_DTC_0x0d0400_CAN_Network_ETAS_BusOff_Event: operation=CBClrEvt_DTC_0x0d0400_CAN_Network_ETAS_BusOff_Event.ClearEventAllowed
            SSC_CBClrEvt_DTC_0xc07388_Event: operation=CBClrEvt_DTC_0xc07388_Event.ClearEventAllowed
            SSC_CBClrEvt_DTC_0xc12687_Event: operation=CBClrEvt_DTC_0xc12687_Event.ClearEventAllowed
            SSC_CBClrEvt_DTC_0xc14587_Event: operation=CBClrEvt_DTC_0xc14587_Event.ClearEventAllowed
            SSC_CBClrEvt_DTC_0xc22a87_Event: operation=CBClrEvt_DTC_0xc22a87_Event.ClearEventAllowed
            SSC_CBClrEvt_DTC_0xc41487_Event: operation=CBClrEvt_DTC_0xc41487_Event.ClearEventAllowed
            SSC_CBClrEvt_DTC_0xd56217_Event: operation=CBClrEvt_DTC_0xd56217_Event.ClearEventAllowed
            SSC_CBClrEvt_DTC_0xd56316_Event: operation=CBClrEvt_DTC_0xd56316_Event.ClearEventAllowed
            SSC_CBClrEvt_DTC_0xe00141_Event: operation=CBClrEvt_DTC_0xe00141_Event.ClearEventAllowed
            SSC_CBClrEvt_DTC_0xe00142_Event: operation=CBClrEvt_DTC_0xe00142_Event.ClearEventAllowed
            SSC_CBClrEvt_DTC_0xe26200_Event: operation=CBClrEvt_DTC_0xe26200_Event.ClearEventAllowed
        SetEventStatus: arguments=[symbol=EventId, symbol=EventStatus], can-be-invoked-concurrently=true, symbol=Dem_SetEventStatus
        SetEventStatusWithEnvdata: arguments=[symbol=EventId, symbol=EventStatus, symbol=debug0, symbol=debug1], can-be-invoked-concurrently=true, symbol=Dem_SetEventStatusWithEnvData
        ResetEventStatus: runnable-entity-argument=symbol=EventId, can-be-invoked-concurrently=true, symbol=Dem_ResetEventStatus
        PrestoreFreezeFrame: runnable-entity-argument=symbol=EventId, can-be-invoked-concurrently=true, symbol=Dem_PrestoreFreezeFrame
        ClearPrestoredFreezeFrame: runnable-entity-argument=symbol=EventId, can-be-invoked-concurrently=true, symbol=Dem_ClearPrestoredFreezeFrame
        ResetEventDebounceStatus: arguments=[symbol=EventId, symbol=DebounceResetStatus], can-be-invoked-concurrently=true, symbol=Dem_ResetEventDebounceStatus
        GetEventStatus: arguments=[symbol=EventId, symbol=EventStatusExtended], can-be-invoked-concurrently=true, symbol=Dem_GetEventStatus
        GetEventFailed: arguments=[symbol=EventId, symbol=EventFailed], can-be-invoked-concurrently=true, symbol=Dem_GetEventFailed
        GetEventTested: arguments=[symbol=EventId, symbol=EventTested], can-be-invoked-concurrently=true, symbol=Dem_GetEventTested
        GetDTCOfEvent: arguments=[symbol=EventId, symbol=DTCFormat, symbol=DTCOfEvent], can-be-invoked-concurrently=true, symbol=Dem_GetDTCOfEvent
        GetDebouncingOfEvent: arguments=[symbol=EventId, symbol=DebouncingState], can-be-invoked-concurrently=true, symbol=Dem_GetDebouncingOfEvent
        GetFaultDetectionCounter: arguments=[symbol=EventId, symbol=FaultDetectionCounter], can-be-invoked-concurrently=true, symbol=Dem_GetFaultDetectionCounter
        SetWIRStatus: arguments=[symbol=EventId, symbol=WIRStatus], can-be-invoked-concurrently=true, symbol=Dem_SetWIRStatus
        GetEventExtendedDataRecord: arguments=[symbol=EventId, symbol=RecordNumber, symbol=DestBuffer], can-be-invoked-concurrently=true, symbol=Dem_GetEventExtendedDataRecordForRTE
        GetEventExtendedDataRecordEx: arguments=[symbol=EventId, symbol=RecordNumber, symbol=DestBuffer, symbol=BufSize], can-be-invoked-concurrently=true, symbol=Dem_GetEventExtendedDataRecordEx
        GetEventFreezeFrameData: arguments=[symbol=EventId, symbol=RecordNumber, symbol=ReportTotalRecord, symbol=DataId, symbol=DestBuffer], can-be-invoked-concurrently=true, symbol=Dem_GetEventFreezeFrameDataForRTE
        GetEventFreezeFrameDataEx: arguments=[symbol=EventId, symbol=RecordNumber, symbol=DataId, symbol=DestBuffer, symbol=BufSize], can-be-invoked-concurrently=true, symbol=Dem_GetEventFreezeFrameDataEx
        SetOperationCycleState: arguments=[symbol=OperationCycleId, symbol=CycleState], can-be-invoked-concurrently=true, symbol=Dem_SetOperationCycleState
        GetOperationCycleState: arguments=[symbol=OperationCycleId, symbol=CycleState], can-be-invoked-concurrently=true, symbol=Dem_GetOperationCycleState
        GetCycleQualified: arguments=[symbol=OperationCycleId, symbol=isQualified], can-be-invoked-concurrently=true, symbol=Dem_GetCycleQualified
        SetCycleQualified: runnable-entity-argument=symbol=OperationCycleId, can-be-invoked-concurrently=true, symbol=Dem_SetCycleQualified
        SetEnableCondition: arguments=[symbol=EnableConditionID, symbol=ConditionFulfilled], can-be-invoked-concurrently=true, symbol=Dem_SetEnableCondition
        GetEnableCondition: arguments=[symbol=EnableConditionID, symbol=ConditionFulfilled], can-be-invoked-concurrently=true, symbol=Dem_GetEnableCondition
        SetStorageCondition: arguments=[symbol=StorageConditionID, symbol=ConditionFulfilled], can-be-invoked-concurrently=true, symbol=Dem_SetStorageCondition
        GetStorageCondition: arguments=[symbol=StorageConditionID, symbol=ConditionFulfilled], can-be-invoked-concurrently=true, symbol=Dem_GetStorageCondition
        GetIndicatorStatus: arguments=[symbol=IndicatorId, symbol=IndicatorStatus], can-be-invoked-concurrently=true, symbol=Dem_GetIndicatorStatus
        SetDTCSuppression: arguments=[symbol=ClientId, symbol=SuppressionStatus], symbol=Dem_SetDTCSuppression
        GetDTCSuppression: arguments=[symbol=ClientId, symbol=SuppressionStatus], symbol=Dem_GetDTCSuppression
        GetEventMemoryOverflow: arguments=[symbol=ClientId, symbol=DTCOrigin, symbol=OverflowIndication], can-be-invoked-concurrently=true, symbol=Dem_GetEventMemoryOverflow
        GetNumberOfEventMemoryEntries: arguments=[symbol=ClientId, symbol=DTCOrigin, symbol=NumberOfEventMemoryEntries], can-be-invoked-concurrently=true, symbol=Dem_GetNumberOfEventMemoryEntries
        ClearDTC: runnable-entity-argument=symbol=ClientId, symbol=Dem_ClearDTC
        SelectDTC: arguments=[symbol=ClientId, symbol=DTC, symbol=DTCFormat, symbol=DTCOrigin], symbol=Dem_SelectDTC
        Dem_GetEventStatus_GeneralEvtInfo: arguments=[symbol=EventId, symbol=EventStatusExtended], can-be-invoked-concurrently=true
        Dem_GetEventFailed_GeneralEvtInfo: can-be-invoked-concurrently=true
        Dem_GetEventTested_GeneralEvtInfo: arguments=[symbol=EventId, symbol=EventTested], can-be-invoked-concurrently=true
        Dem_GetDTCOfEvent_GeneralEvtInfo: can-be-invoked-concurrently=true
        Dem_GetFaultDetectionCounter_GeneralEvtInfo: arguments=[symbol=EventId, symbol=FaultDetectionCounter], can-be-invoked-concurrently=true
        Dem_GetEventExtendedDataRecord_GeneralEvtInfo: can-be-invoked-concurrently=true
        Dem_GetEventFreezeFrameData_GeneralEvtInfo: can-be-invoked-concurrently=true
        Dem_GetEventExtendedDataRecordEx_GeneralEvtInfo: arguments=[symbol=EventId, symbol=RecordNumber, symbol=DestBuffer, symbol=BufSize], can-be-invoked-concurrently=true
        Dem_GetEventFreezeFrameDataEx_GeneralEvtInfo: can-be-invoked-concurrently=true
        GetDebouncingOfEvent_GeneralEvtInfo: can-be-invoked-concurrently=true, symbol=Dem_GetDebouncingOfEvent_GeneralEvtInfo
        Dem_GetEventIdCausingLastDetError: can-be-invoked-concurrently=true
        SetEventAvailable: arguments=[symbol=EventId, symbol=AvailableStatus], can-be-invoked-concurrently=true, symbol=Dem_SetEventAvailable
package /AUTOSAR_Dem/PortInterfaces
  21 x client server interface, all with is-service=true:
    DiagnosticMonitor
      6 x operation, all with possible-error=[DiagnosticMonitor/E_OK, DiagnosticMonitor/E_NOT_OK]:
        SetEventStatus
          arg EventStatus: type=Dem_EventStatusType, direction=IN
        SetEventStatusWithEnvdata
          arg EventStatus: type=Dem_EventStatusType, direction=IN
          arg debug0: type=Dem_DebugDataType, direction=IN
          arg debug1: type=Dem_DebugDataType, direction=IN
        ResetEventStatus
        PrestoreFreezeFrame
        ClearPrestoredFreezeFrame
        ResetEventDebounceStatus
          arg DebounceResetStatus: type=Dem_DebounceResetStatusType, direction=IN
      error E_OK: error-code=0
      error E_NOT_OK: error-code=1
    DiagnosticInfo
      10 x operation:
        GetEventStatus: possible-error=[DiagnosticInfo/E_OK, DiagnosticInfo/E_NOT_OK]
          arg EventStatusByte: type=Dem_UdsStatusByteType, direction=OUT
        GetEventFailed: possible-error=[DiagnosticInfo/E_OK, DiagnosticInfo/E_NOT_OK]
          arg EventFailed: type=boolean, direction=OUT
        GetEventTested: possible-error=[DiagnosticInfo/E_OK, DiagnosticInfo/E_NOT_OK]
          arg EventTested: type=boolean, direction=OUT
        GetDTCOfEvent: possible-error=[DiagnosticInfo/E_OK, DiagnosticInfo/E_NOT_OK, DiagnosticInfo/DEM_E_NO_DTC_AVAILABLE]
          arg DTCFormat: type=Dem_DTCFormatType, direction=IN
          arg DTCOfEvent: type=uint32, direction=OUT
        GetDebouncingOfEvent: possible-error=[DiagnosticInfo/E_OK, DiagnosticInfo/E_NOT_OK]
          arg DebouncingState: type=Dem_DebouncingStateType, direction=OUT
        GetFaultDetectionCounter: possible-error=[DiagnosticInfo/E_OK, DiagnosticInfo/E_NOT_OK, DiagnosticInfo/DEM_E_NO_FDC_AVAILABLE]
          arg FaultDetectionCounter: type=sint8, direction=OUT
        GetEventExtendedDataRecord: possible-error=[DiagnosticInfo/E_OK, DiagnosticInfo/E_NOT_OK]
          arg RecordNumber: type=uint8, direction=IN
          arg DestBuffer: type=Dem_MaxDataValueType, direction=OUT
        GetEventExtendedDataRecordEx: possible-error=[DiagnosticInfo/E_OK, DiagnosticInfo/E_NOT_OK]
          arg RecordNumber: type=uint8, direction=IN
          arg DestBuffer: type=Dem_MaxDataValueType, direction=OUT
          arg Bufsize: type=uint16, direction=INOUT
        GetEventFreezeFrameData: possible-error=[DiagnosticInfo/E_OK, DiagnosticInfo/E_NOT_OK]
          4 x arg:
            RecordNumber: type=uint8, direction=IN
            ReportTotalRecord: type=boolean, direction=IN
            DataId: type=uint16, direction=IN
            DestBuffer: type=Dem_MaxDataValueType, direction=OUT
        GetEventFreezeFrameDataEx: possible-error=[DiagnosticInfo/E_OK, DiagnosticInfo/E_NOT_OK]
          4 x arg:
            RecordNumber: type=uint8, direction=IN
            DataId: type=uint16, direction=IN
            DestBuffer: type=Dem_MaxDataValueType, direction=OUT
            BufSize: type=uint16, direction=INOUT
      4 x error:
        E_OK: error-code=0
        E_NOT_OK: error-code=1
        DEM_E_NO_DTC_AVAILABLE: error-code=2
        DEM_E_NO_FDC_AVAILABLE: error-code=3
    GetDataOfPID21
      operation GetDataOfPID21: possible-error=[GetDataOfPID21/E_OK, GetDataOfPID21/E_NOT_OK]
        arg PID21value: type=Dem_PID21valueType, direction=OUT
      error E_OK: error-code=0
      error E_NOT_OK: error-code=1
    GetDataOfPID31
      operation GetDataOfPID31: possible-error=[GetDataOfPID31/E_OK, GetDataOfPID31/E_NOT_OK]
        arg PID31value: type=Dem_PID31valueType, direction=OUT
      error E_OK: error-code=0
      error E_NOT_OK: error-code=1
    SetDataOfPID21
      operation SetDataOfPID21: possible-error=[SetDataOfPID21/E_OK, SetDataOfPID21/E_NOT_OK]
        arg PID21value: type=Dem_PID21valueType, direction=IN
      error E_OK: error-code=0
      error E_NOT_OK: error-code=1
    SetDataOfPID31
      operation SetDataOfPID31: possible-error=[SetDataOfPID31/E_OK, SetDataOfPID31/E_NOT_OK]
        arg PID31value: type=Dem_PID31valueType, direction=IN
      error E_OK: error-code=0
      error E_NOT_OK: error-code=1
    SetDataOfPID4D
      operation SetDataOfPID4D: possible-error=[SetDataOfPID4D/E_OK, SetDataOfPID4D/E_NOT_OK]
        arg PID4Dvalue: type=Dem_PID4DvalueType, direction=IN
      error E_OK: error-code=0
      error E_NOT_OK: error-code=1
    SetDataOfPID4E
      operation SetDataOfPID4E: possible-error=[SetDataOfPID4E/E_OK, SetDataOfPID4E/E_NOT_OK]
        arg PID4Evalue: type=Dem_PID4EvalueType, direction=IN
      error E_OK: error-code=0
      error E_NOT_OK: error-code=1
    GetDataOfPID4D
      operation GetDataOfPID4D: possible-error=[GetDataOfPID4D/E_OK, GetDataOfPID4D/E_NOT_OK]
        arg PID4Dvalue: type=Dem_PID4DvalueType, direction=OUT
      error E_OK: error-code=0
      error E_NOT_OK: error-code=1
    GetDataOfPID4E
      operation GetDataOfPID4E: possible-error=[GetDataOfPID4E/E_OK, GetDataOfPID4E/E_NOT_OK]
        arg PID4Evalue: type=Dem_PID4EvalueType, direction=OUT
      error E_OK: error-code=0
      error E_NOT_OK: error-code=1
    GeneralDiagnosticInfo
      11 x operation:
        GetEventStatus: possible-error=[GeneralDiagnosticInfo/E_OK, GeneralDiagnosticInfo/E_NOT_OK]
          arg EventId: type=Dem_EventIdType, direction=IN
          arg EventStatusByte: type=Dem_UdsStatusByteType, direction=OUT
        GetEventFailed: possible-error=[GeneralDiagnosticInfo/E_OK, GeneralDiagnosticInfo/E_NOT_OK]
          arg EventId: type=Dem_EventIdType, direction=IN
          arg EventFailed: type=boolean, direction=OUT
        GetEventTested: possible-error=[GeneralDiagnosticInfo/E_OK, GeneralDiagnosticInfo/E_NOT_OK]
          arg EventId: type=Dem_EventIdType, direction=IN
          arg EventTested: type=boolean, direction=OUT
        GetDTCOfEvent: possible-error=[GeneralDiagnosticInfo/E_OK, GeneralDiagnosticInfo/E_NOT_OK, GeneralDiagnosticInfo/DEM_E_NO_DTC_AVAILABLE]
          arg EventId: type=Dem_EventIdType, direction=IN
          arg DTCFormat: type=Dem_DTCFormatType, direction=IN
          arg DTCOfEvent: type=uint32, direction=OUT
        GetDebouncingOfEvent: possible-error=[GeneralDiagnosticInfo/E_OK, GeneralDiagnosticInfo/E_NOT_OK]
          arg EventId: type=Dem_EventIdType, direction=IN
          arg DebouncingState: type=Dem_DebouncingStateType, direction=OUT
        GetFaultDetectionCounter: possible-error=[GeneralDiagnosticInfo/E_OK, GeneralDiagnosticInfo/E_NOT_OK, GeneralDiagnosticInfo/DEM_E_NO_FDC_AVAILABLE]
          arg EventId: type=Dem_EventIdType, direction=IN
          arg FaultDetectionCounter: type=sint8, direction=OUT
        GetEventExtendedDataRecord: possible-error=[GeneralDiagnosticInfo/E_OK, GeneralDiagnosticInfo/E_NOT_OK]
          arg EventId: type=Dem_EventIdType, direction=IN
          arg RecordNumber: type=uint8, direction=IN
          arg DestBuffer: type=Dem_MaxDataValueType, direction=OUT
        GetEventFreezeFrameData: possible-error=[GeneralDiagnosticInfo/E_OK, GeneralDiagnosticInfo/E_NOT_OK]
          5 x arg:
            EventId: type=Dem_EventIdType, direction=IN
            RecordNumber: type=uint8, direction=IN
            ReportTotalRecord: type=boolean, direction=IN
            DataId: type=uint16, direction=IN
            DestBuffer: type=Dem_MaxDataValueType, direction=OUT
        GetEventExtendedDataRecordEx: possible-error=[GeneralDiagnosticInfo/E_OK, GeneralDiagnosticInfo/E_NOT_OK]
          4 x arg:
            EventId: type=Dem_EventIdType, direction=IN
            RecordNumber: type=uint8, direction=IN
            DestBuffer: type=Dem_MaxDataValueType, direction=OUT
            Bufsize: type=uint16, direction=INOUT
        GetEventFreezeFrameDataEx: possible-error=[GeneralDiagnosticInfo/E_OK, GeneralDiagnosticInfo/E_NOT_OK]
          5 x arg:
            EventId: type=Dem_EventIdType, direction=IN
            RecordNumber: type=uint8, direction=IN
            DataId: type=uint16, direction=IN
            DestBuffer: type=Dem_MaxDataValueType, direction=OUT
            BufSize: type=uint16, direction=INOUT
        GetEventIdCausingLastDetError: possible-error=[GeneralDiagnosticInfo/E_OK, GeneralDiagnosticInfo/E_NOT_OK]
          arg EventId: type=Dem_EventIdType, direction=OUT
      4 x error:
        E_OK: error-code=0
        E_NOT_OK: error-code=1
        DEM_E_NO_DTC_AVAILABLE: error-code=2
        DEM_E_NO_FDC_AVAILABLE: error-code=3
    OperationCycle
      4 x operation, all with possible-error=[OperationCycle/E_OK, OperationCycle/E_NOT_OK]:
        SetOperationCycleState
          arg CycleState: type=Dem_OperationCycleStateType, direction=IN
        GetOperationCycleState
          arg CycleState: type=Dem_OperationCycleStateType, direction=OUT
        GetCycleQualified
          arg CycleState: type=boolean, direction=OUT
        SetCycleQualified
      error E_OK: error-code=0
      error E_NOT_OK: error-code=1
    EventAvailable
      operation SetEventAvailable: possible-error=[EventAvailable/E_OK, EventAvailable/E_NOT_OK]
        arg AvailableStatus: type=boolean, direction=IN
      error E_OK: error-code=0
      error E_NOT_OK: error-code=1
    EnableCondition
      operation SetEnableCondition: possible-error=[EnableCondition/E_OK, EnableCondition/E_NOT_OK]
        arg ConditionFulfilled: type=boolean, direction=IN
      operation GetEnableCondition: possible-error=[EnableCondition/E_OK, EnableCondition/E_NOT_OK]
        arg ConditionFulfilled: type=boolean, direction=OUT
      error E_OK: error-code=0
      error E_NOT_OK: error-code=1
    StorageCondition
      operation SetStorageCondition: possible-error=[StorageCondition/E_OK, StorageCondition/E_NOT_OK]
        arg ConditionFulfilled: type=boolean, direction=IN
      operation GetStorageCondition: possible-error=[StorageCondition/E_OK, StorageCondition/E_NOT_OK]
        arg ConditionFulfilled: type=boolean, direction=OUT
      error E_OK: error-code=0
      error E_NOT_OK: error-code=1
    IndicatorStatus
      operation GetIndicatorStatus: possible-error=[IndicatorStatus/E_OK, IndicatorStatus/E_NOT_OK]
        arg IndicatorStatus: type=Dem_IndicatorStatusType, direction=OUT
      error E_OK: error-code=0
      error E_NOT_OK: error-code=1
    DTCSuppression
      operation SetDTCSuppression: possible-error=[DTCSuppression/E_OK, DTCSuppression/E_NOT_OK, DTCSuppression/DEM_WRONG_DTC, DTCSuppression/DEM_WRONG_DTCORIGIN, DTCSuppression/DEM_PENDING]
        arg SuppressionStatus: type=boolean, direction=IN
      operation GetDTCSuppression: possible-error=[DTCSuppression/E_OK, DTCSuppression/E_NOT_OK, DTCSuppression/DEM_WRONG_DTC, DTCSuppression/DEM_WRONG_DTCORIGIN, DTCSuppression/DEM_PENDING]
        arg SuppressionStatus: type=boolean, direction=OUT
      5 x error:
        E_OK: error-code=0
        E_NOT_OK: error-code=1
        DEM_PENDING: error-code=4
        DEM_WRONG_DTC: error-code=8
        DEM_WRONG_DTCORIGIN: error-code=9
    EvMemOverflowIndication
      operation GetEventMemoryOverflow: possible-error=[EvMemOverflowIndication/E_OK, EvMemOverflowIndication/E_NOT_OK]
        arg OverflowIndication: type=boolean, direction=OUT
      operation GetNumberOfEventMemoryEntries: possible-error=[EvMemOverflowIndication/E_OK, EvMemOverflowIndication/E_NOT_OK]
        arg NumberOfEventMemoryEntries: type=uint8, direction=OUT
      error E_OK: error-code=0
      error E_NOT_OK: error-code=1
    CallbackClearEventAllowed
      operation ClearEventAllowed: possible-error=[CallbackClearEventAllowed/E_OK, CallbackClearEventAllowed/E_NOT_OK]
        arg Allowed: type=boolean, direction=OUT
      error E_OK: error-code=0
      error E_NOT_OK: error-code=1
    EventStatus
      operation SetWIRStatus: possible-error=[EventStatus/E_OK, EventStatus/E_NOT_OK]
        arg WIRStatus: type=boolean, direction=IN
      error E_OK: error-code=0
      error E_NOT_OK: error-code=1
    ClearDTC
      operation ClearDTC: possible-error=[ClearDTC/E_OK, ClearDTC/E_NOT_OK, ClearDTC/DEM_PENDING, DEM_CLEAR_BUSY, DEM_CLEAR_MEMORY_ERROR, DEM_CLEAR_FAILED, ClearDTC/DEM_WRONG_DTC, ClearDTC/DEM_WRONG_DTCORIGIN, DEM_BUSY]
      operation SelectDTC: possible-error=[ClearDTC/E_OK, ClearDTC/E_NOT_OK]
        arg DTC: type=uint32, direction=IN
        arg DTCFormat: type=Dem_DTCFormatType, direction=IN
        arg DTCOrigin: type=Dem_DTCOriginType, direction=IN
      9 x error:
        E_OK: error-code=0
        E_NOT_OK: error-code=1
        DEM_PENDING: error-code=4
        DEM_CLEAR_BUSY: error-code=5
        DEM_CLEAR_MEMORY_ERROR: error-code=6
        DEM_CLEAR_FAILED: error-code=7
        DEM_WRONG_DTC: error-code=8
        DEM_WRONG_DTCORIGIN: error-code=9
        DEM_BUSY: error-code=22
package /AUTOSAR_Dem/SwcImplementations
  swc implementation Impl_Dem: programming-language=C, sw-version=9.0.0, swc-bsw-mapping=SwcBswMappings, vendor-id=6, behavior=IntBeh_Dem
    code-descriptors:
      code CodeDescr_Dem: artifact-descriptors=autosar-engineering-object={short-label=Code_0, category=SWSRC}
package /AUTOSAR_Dem/ImplementationDataTypes
  18 x impl type:
    Dem_EventStatusType: compu {1=DEM_EVENT_STATUS_FAILED, 4=DEM_EVENT_STATUS_FDC_THRESHOLD_REACHED, 0=DEM_EVENT_STATUS_PASSED, 3=DEM_EVENT_STATUS_PREFAILED, 2=DEM_EVENT_STATUS_PREPASSED}, implementation-data-type=uint8
    Dem_DebugDataType: implementation-data-type=uint8
    Dem_EventIdType: implementation-data-type=uint16
    Dem_UdsStatusByteType: compu {0x01=DEM_UDS_STATUS_TF, 0x02=DEM_UDS_STATUS_TFTOC, 0x04=DEM_UDS_STATUS_PDTC, 0x08=DEM_UDS_STATUS_CDTC, 0x10=DEM_UDS_STATUS_TNCSLC, 0x20=DEM_UDS_STATUS_TFSLC, 0x40=DEM_UDS_STATUS_TNCTOC, 0x80=DEM_UDS_STATUS_WIR}, implementation-data-type=uint8
    Dem_OperationCycleStateType: compu {0x01=DEM_CYCLE_STATE_END, 0x00=DEM_CYCLE_STATE_START}, implementation-data-type=uint8
    Dem_OperationCycleIdType: implementation-data-type=uint8
    Dem_MaxDataValueType: category=ARRAY, type-emitter=RTE
      element uint8: array-size=6, array-size-semantics=FIXED-SIZE, implementation-data-type=uint8
    Dem_PID21valueType: category=ARRAY, type-emitter=RTE
      element PID21value: array-size=2, array-size-semantics=FIXED-SIZE, implementation-data-type=uint8
    Dem_PID31valueType: category=ARRAY, type-emitter=RTE
      element PID31value: array-size=2, array-size-semantics=FIXED-SIZE, implementation-data-type=uint8
    Dem_PID4DvalueType: category=ARRAY, type-emitter=RTE
      element PID4Dvalue: array-size=2, array-size-semantics=FIXED-SIZE, implementation-data-type=uint8
    Dem_PID4EvalueType: category=ARRAY, type-emitter=RTE
      element PID4Evalue: array-size=2, array-size-semantics=FIXED-SIZE, implementation-data-type=uint8
    Dem_IndicatorIdType: implementation-data-type=uint8
    Dem_IndicatorStatusType: compu {0x00=DEM_INDICATOR_OFF, 0x01=DEM_INDICATOR_CONTINUOUS, 0x02=DEM_INDICATOR_BLINKING, 0x03=DEM_INDICATOR_BLINK_CONT, 0x04=DEM_INDICATOR_SLOW_FLASH, 0x05=DEM_INDICATOR_FAST_FLASH}, implementation-data-type=uint8
    Dem_DTCOriginType: compu {0x0001=DEM_DTC_ORIGIN_PRIMARY_MEMORY, 0x0002=DEM_DTC_ORIGIN_MIRROR_MEMORY, 0x0003=DEM_DTC_ORIGIN_PERMANENT_MEMORY, 0x0004=DEM_DTC_ORIGIN_OBD_RELEVANT_MEMORY, 0x0005=DEM_DTC_ORIGIN_SECONDARY_MEMORY}, implementation-data-type=uint16
    Dem_InitMonitorReasonType: compu {0x01=DEM_INIT_MONITOR_CLEAR, 0x02=DEM_INIT_MONITOR_RESTART, 0x03=DEM_INIT_MONITOR_REENABLED, 0x04=DEM_INIT_MONITOR_STORAGE_REENABLED}, implementation-data-type=uint8
    Dem_DTCFormatType: compu {0=DEM_DTC_FORMAT_OBD, 1=DEM_DTC_FORMAT_UDS, 2=DEM_DTC_FORMAT_J1939}, implementation-data-type=uint8
    Dem_DebouncingStateType: compu {0x01=DEM_TEMPORARILY_DEFECTIVE, 0x02=DEM_FINALLY_DEFECTIVE, 0x04=DEM_TEMPORARILY_HEALED, 0x08=DEM_TEST_COMPLETE, 0x10=DEM_DTR_UPDATE}, implementation-data-type=uint8
    Dem_DebounceResetStatusType: compu {0x00=DEM_DEBOUNCE_STATUS_FREEZE, 0x01=DEM_DEBOUNCE_STATUS_RESET}, implementation-data-type=uint8
package /AUTOSAR_Dem/SwcBswMappings
  swc bsw mapping SwcBswMappings: bsw-behavior=IB_Dem, swc-bsw-runnable-mapping{bsw-entity=BSWSE_DemMainFunction, swc-runnable=Dem_MainFunction}, swc-behavior=IntBeh_Dem

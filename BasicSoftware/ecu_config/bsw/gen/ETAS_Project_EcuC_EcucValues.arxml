AUTOSAR XML (schema 00047)
package /ETAS_BIP/EcucModuleConfigurationValuess
  module config EcuC: implementation-config-variant=VARIANT-PRE-COMPILE
    EcucConfigSet
      EcucPduCollection: PduIdTypeEnum=uint16, PduLengthTypeEnum=uint16
        27 x Pdu:
          ComTx_0x55_Com2PduR_Can_Network_ETAS_Channel_CAN: PduLength=6, SysTPduToPduTriggeringRef=PduTrig_ComTx_0x55
          ComTx_0x55_PduR2CanIf_Can_Network_ETAS_Channel_CAN: PduLength=6, SysTPduToPduTriggeringRef=PduTrig_ComTx_0x55
          ComRx_0x261_CanIf2PduR_Can_Network_ETAS_Channel_CAN: PduLength=1, SysTPduToPduTriggeringRef=PduTrig_ComRx_0x261
          ComRx_0x261_PduR2Com_Can_Network_ETAS_Channel_CAN: PduLength=1, SysTPduToPduTriggeringRef=PduTrig_ComRx_0x261
          ComRx_0x81_CanIf2PduR_Can_Network_ETAS_Channel_CAN: PduLength=8, SysTPduToPduTriggeringRef=PduTrig_ComRx_0x81
          ComRx_0x81_PduR2Com_Can_Network_ETAS_Channel_CAN: PduLength=8, SysTPduToPduTriggeringRef=PduTrig_ComRx_0x81
          NM_Rx_0x677_CanIf2CanNm_Can_Network_ETAS_Channel_CAN: PduLength=8, SysTPduToFrameTriggeringRef=NM_Rx_0x677_Trgr
          NM_Tx_0x600_CanNm2CanIf_Can_Network_ETAS_Channel_CAN: PduLength=8, SysTPduToFrameTriggeringRef=NM_Tx_0x600_Trgr
          XcpTx_0x333_Xcp2CanIf_Can_Network_ETAS_Channel_CAN: PduLength=8, SysTPduToPduTriggeringRef=PduTrig_XcpTx_0x333
          XcpRx_0x332_CanIf2Xcp_Can_Network_ETAS_Channel_CAN: PduLength=8, SysTPduToPduTriggeringRef=PduTrig_XcpRx_0x332
          NPdu_UdsRxFnc_CanIf2CanTp_Can_Network_ETAS_Channel_CAN: PduLength=8, SysTPduToFrameTriggeringRef=UdsRxFnc_Trgr
          NPdu_UdsRxPhy_CanIf2CanTp_Can_Network_ETAS_Channel_CAN: PduLength=8, SysTPduToFrameTriggeringRef=UdsRxPhy_Trgr
          NPdu_UdsTxPhy_CanTp2CanIf_Can_Network_ETAS_Channel_CAN: PduLength=8, SysTPduToFrameTriggeringRef=UdsTxPhy_Trgr
          NM_Tx_0x600_Com2PduR_Can_Network_ETAS_Channel_CAN: PduLength=6, SysTPduToFrameTriggeringRef=NM_Tx_0x600_Trgr
          NM_Tx_0x600_PduR2CanNm_Can_Network_ETAS_Channel_CAN: PduLength=6, SysTPduToFrameTriggeringRef=NM_Tx_0x600_Trgr
          UdsRxFnc_CanTp2PduR_Can_Network_ETAS_Channel_CAN: PduLength=8, SysTPduToPduTriggeringRef=PduTrig_UdsRxFnc
          UdsRxFnc_PduR2Dcm_Can_Network_ETAS_Channel_CAN: PduLength=8, SysTPduToPduTriggeringRef=PduTrig_UdsRxFnc
          UdsRxPhy_CanTp2PduR_Can_Network_ETAS_Channel_CAN: PduLength=8, SysTPduToPduTriggeringRef=PduTrig_UdsRxPhy
          UdsRxPhy_PduR2Dcm_Can_Network_ETAS_Channel_CAN: PduLength=8, SysTPduToPduTriggeringRef=PduTrig_UdsRxPhy
          UdsTxPhy_Dcm2PduR_Can_Network_ETAS_Channel_CAN: PduLength=8, SysTPduToPduTriggeringRef=PduTrig_UdsTxPhy
          UdsTxPhy_PduR2CanTp_Can_Network_ETAS_Channel_CAN: PduLength=8, SysTPduToPduTriggeringRef=PduTrig_UdsTxPhy
          ComRx_0x456_CanIf2PduR_Can_Network_ETAS_Channel_CAN: PduLength=8, SysTPduToPduTriggeringRef=PduTrig_ComRx_0x456
          ComRx_0x456_PduR2Com_Can_Network_ETAS_Channel_CAN: PduLength=8, SysTPduToPduTriggeringRef=PduTrig_ComRx_0x456
          ComTx_0x123_Com2PduR_Can_Network_ETAS_Channel_CAN: PduLength=8, SysTPduToPduTriggeringRef=PduTrig_ComTx_0x123
          ComTx_0x123_PduR2CanIf_Can_Network_ETAS_Channel_CAN: PduLength=8, SysTPduToPduTriggeringRef=PduTrig_ComTx_0x123
          ComTx_0x98_Com2PduR_Can_Network_ETAS_Channel_CAN: PduLength=7, SysTPduToPduTriggeringRef=PduTrig_ComTx_0x98
          ComTx_0x98_PduR2CanIf_Can_Network_ETAS_Channel_CAN: PduLength=7, SysTPduToPduTriggeringRef=PduTrig_ComTx_0x98
    EcuCRbSettings: EcuCRbRteInUse=true, EcuCRbArRelease=AR42_Rev2

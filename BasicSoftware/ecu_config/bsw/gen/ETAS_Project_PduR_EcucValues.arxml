AUTOSAR XML (schema 00047)
package /ETAS_BIP/EcucModuleConfigurationValuess
  module config PduR: implementation-config-variant=VARIANT-PRE-COMPILE
    PduRRoutingTables: PduRConfigurationId=0
      PduRRoutingTable
        10 x PduRRoutingPath:
          ComTx_0x55_Com2CanIf_Can_Network_ETAS_Channel_CAN
            ComTx_0x55_Com2PduR_Can_Network_ETAS_Channel_CAN (PduRSrcPdu): PduRSrcPduRef=ComTx_0x55_Com2PduR_Can_Network_ETAS_Channel_CAN
            ComTx_0x55_PduR2CanIf_Can_Network_ETAS_Channel_CAN (PduRDestPdu): PduRDestPduRef=ComTx_0x55_PduR2CanIf_Can_Network_ETAS_Channel_CAN
          ComRx_0x261_CanIf2Com_Can_Network_ETAS_Channel_CAN
            ComRx_0x261_PduR2Com_Can_Network_ETAS_Channel_CAN (PduRDestPdu): PduRDestPduRef=ComRx_0x261_PduR2Com_Can_Network_ETAS_Channel_CAN
            ComRx_0x261_CanIf2PduR_Can_Network_ETAS_Channel_CAN (PduRSrcPdu): PduRSrcPduRef=ComRx_0x261_CanIf2PduR_Can_Network_ETAS_Channel_CAN
          ComRx_0x81_CanIf2Com_Can_Network_ETAS_Channel_CAN
            ComRx_0x81_PduR2Com_Can_Network_ETAS_Channel_CAN (PduRDestPdu): PduRDestPduRef=ComRx_0x81_PduR2Com_Can_Network_ETAS_Channel_CAN
            ComRx_0x81_CanIf2PduR_Can_Network_ETAS_Channel_CAN (PduRSrcPdu): PduRSrcPduRef=ComRx_0x81_CanIf2PduR_Can_Network_ETAS_Channel_CAN
          NM_Tx_0x600_Com2CanNm_Can_Network_ETAS_Channel_CAN
            NM_Tx_0x600_Com2PduR_Can_Network_ETAS_Channel_CAN (PduRSrcPdu): PduRSrcPduRef=NM_Tx_0x600_Com2PduR_Can_Network_ETAS_Channel_CAN
            NM_Tx_0x600_PduR2CanNm_Can_Network_ETAS_Channel_CAN (PduRDestPdu): PduRDestPduRef=NM_Tx_0x600_PduR2CanNm_Can_Network_ETAS_Channel_CAN
          UdsRxFnc_CanTp2Dcm_Can_Network_ETAS_Channel_CAN
            UdsRxFnc_PduR2Dcm_Can_Network_ETAS_Channel_CAN (PduRDestPdu): PduRDestPduRef=UdsRxFnc_PduR2Dcm_Can_Network_ETAS_Channel_CAN
            UdsRxFnc_CanTp2PduR_Can_Network_ETAS_Channel_CAN (PduRSrcPdu): PduRSrcPduRef=UdsRxFnc_CanTp2PduR_Can_Network_ETAS_Channel_CAN
          UdsRxPhy_CanTp2Dcm_Can_Network_ETAS_Channel_CAN
            UdsRxPhy_PduR2Dcm_Can_Network_ETAS_Channel_CAN (PduRDestPdu): PduRDestPduRef=UdsRxPhy_PduR2Dcm_Can_Network_ETAS_Channel_CAN
            UdsRxPhy_CanTp2PduR_Can_Network_ETAS_Channel_CAN (PduRSrcPdu): PduRSrcPduRef=UdsRxPhy_CanTp2PduR_Can_Network_ETAS_Channel_CAN
          UdsTxPhy_Dcm2CanTp_Can_Network_ETAS_Channel_CAN
            UdsTxPhy_Dcm2PduR_Can_Network_ETAS_Channel_CAN (PduRSrcPdu): PduRSrcPduRef=UdsTxPhy_Dcm2PduR_Can_Network_ETAS_Channel_CAN
            UdsTxPhy_PduR2CanTp_Can_Network_ETAS_Channel_CAN (PduRDestPdu): PduRDestPduRef=UdsTxPhy_PduR2CanTp_Can_Network_ETAS_Channel_CAN
          ComRx_0x456_CanIf2Com_Can_Network_ETAS_Channel_CAN
            ComRx_0x456_PduR2Com_Can_Network_ETAS_Channel_CAN (PduRDestPdu): PduRDestPduRef=ComRx_0x456_PduR2Com_Can_Network_ETAS_Channel_CAN
            ComRx_0x456_CanIf2PduR_Can_Network_ETAS_Channel_CAN (PduRSrcPdu): PduRSrcPduRef=ComRx_0x456_CanIf2PduR_Can_Network_ETAS_Channel_CAN
          ComTx_0x123_Com2CanIf_Can_Network_ETAS_Channel_CAN
            ComTx_0x123_Com2PduR_Can_Network_ETAS_Channel_CAN (PduRSrcPdu): PduRSrcPduRef=ComTx_0x123_Com2PduR_Can_Network_ETAS_Channel_CAN
            ComTx_0x123_PduR2CanIf_Can_Network_ETAS_Channel_CAN (PduRDestPdu): PduRDestPduRef=ComTx_0x123_PduR2CanIf_Can_Network_ETAS_Channel_CAN
          ComTx_0x98_Com2CanIf_Can_Network_ETAS_Channel_CAN
            ComTx_0x98_Com2PduR_Can_Network_ETAS_Channel_CAN (PduRSrcPdu): PduRSrcPduRef=ComTx_0x98_Com2PduR_Can_Network_ETAS_Channel_CAN
            ComTx_0x98_PduR2CanIf_Can_Network_ETAS_Channel_CAN (PduRDestPdu): PduRDestPduRef=ComTx_0x98_PduR2CanIf_Can_Network_ETAS_Channel_CAN
    5 x PduRBswModules, all with PduRRetransmission=false, PduRUseTag=false, PduRCancelReceive=false, PduRChangeParameterApi=false:
      CanIf: PduRUpperModule=false, PduRTriggertransmit=false, PduRCommunicationInterface=true, PduRTransportProtocol=false, PduRCancelTransmit=false, PduRLowerModule=true, PduRTxConfirmation=true, PduRBswModuleRef=CanIf
      Com: PduRUpperModule=true, PduRTriggertransmit=true, PduRCommunicationInterface=true, PduRTransportProtocol=true, PduRCancelTransmit=false, PduRLowerModule=false, PduRTxConfirmation=false, PduRBswModuleRef=Com
      CanNm: PduRUpperModule=false, PduRTriggertransmit=true, PduRCommunicationInterface=true, PduRTransportProtocol=false, PduRCancelTransmit=false, PduRLowerModule=true, PduRTxConfirmation=true, PduRBswModuleRef=CanNm
      CanTp: PduRUpperModule=false, PduRTriggertransmit=false, PduRTransportProtocol=true, PduRCommunicationInterface=false, PduRCancelTransmit=true, PduRLowerModule=true, PduRTxConfirmation=true, PduRBswModuleRef=CanTp
        PduRInvalidHandlers: PduRIHCancelReceive=false, PduRIHCancelTransmit=false
      Dcm: PduRUpperModule=true, PduRTriggertransmit=false, PduRCommunicationInterface=false, PduRTransportProtocol=true, PduRCancelTransmit=true, PduRLowerModule=false, PduRTxConfirmation=true, PduRBswModuleRef=Dcm
    PduRGeneral:
      PduRTPGatewayOperation = false
      PduRVersionInfoApi = false
      PduRMulticastFromTpSupport = false
      PduRZeroCostOperation = false
      PduRMulticastToTpSupport = false
      PduRQueueingSupport = false
      PduRMulticastToIfSupport = false
      PduRIFGatewayOperation = false
      PduRGwTpWithLimitedBuffer = false
      PduRDevErrorDetect = true

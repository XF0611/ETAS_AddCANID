AUTOSAR XML (schema 00047)
package /AUTOSAR_Dcm/ApplicationDataTypes
  app type Dcm_DataType_0x100_New_Data_Object: category=VALUE, compu {identical}
  application array data type Dcm_ArrDataType_0x100_New_Data_Object: category=ARRAY
    element ApplicationArrayElement_New_Data_Object: category=VALUE, type=Dcm_DataType_0x100_New_Data_Object, array-size-semantics=FIXED-SIZE, max-number-of-elements=16
  8 x app type, all with category=VALUE, compu {identical}:
    Dcm_DataType_0x10B_Year: range raw 0..255
    Dcm_DataType_0x10B_Month: range raw 0..255
    Dcm_DataType_0x10B_Day: range raw 0..255
    Dcm_DataType_0x10B_Hour: range raw 0..255
    Dcm_DataType_0x10B_Minute: range raw 0..255
    Dcm_DataType_0x10B_Second: range raw 0..255
    Dcm_DataType_0x112_New_Data_Object: range raw 0..255
    Dcm_DataType_0xB950_New_Data_Object
  application array data type Dcm_ArrDataType_0xB950_New_Data_Object: category=ARRAY
    element ApplicationArrayElement_New_Data_Object: category=VALUE, type=Dcm_DataType_0xB950_New_Data_Object, array-size-semantics=FIXED-SIZE, max-number-of-elements=8
  app type Dcm_DataType_0xD001_New_Data_Object: category=VALUE, compu {identical}, range raw 0..255
  app type Dcm_DataType_0xD901_New_Data_Object: category=VALUE, compu {identical}, range raw 0..255
  app type Dcm_DataType_0xE101_New_Data_Object: category=VALUE, compu {identical}
  application array data type Dcm_ArrDataType_0xE101_New_Data_Object: category=ARRAY
    element ApplicationArrayElement_New_Data_Object: category=VALUE, type=Dcm_DataType_0xE101_New_Data_Object, array-size-semantics=FIXED-SIZE, max-number-of-elements=3
  app type Dcm_DataType_0xE900_New_Data_Object: category=VALUE, compu {identical}, range raw 0..255
  app type Dcm_DataType_0xF100_New_Data_Object: category=VALUE, compu {identical}
  application array data type Dcm_ArrDataType_0xF100_New_Data_Object: category=ARRAY
    element ApplicationArrayElement_New_Data_Object: category=VALUE, type=Dcm_DataType_0xF100_New_Data_Object, array-size-semantics=FIXED-SIZE, max-number-of-elements=5
  app type Dcm_DataType_0xF100_New_Data_Object_1: category=VALUE, compu {identical}
  application array data type Dcm_ArrDataType_0xF100_New_Data_Object_1: category=ARRAY
    element ApplicationArrayElement_New_Data_Object_1: category=VALUE, type=Dcm_DataType_0xF100_New_Data_Object_1, array-size-semantics=FIXED-SIZE, max-number-of-elements=6
  app type Dcm_DataType_0xF110_New_Data_Object: category=VALUE, compu {identical}
  application array data type Dcm_ArrDataType_0xF110_New_Data_Object: category=ARRAY
    element ApplicationArrayElement_New_Data_Object: category=VALUE, type=Dcm_DataType_0xF110_New_Data_Object, array-size-semantics=FIXED-SIZE, max-number-of-elements=16
  app type Dcm_DataType_0xF111_New_Data_Object: category=VALUE, compu {identical}
  application array data type Dcm_ArrDataType_0xF111_New_Data_Object: category=ARRAY
    element ApplicationArrayElement_New_Data_Object: category=VALUE, type=Dcm_DataType_0xF111_New_Data_Object, array-size-semantics=FIXED-SIZE, max-number-of-elements=16
  app type Dcm_DataType_0xF112_New_Data_Object: category=VALUE, compu {identical}
  application array data type Dcm_ArrDataType_0xF112_New_Data_Object: category=ARRAY
    element ApplicationArrayElement_New_Data_Object: category=VALUE, type=Dcm_DataType_0xF112_New_Data_Object, array-size-semantics=FIXED-SIZE, max-number-of-elements=16
  app type Dcm_DataType_0xF113_New_Data_Object: category=VALUE, compu {identical}
  application array data type Dcm_ArrDataType_0xF113_New_Data_Object: category=ARRAY
    element ApplicationArrayElement_New_Data_Object: category=VALUE, type=Dcm_DataType_0xF113_New_Data_Object, array-size-semantics=FIXED-SIZE, max-number-of-elements=16
  app type Dcm_DataType_0xF114_New_Data_Object: category=VALUE, compu {identical}
  application array data type Dcm_ArrDataType_0xF114_New_Data_Object: category=ARRAY
    element ApplicationArrayElement_New_Data_Object: category=VALUE, type=Dcm_DataType_0xF114_New_Data_Object, array-size-semantics=FIXED-SIZE, max-number-of-elements=16
  app type Dcm_DataType_0xF115_New_Data_Object: category=VALUE, compu {identical}
  application array data type Dcm_ArrDataType_0xF115_New_Data_Object: category=ARRAY
    element ApplicationArrayElement_New_Data_Object: category=VALUE, type=Dcm_DataType_0xF115_New_Data_Object, array-size-semantics=FIXED-SIZE, max-number-of-elements=16
  app type Dcm_DataType_0xF116_New_Data_Object: category=VALUE, compu {identical}
  application array data type Dcm_ArrDataType_0xF116_New_Data_Object: category=ARRAY
    element ApplicationArrayElement_New_Data_Object: category=VALUE, type=Dcm_DataType_0xF116_New_Data_Object, array-size-semantics=FIXED-SIZE, max-number-of-elements=16
  app type Dcm_DataType_0xF117_New_Data_Object: category=VALUE, compu {identical}
  application array data type Dcm_ArrDataType_0xF117_New_Data_Object: category=ARRAY
    element ApplicationArrayElement_New_Data_Object: category=VALUE, type=Dcm_DataType_0xF117_New_Data_Object, array-size-semantics=FIXED-SIZE, max-number-of-elements=16
  app type Dcm_DataType_0xF118_New_Data_Object: category=VALUE, compu {identical}
  application array data type Dcm_ArrDataType_0xF118_New_Data_Object: category=ARRAY
    element ApplicationArrayElement_New_Data_Object: category=VALUE, type=Dcm_DataType_0xF118_New_Data_Object, array-size-semantics=FIXED-SIZE, max-number-of-elements=16
  app type Dcm_DataType_0xF119_New_Data_Object: category=VALUE, compu {identical}
  application array data type Dcm_ArrDataType_0xF119_New_Data_Object: category=ARRAY
    element ApplicationArrayElement_New_Data_Object: category=VALUE, type=Dcm_DataType_0xF119_New_Data_Object, array-size-semantics=FIXED-SIZE, max-number-of-elements=16
  app type Dcm_DataType_0xF11A_New_Data_Object: category=VALUE, compu {identical}
  application array data type Dcm_ArrDataType_0xF11A_New_Data_Object: category=ARRAY
    element ApplicationArrayElement_New_Data_Object: category=VALUE, type=Dcm_DataType_0xF11A_New_Data_Object, array-size-semantics=FIXED-SIZE, max-number-of-elements=16
  app type Dcm_DataType_0xF11B_New_Data_Object: category=VALUE, compu {identical}
  application array data type Dcm_ArrDataType_0xF11B_New_Data_Object: category=ARRAY
    element ApplicationArrayElement_New_Data_Object: category=VALUE, type=Dcm_DataType_0xF11B_New_Data_Object, array-size-semantics=FIXED-SIZE, max-number-of-elements=16
  app type Dcm_DataType_0xF11C_New_Data_Object: category=VALUE, compu {identical}
  application array data type Dcm_ArrDataType_0xF11C_New_Data_Object: category=ARRAY
    element ApplicationArrayElement_New_Data_Object: category=VALUE, type=Dcm_DataType_0xF11C_New_Data_Object, array-size-semantics=FIXED-SIZE, max-number-of-elements=16
  app type Dcm_DataType_0xF11D_New_Data_Object: category=VALUE, compu {identical}
  application array data type Dcm_ArrDataType_0xF11D_New_Data_Object: category=ARRAY
    element ApplicationArrayElement_New_Data_Object: category=VALUE, type=Dcm_DataType_0xF11D_New_Data_Object, array-size-semantics=FIXED-SIZE, max-number-of-elements=16
  app type Dcm_DataType_0xF11E_New_Data_Object: category=VALUE, compu {identical}
  application array data type Dcm_ArrDataType_0xF11E_New_Data_Object: category=ARRAY
    element ApplicationArrayElement_New_Data_Object: category=VALUE, type=Dcm_DataType_0xF11E_New_Data_Object, array-size-semantics=FIXED-SIZE, max-number-of-elements=16
  app type Dcm_DataType_0xF11F_New_Data_Object: category=VALUE, compu {identical}
  application array data type Dcm_ArrDataType_0xF11F_New_Data_Object: category=ARRAY
    element ApplicationArrayElement_New_Data_Object: category=VALUE, type=Dcm_DataType_0xF11F_New_Data_Object, array-size-semantics=FIXED-SIZE, max-number-of-elements=16
  app type Dcm_DataType_0xF120_New_Data_Object: category=VALUE, compu {identical}
  application array data type Dcm_ArrDataType_0xF120_New_Data_Object: category=ARRAY
    element ApplicationArrayElement_New_Data_Object: category=VALUE, type=Dcm_DataType_0xF120_New_Data_Object, array-size-semantics=FIXED-SIZE, max-number-of-elements=16
  app type Dcm_DataType_0xF121_New_Data_Object: category=VALUE, compu {identical}
  application array data type Dcm_ArrDataType_0xF121_New_Data_Object: category=ARRAY
    element ApplicationArrayElement_New_Data_Object: category=VALUE, type=Dcm_DataType_0xF121_New_Data_Object, array-size-semantics=FIXED-SIZE, max-number-of-elements=16
  app type Dcm_DataType_0xF183_New_Data_Object: category=VALUE, compu {identical}
  application array data type Dcm_ArrDataType_0xF183_New_Data_Object: category=ARRAY
    element ApplicationArrayElement_New_Data_Object: category=VALUE, type=Dcm_DataType_0xF183_New_Data_Object, array-size-semantics=FIXED-SIZE, max-number-of-elements=5
  app type Dcm_DataType_0xF183_New_Data_Object_2: category=VALUE, compu {identical}
  application array data type Dcm_ArrDataType_0xF183_New_Data_Object_2: category=ARRAY
    element ApplicationArrayElement_New_Data_Object_2: category=VALUE, type=Dcm_DataType_0xF183_New_Data_Object_2, array-size-semantics=FIXED-SIZE, max-number-of-elements=5
  app type Dcm_DataType_0xF187_New_Data_Object: category=VALUE, compu {identical}
  application array data type Dcm_ArrDataType_0xF187_New_Data_Object: category=ARRAY
    element ApplicationArrayElement_New_Data_Object: category=VALUE, type=Dcm_DataType_0xF187_New_Data_Object, array-size-semantics=FIXED-SIZE, max-number-of-elements=5
  app type Dcm_DataType_0xF18A_New_Data_Object: category=VALUE, compu {identical}
  application array data type Dcm_ArrDataType_0xF18A_New_Data_Object: category=ARRAY
    element ApplicationArrayElement_New_Data_Object: category=VALUE, type=Dcm_DataType_0xF18A_New_Data_Object, array-size-semantics=FIXED-SIZE, max-number-of-elements=5
  app type Dcm_DataType_0xF18B_New_Data_Object: category=VALUE, compu {identical}
  application array data type Dcm_ArrDataType_0xF18B_New_Data_Object: category=ARRAY
    element ApplicationArrayElement_New_Data_Object: category=VALUE, type=Dcm_DataType_0xF18B_New_Data_Object, array-size-semantics=FIXED-SIZE, max-number-of-elements=3
  app type Dcm_DataType_0xF18C_New_Data_Object: category=VALUE, compu {identical}
  application array data type Dcm_ArrDataType_0xF18C_New_Data_Object: category=ARRAY
    element ApplicationArrayElement_New_Data_Object: category=VALUE, type=Dcm_DataType_0xF18C_New_Data_Object, array-size-semantics=FIXED-SIZE, max-number-of-elements=16
  app type Dcm_DataType_0xF190_New_Data_Object: category=VALUE, compu {identical}
  application array data type Dcm_ArrDataType_0xF190_New_Data_Object: category=ARRAY
    element ApplicationArrayElement_New_Data_Object: category=VALUE, type=Dcm_DataType_0xF190_New_Data_Object, array-size-semantics=FIXED-SIZE, max-number-of-elements=17
  app type Dcm_DataType_0xF192_New_Data_Object: category=VALUE, compu {identical}
  application array data type Dcm_ArrDataType_0xF192_New_Data_Object: category=ARRAY
    element ApplicationArrayElement_New_Data_Object: category=VALUE, type=Dcm_DataType_0xF192_New_Data_Object, array-size-semantics=FIXED-SIZE, max-number-of-elements=5
  app type Dcm_DataType_0xF192_New_Data_Object_3: category=VALUE, compu {identical}
  application array data type Dcm_ArrDataType_0xF192_New_Data_Object_3: category=ARRAY
    element ApplicationArrayElement_New_Data_Object_3: category=VALUE, type=Dcm_DataType_0xF192_New_Data_Object_3, array-size-semantics=FIXED-SIZE, max-number-of-elements=5
  app type Dcm_DataType_0xF194_New_Data_Object: category=VALUE, compu {identical}
  application array data type Dcm_ArrDataType_0xF194_New_Data_Object: category=ARRAY
    element ApplicationArrayElement_New_Data_Object: category=VALUE, type=Dcm_DataType_0xF194_New_Data_Object, array-size-semantics=FIXED-SIZE, max-number-of-elements=5
  app type Dcm_DataType_0xF194_New_Data_Object_4: category=VALUE, compu {identical}
  application array data type Dcm_ArrDataType_0xF194_New_Data_Object_4: category=ARRAY
    element ApplicationArrayElement_New_Data_Object_4: category=VALUE, type=Dcm_DataType_0xF194_New_Data_Object_4, array-size-semantics=FIXED-SIZE, max-number-of-elements=5
  app type Dcm_DataType_0xF198_New_Data_Object: category=VALUE, compu {identical}
  application array data type Dcm_ArrDataType_0xF198_New_Data_Object: category=ARRAY
    element ApplicationArrayElement_New_Data_Object: category=VALUE, type=Dcm_DataType_0xF198_New_Data_Object, array-size-semantics=FIXED-SIZE, max-number-of-elements=5
  app type Dcm_DataType_0xF198_New_Data_Object_5: category=VALUE, compu {identical}
  application array data type Dcm_ArrDataType_0xF198_New_Data_Object_5: category=ARRAY
    element ApplicationArrayElement_New_Data_Object_5: category=VALUE, type=Dcm_DataType_0xF198_New_Data_Object_5, array-size-semantics=FIXED-SIZE, max-number-of-elements=6
  app type Dcm_DataType_0xF1A0_New_Data_Object: category=VALUE, compu {identical}
  application array data type Dcm_ArrDataType_0xF1A0_New_Data_Object: category=ARRAY
    element ApplicationArrayElement_New_Data_Object: category=VALUE, type=Dcm_DataType_0xF1A0_New_Data_Object, array-size-semantics=FIXED-SIZE, max-number-of-elements=5
  app type Dcm_DataType_0xF1A1_New_Data_Object: category=VALUE, compu {identical}
  application array data type Dcm_ArrDataType_0xF1A1_New_Data_Object: category=ARRAY
    element ApplicationArrayElement_New_Data_Object: category=VALUE, type=Dcm_DataType_0xF1A1_New_Data_Object, array-size-semantics=FIXED-SIZE, max-number-of-elements=5
  app type Dcm_DataType_0xF1A2_New_Data_Object: category=VALUE, compu {identical}
  application array data type Dcm_ArrDataType_0xF1A2_New_Data_Object: category=ARRAY
    element ApplicationArrayElement_New_Data_Object: category=VALUE, type=Dcm_DataType_0xF1A2_New_Data_Object, array-size-semantics=FIXED-SIZE, max-number-of-elements=8
  app type Dcm_DataType_0xF1A5_New_Data_Object: category=VALUE, compu {identical}
  application array data type Dcm_ArrDataType_0xF1A5_New_Data_Object: category=ARRAY
    element ApplicationArrayElement_New_Data_Object: category=VALUE, type=Dcm_DataType_0xF1A5_New_Data_Object, array-size-semantics=FIXED-SIZE, max-number-of-elements=3
  app type Dcm_DataType_0xF1A8_New_Data_Object: category=VALUE, compu {identical}
  application array data type Dcm_ArrDataType_0xF1A8_New_Data_Object: category=ARRAY
    element ApplicationArrayElement_New_Data_Object: category=VALUE, type=Dcm_DataType_0xF1A8_New_Data_Object, array-size-semantics=FIXED-SIZE, max-number-of-elements=20
  app type Dcm_DataType_0xF1A9_New_Data_Object: category=VALUE, compu {identical}
  application array data type Dcm_ArrDataType_0xF1A9_New_Data_Object: category=ARRAY
    element ApplicationArrayElement_New_Data_Object: category=VALUE, type=Dcm_DataType_0xF1A9_New_Data_Object, array-size-semantics=FIXED-SIZE, max-number-of-elements=5
  app type Dcm_DataType_0xF1AA_New_Data_Object: category=VALUE, compu {identical}
  application array data type Dcm_ArrDataType_0xF1AA_New_Data_Object: category=ARRAY
    element ApplicationArrayElement_New_Data_Object: category=VALUE, type=Dcm_DataType_0xF1AA_New_Data_Object, array-size-semantics=FIXED-SIZE, max-number-of-elements=5
  app type Dcm_DataType_StartOut_515_Out_New_Data_Object: category=VALUE, compu {identical}, range raw 0..255
  app type Dcm_DataType_RequestOut_44031_Out_New_Data_Object: category=VALUE, compu {identical}, range raw 0..255

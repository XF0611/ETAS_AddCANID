AUTOSAR XML (schema 4-3-0)
package /CanSM_EOC
  bsw module timing CanSM: behavior=BswInternalBehavior
    timing-requirements:
      execution order constraint EOC_CanSM_MainFunction: execution-order-constraint-type=ORDINARY-EOC, is-event=true, permit-multiple-references-to-ee=false
        ordered-elements:
          eoc event ref EventRef_CanSM_MainFunction: bsw-module-instance=CanSM, event=EV_SE_MainFunction, successor=EventRef_Com_MainFunctionTx
          eoc event ref EventRef_Com_MainFunctionTx: bsw-module-instance=Com, event=EV_SE_MainFunctionTx
      execution order constraint EOC_CanSM_Init: is-event=false, permit-multiple-references-to-ee=false
        ordered-elements:
          eoc executable entity ref EOCExecutableEntityRef_CanTSyn_Init: bsw-module-instance=CanSM, executable=CE_Init

AUTOSAR XML (schema 4-2-2)
package /AUTOSAR_Com/BswModuleEntrys
  12 x bsw module entry, all with is-reentrant=false, sw-service-impl-policy=STANDARD:
    Com_Init: is-synchronous=true, call-type=REGULAR, execution-context=UNSPECIFIED
    Com_MainFunctionRx: is-synchronous=true, call-type=SCHEDULED, execution-context=TASK
    Com_MainFunctionRouteSignals: is-synchronous=true, call-type=SCHEDULED, execution-context=TASK
    Com_MainFunctionTx: is-synchronous=true, call-type=SCHEDULED, execution-context=TASK
    Com_TxConfirmation: is-synchronous=false, call-type=CALLBACK, execution-context=UNSPECIFIED
    Com_RxIndication: is-synchronous=false, call-type=CALLBACK, execution-context=UNSPECIFIED
    Com_TriggerTransmit: is-synchronous=true, call-type=CALLBACK, execution-context=UNSPECIFIED
    Com_CopyTxData: is-synchronous=false, call-type=CALLBACK, execution-context=UNSPECIFIED
    Com_TpTxConfirmation: is-synchronous=false, call-type=CALLBACK, execution-context=UNSPECIFIED
    Com_StartOfReception: is-synchronous=false, call-type=CALLBACK, execution-context=UNSPECIFIED
    Com_CopyRxData: is-synchronous=false, call-type=CALLBACK, execution-context=UNSPECIFIED
    Com_TpRxIndication: is-synchronous=false, call-type=CALLBACK, execution-context=UNSPECIFIED

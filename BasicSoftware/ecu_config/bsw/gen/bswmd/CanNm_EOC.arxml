AUTOSAR XML (schema 4-3-0)
package /CanNm_EOC
  bsw module timing CanNm: behavior=BswInternalBehavior
    timing-requirements:
      execution order constraint EOC_CanNm_Init: execution-order-constraint-type=ORDINARY-EOC, is-event=false, permit-multiple-references-to-ee=false
        ordered-elements:
          eoc executable entity ref EOCExecutableEntityRef_CanNm_Init: bsw-module-instance=CanNm, executable=CE_Init
      execution order constraint EOC_CanNm_MainFunction: is-event=true, permit-multiple-references-to-ee=false
        ordered-elements:
          eoc event ref EventRef_CanNm_MainFunction: bsw-module-instance=CanNm, event=EV_SE_MainFunction, successor=EventRef_Com_MainFunctionTx
          eoc event ref EventRef_Com_MainFunctionTx: bsw-module-instance=Com, event=EV_SE_MainFunctionTx

AUTOSAR XML (schema 4-1-1)
package /AUTOSAR_Mfl/BswModuleDescriptions
  bsw module description Mfl: category=BSW_MODULE, module-id=210
    bsw internal behavior BswInternalBehavior
      bsw scheduler name prefix Mfl
package /AUTOSAR_Mfl/ImplementationDataTypes
  16 x impl type, all with category=STRUCTURE, type-emitter=HEADER_FILE:
    Mfl_DeadTimeParam_Type  # Structure definition for Dead Time routine | This structure contains parameters for the Dead Time routine in Mfl Component.
      4 x element:
        dsintStatic: implementation-data-type=float32
        lszStatic: category=DATA_REFERENCE, sw-pointer-target-props={target-category=VALUE, base-type=float32}
        dtbufBegStatic: category=DATA_REFERENCE, sw-pointer-target-props={target-category=VALUE, base-type=float32}
        dtbufEndStatic: category=DATA_REFERENCE, sw-pointer-target-props={target-category=VALUE, base-type=float32}
    Mfl_DebounceParam_Type  # Structure definition for Debouncing parameters | This structure contains the parameters for Debounce routine that debounces the input signal and returns the state of the signal.
      element TimeHighLow: implementation-data-type=float32
      element TimeLowHigh: implementation-data-type=float32
    Mfl_DebounceState_Type  # Structure definition for Debouncing state variables. | This structure contains state parameters for Debounce state variables in Mfl Component.
      element XOld: implementation-data-type=boolean
      element Timer: implementation-data-type=float32
    Mfl_Limits_Type  # Controller limit value structure. | This structure contains the minimum value and maximum value to limit the controller routine output..
      element Min_C: implementation-data-type=float32
      element Max_C: implementation-data-type=float32
    Mfl_ParamPD_Type  # System and Time equivalent parameter Structure for PD controller routine | This structure contains System and Time equivalent parameter structure for PD controller routine in Mfl Component.
      element K_C: implementation-data-type=float32
      element Tv_C: implementation-data-type=float32
    Mfl_ParamPI_Type  # System and Time equivalent parameter Structure for PI controller | This structure contains parameters for PI additive (Type 1 and Type 2) controller routine in Mfl Component.
      element K_C: implementation-data-type=float32
      element Tnrec_C: implementation-data-type=float32
    Mfl_ParamPID_Type  # System and Time equivalent parameter Structure for PID Controller. | This structure contains parameters for PID additive (Type 1 and Type 2) controller routine in Mfl Component.
      element K_C: implementation-data-type=float32
      element Tv_C: implementation-data-type=float32
      element Tnrec_C: implementation-data-type=float32
    Mfl_ParamRamp_Type  # Structure definition for Ramp routine | This structure contains slope parameters for Ramp routine in Mfl Component.
      element SlopePos: implementation-data-type=float32
      element SlopeNeg: implementation-data-type=float32
    Mfl_StateDT1Typ1_Type  # System State Structure for DT1-Type1 controller routine | This structure contains state parameters for DT1-Type1 controller routine in Mfl Component.
      element X1: implementation-data-type=float32
      element X2: implementation-data-type=float32
      element Y1: implementation-data-type=float32
    Mfl_StateDT1Typ2_Type  # System State Structure for DT1-Type2 controller routine | This structure contains state parameters for DT1-Type2 controller in Mfl Component.
      element X1: implementation-data-type=float32
      element Y1: implementation-data-type=float32
    Mfl_StateI_Type  # System State Structure for I controller routine | This structure contains state parameters for I controller in Mfl Component.
      element X1: implementation-data-type=float32
      element Y1: implementation-data-type=float32
    Mfl_StatePD_Type  # System State Structure for PD controller routine | This structure contains state parameters for PD controller in Mfl Component.
      element X1: implementation-data-type=float32
      element Y1: implementation-data-type=float32
    Mfl_StatePI_Type  # System State Structure for PI Controller | This structure contains state parameters for PI controller in Mfl Component.
      element X1: implementation-data-type=float32
      element Y1: implementation-data-type=float32
    Mfl_StatePID_Type  # System State Structure for PID Controller. | This structure contains state parameters for PID controller in Mfl Component.
      element X1: implementation-data-type=float32
      element X2: implementation-data-type=float32
      element Y1: implementation-data-type=float32
    Mfl_StatePT1_Type  # System State Structure for PT1 controller. | This structure contains state parameters for PT1 controller in Mfl Component.
      element X1: implementation-data-type=float32
      element Y1: implementation-data-type=float32
    Mfl_StateRamp_Type  # Structure definition for Ramp routine. | This structure contains state parameters for Ramp routine in Mfl Component.
      element State: implementation-data-type=float32
      element Dir: implementation-data-type=sint8
      element Switch: implementation-data-type=sint8
package /AUTOSAR_Mfl/BswImplementations
  bsw implementation Mfl: programming-language=C, sw-version=7.1.0, ar-release-version=4.2.2, behavior=BswInternalBehavior
    code-descriptors:
      code CodeDescriptor: artifact-descriptors=autosar-engineering-object={short-label=ArEngObj, category=SWSRC}
    resource consumption Mfl_ResourceConsumption
      memory section MFL_CODE_SLOW: prefix=MFL, sw-addrmethod=CODE_SLOW, symbol=CODE_SLOW
      memory section MFL_CODE_FAST: prefix=MFL, sw-addrmethod=CODE_FAST, symbol=CODE_FAST
      memory section MFL_CODE: prefix=MFL, sw-addrmethod=CODE, symbol=CODE
      section name prefix MFL

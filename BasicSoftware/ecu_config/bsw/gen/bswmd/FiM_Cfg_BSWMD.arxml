AUTOSAR XML (schema 4-1-1)
package /AUTOSAR_FiM/BswImplementations
  bsw implementation BSWIMPL_FiM: programming-language=C, sw-version=9.0.0, swc-bsw-mapping=SwcBswMappings, vendor-id=6, ar-release-version=4.2.2, behavior=IB_FiM
    code-descriptors:
      code CodeDescriptor: artifact-descriptors=autosar-engineering-object={short-label=ArEngObject, category=SWSRC}
package /AUTOSAR_FiM/BswModuleDescriptions
  bsw module description FiM: category=BSW_MODULE, module-id=11
    bsw internal behavior IB_FiM
      bsw schedulable entity BSWSE_FiMMainFunction: implemented-entry=FiM_MainFunction
      bsw timing event RTE_TEV_FiM_MainFunction: starts-on-event=BSWSE_FiMMainFunction, period=0.01
package /AUTOSAR_FiM/BswModuleEntrys
  bsw module entry FiM_MainFunction: is-reentrant=false, is-synchronous=true, call-type=SCHEDULED, execution-context=TASK, sw-service-impl-policy=STANDARD

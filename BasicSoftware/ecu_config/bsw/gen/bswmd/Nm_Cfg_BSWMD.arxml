AUTOSAR XML (schema 4-2-2)
package /AUTOSAR_Nm/BswImplementations
  bsw implementation Nm: programming-language=C, sw-version=8.0.0, ar-release-version=4.2.2, behavior=BswInternalBehavior
    code-descriptors:
      code CodeDescriptor: artifact-descriptors=autosar-engineering-object={short-label=ArEngObj, category=SWSRC}
    resource consumption Nm_ResourceConsumption
      6 x memory section:
        Nm_CODE: prefix=Nm, sw-addrmethod=CODE, symbol=CODE
        NM_CODE: prefix=NM, sw-addrmethod=CODE, symbol=CODE
        NM_VAR_CLEARED_32: alignment=32, prefix=NM, sw-addrmethod=VAR_CLEARED, symbol=VAR_CLEARED_32
        NM_VAR_CLEARED_UNSPECIFIED: alignment=UNSPECIFIED, prefix=NM, sw-addrmethod=VAR_CLEARED, symbol=VAR_CLEARED_UNSPECIFIED
        NM_CONST_8: alignment=8, prefix=NM, sw-addrmethod=CONST, symbol=CONST_8
        NM_CONST_UNSPECIFIED: alignment=UNSPECIFIED, prefix=NM, sw-addrmethod=CONST, symbol=CONST_UNSPECIFIED
      section name prefix Nm
      section name prefix NM
package /AUTOSAR_Nm/BswModuleDescriptions
  bsw module description Nm: category=BSW_MODULE, module-id=29  # NetworkManagementInterface
    bsw internal behavior BswInternalBehavior
      bsw called entity CE_Init: implemented-entry=Nm_Init
package /AUTOSAR_Nm/Units
  unit NoUnit: display-name=noUnit, factor-si-to-unit=1.0, offset-si-to-unit=0.0, physical-dimension=NoUnit  # No Unit
package /AUTOSAR_Nm/PhysicalDimensions
  physical dimension NoUnit: length-exp=0

AUTOSAR XML (schema 4-1-1)
package /AUTOSAR_Bfx/BswModuleDescriptions
  bsw module description Bfx: category=BSW_MODULE, module-id=205
    bsw internal behavior BswInternalBehavior
      bsw scheduler name prefix Bfx
package /AUTOSAR_Bfx/BswImplementations
  bsw implementation Bfx: programming-language=C, sw-version=7.1.0, ar-release-version=4.2.2, behavior=BswInternalBehavior
    code-descriptors:
      code CodeDescriptor: artifact-descriptors=autosar-engineering-object={short-label=ArEngObj, category=SWSRC}
    resource consumption Bfx_ResourceConsumption
      memory section BFX_CODE_SLOW: prefix=BFX, sw-addrmethod=CODE_SLOW, symbol=CODE_SLOW
      memory section BFX_CODE_FAST: prefix=BFX, sw-addrmethod=CODE_FAST, symbol=CODE_FAST
      memory section BFX_CODE: prefix=BFX, sw-addrmethod=CODE, symbol=CODE
      section name prefix BFX

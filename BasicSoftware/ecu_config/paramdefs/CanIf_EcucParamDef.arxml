AUTOSAR XML (schema 4-2-2)
package /AUTOSAR_CanIf/EcucModuleDefs
  module definition CanIf [0..1]: category=VENDOR_SPECIFIC_MODULE_DEFINITION, post-build-variant-support=true, refined-module-def=CanIf, variants link-time/post-build/pre-compile  # CanIf Module | This container includes all necessary configuration sub-containers according the CAN Interface configuration structure.
    container CanIfCtrlDrvCfg [1..*]: multiplicity set at pre-compile  # Configuration parameters for all the underlying CAN Driver modules are aggregated under this container. For each CAN Driver module a seperate instance of this container has to be provided.
      string CanIfRbCtrlDrvPrefix [0..1]: origin=RB:5.0.0:2018-06-30, set at pre-compile  # This parameter is added to support third party CAN Drivers. It contains Vendor Id and Vendor API infix. The symbolic names of CanObjectIds are appended with Vendor Id and Vendor API infix. This parameter should be configured only when CAN Driver is required to append Vendor Id and Vendor API infix in the symoblic name of CanObjectId. If this parameter is configured by mistake and CAN Driver is not generating the symoblic name of CanObjectId without Vendor Id and Vendor API infix, a compiler error is thrown. If this parameter is configured, then HardwareObjectId symbolic names are generated as follows, <CanIfRbCtrlDrvPrefix>_<CanHardwareObject shortName> If this parameter is not configured, then HardwareObjectId symbolic names are generated as follows, <CanHardwareObject shortName>
      reference CanIfCtrlDrvInitHohConfigRef: set at link in variant link-time+post-build / pre-compile in variant pre-compile, destination=CanIfInitHohCfg  # Reference to the Init Hoh Configuration
      reference CanIfCtrlDrvNameRef: set at pre-compile, destination=CanGeneral  # CAN Interface Driver Reference. This reference can be used to get any information (Ex. Driver Name, Vendor ID) from the CAN driver. The CAN Driver name can be derived from the ShortName of the CAN driver module.
      container CanIfCtrlCfg [1..*]: multiplicity set at pre-compile, post-build-variant-multiplicity=true  # This container contains the configuration (parameters) of an adressed CAN controller by an underlying CAN Driver module. This container is configurable per CAN controller.
        integer CanIfCtrlId: 0..255, scope=ECU, set at pre-compile  # This parameter abstracts from the CAN Driver specific parameter Controller. Each controller of all connected CAN Driver modules shall be assigned to one specific ControllerId of the CanIf. Range: 0..number of configured controllers of all CAN Driver modules
        boolean CanIfCtrlWakeupSupport: scope=ECU, set at link in variant link-time+post-build / pre-compile in variant pre-compile, default-value=false  # This parameter defines if a respective controller of the referenced CAN Driver modules is queriable for wake up events. True: Enabled False: Disabled
        symbolic name reference CanIfCtrlCanCtrlRef: scope=ECU, set at link in variant link-time+post-build / pre-compile in variant pre-compile, destination=CanController  # This parameter references to the logical handle of the underlying CAN controller from the CAN Driver module to be served by the CAN Interface module. The following parameters of CanController config container shall be referenced by this link: CanControllerId, CanWakeupSourceRef Range: 0..max. number of underlying supported CAN controllers
        symbolic name reference CanIfCtrlTrcvRef [0..1]: origin=RB:21.0.0:2016-07-31, set at pre-compile, destination=CanIfTrcvCfg  # This parameter contains a reference to the CanIf Transceiver to which the Controller is connected to. This parametre is mandatory if EcuM Wake-up is to be supported.The multiplicity is 0..1 This is required to have a mapping of Controller to Transceiver.Implementation Type: reference to CanIfTrcvCfg.
    container CanIfDispatchCfg  # Callback functions provided by upper layer modules of the CanIf. The callback functions defined in this container are common to all configured CAN Driver / CAN Transceiver Driver modules.
      function name CanIfDispatchErrorPassiveNotificationName [0..1]: scope=ECU, multiplicity set at link in variant link-time+post-build / pre-compile in variant pre-compile, origin=RB:21.0.0:2016-07-31, set at link in variant link-time+post-build / pre-compile in variant pre-compile  # This parameter defines the name of <User_ErrorPassiveNotification>.This parameter defines the function to be invoked when there is Error Passive notification by the underlying Can Driver.
      function name CanIfDispatchUserCheckTrcvWakeFlagIndicationName [0..1]: scope=ECU, multiplicity set at link in variant link-time+post-build / pre-compile in variant pre-compile, set at link in variant link-time+post-build / pre-compile in variant pre-compile  # This parameter defines the name of <User_ClearTrcvWufFlagIndication>. If CANIF_DISPATCH_USERCHECKTRCVWAKEFLAGINDICATION_UL equals CAN_SM the name of <User_CheckTrcvWakeFlagIndication> is fixed. If it equals CDD, the name is selectable. If CANIF_PUBLIC_PN_SUPPORT equals False, this parameter shall not be configurable.
      enumeration CanIfDispatchUserCheckTrcvWakeFlagIndicationUL [0..1]: {CAN_SM, CDD}, scope=ECU, multiplicity set at link in variant link-time+post-build / pre-compile in variant pre-compile, set at link in variant link-time+post-build / pre-compile in variant pre-compile  # This parameter defines the upper layer module to which the CheckTrcvWakeFlagIndication from the Driver modules have to be routed. If CANIF_PUBLIC_PN_SUPPORT equals False, this parameter shall not be configurable.
      function name CanIfDispatchUserClearTrcvWufFlagIndicationName [0..1]: scope=ECU, multiplicity set at link in variant link-time+post-build / pre-compile in variant pre-compile, set at link in variant link-time+post-build / pre-compile in variant pre-compile  # This parameter defines the name of <User_ClearTrcvWufFlagIndication>. If CANIF_DISPATCH_USERCLEARTRCVWUFFLAGINDICATION_UL equals CAN_SM the name of <User_ClearTrcvWufFlagIndication> is fixed. If it equals CDD, the name is selectable. If CANIF_PUBLIC_PN_SUPPORT equals False, this parameter shall not be configurable.
      enumeration CanIfDispatchUserClearTrcvWufFlagIndicationUL [0..1]: {CAN_SM, CDD}, scope=ECU, multiplicity set at link in variant link-time+post-build / pre-compile in variant pre-compile, set at link in variant link-time+post-build / pre-compile in variant pre-compile  # This parameter defines the upper layer module to which the ClearTrcvWufFlagIndication from the Driver modules have to be routed. If CANIF_PUBLIC_PN_SUPPORT equals False, this parameter shall not be configurable.
      function name CanIfDispatchUserConfirmPnAvailabilityName [0..1]: scope=ECU, multiplicity set at link in variant link-time+post-build / pre-compile in variant pre-compile, set at link in variant link-time+post-build / pre-compile in variant pre-compile  # This parameter defines the name of <User_ConfirmPnAvailability>. If CANIF_DISPATCH_USERCONFIRMPNAVAILABILITY_UL equals CAN_SM the name of <User_ConfirmPnAvailability> is fixed. If it equals CDD, the name is selectable. If CANIF_PUBLIC_PN_SUPPORT equals False, this parameter shall not be configurable.
      enumeration CanIfDispatchUserConfirmPnAvailabilityUL [0..1]: {CAN_SM, CDD}, scope=ECU, multiplicity set at link in variant link-time+post-build / pre-compile in variant pre-compile, set at link in variant link-time+post-build / pre-compile in variant pre-compile  # This parameter defines the upper layer module to which the ConfirmPnAvailability notification from the Driver modules have to be routed. If CANIF_PUBLIC_PN_SUPPORT equals False, this parameter shall not be configurable.
      function name CanIfDispatchUserCtrlBusOffName [0..1]: scope=ECU, multiplicity set at link in variant link-time+post-build / pre-compile in variant pre-compile, set at link in variant link-time+post-build / pre-compile in variant pre-compile, max-length=32, min-length=1  # This parameter defines the name of <User_ControllerBusOff>. This parameter depends on the parameter CANIF_USERCTRLBUSOFF_UL. If CANIF_USERCTRLBUSOFF_UL equals CAN_SM the name of <User_ControllerBusOff> is fixed. If CANIF_USERCTRLBUSOFF_UL equals CDD, the name of <User_ControllerBusOff> is selectable.
      enumeration CanIfDispatchUserCtrlBusOffUL: {CAN_SM, CDD}, scope=ECU, set at link in variant link-time+post-build / pre-compile in variant pre-compile  # This parameter defines the upper layer (UL) module to which the notifications of all ControllerBusOff events from the CAN Driver modules have to be routed via <User_ControllerBusOff> There is no possibility to configure no upper layer (UL) module as the provider of <User_ControllerBusOff>.
      function name CanIfDispatchUserCtrlModeIndicationName [0..1]: scope=ECU, multiplicity set at link in variant link-time+post-build / pre-compile in variant pre-compile, set at link in variant link-time+post-build / pre-compile in variant pre-compile, max-length=32, min-length=1  # This parameter defines the name of <User_ControllerModeIndication>. This parameter depends on the parameter CANIF_USERCTRLMODEINDICATION_UL. If CANIF_USERCTRLMODEINDICATION_UL equals CAN_SM the name of <User_ControllerModeIndication> is fixed. If CANIF_USERCTRLMODEINDICATION_UL equals CDD, the name of <User_ControllerModeIndication> is selectable.
      enumeration CanIfDispatchUserCtrlModeIndicationUL: {CAN_SM, CDD}, scope=ECU, set at link in variant link-time+post-build / pre-compile in variant pre-compile  # This parameter defines the upper layer (UL) module to which the notifications of all ControllerTransition events from the CAN Driver modules have to be routed via <User_ControllerModeIndication>.
      function name CanIfDispatchUserTrcvModeIndicationName [0..1]: scope=ECU, multiplicity set at link in variant link-time+post-build / pre-compile in variant pre-compile, set at link in variant link-time+post-build / pre-compile in variant pre-compile, max-length=32, min-length=1  # This parameter defines the name of <User_TrcvModeIndication>. This parameter depends on the parameter CANIF_USERTRCVMODEINDICATION_UL. If CANIF_USERTRCVMODEINDICATION_UL equals CAN_SM the name of <User_TrcvModeIndication> is fixed. If CANIF_USERTRCVMODEINDICATION_UL equals CDD, the name of <User_TrcvModeIndication> is selectable.
      enumeration CanIfDispatchUserTrcvModeIndicationUL [0..1]: {CAN_SM, CDD}, scope=ECU, multiplicity set at link in variant link-time+post-build / pre-compile in variant pre-compile, set at link in variant link-time+post-build / pre-compile in variant pre-compile  # This parameter defines the upper layer (UL) module to which the notifications of all TransceiverTransition events from the CAN Transceiver Driver modules have to be routed via <User_TrcvModeIndication>. If no UL module is configured, no upper layer callback function will be called.
      function name CanIfDispatchUserValidateWakeupEventName [0..1]: scope=ECU, multiplicity set at link in variant link-time+post-build / pre-compile in variant pre-compile, set at link in variant link-time+post-build / pre-compile in variant pre-compile, max-length=32, min-length=1  # This parameter defines the name of <User_ValidateWakeupEvent>. This parameter depends on the parameter CANIF_USERVALIDATEWAKEUPEVENT_UL. CANIF_USERVALIDATEWAKEUPEVENT_UL equals ECUM the name of <User_ValidateWakeupEvent> is fixed. CANIF_USERVALIDATEWAKEUPEVENT_UL equals CDD, the name of <User_ValidateWakeupEvent> is selectable. If parameter CANIF_WAKEUP_CHECK_VALIDATION_API is disabled, no <User_ValidateWakeupEvent> API can be configured.
      enumeration CanIfDispatchUserValidateWakeupEventUL [0..1]: {CDD, ECUM}, scope=ECU, multiplicity set at link in variant link-time+post-build / pre-compile in variant pre-compile, set at link in variant link-time+post-build / pre-compile in variant pre-compile  # This parameter defines the upper layer (UL) module to which the notifications about positive former requested wake up sources have to be routed via <User_ValidateWakeupEvent>. If parameter CANIF_WAKEUP_CHECK_VALIDATION_API is disabled, this parameter cannot be configured.
    container CanIfInitCfg  # This container contains the init parameters of the CAN Interface.
      string CanIfInitCfgSet: post-build-variant-value=true, set at link in variant link-time / post-build in variant post-build / pre-compile in variant pre-compile, max-length=32, min-length=1  # Selects the CAN Interface specific configuration setup. This type of the external data structure shall contain the post build initialization data for the CAN Interface for all underlying CAN Dirvers. constant to CanIf_ConfigType.
      integer CanIfMaxBufferSize [0..0]: 0..18446744073709551615, multiplicity set at link in variant link-time+post-build / pre-compile in variant pre-compile, set at link in variant link-time+post-build / pre-compile in variant pre-compile  # Maximum total size of all Tx buffers. This parameter is needed only in case of post-build loadable implementation using static memory. This parameter is not suuported currently. | allocation.
      integer CanIfMaxRxPduCfg [0..0]: 0..18446744073709551615, multiplicity set at link in variant link-time+post-build / pre-compile in variant pre-compile, set at link in variant link-time+post-build / pre-compile in variant pre-compile  # Maximum number of Pdus. This parameter is needed only in case of post-build loadable implementation using static memory allocation. This parameter is not supported currently.
      integer CanIfMaxTxPduCfg [0..0]: 0..18446744073709551615, multiplicity set at link in variant link-time+post-build / pre-compile in variant pre-compile, set at link in variant link-time+post-build / pre-compile in variant pre-compile  # Maximum number of Pdus. This parameter is needed only in case of post-build loadable implementation using static memory allocation. This parameter is not supported currently.
      container CanIfBufferCfg [0..*]: multiplicity set at link in variant link-time / post-build in variant post-build / pre-compile in variant pre-compile, post-build-variant-multiplicity=true  # This container contains the Txbuffer configuration. Multiple buffers with different sizes could be configured. If CanIfBufferSize (ECUC_CanIf_00834) equals 0, the CanIf Tx L-PDU only refers via this CanIfBufferCfg the corresponding CanIfHthCfg.
        integer CanIfBufferSize: 0..255, post-build-variant-value=true, set at link in variant link-time / post-build in variant post-build / pre-compile in variant pre-compile, default-value=0  # This parameter defines the number of CanIf Tx L-PDUs which can be buffered in one Txbuffer. If this value equals 0, the CanIf does not perform Txbuffering for the CanIf Tx L-PDUs which are assigned to this Txbuffer. If CanIfPublicTxBuffering equals False, this parameter equals 0 for all TxBuffer. If the CanHandleType of the referred HTH equals FULL, this parameter equals 0 for this TxBuffer.
        reference CanIfBufferHthRef: post-build-variant-value=true, set at link in variant link-time / post-build in variant post-build / pre-compile in variant pre-compile, destination=CanIfHthCfg  # Reference to HTH, that defines the hardware object or the pool of hardware objects configured for transmission. All the CanIf Tx L-PDUs refer via the CanIfBufferCfg and this parameter to the HTHs if TxBuffering is enabled, or not. Each HTH shall not be assigned to more than one buffer.
      container CanIfInitHohCfg [0..*]: multiplicity set at pre-compile  # This container contains the references to the configuration setup of each underlying CAN Driver.
        container CanIfHrhCfg [0..*]: multiplicity set at link in variant link-time / post-build in variant post-build / pre-compile in variant pre-compile, post-build-variant-multiplicity=true  # This container contains configuration parameters for each hardware receive object (HRH).
          boolean CanIfHrhSoftwareFilter [0..0]: set at link in variant link-time+post-build / pre-compile in variant pre-compile, default-value=true  # Selects the hardware receive objects by using the HRH range/list from CAN Driver configuration to define, for which HRH a software filtering has to be performed at during receive processing. True: Software filtering is enabled False: Software filtering is enabled
          reference CanIfHrhCanCtrlIdRef: scope=ECU, set at link in variant link-time+post-build / pre-compile in variant pre-compile, destination=CanIfCtrlCfg  # Reference to controller Id to which the HRH belongs to. A controller can contain one or more HRHs.
          symbolic name reference CanIfHrhIdSymRef: scope=ECU, post-build-variant-value=true, set at link in variant link-time / post-build in variant post-build / pre-compile in variant pre-compile, destination=CanHardwareObject  # The parameter refers to a particular HRH object in the CanDrv configuration (see CanHardwareObject ECUC_Can_00324).The type of the HRH can either be Full-CAN or Basic-CAN. The type of HRHs is defined in the CAN Driver Module and hence it is derived from CAN Driver Configuration of a Hardware Object. If BasicCAN is configured, software filtering is enabled CanIf receives the following information of the CanDrv module by this reference: - CanHandleType (see ECUC_Can_00323) - CanObjectId (see ECUC_Can_00326)
          container CanIfHrhListCfg [0..1]: multiplicity set at link in variant link-time / post-build in variant post-build / pre-compile in variant pre-compile, post-build-variant-multiplicity=true  # This container contains the configuration of CanId lists to be received
            integer CanIfHrhListCanId [1..*]: 0..536870911, multiplicity set at link in variant link-time / post-build in variant post-build / pre-compile in variant pre-compile, origin=RB:16.0.1:2015-02-18, post-build-variant-multiplicity=true, post-build-variant-value=true, set at link in variant link-time / post-build in variant post-build / pre-compile in variant pre-compile  # This parameter contains the list of CanIds to be received via this HRH.
          container CanIfHrhRangeCfg [0..1]: multiplicity set at link in variant link-time / post-build in variant post-build / pre-compile in variant pre-compile, post-build-variant-multiplicity=true  # Defines the parameters required for configurating multiple CANID ranges for a given same HRH.
            integer CanIfHrhRangeBaseId [0..1]: 0..536870911, multiplicity set at link in variant link-time / post-build in variant post-build / pre-compile in variant pre-compile, post-build-variant-multiplicity=true, post-build-variant-value=true, set at link in variant link-time / post-build in variant post-build / pre-compile in variant pre-compile  # CAN Identifier used as base value in combination with CanIfHrhRangeMask for a masked ID range in which all CAN Ids shall pass the software filtering. The size of this parameter is limited by CanIfHrhRangeRxPduRangeCanIdType.
            integer CanIfHrhRangeMask [0..1]: 0..536870911, multiplicity set at link in variant link-time / post-build in variant post-build / pre-compile in variant pre-compile, post-build-variant-multiplicity=true, post-build-variant-value=true, set at link in variant link-time / post-build in variant post-build / pre-compile in variant pre-compile  # Used as mask value in combination with CanIfHrhRangeBaseId for a masked ID range in which all CAN Ids shall pass the software filtering. The size of this parameter is limited by CanIfHrhRangeRxPduRangeCanIdType.
            integer CanIfHrhRangeRxPduLowerCanId [0..1]: 0..536870911, multiplicity set at link in variant link-time / post-build in variant post-build / pre-compile in variant pre-compile, post-build-variant-multiplicity=true, post-build-variant-value=true, set at link in variant link-time / post-build in variant post-build / pre-compile in variant pre-compile  # Lower CAN Identifier of a receive CAN L-PDU for identifier range definition, in which all CAN Ids shall pass the software filtering.
            enumeration CanIfHrhRangeRxPduRangeCanIdType: {EXTENDED, STANDARD}, post-build-variant-value=true, set at link in variant link-time / post-build in variant post-build / pre-compile in variant pre-compile  # Specifies whether a configured Range of CAN Ids shall only consider standard CAN Ids or extended CAN Ids.
            integer CanIfHrhRangeRxPduUpperCanId [0..1]: 0..536870911, multiplicity set at link in variant link-time / post-build in variant post-build / pre-compile in variant pre-compile, post-build-variant-multiplicity=true, post-build-variant-value=true, set at link in variant link-time / post-build in variant post-build / pre-compile in variant pre-compile  # Upper CAN Identifier of a receive CAN L-PDU for identifier range definition, in which all CAN Ids shall pass the software filtering.
        container CanIfHthCfg [0..*]: multiplicity set at link in variant link-time / post-build in variant post-build / pre-compile in variant pre-compile, post-build-variant-multiplicity=true  # This container contains parameters related to each HTH.
          reference CanIfHthCanCtrlIdRef: scope=ECU, post-build-variant-value=true, set at link in variant link-time / post-build in variant post-build / pre-compile in variant pre-compile, destination=CanIfCtrlCfg  # Reference to controller Id to which the HTH belongs to. A controller can contain one or more HTHs.
          symbolic name reference CanIfHthIdSymRef: scope=ECU, set at link in variant link-time+post-build / pre-compile in variant pre-compile, destination=CanHardwareObject  # The parameter refers to a particular HTH object in the CanDrv configuration (see CanHardwareObject ECUC_Can_00324).The type of the HTH can either be Full-CAN or Basic-CAN. The type of HTHs is defined in the CAN Driver Module and hence it is derived from CAN Driver Configuration of a Hardware Object CanIf receives the following information of the CanDrv module by this reference: - CanHandleType (see ECUC_Can_00323) - CanObjectId (see ECUC_Can_00326)
      container CanIfRxPduCfg [0..*]: multiplicity set at link in variant link-time / post-build in variant post-build / pre-compile in variant pre-compile, post-build-variant-multiplicity=true  # This container contains the configuration (parameters) of each receive CAN L-PDU. The SHORT-NAME of "CanIfRxPduConfig" container itself represents the symolic name of Receive L-PDU.
        integer CanIfRxPduCanId [0..1]: 0..536870911, scope=ECU, multiplicity set at link in variant link-time / post-build in variant post-build / pre-compile in variant pre-compile, post-build-variant-multiplicity=true, post-build-variant-value=true, set at link in variant link-time / post-build in variant post-build / pre-compile in variant pre-compile  # CAN Identifier of Receive CAN L-PDUs used by the CAN Interface. Exa: Software Filtering. This parameter is used if exactly one Can Identifier is assigned to the Pdu. If a range is assigned then the CanIfRxPduCanIdRange parameter shall be used. Range: 11 Bit For Standard CAN Identifier ... 29 Bit For Extended CAN identifier
        integer CanIfRxPduCanIdMask [0..1]: 0..536870911, scope=ECU, multiplicity set at link in variant link-time / post-build in variant post-build / pre-compile in variant pre-compile, post-build-variant-multiplicity=true, post-build-variant-value=true, set at link in variant link-time / post-build in variant post-build / pre-compile in variant pre-compile, default-value=536870911  # Identifier mask which denotes relevant bits in the CAN Identifier. This parameter defines a CAN Identifier range in an alternative way to CanIfRxPduCanIdRange. It identifies the bits of the configured CAN Identifier that must match the received CAN Identifier. Range: 11 bits for Standard CAN Identifier, 29 bits for Extended CAN Identifier.
        enumeration CanIfRxPduCanIdType: {EXTENDED_CAN, EXTENDED_FD_CAN, EXTENDED_NO_FD_CAN, STANDARD_CAN, STANDARD_FD_CAN, STANDARD_NO_FD_CAN}, post-build-variant-value=true, set at link in variant link-time / post-build in variant post-build / pre-compile in variant pre-compile  # CAN Identifier of receive CAN L-PDUs used by the CAN Driver for CAN L-PDU reception.
        integer CanIfRxPduDlc: 0..64, scope=ECU, post-build-variant-value=true, set at link in variant link-time / post-build in variant post-build / pre-compile in variant pre-compile  # Data length of the received CAN L-PDUs used by the CAN Interface. This information is used for DLC checking. Additionally it might specify the valid bits in case of the discrete DLC for CAN FD L-PDUs > 8 bytes. The data area size of a CAN L-PDU can have a range from 0 to 64 bytes.
        integer CanIfRxPduId: 0..4294967295, scope=ECU, set at pre-compile, symbolic-name-value=true, with-auto=true  # ECU wide unique, symbolic handle for receive CAN L-SDU. It shall fulfill ANSI/AUTOSAR definitions for constant defines. Range: 0..max. number of defined CanRxPduIds
        boolean CanIfRxPduReadData: scope=ECU, post-build-variant-value=true, set at link in variant link-time / post-build in variant post-build / pre-compile in variant pre-compile, default-value=false  # Enables and disables the Rx buffering for reading of received L-SDU data. True: Enabled False: Disabled
        boolean CanIfRxPduReadNotifyStatus: post-build-variant-value=true, set at link in variant link-time / post-build in variant post-build / pre-compile in variant pre-compile, default-value=false  # Enables and disables receive indication for each receive CAN L-SDU for reading its notification status. True: Enabled False: Disabled
        enumeration CanIfRxPduType [0..1]: {DYNAMIC, STATIC}, scope=ECU, origin=RB:5.0.0:2018-04-30, post-build-variant-value=true, set at link in variant link-time / post-build in variant post-build / pre-compile in variant pre-compile  # Defines the type of each receive CAN L-PDU. 1). DYNAMIC - CanId of the Rx L-PDU can be reconfigured 2). STATIC - CanId of the Rx L-PDU cannot be reconfigured. The default value is STATIC (even if this parameter is left unconfigured). The API CanIf_Rb_ChangeRxPduCanId() is used to reconfigure the CanId of RxPdu if the CanIfRxPduType is configured as DYNAMIC.
        function name CanIfRxPduUserRxIndicationName [0..1]: scope=ECU, multiplicity set at link in variant link-time+post-build / pre-compile in variant pre-compile, set at link in variant link-time+post-build / pre-compile in variant pre-compile, max-length=32, min-length=1  # This parameter defines the name of the <User_RxIndication>. This parameter depends on the parameter CANIF_RXPDU_USERRXINDICATION_UL. If CANIF_RXPDU_USERRXINDICATION_UL equals CAN_TP, CAN_NM, PDUR, XCP, CAN_TSYN, J1939NM or J1939TP, the name of the <User_RxIndication> is fixed. If CANIF_RXPDU_USERRXINDICATION_UL equals CDD, the name of the <User_RxIndication> is selectable.
        enumeration CanIfRxPduUserRxIndicationUL [0..1]: {CAN_NM, J1939NM, CAN_TP, CAN_TSYN, CDD, J1939TP, PDUR, XCP}, scope=ECU, multiplicity set at link in variant link-time+post-build / pre-compile in variant pre-compile, set at link in variant link-time+post-build / pre-compile in variant pre-compile  # This parameter defines the upper layer (UL) module to which the indication of the successfully received CANRXPDUID has to be routed via <User_RxIndication>. This <User_RxIndication> has to be invoked when the indication of the configured CANRXPDUID will be received by an Rx indication event from the CAN Driver module. If no upper layer (UL) module is configured, no <User_RxIndication> has to be called in case of an Rx indication event of the CANRXPDUID from the CAN Driver module.
        reference CanIfRxPduHrhIdRef: post-build-variant-value=true, set at link in variant link-time / post-build in variant post-build / pre-compile in variant pre-compile, destination=CanIfHrhCfg  # The HRH to which Rx L-PDU belongs to, is referred through this parameter.
        reference CanIfRxPduRef: scope=ECU, post-build-variant-value=true, set at link in variant link-time / post-build in variant post-build / pre-compile in variant pre-compile, destination=Pdu  # Reference to the "global" Pdu structure to allow harmonization of handle IDs in the COM-Stack.
        container CanIfRxPduCanIdRange [0..1]  # Optional container that allows to map a range of CAN Ids to one PduId.
          integer CanIfRxPduCanIdRangeLowerCanId: 0..536870911, post-build-variant-value=true, set at link in variant link-time / post-build in variant post-build / pre-compile in variant pre-compile  # Lower CAN Identifier of a receive CAN L-PDU for identifier range definition, in which all CAN Ids are mapped to one PduId.
          integer CanIfRxPduCanIdRangeUpperCanId: 0..536870911, post-build-variant-value=true, set at link in variant link-time / post-build in variant post-build / pre-compile in variant pre-compile  # Upper CAN Identifier of a receive CAN L-PDU for identifier range definition, in which all CAN Ids are mapped to one PduId.
        container CanIfTTRxFrameTriggering [0..0]  # CanIfTTRxFrameTriggering is specified in the SWS TTCAN Interface and defines Frame trigger for TTCAN reception. This feature is not supported currently. | This container is only included and valid if TTCAN is supported by the controller, enabled (see CanIfSupportTTCAN, ECUC_CanIf_00675), and a joblist is used for reception.
          integer CanTTRxJoblistTimeMark [0..0]: 0..65535, multiplicity set at link in variant link-time / post-build in variant post-build / pre-compile in variant pre-compile, post-build-variant-multiplicity=true, post-build-variant-value=true, set at link in variant link-time / post-build in variant post-build / pre-compile in variant pre-compile  # Defines the point in time, when the joblist execution funciton (JLEF) shall be called for the referenced rx trigger. Value is given in cycle time. This parameter is only configurable if a joblist is enabled by parameter CanIfTTJobList.
          reference CanIfTTRxHwObjectTriggerIdRef [0..0]: post-build-variant-value=true, set at link in variant link-time / post-build in variant post-build / pre-compile in variant pre-compile, destination=CanTTHardwareObjectTrigger  # This parameter refers to a particular TTCAN hardware receive object Trigger of a hardware object in the TTCAN Driver Module, which is referred via plain CAN parameter CANIF_HRH_HANDLETYPE_REF. This parameter is only configurable if a joblist is enabled by parameter CanIfTTJobList.
      container CanIfTxPduCfg [0..*]: multiplicity set at link in variant link-time / post-build in variant post-build / pre-compile in variant pre-compile, post-build-variant-multiplicity=true  # This container contains the configuration (parameters) of a transmit CAN L-PDU. It has to be configured as often as a transmit CAN L-PDU is needed. The SHORT-NAME of "CanIfTxPduConfig" container represents the symolic name of Transmit L-PDU.
        integer CanIfTxPduCanId [0..1]: 0..536870911, scope=ECU, multiplicity set at link in variant link-time / post-build in variant post-build / pre-compile in variant pre-compile, post-build-variant-multiplicity=true, post-build-variant-value=true, set at link in variant link-time / post-build in variant post-build / pre-compile in variant pre-compile  # CAN Identifier of transmit CAN L-PDUs used by the CAN Driver for CAN L-PDU transmission. Range: 11 Bit For Standard CAN Identifier ... 29 Bit For Extended CAN identifier The CAN Identifier may be omitted for dynamic transmit L-PDUs.
        integer CanIfTxPduCanIdMask [0..1]: 0..536870911, scope=ECU, multiplicity set at link in variant link-time / post-build in variant post-build / pre-compile in variant pre-compile, post-build-variant-multiplicity=true, post-build-variant-value=true, set at link in variant link-time / post-build in variant post-build / pre-compile in variant pre-compile, default-value=536870911  # Identifier mask which denotes relevant bits in the CAN Identifier. This parameter may be used to keep parts of the CAN Identifier of dynamic transmit L-PDUs static. Range: 11 bits for Standard CAN Identifier, 29 bits for Extended CAN Identifier.
        enumeration CanIfTxPduCanIdType: {EXTENDED_CAN, EXTENDED_FD_CAN, STANDARD_CAN, STANDARD_FD_CAN}, scope=ECU, post-build-variant-value=true, set at link in variant link-time / post-build in variant post-build / pre-compile in variant pre-compile  # Type of CAN Identifier of the transmit CAN L-PDU used by the CAN Driver module for CAN L-PDU transmission.
        integer CanIfTxPduId: 0..4294967295, scope=ECU, set at pre-compile, symbolic-name-value=true  # ECU wide unique, symbolic handle for transmit CAN L-SDU. Range: 0..max. number of CantTxPduIds
        boolean CanIfTxPduPnFilterPdu [0..1]: multiplicity set at link in variant link-time / post-build in variant post-build / pre-compile in variant pre-compile, post-build-variant-multiplicity=true, post-build-variant-value=true, set at link in variant link-time / post-build in variant post-build / pre-compile in variant pre-compile, default-value=false  # If CanIfPublicPnFilterSupport is enabled, by this parameter PDUs could be configured which will pass the CanIfPnFilter. If there is no CanIfTxPduPnFilterPdu configured per controller, the corresponding controller applies no CanIfPnFilter.
        boolean CanIfTxPduReadNotifyStatus: post-build-variant-value=true, set at link in variant link-time / post-build in variant post-build / pre-compile in variant pre-compile, default-value=false  # Enables and disables transmit confirmation for each transmit CAN L-SDU for reading its notification status. True: Enabled False: Disabled
        boolean CanIfTxPduTriggerTransmit [0..1]: scope=ECU, post-build-variant-value=true, set at link in variant link-time / post-build in variant post-build / pre-compile in variant pre-compile, default-value=false  # Determines if or if not CanIf shall use the trigger transmit API for this PDU.
        boolean CanIfTxPduTruncation: scope=ECU, post-build-variant-value=true, set at link in variant link-time / post-build in variant post-build / pre-compile in variant pre-compile, default-value=true  # Enables/disables truncation of PDUs that exceed the configured size.
        enumeration CanIfTxPduType: {DYNAMIC, STATIC}, scope=ECU, post-build-variant-value=true, set at link in variant link-time / post-build in variant post-build / pre-compile in variant pre-compile  # Defines the type of each transmit CAN L-PDU.
        function name CanIfTxPduUserTriggerTransmitName [0..1]: scope=ECU, multiplicity set at link in variant link-time+post-build / pre-compile in variant pre-compile, set at link in variant link-time+post-build / pre-compile in variant pre-compile, max-length=32, min-length=1  # This parameter defines the name of the <User_TriggerTransmit>. This parameter depends on the parameter CanIfTxPduUserTxConfirmationUL. If CanIfTxPduUserTxConfirmationUL equals CAN_TP, CAN_NM, PDUR, XCP, CAN_TSYN, J1939NM or J1939TP, the name of the <User_TriggerTransmit> is fixed. If CanIfTxPduUserTxConfirmationUL equals CDD, the name of the <User_TxConfirmation> is selectable. | Please be aware that this parameter depends on the same parameter as CanIfTxPduUserTxConfirmationName. It shall be clear which upper layer is responsible for that PDU.
        function name CanIfTxPduUserTxConfirmationName [0..1]: scope=ECU, multiplicity set at link in variant link-time+post-build / pre-compile in variant pre-compile, set at link in variant link-time+post-build / pre-compile in variant pre-compile, max-length=32, min-length=1  # This parameter defines the name of the <User_TxConfirmation>. This parameter depends on the parameter CANIF_TXPDU_USERTXCONFIRMATION_UL. If CANIF_TXPDU_USERTXCONFIRMATION_UL equals CAN_TP, CAN_NM, PDUR, XCP, CAN_TSYN, J1939NM or J1939TP, the name of the <User_TxConfirmation> is fixed. If CANIF_TXPDU_USERTXCONFIRMATION_UL equals CDD, the name of the <User_TxConfirmation> is selectable.
        enumeration CanIfTxPduUserTxConfirmationUL [0..1]: {CAN_NM, CAN_TP, CAN_TSYN, CDD, J1939NM, J1939TP, PDUR, XCP}, scope=ECU, multiplicity set at link in variant link-time+post-build / pre-compile in variant pre-compile, set at link in variant link-time+post-build / pre-compile in variant pre-compile  # This parameter defines the upper layer (UL) module to which the confirmation of the successfully transmitted CANTXPDUID has to be routed via the <User_TxConfirmation>. This <User_TxConfirmation> has to be invoked when the confirmation of the configured CANTXPDUID will be received by a Tx confirmation event from the CAN Driver module. If no upper layer (UL) module is configured, no <User_TxConfirmation> has to be called in case of a Tx confirmation event of the CANTXPDUID from the CAN Driver module.
        reference CanIfTxPduBufferRef: scope=ECU, post-build-variant-value=true, set at link in variant link-time / post-build in variant post-build / pre-compile in variant pre-compile, destination=CanIfBufferCfg  # Configurable reference to a CanIf buffer configuration.
        reference CanIfTxPduRef: scope=ECU, post-build-variant-value=true, set at link in variant link-time / post-build in variant post-build / pre-compile in variant pre-compile, destination=Pdu  # Reference to the "global" Pdu structure to allow harmonization of handle IDs in the COM-Stack. Currently Unused Parameter.
        container CanIfTTTxFrameTriggering [0..0]  # CanIfTTTxFrameTriggering is specified in the SWS TTCAN Interface and defines Frame trigger for TTCAN transmission. This feature is not supported currently. | This container is only included and valid if TTCAN is supported by the controller, enabled (see CanIfSupportTTCAN, ECUC_CanIf_00675), and a joblist is used.
          integer CanIfTTTxJoblistTimeMark [0..1]: 0..65535, multiplicity set at link in variant link-time / post-build in variant post-build / pre-compile in variant pre-compile, post-build-variant-multiplicity=true, post-build-variant-value=true, set at link in variant link-time / post-build in variant post-build / pre-compile in variant pre-compile  # Defines the point in time, when the joblist execution funciton (JLEF) shall be called for the referenced tx frame trigger. | Value is given in cycle time. This parameter is only configurable if a joblist is enabled by parameter CanIfTTJobList.
          reference CanIfTTTxHwObjectTriggerIdRef [0..0]: post-build-variant-value=true, set at link in variant link-time / post-build in variant post-build / pre-compile in variant pre-compile, destination=CanTTHardwareObjectTrigger  # This parameter refers to a particular TTCAN hardware transmit object Trigger of a hardware object in the TTCAN Driver Module, | which is referred via plain CAN parameter CANIF_HTH_HANDLETYPE_REF. This parameter is only configurable if a joblist is enabled by parameter CanIfTTJobList.
    container CanIfPrivateCfg  # This container contains the private configuration (parameters) of the CAN Interface.
      boolean CanIfDummyBoolean [0..0]: origin=RB:21.0.0:2016-07-31, set at pre-compile  # Dummy boolean parameter to check CUBEC compatibility options.
      float CanIfDummyFloat [0..0]: 0.001..0.1, origin=RB:21.0.0:2016-07-31, set at pre-compile  # Dummy float parameter to check CUBEC compatibility options
      integer CanIfDummyInteger [0..0]: 0..255, origin=RB:21.0.0:2016-07-31, set at pre-compile  # Dummy integer parameter to check CUBEC compatibility options.
      string CanIfDummyString [0..0]: origin=RB:21.0.0:2016-07-31, set at pre-compile, max-length=32, min-length=1  # Dummy string parameter to check CUBEC compatibility options.
      boolean CanIfFixedBuffer [0..1]: multiplicity set at pre-compile, set at pre-compile, default-value=false  # This parameter defines if the buffer element length shall be fixed to 8 Bytes for buffers to which only PDUs < 8 Bytes are assigned. This parameter is not supported currently. | TRUE: Minimum buffer element length is fixed to 8 Bytes. FALSE: Buffer element length depends on the size of the referencing PDUs.
      boolean CanIfPrivateDlcCheck: set at pre-compile, default-value=true  # Selects whether the DLC check is supported. True: Enabled False: Disabled
      enumeration CanIfPrivateSoftwareFilterType [0..0]: {BINARY, INDEX, LINEAR, TABLE}, set at pre-compile  # Selects the desired software filter mechanism for reception only. This parameter is not supported currently. | Each implemented software filtering method is identified by this enumeration number. Range: Types implemented software filtering methods
      boolean CanIfSupportTTCAN [0..0]: scope=ECU, set at pre-compile, default-value=false  # Defines whether TTCAN is supported. This parameter is not supported currently. | TRUE: TTCAN is supported. FALSE: TTCAN is not supported, only normal CAN communication is possible.
      symbolic name reference CanIfDummyReference [0..0]: origin=RB:21.0.0:2016-07-31, set at pre-compile, destination=CanIfInitHohCfg  # Dummy reference parameter to check CUBEC compatibility options
      container CanIfRbXCore [0..1]: multiplicity set at pre-compile  # Module to define CanIf XCore parameters to support multi-core operation of the CanIf transmission, reception and transmission confirmation
        container CanIfRbXCoreCanControllerCoreAffinity [1..*]: multiplicity set at pre-compile  # This container defines which CPU Core has "ownership" on which CAN Controller. This means that for each Can controller configured, an element must be present here to configure the destination core on which it will operate. The CAN Controller Interrupt and/or CAN Main function RX and TX will be scheduled on the owner CPU Core. Example: CAN Controller 0 will be owned by CPU Core 2. CAN Interrupt for Controller 0 MUST be routed to CPU Core 2
          integer CanIfRbXCoreCtrlDestCoreID: 0..255, multiplicity set at pre-compile, origin=RB:5.1.0:2018-08-03, set at pre-compile  # Indicates the core ID on which context CanIfRbXCoreCanControllerRef will operate
          symbolic name reference CanIfRbXCoreCanControllerRef: origin=RB:5.1.0:2018-08-03, set at link in variant link-time+post-build / pre-compile in variant pre-compile, destination=CanController  # This parameter holds a reference to the Can controller that will operate on the core context specified by CanIf XCore DestCoreID
        container CanIfRbXCoreGeneral: multiplicity set at pre-compile  # Container for general pre-compile parameters of the CanIf xcore.
          boolean CanIfRbXCoreDebug [0..1]: multiplicity set at pre-compile, origin=RB:5.1.0:2018-08-03, set at pre-compile, default-value=false  # DEBUG_INSTRUMENTATION_ACTIVE ON or OFF.
        container CanIfRbXCorePipe [1..*]: multiplicity set at pre-compile  # Configuration of the pipes used by CanIf XCore when a Tx confirmation, Tx request or Rx indication needs to be redirected from the current core to the destination core. For each user type of Tx confirmation and Rx indication a pipe will be defined from the Can controller to the core designated to handle that specific type of callback(specification per PDU of destination core is not possible, only per user type and callback type). For Tx, for each core to Can controller a pipe will be defined except for the core the Can controller runs on (a direct call is allowed).
          string CanIfRbXCoreDestRecvId [0..1]: multiplicity set at pre-compile, origin=RB:5.1.0:2018-08-03, set at pre-compile  # TaskID of the receiver on the destination core. Task name of the destination core should be as per the configured OS Task name.
          integer CanIfRbXCorePipeDestCore: 0..255, multiplicity set at pre-compile, origin=RB:5.1.0:2018-08-03, set at pre-compile  # Destination Core ID of this pipe
          integer CanIfRbXCorePipeId: 0..65535, multiplicity set at pre-compile, origin=RB:5.1.0:2018-08-03, set at pre-compile, symbolic-name-value=true, with-auto=true  # Unique ID of the pipe
          enumeration CanIfRbXCorePipeProcessingMode: {POLLING, SWI, TASK}, multiplicity set at pre-compile, origin=RB:5.1.0:2018-08-03, set at pre-compile  # Pipe Processing Mode as Polling, INTERRUPT, TASK
          enumeration CanIfRbXCorePipeProcessingType: {RX, TX, TXCONF}, multiplicity set at pre-compile, origin=RB:5.1.0:2018-08-03, set at pre-compile  # Pipe Processing Type as Rx, Tx and TxConfirmation.
          integer CanIfRbXCorePipeRamSize: 0..65535, multiplicity set at pre-compile, origin=RB:5.1.0:2018-08-03, set at pre-compile  # RAM_SIZE of this pipe
          integer CanIfRbXCorePipeSrcCore: 0..255, multiplicity set at pre-compile, origin=RB:5.1.0:2018-08-03, set at pre-compile  # Source Core ID of this pipe
          integer CanIfRbXCorePipeTaskPeriod [0..1]: 0..65535, multiplicity set at pre-compile, origin=RB:5.1.0:2018-08-03, set at pre-compile  # Pipe Task Period [ms]. when configured Task, calling period must be set
        container CanIfRbXCoreUserTypeCoreAffinity [1..*]: multiplicity set at pre-compile  # This container defines which CPU Core will receive the traffic for a specific CanIf_Cfg_UserType_ten. Eg: CAN NM traffic can be routed to Core1, and Can TP traffic can be routed to Core0
          enumeration CanIfRbUserType: {CAN_NM, J1939NM, CAN_TP, CAN_TSYN, CDD, J1939TP, XCP}, multiplicity set at pre-compile, origin=RB:5.1.0:2018-08-03, set at pre-compile  # Indicates UserType group of PDU's which Tx confirmation and Rx indication will be processed on the core indicated by CanIf XCore DestCoreID
          integer CanIfRbXCoreUserTypeDestCoreID: 0..255, multiplicity set at pre-compile, origin=RB:5.1.0:2018-08-03, set at pre-compile  # Indicates the core ID which will handle all the Tx confirmation and Rx indication for PDU's configured with CanIf UserType
      container CanIfTTGeneral [0..0]  # CanIfTTGeneral is specified in the SWS TTCAN Interface and defines if and in which way TTCAN is supported. | This container is only included and valid if TTCAN is supported by the controller, enabled (see CanIfSupportTTCAN, ECUC_CanIf_00675), and used.
        boolean CanIfTTJoblist [0..0]: set at pre-compile, default-value=false  # Defines whether TTCAN is processed via a joblist. | TRUE: Joblist is used. FALSE: No joblist is used. This parameter is only configurable if TTCAN is enabled by parameter CanIfSupportTTCAN.
        integer CanIfTTMaxIsrDelay [0..0]: 0..65535, post-build-variant-value=true, set at link in variant link-time / post-build in variant post-build / pre-compile in variant pre-compile  # Defines the maximum delay for the execution of the joblist execution function JLEF. This parameter is only configurable if a joblist is enabled by parameter CanIfTTJobList. This parameter is not supported currently.
        container CanIfTTDemEventParameterRefs [0..0]  # Container for the references to DemEventParameter elements which shall be invoked using the API Dem_ReportErrorStatus API in case the corresponding error occurs. The EventId is taken from the referenced DemEventParameter's DemEventId value. The standardized errors are provided in the container and can be extended by vendor specific error references. This parameter is not supported currently
          symbolic name reference CANIF_TT_E_JLE_SYNC [0..0]: multiplicity set at link in variant link-time / post-build in variant post-build / pre-compile in variant pre-compile, post-build-variant-multiplicity=true, post-build-variant-value=true, set at link in variant link-time / post-build in variant post-build / pre-compile in variant pre-compile, destination=DemEventParameter  # Reference to configured DEM event to report that the JLEF lost synchronization to the local time of the TTCAN controller. This parameter is not supported currently.
    container CanIfPublicCfg  # This container contains the public configuration (parameters) of the CAN Interface.
      boolean CanIfMetaDataSupport [0..1]: scope=ECU, multiplicity set at pre-compile, set at pre-compile, default-value=false  # Enable support for dynamic ID handling using L-SDU MetaData.
      boolean CanIfPublicBusoffRecoveryfromRxIndication: origin=RB:21.0.0:2016-07-31, set at pre-compile, default-value=false  # Configuration parameter to make busoff recovery from Rx indication optional. By default, this parameter shall be FALSE as it is a bosch specific parameter and this would impact the Busoff recovery in a way which is not intended by Autosar.. Then the busoff recovery would consider Rx indication of the Pdu transmitted to recover from busoff apart from getting Tx conformation for the same.If not, the busoff may be considered as recovered after a successful transmission.
      boolean CanIfPublicCanIfLiteConfiguration: origin=RB:21.0.0:2016-07-31, set at pre-compile  # This parameter defines whether CanIf Lite configuration is required(TRUE) or not(FALSE).
      boolean CanIfPublicCancelTransmitSupport: scope=ECU, set at pre-compile  # Configuration parameter to enable/disable dummy API for upper layer modules which allows to request the cancellation of an I-PDU.
      string CanIfPublicCddHeaderFile [0..*]: scope=ECU, multiplicity set at pre-compile, set at pre-compile, max-length=32, min-length=1  # Defines header files for callback functions which shall be included in case of CDDs. Range of characters is 1.. 32.
      boolean CanIfPublicDevErrorDetect: set at pre-compile, default-value=true  # Switches the Default Error Tracer (Det) detection and notification ON or OFF. * true: enabled (ON). * false: disabled (OFF).
      boolean CanIfPublicErrorPassiveSupport: scope=ECU, origin=RB:21.0.0:2016-07-31, set at pre-compile, default-value=false  # This parameter defines whether Error Passive Support is configured(TRUE) or not(FALSE).
      enumeration CanIfPublicHandleTypeEnum [0..1]: {UINT16, UINT8}, scope=ECU, set at pre-compile  # This parameter is used to configure the Can_HwHandleType. The Can_HwHandleType represents the hardware object handles of a CAN hardware unit. For CAN hardware units with more than 255 HW objects the extended range shall be used (UINT16).
      boolean CanIfPublicIcomSupport [0..0]: scope=ECU, set at pre-compile, default-value=false  # Selects support of Pretended Network features in CanIf. This parameter is not supported currently. | True: Enabled False: Disabled
      boolean CanIfPublicMultipleDrvSupport: scope=ECU, set at pre-compile, default-value=false  # Selects support for multiple CAN Drivers. True: Enabled False: Disabled.
      boolean CanIfPublicPnSupport: scope=ECU, set at pre-compile, default-value=false  # Selects support of Partial Network features in CanIf. True: Enabled False: Disabled
      boolean CanIfPublicReadRxPduDataApi: scope=ECU, set at pre-compile, default-value=false  # Enables / Disables the API CanIf_ReadRxPduData() for reading received L-SDU data. True: Enabled False: Disabled
      boolean CanIfPublicReadRxPduNotifyStatusApi: scope=ECU, set at pre-compile, default-value=false  # Enables and disables the API for reading the notification status of receive L-PDUs. True: Enabled False: Disabled
      boolean CanIfPublicReadTxPduNotifyStatusApi: scope=ECU, set at pre-compile, default-value=false  # Enables and disables the API for reading the notification status of transmit L-PDUs. True: Enabled False: Disabled
      boolean CanIfPublicSetDynamicTxIdApi: scope=ECU, set at pre-compile, default-value=false  # Enables and disables the API for reconfiguration of the CAN Identifier for each Transmit L-PDU. True: Enabled False: Disabled
      boolean CanIfPublicTxBuffering: scope=ECU, set at pre-compile, default-value=false  # Enables and disables the buffering of transmit L-PDUs (rejected by the CanDrv) within the CAN Interface module. True: Enabled False: Disabled
      boolean CanIfPublicTxConfirmPollingSupport: set at pre-compile  # Configuration parameter to enable/disable the API to poll for Tx Confirmation state.
      function name CanIfPublicUserDlcErrorNotificationName [0..1]: multiplicity set at link in variant link-time+post-build / pre-compile in variant pre-compile, origin=RB:21.0.0:2016-07-31, set at link in variant link-time+post-build / pre-compile in variant pre-compile  # This parameter defines the function to be invoked when there is a error in the received DLC. This parameter depends on the parameter CanIfPrivateDlcCheck.If CanIfPrivateDlcCheck is true and if an RxPdu with invalid DLC is received. It is notified to <User_DlcErrorNotifaction>.
      boolean CanIfPublicUserTpTxInOfflineMode: origin=RB:21.0.0:2016-07-31, set at pre-compile  # This parameter configures whether CANTP/USER Pdus have to be transmitted(TRUE) or not(FALSE) when the TxPdu Mode is OFFLINE.
      function name CanIfPublicUserTxBufClearNotifCallBack [0..1]: multiplicity set at link in variant link-time+post-build / pre-compile in variant pre-compile, origin=RB:21.0.0:2016-07-31, set at link in variant link-time+post-build / pre-compile in variant pre-compile  # This parameter defines the function to be invoked by CanIf when a PDU in the TxBuffer is cleared due to CAN driver couldn't accept the transmission request. This function will be called in Interrupt lock context. So the function has to be very small.
      boolean CanIfPublicUserTxBufClearNotification [0..1]: origin=RB:21.0.0:2016-07-31, set at pre-compile, default-value=false  # This parameter enables/disables the user notification when a PDU in the TxBuffer is cleared due to CAN driver couldn't accept the transmission request.
      boolean CanIfPublicVersionInfoApi: set at pre-compile, default-value=true  # Enables and disables the API for reading the version information about the CAN Interface. True: Enabled False: Disabled
      boolean CanIfPublicWakeupCheckValidByNM [0..1]: scope=ECU, multiplicity set at pre-compile, set at pre-compile, default-value=false  # If enabled, only NM messages shall validate a detected wake-up event in CanIf. If disabled, all received messages corresponding to a configured Rx PDU shall validate such a wake-up event. This parameter depends on CanIfPublicWakeupCheckValidSupport and shall only be configurable, if it is enabled. True: Enabled False: Disabled
      boolean CanIfPublicWakeupCheckValidSupport: scope=ECU, set at pre-compile, default-value=false  # Selects support for wake up validation. True: Enabled False: Disabled
      boolean CanIfRbChangeRxPduIdApi [0..1]: scope=ECU, origin=RB:5.0.0:2018-04-30, set at pre-compile, default-value=false  # Enables and disables the API for reconfiguration of the CAN Identifier for each Receive L-PDU. True: Enabled False: Disabled.
      string CanIfRbPublicDlcErrorNotifHeaderFile [0..1]: multiplicity set at pre-compile, origin=RB:5.0.0:2018-04-04, set at pre-compile, max-length=32, min-length=1  # Defines header files for callback functions which shall be included in case CanIfPublicUserDlcErrorNotificationName parameter is configured.
      string CanIfRbPublicUserHeaderFile [0..*]: multiplicity set at pre-compile, origin=RB:21.0.0:2018-03-19, set at pre-compile, max-length=32, min-length=1  # Defines header files for callback functions which shall be included in case of USER. Range of characters is 1.. 32
      boolean CanIfRbVarDlcSupport [0..1]: origin=RB:9.4.0:2020-10-15, set at pre-compile, default-value=false  # Determines if or if not CanIf shall enable Variable DLC handling .
      boolean CanIfReadMsgIdApi [0..1]: origin=RB:21.0.0:2016-07-31, set at pre-compile, default-value=false  # Enables / Disables the APIs CanIf_ReadTxmsgId() and CanIf_ReadRxmsgId() for reading configured CanId for configured hardware object (HOH). True: Enabled False: Disabled.
      boolean CanIfSetBaudrateApi [0..1]: scope=ECU, multiplicity set at pre-compile, set at pre-compile, default-value=false  # Configuration parameter to enable/disable the CanIf_SetBaudrate API to change the baud rate of a CAN Controller. If this parameter is set to true the CanIf_SetBaudrate API shall be supported. Otherwise the API is not supported.
      boolean CanIfTriggerTransmitSupport: scope=ECU, multiplicity set at pre-compile, default-value=true  # Enables the CanIf_TriggerTransmit API at Pre-Compile-Time. Therefore, this parameter defines if there shall be support for trigger transmit transmissions. | TRUE: Enabled FALSE: Disabled
      boolean CanIfTxOfflineActiveSupport: scope=ECU, set at pre-compile, default-value=false  # Determines wether TxOffLineActive feature (see SWS_CANIF_00072) is supported by CanIf. | True: Enabled False: Disabled
      boolean CanIfWakeupSupport: scope=ECU, set at pre-compile, default-value=true  # Enables the CanIf_CheckWakeup API at Pre-Compile-Time. Therefore, this parameter defines if there shall be support for wake-up. | TRUE: Enabled FALSE: Disabled
      container CanIfRbCalibrationSupport [0..1]  # This container contains the switch which has to be enabled/disabled for Calibration support
        boolean CanIfRbCalibration [0..1]: origin=RB:5.4.0:2018-09-26, set at link in variant link-time / post-build in variant post-build / pre-compile in variant pre-compile, default-value=false  # This parameter defines whether CanIf supports calibration (of Tx CanId, Rx CanId, Tx DLC, Rx DLC and assigning Node for the Pdus) or not.
    container CanIfTrcvDrvCfg [0..*]: multiplicity set at pre-compile  # This container contains the configuration (parameters) of all addressed CAN transceivers by each underlying CAN Transceiver Driver module. For each CAN transceiver Driver a seperate instance of this container shall be provided.
      container CanIfTrcvCfg [1..*]: multiplicity set at pre-compile  # This container contains the configuration (parameters) of one addressed CAN transceiver by the underlying CAN Transceiver Driver module. For each CAN transceiver a seperate instance of this container has to be provided.
        integer CanIfTrcvId: 0..255, scope=ECU, set at pre-compile, symbolic-name-value=true, with-auto=true  # This parameter abstracts from the CAN Transceiver Driver specific parameter Transceiver. Each transceiver of all connected CAN Transceiver Driver modules shall be assigned to one specific TransceiverId of the CanIf. Range: 0..number of configured transceivers of all CAN Transceiver Driver modules
        boolean CanIfTrcvWakeupSupport: scope=ECU, set at link in variant link-time+post-build / pre-compile in variant pre-compile, default-value=false  # This parameter defines if a respective transceiver of the referenced CAN Transceiver Driver modules is queriable for wake up events. True: Enabled False: Disabled
        symbolic name reference CanIfTrcvCanTrcvRef: scope=ECU, set at link in variant link-time+post-build / pre-compile in variant pre-compile, destination=CanTrcvChannel  # This parameter references to the logical handle of the underlying CAN. Currently unused parameter. transceiver from the CAN transceiver driver module to be served by the CAN Interface module. Range: 0..max. number of underlying supported CAN transceivers

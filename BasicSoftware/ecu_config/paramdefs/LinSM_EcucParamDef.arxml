AUTOSAR XML (schema 4-2-2)
package /AUTOSAR_LinSM/EcucModuleDefs
  module definition LinSM [0..1]: category=VENDOR_SPECIFIC_MODULE_DEFINITION, post-build-variant-support=true, refined-module-def=LinSM, variants link-time/post-build/pre-compile  # Lin State manager Module | Configuration of the Lin State Manager module(with vendor specific enhancements of RB).
    container LinSMConfigSet  # This container contains the configuration parameters and sub containers of the AUTOSAR LinSm module.
      integer LinSMModeRequestRepetitionMax: 0..255, origin=RB:2019-09-09, post-build-variant-value=true, set at link in variant link-time / post-build in variant post-build / pre-compile in variant pre-compile  # Specifies the maximal amount of mode request repetitions without a respective mode indication from the LinIf module until the LinSM module reports a Production Error to the Dem and tries to go back to no communication.
      container LinSMChannel [1..*]  # Describes each LIN channel the LinSM is connected to.
        float LinSMConfirmationTimeout: 0..Inf, set at pre-compile  # Timeout in seconds for the goto sleep and wakeup calls to LinIf. The timeout must be longer than a goto-sleep command on the bus (i.e. it is bit rate dependent).
        boolean LinSMEnableScheduleTableQueue [0..1]: origin=RB:2016-03-15, set at pre-compile, default-value=false  # This parameter enables or disables of queue Handling for Run Once Schedule table per channel.
        integer LinSMMaxQUEUESize [0..1]: 1..255, origin=RB:2016-03-16, set at pre-compile  # This parameter holds the Maximum queue size
        boolean LinSMSleepSupport: origin=RB:2017-01-13, set at pre-compile  # Some LIN clusters does not need sleep, they will just shut off. This parameter will affect the behavior to achieve the no communication state.
        boolean LinSMTransceiverPassiveMode [0..1]: multiplicity set at pre-compile, set at pre-compile  # Selects STANDBY (true) or SLEEP (false) transceiver mode when entering LINSM_NO_COM.
        integer LinSmNetworkIndex: 0..255, origin=RB:2016-09-21, set at pre-compile, symbolic-name-value=true, with-auto=true  # This parameter holds the unique channel index value. The value shall be the same as the ComMChannelId of the ComMChannel referenced by LinSMComMNetworkHandleRef. Implementation Type: NetworkHandleType
        symbolic name reference LinSMChannelIndex: origin=RB:2016-09-23, set at pre-compile, destination=LinIfChannel  # Index of the controller. To be able to interface to the correct hw.
        symbolic name reference LinSMComMNetworkHandleRef: set at pre-compile, destination=ComMChannel  # Unique handle to identify one certain LIN network. Reference to one of the network handles configured in the ComM.
        container LinSMSchedule [1..*]: multiplicity set at link in variant link-time / post-build in variant post-build / pre-compile in variant pre-compile, post-build-variant-multiplicity=true  # The schedule references to a schedule that is located in the LinIf configuration. Moreover, the PDU groups are located in the COM configuration. Note that there are two references to PDU groups. The simple reason is that a PDU group is only allowed to contain one direction (TX or RX).
          integer LinSMScheduleIndex: 0..255, set at pre-compile, symbolic-name-value=true  # This index parameter can be used by the BswM as a SymbolicNameReference target. The LinSM just forwards the request from the BswM to LinIf. Note that the value of the LinSMScheduleIndex shall be the same as the value from the LinIf.
          integer LinSMScheduleTablePriority [0..1]: 1..255, origin=RB:2016-03-15, set at pre-compile  # This parameter holds the priority of each schedule table
          symbolic name reference LinSMScheduleIndexRef: post-build-variant-value=true, set at link in variant link-time / post-build in variant post-build / pre-compile in variant pre-compile, destination=LinIfScheduleTable  # Reference to a schedule table in the LinIf configuration
        container LinSmDemEventParameterRefs [0..1]  # Container for the references to DemEventParameter elements which shall be invoked using the API Dem_ReportErrorStatus API in case the corresponding error occurs. The EventId is taken from the referenced DemEventParameter's DemEventId value. The standardized errors are provided in the container and can be extended by vendor specific error references.
          enumeration LinSMRbDynCreate_LINSM_E_CONFIRMATION_TIMEOUT [0..1]: {Disabled, Standard}, origin=RB:2015-02-18, set at pre-compile, default-value=Disabled  # Selects the way how the LinSM DemEvents are created and referenced. If not set or set to "Disabled", no such DemEvent is automatically/dynamically created. If the dynamic creation of this DemEvent is standard, the reference to this DemEvent (in parameter LINSM_E_CONFIRMATION_TIMEOUT) is also automatically created and shall therefore not be set manually.
          symbolic name reference LINSM_E_CONFIRMATION_TIMEOUT [0..1]: origin=RB:2016-01-01, set at pre-compile, destination=DemEventParameter  # Reference to the DemEventParameter which shall be issued when the error "Timeout of the callbacks from LinIf" has occured.
    container LinSMGeneral  # This container contains general parameters of LIN State Manager module.
      boolean LinSMDSMReInitEnabled [0..1]: set at pre-compile, default-value=false  # Enables or disables the reporting of DEM events to DSM after the Re-initialisation of DSM has occured.
      boolean LinSMDevErrorDetect: set at pre-compile  # Switches the Development Error Detection and Notification ON or OFF. | * true: enabled (ON). * false: disabled (OFF).
      float LinSMMainProcessingPeriod: 0..Inf, set at pre-compile  # Fixed period that the MainFunction shall be called.
      boolean LinSMVersionInfoApi: set at pre-compile  # Switches the LinSM_GetVersionInfo function ON or OFF.

AUTOSAR XML (schema 00044)
package /AUTOSAR_Rte_Rips_CSXfrm/EcucModuleDefs
  module definition Rte_Rips_CSXfrm [0..1]: category=VENDOR_SPECIFIC_MODULE_DEFINITION, variants pre-compile  # Configuration of the RIPS module to support Inter-ECU C/S Communication with Transformers.
    container RteRipsPluginProps: destination-uri=RteRipsPlugin  # This container defines the identity of the Rte Implementation Plug-in and provides the RTE relevant parameters of the Rte Implementation Plug-in.
      boolean RtePluginSupportsIReadIWrite: default-value=false  # Denotes if or if not the plug-in supports the Rte_Rips_IRead/IWrite macros for primitive/complex data.
      enumeration RteRipsGlobalCopyInstantiationPolicy: {RTE_RIPS_INSTANTIATION_BY_PLUGIN, RTE_RIPS_INSTANTIATION_BY_RTE}, default-value=RTE_RIPS_INSTANTIATION_BY_RTE  # Globally enables or disables the support for Rte Implementation Plug-Ins (RIPS) Tags: atp.Status=draft
      boolean RtePluginSupportsInvokeReturnResult: origin=RB, default-value=false  # Denotes if or if not the plug-in supports the Rte_Rips_Invoke/ReturnResult APIs for (a)synchronous C/S Communication.
      boolean RtePluginSupportsTimoutHandling: origin=RB, default-value=false  # Denotes if or if not the plug-in supports the (a)synchronous C/S Data Transformation via LDCOM_TP.
      boolean RtePluginSupportsLdComTP: origin=RB, default-value=false  # Denotes if or if not the plug-in supports the (a)synchronous C/S Data Transformation via LDCOM_TP.
      boolean RtePluginSupportsLdComIF: origin=RB, default-value=false  # Denotes if or if not the plug-in supports the (a)synchronous C/S Data Transformation via LDCOM_IF.
      enumeration RtePluginCallbackMemMapPolicy: {RTE_RIPS_SIGNAL_BASED_MEMMAP_ENABLED, RTE_RIPS_SIGNAL_BASED_MEMMAP_DISABLED}, origin=RB, default-value=RTE_RIPS_SIGNAL_BASED_MEMMAP_ENABLED  # Globally enables or disables the support for Rte Implementation Plug-Ins (RIPS)
    container RteRipsPluginFillFlushRoutine [0..*]: destination-uri=RteRipsPluginFillFlushRoutine
      enumeration RteRipsModeDisablingHandling: {RTE_RIPS_CONSIDER_MODE_DISABLINGS, RTE_RIPS_IGNORE_MODE_DISABLINGS}  # This parameter configures whether mode disabling dependencies are considered for the invocation of Rte_Rips_FillFlushRoutines.
      enumeration RteRipsOsSchedulePoint [0..1]: {NONE, UNCONDITIONAL}  # Introduce a schedule point by explicitly calling Os Schedule service after the execution of the Rte_Rips_FillFlushRoutine.
      function name RteRipsPluginFillFlushRoutineSymbol: origin=RB  # C-Symbol of the Rte_Rips_FillFlushRoutine function.
    container RteRipsInvocationHandler [0..*]: destination-uri=RteRipsInvocationHandler
      container RteRipsInvocationHandlerFnc [0..*]  # This container describes an invocation handler function implemented by an RTE Implementation Plug-In to handle the invocation of server runnables.
        function name RteRipsInvocationHandlerFncSymbol  # C-Symbol of the Rte_Rips_InvocationHandler function.

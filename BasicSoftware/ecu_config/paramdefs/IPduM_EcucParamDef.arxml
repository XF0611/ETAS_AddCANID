AUTOSAR XML (schema 4-2-2)
package /AUTOSAR_IpduM/EcucModuleDefs
  module definition IpduM [0..1]: category=VENDOR_SPECIFIC_MODULE_DEFINITION, post-build-variant-support=true, refined-module-def=IpduM, variants pre-compile  # I-Pdu Multiplexer Module | Configuration of the IpduM (Ipdu Multiplexer) module.
    container IpduMConfig  # This container contains the sub containers of the IpduM module.The IpduMTxPathway subcontainer includes information about sent I-PDUs. The IpduMRxPathway includes information about received I-PDUs. The IpduMTxContainerPdu and IpduMTxContainedPdu include information about the sending of ContainerPdus. The IpduMRxContainerPdu and IpduMRxContainedPdu include information about the reception of ContainerPdus
      integer IpduMMaxTxBufferSize [0..1]: 0..65535, multiplicity set at pre-compile, set at pre-compile  # Maximum total size of all Tx buffers. This parameter is needed only in case of post-build loadable implementation using static memory allocation. This parameter is currently not supported.
      integer IpduMMaxTxPathwayCnt [0..1]: 0..65535, multiplicity set at pre-compile, set at pre-compile  # Maximum number of transmitted IPdus. This parameter is needed only in case of post-build loadable implementation using static memory allocation. This parameter is currently not supported.
      container IpduMContainedRxPdu [0..*]: multiplicity set at pre-compile, post-build-variant-multiplicity=true  # Configuration of a received contained Pdu.
        integer IpduMContainedPduOffset [0..1]: 0..4294967295, post-build-variant-value=true, set at pre-compile  # Static offset (in bytes) of the ContainedPdu. Only valid if IpduMContainerHeaderSize is set to IPDUM_HEADERTYPE_NONE.
        integer IpduMContainedRxPduLongHeaderId [0..1]: 1..4294967295, multiplicity set at pre-compile, post-build-variant-multiplicity=true, post-build-variant-value=true, set at pre-compile  # LongHeader Id which is part of the ContainerPdu when this ContainedPdu is inside.
        integer IpduMContainedRxPduShortHeaderId [0..1]: 1..16777215, multiplicity set at pre-compile, post-build-variant-value=true, set at pre-compile  # ShortHeader Id which is part of the ContainerPdu when this ContainedPdu is inside.
        integer IpduMPduUpdateBitPosition [0..1]: 0..4294967295, scope=ECU, post-build-variant-value=true, set at pre-compile  # This value specifies where the PDU's Update-Bit is stored in the Container PDU (bit location of PDU's Update-Bit in the Container PDU). Only valid if IpduMContainerHeaderSize is set to IPDUM_HEADERTYPE_NONE.
        reference IpduMContainedRxInContainerPduRef [0..1]: multiplicity set at pre-compile, post-build-variant-multiplicity=true, post-build-variant-value=true, set at pre-compile, destination=IpduMContainerRxPdu  # Optional reference to a container Pdu this contained Pdu may be transported in. The reference may be omitted in case IpduMContainerRxAcceptContainedPdu=IPDUM_ACCEPT_ALL.
        reference IpduMContainedRxPduRef: scope=ECU, post-build-variant-value=true, set at pre-compile, destination=Pdu  # Reference to the Pdu which represents this ContainedPdu and is used for reception indication.
      container IpduMContainedTxPdu [0..*]: multiplicity set at pre-compile, post-build-variant-multiplicity=true  # Configuration of a sender ContainedPdu.
        integer IpduMContainedPduHeaderId [0..1]: 1..4294967295, post-build-variant-value=true, set at pre-compile  # Header Id which is part of the ContainerPdu when this ContainedPdu is inside.
        integer IpduMContainedPduOffset [0..1]: 0..4294967295, post-build-variant-value=true, set at pre-compile  # Static offset (in bytes) of the ContainedPdu. Only valid if IpduMContainerHeaderSize is set to IPDUM_HEADERTYPE_NONE.
        enumeration IpduMContainedTxPduCollectionSemantics: {IPDUM_COLLECT_LAST_IS_BEST, IPDUM_COLLECT_QUEUED}, post-build-variant-value=true, set at pre-compile  # Defines whether this IpduMContainedTxPdu shall be collected using a last-is-best or queued semantics.
        boolean IpduMContainedTxPduConfirmation [0..1]: multiplicity set at pre-compile, set at pre-compile, default-value=false  # This Parameter determines whether for this contained I-PDU a TxConfirmation shall be provided. If set to TRUE a TxConfirmation is issued. It is not used when an I-PDU is requested using the trigger transmit API. If this Parameter is omitted, the default value shall be used.
        integer IpduMContainedTxPduHandleId: 0..65535, scope=ECU, set at pre-compile, symbolic-name-value=true  # Handle Id of the ContainedPdu.
        integer IpduMContainedTxPduPriority [0..1]: 0..255, multiplicity set at pre-compile, post-build-variant-multiplicity=true, post-build-variant-value=true, set at pre-compile, default-value=255  # Defines a priority of a ContainedTxPdu. 255 represents the lowest priority and 0 represent the highest priority. | Dependency: The IpduMContainedTxPduPriority shall only be considered if IpduMContainedTxPduPriorityHandling is set to TRUE.
        float IpduMContainedTxPduSendTimeout [0..1]: 0..65.535, multiplicity set at pre-compile, post-build-variant-multiplicity=true, post-build-variant-value=true, set at pre-compile  # Defines a ContainedPdu specific sender timeout which can reduce the ContainerPdu timer when this ContainedPdu is put inside the ContainerPdu. Defined in seconds.
        enumeration IpduMContainedTxPduTrigger: {IPDUM_TRIGGER_ALWAYS, IPDUM_TRIGGER_NEVER}, post-build-variant-value=true, set at pre-compile  # Defines whether this Pdu triggers the sending of the ContainerPdu.
        integer IpduMPduUpdateBitPosition [0..1]: 0..4294967295, scope=ECU, post-build-variant-value=true, set at pre-compile  # This value specifies where the PDU's Update-Bit is stored in the Container PDU (bit location of PDU's Update-Bit in the Container PDU). Only valid if IpduMContainerHeaderSize is set to IPDUM_HEADERTYPE_NONE.
        reference IpduMContainedTxInContainerPduRef: post-build-variant-value=true, set at pre-compile, destination=IpduMContainerTxPdu  # Reference to the container Pdu which this contained Pdu shall be collected in.
        reference IpduMContainedTxPduRef: scope=ECU, post-build-variant-value=true, set at pre-compile, destination=Pdu  # Reference to the Pdu which represents this ContainedPdu and is used for transmission.
      container IpduMContainerRxPdu [0..*]: multiplicity set at pre-compile, post-build-variant-multiplicity=true  # Configuration of a receiver ContainerPdu which may collect several ContainedPdus.
        enumeration IpduMContainerHeaderSize: {IPDUM_HEADERTYPE_LONG, IPDUM_HEADERTYPE_NONE, IPDUM_HEADERTYPE_SHORT}, post-build-variant-value=true, set at pre-compile  # Defines the layout of the header information (header id and length).
        enumeration IpduMContainerPduProcessing: {IPDUM_PROCESSING_DEFERRED, IPDUM_PROCESSING_IMMEDIATE}, post-build-variant-value=true, set at pre-compile  # Defines whether the handling of this ContainerPdu shall be done in the context of the caller (IMMEDIATE) or in the next IpduM main function (DEFERRED).
        integer IpduMContainerQueueSize [0..1]: 1..255, multiplicity set at pre-compile, post-build-variant-multiplicity=true, post-build-variant-value=true, set at pre-compile, default-value=1  # Defines a local queue for handling of each ContainerPdu. Defined in number of instances of this ContainerPdu. Ex: If this parameter is unconfigured or configured to 1 implies there will be one instance of this container Pdu If this parameter configured to 2 implies there will be one instance of this container pdu plus one queued instance. If this paramter configured to 3 implies there will be one instance of this container pdu plus two queued instance and so on. Defined in number of instances of this ContainerPdu.
        enumeration IpduMContainerRxAcceptContainedPdu: {IPDUM_ACCEPT_ALL, IPDUM_ACCEPT_CONFIGURED}, post-build-variant-value=true, set at pre-compile  # Defines for the received IpduMRxContainerPdu whether the list of referencing IpduMRxContainedPdus (via the reference IpduMRxContainedPduContainerRef) is a closed set.
        integer IpduMContainerRxHandleId: 0..65535, scope=ECU, set at pre-compile, symbolic-name-value=true  # Handle Id used by the PduR for RxIndication.
        reference IpduMContainerRxPduRef: scope=ECU, post-build-variant-value=true, set at pre-compile, destination=Pdu  # Reference to the Pdu which represents the container and is used for reception.
        reference IpduMMainFunctionRxRef [0..1]: multiplicity set at pre-compile, set at pre-compile, destination=IpduMMainFunctionRx  # Reference to the IpduM_MainFunctionRx instance this container PDU belongs to. Tags: atp.Status=draft | Mandatory, if more than one IpduM_MainFunctionRx is defined.
      container IpduMContainerTxPdu [0..*]: multiplicity set at pre-compile, post-build-variant-multiplicity=true  # Configuration of a transmitted container Pdu.
        enumeration IpduMContainerHeaderSize: {IPDUM_HEADERTYPE_LONG, IPDUM_HEADERTYPE_NONE, IPDUM_HEADERTYPE_SHORT}, post-build-variant-value=true, set at pre-compile  # Defines the layout of the header information (header id and length).
        integer IpduMContainerQueueSize [0..1]: 1..255, multiplicity set at pre-compile, post-build-variant-multiplicity=true, post-build-variant-value=true, set at pre-compile, default-value=1  # Defines a local queue for handling of each ContainerPdu.Defined in number of instances of this ContainerPdu.
        float IpduMContainerTxConfirmationTimeout [0..1]: 0..65.535, multiplicity set at pre-compile, post-build-variant-multiplicity=true, post-build-variant-value=true, set at pre-compile  # This timeout (in seconds) defines the timeout period for monitoring the reception of the TxConfirmation. It is not used when an I-PDU is requested using the trigger transmit API. If this Parameter is omitted, the default value shall be used.
        boolean IpduMContainerTxDisableLastIsBestProcessing [0..1]: origin=RB:2018-12-31, set at pre-compile, default-value=false  # Switch to Enable or Disable the LAST_IS_BEST Processing of all Contained Pdu's inside Container Tx PDU whose TriggerMode is set as IPDUM_TRIGGERTRANSMIT. Should be configured only for Containers having ContainerTxTriggerMode set as IPDUM_TRIGGERTRANSMIT.
        boolean IpduMContainerTxFirstContainedPduTrigger: post-build-variant-value=true, set at pre-compile  # Defines if the transmission of this IpduMContainerTxPdu shall be requested right after the first IpduMContainedTxPdu was put into it.
        integer IpduMContainerTxHandleId [0..1]: 0..65535, scope=ECU, multiplicity set at pre-compile, set at pre-compile, symbolic-name-value=true  # Handle Id used by the PduR for TxConfirmation and for TriggerTransmit of the ContainerPdu.
        float IpduMContainerTxSendTimeout [0..1]: 0..65.535, multiplicity set at pre-compile, post-build-variant-multiplicity=true, post-build-variant-value=true, set at pre-compile  # When this timeout expires the ContainerPdu is triggered for sending. The respective timer is started when the first Pdu is put into the ContainerPdu.If this Parameter is omitted, the default value shall be used.
        integer IpduMContainerTxSizeThreshold [0..1]: 0..4294967295, multiplicity set at pre-compile, post-build-variant-multiplicity=true, post-build-variant-value=true, set at pre-compile  # Defines the size threshold in bytes which, when exceeded, triggers the sending of the ContainerPdu although the maxium Pdu size (PduLength parameter of Pdu object) has not been reached yet.
        enumeration IpduMContainerTxTriggerMode: {IPDUM_DIRECT, IPDUM_TRIGGERTRANSMIT}, post-build-variant-value=true, set at pre-compile  # Defines whether this ContainerPdu is fetched via trigger transmit.
        integer IpduMUnusedAreasDefault [0..1]: 0..255, scope=ECU, multiplicity set at pre-compile, post-build-variant-value=true, set at pre-compile  # IpduM fills not updated areas of the Container PDU with this byte-pattern. Only valid if IpduMContainerHeaderSize is set to IPDUM_HEADERTYPE_NONE and should be aligned to bus-specific padding value if available.
        reference IpduMContainerTxPduRef: scope=ECU, post-build-variant-value=true, set at pre-compile, destination=Pdu  # Reference to the Pdu which represents the container and is used for transmission.
        reference IpduMIPduMainFunctionRef [0..1]: origin=RB:2019-12-31, set at pre-compile, destination=IpduMMainFunction  # Reference to the IpduM_MainFunctionTx instance this I-PDU belongs to. Mandatory, if multi-core distribution feature is enabled.
      container IpduMMainFunctionRx [0..*]: multiplicity set at pre-compile  # Each element of this container defines one instance IpduM_MainFunctionRx, in case multi-core distribution feature is active. Tags: atp.Status=draft
        float IpduMMainRxTimeBase: 0..INF, set at pre-compile  # The period between successive calls to according instance of IpduM_MainFunctionRx in seconds. This parameter may be used by the IpduM generator to transform the values of the reception related timing configuration parameters of the IpduM module to internal implementation specific counter or tick values. The IpduM module's internal timing handling is implementation specific. Tags: atp.Status=draft | The IpduM module (generator) may rely on the fact that IpduM_MainFunctionRx is scheduled according to the value configured here.
        reference IpduMMainRxPartitionRef: set at pre-compile, destination=EcucPartition  # Reference to EcucPartition, where the according IpduM_MainFunction instance is assigned to. Tags: atp.Status=draft
      container IpduMRxPathway [0..*]: multiplicity set at pre-compile, post-build-variant-multiplicity=true  # Contains the configuration parameters received I-PDUs by the IpduM module.
        container IpduMRxIndication  # Contains the configuration for incoming RxIndication calls.
          enumeration IpduMByteOrder: {BIG_ENDIAN, LITTLE_ENDIAN}, post-build-variant-value=true, set at pre-compile  # This parameter defines the ByteOrder for all IpduMSegments (static and dynamic part) and for the selectorField within the MultiplexedPdu.The absolute position of a segment in the MultiplexedIPdu is determined by the definition of the ByteOrder parameter: If BIG_ENDIAN is specified, the SegmentPosition indicates the bit position of the most significant bit in an IPDU. If LITTLE_ENDIAN is specified, the SegmentPosition indicates the bit position of the least significant bit in an IPDU. The absolute position of a segment in the MultiplexedIPdu is determined by the definition of the ByteOrder parameter: If BIG_ENDIAN is specified, the SegmentPosition indicates the bit position of the most significant bit in an IPDU. If LITTLE_ENDIAN is specified, the SegmentPosition indicates the bit position of the least significant bit in an IPDU.
          integer IpduMRxHandleId: 0..65535, scope=ECU, set at pre-compile, symbolic-name-value=true, with-auto=true  # This is the I-PDU ID of the incoming I-PDU. If an incoming RxIndication's I-PDU ID matches this value then it is unpacked according to the specification in this container.
          reference IpduMRxIndicationPduRef: scope=ECU, post-build-variant-value=true, set at pre-compile, destination=Pdu  # Reference to the received Pdu representation in the ECU Configuration Description exchange file.
          container IpduMRxDynamicPart [1..*]: multiplicity set at pre-compile, post-build-variant-multiplicity=true  # This container contains the configuration for the dynamic part of incoming RxIndication calls. When an incoming received I-PDU's selector field matches the IpduMRxSelectorValue, the new outgoing I-PDU for the dynamic part is constructed as defined by the segments (defined in the IpduMDynamicSegment container) and sent out with the I-PDU ID referenced by IpduMOutgoingDynamicPduRef. In case no dynamic part shall be extracted from this received I-PDU this container does not exist. This use-case can occur in case a MultiplexedIPdu is received by an ECU which is only interested in the static part of the MultiplexedIPdu.
            integer IpduMRxSelectorValue: 0..65535, post-build-variant-value=true, set at pre-compile  # This is the selector value that this container refers to.
            reference IpduMOutgoingDynamicPduRef: scope=ECU, post-build-variant-value=true, set at pre-compile, destination=Pdu  # When the new I-PDU is sent out it is sent with this I-PDU ID. Reference to the sent PDU representation in the ECU Configuration Description exchange file.
          container IpduMRxDynamicSegment [1..*]: multiplicity set at pre-compile, post-build-variant-multiplicity=true  # The dynamic part of the multiplexed incoming I-Pdu (referenced by IpduMRxIndicationPduRef) can be separated into several segments. For each segment one IpduMRxDynamicSegment container shall be created that contains the location and the length of the segment. Please note that each configured segment will be copied into the destination I-Pdu that is referenced in the IpduMRxDynamicPart container and will be copied from the same location in the multiplexed incoming I-Pdu. The segment layout for all dynamic Parts is always identical.
            integer IpduMSegmentLength: 1..2032, post-build-variant-value=true, set at pre-compile  # Length of the segment in bits.
            integer IpduMSegmentPosition: 0..2031, post-build-variant-value=true, set at pre-compile  # Segments bit position in the multiplexed Pdu.
          container IpduMRxStaticPart [0..1]: multiplicity set at pre-compile  # This container contains the configuration for the static part of incoming RxIndication calls. On reception, the new outgoing I-PDU for the static part is constructed as defined by the segments (defined in the IpduMStaticSegment container) and sent out with the I-PDU ID referenced by IpduMOutgoingStaticPduRef.
            reference IpduMOutgoingStaticPduRef: scope=ECU, post-build-variant-value=true, set at pre-compile, destination=Pdu  # When the new I-PDU is sent out it is sent with this I-PDU ID. Reference to the sent Pdu representation in the ECU Configuration Description exchange file.
          container IpduMRxStaticSegment [0..*]: multiplicity set at pre-compile, post-build-variant-multiplicity=true  # The static part of the multiplexed incoming I-Pdu (referenced by IpduMRxIndicationPduRef) can be separated into several segments. For each segment one IpduMRxStaticSegment container shall be created that contains the location and the length of the segment. Please note that each configured segment will be copied into the destination I-Pdu that is referenced in the IpduMRxStaticPart container and will be copied from the same location in the multiplexed incoming I-Pdu.
            integer IpduMSegmentLength: 1..2032, post-build-variant-value=true, set at pre-compile  # Length of the segment in bits.
            integer IpduMSegmentPosition: 0..2031, post-build-variant-value=true, set at pre-compile  # Segments bit position in the multiplexed Pdu.
          container IpduMSelectorField  # This contains the location and the length of the selector field.
            integer IpduMSelectorFieldLength: 1..16, post-build-variant-value=true, set at pre-compile  # Length of the selector field in bits.
            integer IpduMSelectorFieldPosition: 0..2031, post-build-variant-value=true, set at pre-compile  # Selector field bit position in the multiplexed Pdu. Range: 0..63 for CAN/ LIN I-PDUs, 0..511 for CAN FD I-PDUs, 0..2031 for FlexRay I-PDUs.
      container IpduMTxPathway [0..*]: multiplicity set at pre-compile, post-build-variant-multiplicity=true  # Contains the configuration parameters transmitted I-PDUs by the IpduM module.
        container IpduMTxRequest  # This container is used to specify the configuration for Transmit requests. There will be one instance of this container for each I-PDU that can be requested for transmission (the outgoing I-PDUs) by the IpduM.
          enumeration IpduMByteOrder: {BIG_ENDIAN, LITTLE_ENDIAN}, post-build-variant-value=true, set at pre-compile  # This parameter defines the ByteOrder for all segments (static and dynamic part) and for the selectorField within the MultiplexedPdu. The absolute position of a segment in the MultiplexedIPdu is determined by the definition of the ByteOrder parameter: If BIG_ENDIAN is specified, the SegmentPosition indicates the bit position of the most significant bit in an IPDU. If LITTLE_ENDIAN is specified, the SegmentPosition indicates the bit position of the least significant bit in an IPDU.
          integer IpduMIPduUnusedAreasDefault [0..1]: 0..255, multiplicity set at pre-compile, post-build-variant-multiplicity=true, post-build-variant-value=true, set at pre-compile  # IpduM module fills not used areas of an I-PDU with this bit-pattern. If this attribute is omitted the IpduM module does not fill the I-PDU.
          integer IpduMTxConfirmationPduId: 0..65535, multiplicity set at pre-compile, set at pre-compile, symbolic-name-value=true, with-auto=true  # Handle Id used by the PduR for confirmation (IpduM_TxConfirmation) and for TriggerTransmit (IpduM_TriggerTransmit). The existence of this parameter is essential for the PduR generation tool to actually find a symbolicNameValue for the OutgoingPdu.
          float IpduMTxConfirmationTimeout [0..1]: 0..3600, multiplicity set at pre-compile, post-build-variant-multiplicity=true, post-build-variant-value=true, set at pre-compile  # This timeout (in seconds) defines the timeout period for monitoring the reception of the TxConfirmation. Min and Max are not supported. It is not used when an I-PDU is requested using the trigger transmit API.
          enumeration IpduMTxTriggerMode: {DYNAMIC_PART_TRIGGER, NONE, STATIC_OR_DYNAMIC_PART_TRIGGER, STATIC_PART_TRIGGER}, post-build-variant-value=true, set at pre-compile  # Selects whether to send the multiplexed I-PDU immediately or at some later date.
          reference IpduMInitialDynamicPart: post-build-variant-value=true, set at pre-compile, destination=IpduMTxDynamicPart  # Reference to the dynamic part that shall be used to initialize this multiplexed TX-I-PDU.
          reference IpduMOutgoingPduRef: scope=ECU, post-build-variant-value=true, set at pre-compile, destination=Pdu  # Reference to the PDU defining the outgoing I-PDU.When the outgoing I-PDU is sent this is the I-PDU ID to give it. It is the IpduM I-PDU ID of the assembled I-PDU.
          container IpduMSelectorField  # This contains the location and the length of the selector field.
            integer IpduMSelectorFieldLength: 1..16, post-build-variant-value=true, set at pre-compile  # Length of the selector field in bits.
            integer IpduMSelectorFieldPosition: 0..2031, post-build-variant-value=true, set at pre-compile  # Selector field bit position in the multiplexed Pdu. Range: 0..63 for CAN/ LIN I-PDUs, 0..511 for CAN FD I-PDUs, 0..2031 for FlexRay I-PDUs.
          container IpduMTxDynamicPart [1..*]: multiplicity set at pre-compile, post-build-variant-multiplicity=true  # Configuration parameters for an instance of a TxRequest call into the IpduM. When a Tx Request with the IpduMTxDynamicHandleId is received by the IpduM, all segments (defined in the IpduMDynamicSegment container) are copied from the incoming I-PDU into the outgoing I-PDU buffer and then the send mode honored. This container is used by the dynamic part of a TxRequest configuration. Therefore, for each outgoing I-PDU there will be one instance of this container for the dynamic part.
            boolean IpduMJitUpdate [0..1]: multiplicity set at pre-compile, post-build-variant-multiplicity=true, post-build-variant-value=true, set at pre-compile, default-value=false  # If configured to true fetch the data of this part Just-In-Time via the triggerTransmit API of the PduR.
            boolean IpduMTxDynamicConfirmation: post-build-variant-value=true, set at pre-compile  # A transmit request can be confirmed by the lower layer. If this parameter is set to true a confirmation of the I-PDU in COM representing the dynamic part is generated.
            integer IpduMTxDynamicHandleId: 0..65535, scope=ECU, set at pre-compile, symbolic-name-value=true, with-auto=true  # This defines an incoming handle id. When the handle of an incoming Tx Request matches this id, the configured dynamic segments are copied and the IpduMTxTriggerMode is honored.
            reference IpduMTxDynamicPduRef: scope=ECU, post-build-variant-value=true, set at pre-compile, destination=Pdu  # Reference to the Pdu representation in the ECU Configuration Description exchange file to be transmitted.
          container IpduMTxDynamicSegment [1..*]: multiplicity set at pre-compile, post-build-variant-multiplicity=true  # The dynamic part of the multiplexed outgoing I-Pdu (referenced by IpduMOutgoingPduRef) can be separated into several segments. For each segment one IpduMTxDynamicSegment container shall be created that contains the location and the length of the segment. Please note that each configured segment will be copied out of the source I-Pdu that is referenced in the IpduMTxDynamicPart container and will be copied to the same location in the multiplexed outgoing I-Pdu. The segment layout for all dynamic Parts is always identical.
            integer IpduMSegmentLength: 1..2032, post-build-variant-value=true, set at pre-compile  # Length of the segment in bits.
            integer IpduMSegmentPosition: 0..2031, post-build-variant-value=true, set at pre-compile  # Segments bit position in the multiplexed Pdu.
          container IpduMTxStaticPart [0..1]: multiplicity set at pre-compile  # Configuration parameters for an instance of a Tx_Request call into the IpduM. When a Tx Request with the IpduMTxStaticHandleId is received by the IpduM, all segments (defined in the IpduMStaticSegment container) are copied from the incoming I-PDU into the outgoing I-PDU buffer and then the send mode honored. This container is used for the static part of a TxRequest configuration. Therefore, for each outgoing I-PDU there will be one instance of this container for the static part if it exists.
            boolean IpduMJitUpdate [0..1]: multiplicity set at pre-compile, post-build-variant-multiplicity=true, post-build-variant-value=true, set at pre-compile, default-value=false  # If configured to true fetch the data of this part Just-In-Time via the triggerTransmit API of the PduR.
            boolean IpduMTxStaticConfirmation: post-build-variant-value=true, set at pre-compile  # A transmit request can be confirmed by the lower layer. If this parameter is set to true a confirmation of the I-PDU in COM representing the static part is generated.
            integer IpduMTxStaticHandleId: 0..65535, scope=ECU, set at pre-compile, symbolic-name-value=true, with-auto=true  # This defines an incoming handle id. When the handle of an incoming Tx Request matches this id, the configured static segments are copied and the IpduMTxTriggerMode is honored.
            reference IpduMTxStaticPduRef: scope=ECU, post-build-variant-value=true, set at pre-compile, destination=Pdu  # Reference to the Pdu representation in the ECU Configuration Description exchange file to be transmitted.
          container IpduMTxStaticSegment [0..*]: multiplicity set at pre-compile, post-build-variant-multiplicity=true  # The static part of the multiplexed outgoing I-Pdu (referenced by IpduMOutgoingPduRef) can be separated into several segments. For each segment one IpduMTxStaticSegment container shall be created that contains the location and the length of the segment. Please note that each segment in the source I-Pdu that is referenced in the IpduMTxStaticPart container will be copied to the same location in the multiplexed outgoing I-Pdu.
            integer IpduMSegmentLength: 1..2032, post-build-variant-value=true, set at pre-compile  # Length of the segment in bits.
            integer IpduMSegmentPosition: 0..2031, post-build-variant-value=true, set at pre-compile  # Segments bit position in the multiplexed Pdu.
    container IpduMGeneral  # Contains the general configuration parameters of IpduM.
      boolean IpduMContainedTxPduPriorityHandling [0..1]: scope=ECU, multiplicity set at pre-compile, set at pre-compile, default-value=false  # This parameter enables/disables handling of priority for IpduMContai-nedTxPdu's with IpduMContainedTxPduCollectionSemantics IPDUM_LAST_IS_BEST. * true: enabled (ON). * false: disabled (OFF).
      boolean IpduMDevErrorDetect: set at pre-compile  # Switches the Default Error Tracer (Det) detection and notification ON or OFF. * true: enabled (ON). * false: disabled (OFF).
      enumeration IpduMHeaderByteOrder [0..1]: {IPDUM_BIG_ENDIAN, IPDUM_LITTLE_ENDIAN}, set at pre-compile  # This parameter defines the ByteOrder of the headers inside a Container I-PDU.
      float IpduMRxTimeBase [0..1]: 0..3600, scope=ECU, multiplicity set at pre-compile, set at pre-compile  # The period between successive calls to IpduM_MainFunctionRx in seconds. This parameter may be used by the IpduM generator to transform the values of the reception related timing configuration parameters of the IpduM module to internal implementation specific counter or tick values. The IpduM module's internal timing handling is implementation specific. | The IpduM module (generator) may rely on the fact that IpduM_MainFunctionRx is scheduled according to the value configured here.
      boolean IpduMStaticPartExists: set at pre-compile  # This is to allow optimizations in the case the IpduM will never be used with a static part. Note that this is a pre-compile option. If this is set to False then it will not be possible to add static parts after compilation. True: A static part may exist. False: A static part will never exist.
      float IpduMTxTimeBase [0..1]: 0..3600, scope=ECU, multiplicity set at pre-compile, set at pre-compile  # The period between successive calls to IpduM_MainFunctionTx in seconds. This parameter may be used by the IpduM generator to transform the values of the reception related timing configuration parameters of the IpduM module to internal implementation specific counter or tick values. The IpduM module's internal timing handling is implementation specific. | The IpduM module (generator) may rely on the fact that IpduM_MainFunctionTx is scheduled according to the value configured here.
      boolean IpduMVersionInfoApi: set at pre-compile  # Active/Deactivate the version information API. true: version information activated false: version information deactivated
    container IpduMMultipleMain [0..1]  # Each element of this container defines one instance IpduM_MainFunctionTx, in case multi-core distribution feature is active.
      container IpduMMainFunction [0..*]  # Generates multiple IpduM_MainFunctionTx's to process the referred Pdus.
        enumeration IpduMMainFunctionDirection: {SEND}, origin=RB:2019-12-31, set at pre-compile  # Direction of IpduMMainFunction. Direction of this IpduMMainFunction and the referred Tx Container direction shall be same.
        string IpduMMainFunctionSuffix: origin=RB:2019-12-31, set at pre-compile  # This parameter shall be used as suffix to generate MainFunction name. For example, if "Core1_10ms" is configured here, then a separate mainFunction is generated as IpduM_MainFunctionRx_Core1_10ms() or as IpduM_MainFunctionTx_Core1_10ms() for Tx-MainFunction respectively.
        float IpduMMainFunctionTimeBase [0..1]: 0..3600, scope=ECU, multiplicity set at pre-compile, origin=RB:2019-12-31, set at pre-compile  # The period between successive calls to IpduM_MainFunctionRx_"IpduMMainFunctionSuffix" or IpduM_MainFunctionTx_"IpduMMainFunctionSuffix" in seconds for Rx- or Tx-IpduMMainFunction respectively. This parameter may be used by the ipdum generator to transform the values of the reception related timing configuration parameters of the ipdum module to internal implementation specific counter or tick values. The IpduM module's internal timing handling is implementation specific. .
    container IpduMPublishedInformation  # Additional published parameters not covered by. CommonPublishedInformation container. Note that these parameters do not have any configuration class setting, since they are published information.
      boolean IpduMRxDirectComInvocation: set at published-information  # If set to TRUE the COM invocation optimization as defined in. IPDUM140 is implemented.

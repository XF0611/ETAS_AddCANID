AUTOSAR XML (schema 4-2-2)
package /AUTOSAR_SecOC/EcucModuleDefs
  module definition SecOC [0..1]: category=VENDOR_SPECIFIC_MODULE_DEFINITION, refined-module-def=SecOC, variants pre-compile  # Configuration of the SecOC (Secure Onboard Communication) module.
    container SecOCGeneral  # SecOC General | Container for common configuration options.
      boolean SecOCDevErrorDetect: multiplicity set at , set at pre-compile, default-value=false  # Default error tracer (Det) | Swithces the default error tracer (Det) detection and notification ON or OFF.
      boolean SecOCEnableForcedPassOverride: multiplicity set at , set at pre-compile, default-value=false  # Enable forced pass override | When this configuration option is set to TRUE then the functionality inside the function SecOC_VerifyStatusOverride to forcibly override the VerifyStatus to "Pass" is enabled.
      boolean SecOCIgnoreVerificationResult: multiplicity set at , set at pre-compile, default-value=false  # Ignore verification result | Switches the handling of verification result ON or OFF. If the switch is set to true the verification is performed but the verification result is ignored. So if the verification fails the PDU is forwarded to the PduR nevertheless and an error event is set in the Logging Module. The switch is implemented for the test phase and will be ignored in series software.
      float SecOCMainFunctionPeriodRx: 0..1, multiplicity set at , set at pre-compile, default-value=0.01  # Period of SecOC_MainFunctionRx | Specifies the period of the main function SecOC_MainFunctionRx in seconds
      float SecOCMainFunctionPeriodTx: 0..1, multiplicity set at , set at pre-compile, default-value=0.01  # Period of SecOC_MainFunctionTx | Specifies the period of the main function SecOC_MainFunctionTx in seconds
      enumeration SecOCMaxAlignScalarType: {uint8, uint16, uint32}, multiplicity set at , set at pre-compile, default-value=uint32  # SecOC maximum alignment type | The scalar type which has the maximum alignment restrictions on the given platform. This type can be e.g. uint8, uint16 or uint32.
      enumeration SecOCQueryFreshnessValue: {CFUNC, RTE}, multiplicity set at , set at pre-compile, default-value=CFUNC  # SecOC query freshness value | Specifies if the freshness value shall be determined through a C-function (CD) or a software component (SW-C).
      integer SecOCRbRteQLenVerifyStateOverride [0..1]: 1.., multiplicity set at pre-compile, origin=RB, set at pre-compile, default-value=1  # SecOC Rte queue length for VerifyStatusOverride | This parameter is the depth of the RTE q-length, the history buffer, generated and provided by the Rte. Usage might be needed (IF): Rte is used (AND) Provided PORT and Required PORT are asynchron (AND) running on different OsApplications e.g. 1ms 10ms (AND) a history of all values is needed on the requesting side.
      enumeration SecOCRbRteVerificationStatusServiceInterfaceMode [0..1]: {CS, SR}, multiplicity set at pre-compile, origin=RB, set at pre-compile, default-value=SR  # SecOC Rte Verification Status Service Interface mode | This parameter specifies how the interface SecOCVerificationStatus is annouced, in standard AUTOSAR interface mode Sender/Receiver (SR) or in special Client/Server (CS) mode.
      function name SecOCVerificationStatusCallout [0..*]: multiplicity set at pre-compile, set at pre-compile  # SecOC verification status callout | Name of the verification status callout
      boolean SecOCVersionInfoApi: multiplicity set at , set at pre-compile, default-value=true  # SecOC version Info | Switches the availability of the SecOC_GetVersionInfo ON or OFF.
      boolean SecOCOverrideStatusWithDataId [0..1]: multiplicity set at pre-compile, set at pre-compile, default-value=false  # SecOC Override Status with DataId | This option defines if the parameter "ValueId" of the function SecOC_VerifyStatusOverride() accepts the freshness value (as a collection of one or more Secured I-PDUs to freshness) or the dataID for individual Secured I-PDUs. True: Function SecOC_VerifyStatusOverride accepts SecOCDataId. False: Function SecOC_VerifyStatusOverride accepts SecOCFreshnessValueId.
      boolean SecOCRbEnableCryptPduBypass [0..1]: multiplicity set at pre-compile, origin=RB, set at pre-compile, default-value=false  # SecOC enable cryptgraphic pdu bypass | When this configuration option ist set to TRUE the functionality inside the optional Interface SecOC_VerifyStatusOverride provide an additional overrideStatus = 43 (meaning bypass verification until notice)
      boolean SecOCRbRetryVerifyImmediately: multiplicity set at , origin=RB, set at pre-compile, default-value=false  # SecOC retry verification immediately | If this parameter is set to true, SecOC retries the verification immediately in the same main function cycle if mac verification fails (see section 9.4 in AR specification). This feature is only possible for synchronous jobs.
      boolean SecOCRbEnablePduCollection [0..1]: multiplicity set at pre-compile, origin=RB, set at pre-compile, default-value=false  # SecOC enable pdu collection | If this parameter ist set to TRUE, pdu collection can be used
      integer SecOCDefaultAuthenticationInformationPattern [0..1]: 0..255, multiplicity set at pre-compile, set at pre-compile  # SecOC Default Authentication Information Pattern | The parameter describes the behaviour of SecOC when authentication build counter has reached the configuration value SecOCAuthenticationBuildAttempts, or the query of the freshness function returns E_NOT_OK or the calculation of the authenticator has returned a non-recoverable error such as returning E_NOT_OK or KEY_FAILURE. If the configuration parameter is not present, SecOC module shall remove the Authentic I-PDU from its internal buffer and cancel the transmission request If the configuration parameter is present, SecOC will use this value for each byte of Freshness Value and Authenticator when building the Authentication Information, and will not cancel the transmission request.
      enumeration SecOCRbVerifyStatusOverrideVersion [0..1]: {AR_4_3, AR_4_4}, multiplicity set at pre-compile, origin=RB, set at pre-compile, default-value=AR_4_4  # AR version of SecOC_VerifyStatusOverride | Selects the AUTOSAR version of the API SecOC_VerifyStatusOverride. The interface and the behaviour is different in AR4.3 and AR4.4. For details see the AUTOSAR specifications.
      enumeration SecOCRbTxConfirmationVersion [0..1]: {AR_4_2, AR_4_3}, multiplicity set at pre-compile, origin=RB, set at pre-compile, default-value=AR_4_2  # AR version of SecOC_TxConfirmation | Selects the AUTOSAR version of the API SecOC_TxConfirmation. The interface and the behaviour is different in AR4.2 and AR4.3. For details see the AUTOSAR specifications.
      enumeration SecOCRbPduInfoTypeVersion [0..1]: {AR_4_3, AR_4_4}, multiplicity set at pre-compile, origin=RB, set at pre-compile, default-value=AR_4_3  # AR version of PduInfoType | Selects the AUTOSAR version of the PduInfoType. The type definition is different in AR4.3 and AR4.4. For details see the AUTOSAR specifications.
      enumeration SecOCRbCryptInfoVersion [0..1]: {AR_4_3, AR_4_4}, multiplicity set at pre-compile, origin=RB, set at pre-compile, default-value=AR_4_3  # AR version of crypt information | Selects the AUTOSAR version of the cryptographic information authenticator and freshness value in containers SecOCRxPduProcessing/SecOCTxPduProcessing.The names of these parameters are different in AR4.2/4.3 and AR4.4/4.5. Note: If you select the AR4.4/4.5 solution you have to replace the param defintion file in the SecOC/scripts with the param definition file of template folder. AR_4_3 --> Name of authenticator and freshness parameters of Rx/Tx PDU: SecOCAuthInfoTxLength, SecOCFreshnessValueTxLength AR_4_4 --> Name of authenticator and freshness parameters of Rx/Tx PDU: SecOCAuthInfoTruncLength, SecOCFreshnessValueTruncLength
      enumeration SecOCRbDynamicLengthSupport [0..1]: {SecOC, EcuC}, multiplicity set at pre-compile, origin=RB, set at pre-compile, default-value=EcuC  # Support of parameter DynamicLength | Selects if the parameter DynamicLength is supported by EcuC (AR standard) or by SecOC. The support in SecOC is introduced to support dynamic pdus without secured header even if parameter DynamicLength is not available in EcuC. If EcuC supports the parameter the one in SecOC is ignored.
      enumeration SecOCRbCryptDefaultInterface: {Csm_rba_CryptoBCL, Csm_rba_CryptoCCL, Csm_rba_CryptoHSM, None, Csm_Crypto}, multiplicity set at , origin=RB, set at pre-compile, default-value=Csm_rba_CryptoBCL  # SecOC default cryptographic interface | Selects the default cryptographic interface. It is set for all Rx and Tx pdus if the mac calculation is done via the cryptographic library (value Csm_rba_CryptoBCL or value Csm_rba_CryptoCCL ) or via hardware security module (value Csm_rba_CryptoHSM). If value 'None' is selected no cryptographic interface is called. Nevertheless the PDUs are forwarded to the PduR for further routing. This configuration can be overwritten for each pdu in the pdu configuration containers.
      enumeration SecOCRbDefaultCryptAlgoFamily: {AES, POLY1305, SIPHASH}, multiplicity set at , origin=RB, set at pre-compile, default-value=AES  # SecOC cryptographic algorithm family | Selects the algorithm family used for generation and verification of MAC.*At least the following AlgoFam, Mode, 2ndFam combinations are support:*AES, CMAC, AES*POLY1305, NOT_SET, POLY1305 (Poly1305 algorithm hasn't got different modes)*SIPHASH, SIPHASH_2_4, SPIHASH
      enumeration SecOCRbDefaultCryptAlgoMode: {CMAC, NOT_SET, SIPHASH_2_4}, multiplicity set at , origin=RB, set at pre-compile, default-value=CMAC  # SecOC cryptographic algorithm mode | Selects the algorithm mode used for generation and verification of MAC.*At least the following AlgoFam, Mode, 2ndFam combinations are support:*AES, CMAC, AES*POLY1305, NOT_SET, POLY1305 (Poly1305 algorithm hasn't got different modes)*SIPHASH, SIPHASH_2_4, SPIHASH
      enumeration SecOCRbDefaultCryptAlgoSecondFamily: {AES, POLY1305, SIPHASH}, multiplicity set at , origin=RB, set at pre-compile, default-value=AES  # SecOC cryptographic algorithm secondary family | Selects the algorithm secondary family used for generation and verification of MAC.*At least the following AlgoFam, Mode, 2ndFam combinations are support:*AES, CMAC, AES*POLY1305, NOT_SET, POLY1305 (Poly1305 algorithm hasn't got different modes)*SIPHASH, SIPHASH_2_4, SPIHASH
      enumeration SecOCRbCryptDefaultMode: {asynchronous, synchronous}, multiplicity set at , origin=RB, set at pre-compile, default-value=synchronous  # SecOC cryptographic mode | SecOC can call the cryptographic services synchronous or asynchronous. Both are done in the cyclic main functions but in case of asynchronous mode the result is received via callbacks. AR defines the asynchronous mode. This configuration is set for all Rx and Tx PDUs but it can be overwritten for each pdu in the pdu configuration containers.
    container SecOCSameBufferPduCollection [0..*]  # SecOC Buffer configuration that may be used by a collection of Pdus.
      integer SecOCBufferLength: 0..4294967295, multiplicity set at , set at pre-compile, default-value=0  # Buffer length | This parameter defines the length of the buffer for Pdu collection in bytes.
    container SecOCRxPduProcessing [0..*]  # SecOC configuration of received PDUs to be verified
      integer SecOCAuthDataFreshnessLen [0..1]: 0..64, multiplicity set at pre-compile, set at pre-compile, default-value=0  # SecOC authentic data freshness length | This parameter specifies the length of the external authentic PDU data in bits.
      integer SecOCAuthDataFreshnessStartPosition [0..1]: 0..65535, multiplicity set at pre-compile, set at pre-compile, default-value=0  # SecOC authentic data freshness start position | This parameter determines the start position in bits (uint16) of the Authentic PDU that shall be passed on to the Freshness SWC. The bit position starts counting from the MSB of the first byte of the PDU.
      integer SecOCAuthenticationBuildAttempts [0..1]: 0..65535, multiplicity set at pre-compile, set at pre-compile, default-value=0  # SecOC number of authentication build attempts | This parameter specifies the number of authentication build attempts.
      integer SecOCAuthenticationVerifyAttempts [0..1]: 0..65535, multiplicity set at pre-compile, set at pre-compile, default-value=0  # SecOC number of verification attempts | This parameter specifies the number of authentication verify attempts that are to be carried out when the verification of the authentication information failed for a given Secured I_PDU.If zero is set then only one authentication verification attempt is done.
      integer SecOCAuthInfoTxLength: 1..65535, multiplicity set at , set at pre-compile, default-value=4  # SecOC authentication length | This parameter defines the length in bits of the authentication code to be included in the payload of the Secured I-PDU.
      integer SecOCDataId: 0..65535, multiplicity set at , set at pre-compile  # SecOC data identifier | This parameter defines a unique numerical identifier for the Secured I-PDU.
      integer SecOCFreshnessValueId: 0..65535, multiplicity set at , set at pre-compile  # SecOC freshness value id | This parameter specifies the local freshness identifier used to generate the freshness value used to generate or verify a MAC.
      integer SecOCFreshnessValueLength: 0..64, multiplicity set at , set at pre-compile, default-value=0  # SecOC freshness value length | This parameter defines the length in bits of the Freshness Value.
      integer SecOCFreshnessValueTxLength: 0..64, multiplicity set at , set at pre-compile, default-value=0  # SecOC freshness value payload length | This parameter defines the length in bits of the Freshness Value to be included in the payload of the Secured I-PDU. This length is specific to the least significant bits of the complete Freshness Counter. If the parameter is 0 no Fresh-ness Value is included in the Secured I-PDU.
      enumeration SecOCReceptionOverflowStrategy: {QUEUE, REJECT, REPLACE}, multiplicity set at , set at pre-compile  # SecOC reception overflow strategy | This parameter defines the overflow strategy for receiving PDUs. QUEUE --> Subsequent received message will be queued (Queue length restricted to 1 => currently started verification on lower level e.g. Csm will not be disturbed, message is buffered, last one will be processed next cycle, LastIsBest) REJECT --> Subsequent received message will be discarded (currently started verification on lower level e.g. Csm will not be disturbed, FirstIsBest) REPLACE --> Subsequent received message will replace the currently processed message. (currently started verification on lower level e.g. Csm will not be disturbed but the result will be ignored and discarded, new message is buffered, last one will be processed next cycle)
      integer SecOCReceptionQueueSize [0..1]: 1..1, multiplicity set at pre-compile, set at pre-compile, default-value=1  # SecOC reception queue size | This parameter defines the queue size in case the overflow strategy for receiving PDUs is set to QUEUE. As a difference to the Autosar standard a queue size of 1 (one) is supported only.
      boolean SecOCUseAuthDataFreshness: multiplicity set at , set at pre-compile, default-value=false  # SecOC use authentic PDU data freshness | This parametert indicates if a part of the Authentic-PDU shall be passed on to the SWC that verifies and generates the Freshness. If it is set to TRUE, the values SecOCAuthDataFreshnessStartPosition and SecOCAuthDataFreshnessLen must be set to specify the bit position and length within the Authentic-PDU.
      enumeration SecOCVerificationStatusPropagationMode: {BOTH, FAILURE_ONLY, NONE}, multiplicity set at , set at pre-compile  # SecOC verification status propagation mode | This parameter is used to describe the propagation of the status of each verification attempt from SecOC module to SWCs.
      enumeration SecOCRbRxPduCryptIF [0..1]: {Csm_rba_CryptoBCL, Csm_rba_CryptoCCL, Csm_rba_CryptoHSM, None, Csm_Crypto}, multiplicity set at pre-compile, origin=RB, set at pre-compile  # SecOC cryptographic interface | Selects the default cryptographic interface. It is set if the mac calculation is done via the cryptographic library (value Csm_rba_CryptoBCL or value Csm_rba_CryptoCCL ) or via hardware security module (value Csm_rba_CryptoHSM). If value 'None' is selected no cryptographic interface is called. Nevertheless the PDUs are forwarded to the PduR for further routing. This pdu specific configuration overwrites the global setting in container SecOCGeneral.
      enumeration SecOCRbRxCryptAlgoFamily [0..1]: {AES, POLY1305, SIPHASH}, multiplicity set at pre-compile, origin=RB, set at pre-compile, default-value=AES  # SecOC cryptographic algorithm family | Selects the algorithm family used for generation and verification of MAC.*At least the following AlgoFam, Mode, 2ndFam combinations are support:*AES, CMAC, AES*POLY1305, NOT_SET, POLY1305 (Poly1305 algorithm hasn't got different modes)*SIPHASH, SIPHASH_2_4, SPIHASH
      enumeration SecOCRbRxCryptAlgoMode [0..1]: {CMAC, NOT_SET, SIPHASH_2_4}, multiplicity set at pre-compile, origin=RB, set at pre-compile, default-value=CMAC  # SecOC cryptographic algorithm mode | Selects the algorithm mode used for generation and verification of MAC.*At least the following AlgoFam, Mode, 2ndFam combinations are support:*AES, CMAC, AES*POLY1305, NOT_SET, POLY1305 (Poly1305 algorithm hasn't got different modes)*SIPHASH, SIPHASH_2_4, SPIHASH
      enumeration SecOCRbRxCryptAlgoSecondFamily [0..1]: {AES, POLY1305, SIPHASH}, multiplicity set at pre-compile, origin=RB, set at pre-compile, default-value=AES  # SecOC cryptographic algorithm secondary family | Selects the algorithm secondary family used for generation and verification of MAC.*At least the following AlgoFam, Mode, 2ndFam combinations are support:*AES, CMAC, AES*POLY1305, NOT_SET, POLY1305 (Poly1305 algorithm hasn't got different modes)*SIPHASH, SIPHASH_2_4, SPIHASH
      enumeration SecOCRbRxCryptMode [0..1]: {asynchronous, synchronous}, multiplicity set at pre-compile, origin=RB, set at pre-compile  # SecOC cryptographic mode | SecOC can call the cryptographic services synchronous or asynchronous. Both are done in the cyclic main functions but in case of asynchronous mode the result is received via callbacks. AR defines the asynchronous mode. This pdu specific configuration overwrites the global setting in container SecOCGeneral.
      reference SecOCRxAuthServiceConfigRef [0..1]: multiplicity set at pre-compile, set at pre-compile, destination=CsmJob  # Reference to Csm Job | This reference is used to define which crypto service function is called for authentication.
      reference SecOCSameBufferPduRef [0..1]: multiplicity set at pre-compile, set at pre-compile, destination=SecOCSameBufferPduCollection  # Reference to Buffer collection | This reference is used to collect Pdus that are using the same SecOC buffer.
      container SecOCRxPduSecuredArea [0..1]  # SecOC Rx Pdu secured area
        integer SecOCSecuredRxPduLength: 0..4294967295, multiplicity set at , set at pre-compile  # Length of Rx secured area | This parameter defines the length (in bytes) of the area within the Pdu which is secured.
        integer SecOCSecuredRxPduOffset: 0..4294967295, multiplicity set at , set at pre-compile, default-value=0  # Start position of Rx secured area | This parameter defines the start position (offset in bytes) of the area within the Pdu which is secured.
      choice container SecOCRxSecuredPduLayer: multiplicity set at   # SecOC configuration of received PDU from PduR | This is a choice container
        container SecOCRxSecuredPdu [0..1]  # SecOC configuration of SecOCRxSecuredPdu
          boolean SecOCRbDynamicLength [0..1]: multiplicity set at pre-compile, origin=RB, set at pre-compile, default-value=true  # SecOC dynamic length | This parameter defines whether the Pdu has dynamic length (true) or not (false). This parameter is an alternative configuration possibility in SeOC to configure dynamic PDUs. Normally this configuratin is done in EcuC and if it is available this parameter in SecOC is ignored. But if the parameter is not available in EcuC you can use this Rb specific parameter in SecOC. In this case you have to set parameter SecOCRbDynamicLengthSupport to 'SecOC'.
          integer SecOCAuthPduHeaderLength [0..1]: 0..4, multiplicity set at pre-compile, set at pre-compile, default-value=0  # Length of secured PDU header | This parameter indicates the length in bytes of the Secured I-PDU Header in the Secured I-PDU. The length of zero means there is no header in the secured PDU.
          enumeration SecOCRbSecuredHeaderRepresentation [0..1]: {HEADER_IN_BYTES, HEADER_IN_BITS}, multiplicity set at pre-compile, origin=RB, set at pre-compile, default-value=HEADER_IN_BYTES  # SecOC secured header representation | Secured header length can be configured to be represented in bytes or bits. The representation in bits is not AUTOSAR compliant and is used to handle padding at the end of secured PDU. HEADER_IN_BYTES --> The length of authentic PDU given in the secured header is in bytes HEADER_IN_BITS --> The length of authentic PDU given in the secured header is in bits
          integer SecOCRxSecuredLayerPduId: 0..65535, multiplicity set at , set at pre-compile, symbolic-name-value=true  # SecOC identifier of secured PDU | PDU identifier assigned by SecOC module. Used by PduR for SecOC_PduRRxIndication.
          boolean SecOCSecuredRxPduVerification: multiplicity set at , set at pre-compile, default-value=false  # SecOC verification on secured PDU | This parameter defines whether the signature authentication or MAC verification shall be performed on this Secured I-PDU. If set to false, the SecOC module extracts the Authentic PDU from the Secured PDU without verification. Default value (false) will disable signature authentication or MAC verification on this Secured I-PDU.
          reference SecOCRxSecuredLayerPduRef: multiplicity set at , set at pre-compile, destination=Pdu  # Reference to secured PDU | Reference to the global Pdu.
        container SecOCRxSecuredPduCollection [0..1]  # SecOC configuration of SecOCRxSecuredPduCollection
          boolean SecOCSecuredRxPduVerification: multiplicity set at , set at pre-compile, default-value=false  # SecOC verification on secured PDU | This parameter defines whether the signature authentication or MAC verification shall be performed on this Secured I-PDU. If set to false, the SecOC module extracts the Authentic PDU from the Secured PDU without verification. . Default value (false) will disable signature authentication or MAC verification on this Secured I-PDU.
          container SecOCRxAuthenticPdu  # SecOC configuration of SecOCRxAuthenticPdu
            boolean SecOCRbDynamicLength [0..1]: multiplicity set at pre-compile, origin=RB, set at pre-compile, default-value=true  # SecOC dynamic length | This parameter defines whether the Pdu has dynamic length (true) or not (false). This parameter is an alternative configuration possibility in SeOC to configure dynamic PDUs. Normally this configuratin is done in EcuC and if it is available this parameter in SecOC is ignored. But if the parameter is not available in EcuC you can use this Rb specific parameter in SecOC.
            integer SecOCAuthPduHeaderLength [0..1]: 0..4, multiplicity set at pre-compile, set at pre-compile, default-value=0  # Length of secured PDU header | This parameter indicates the length in bytes of the Secured I-PDU Header in the Authentic I-PDU. The length of zero means there is no header in the Authentic PDU.
            enumeration SecOCRbSecuredHeaderRepresentation [0..1]: {HEADER_IN_BYTES, HEADER_IN_BITS}, multiplicity set at pre-compile, origin=RB, set at pre-compile, default-value=HEADER_IN_BYTES  # SecOC secured header representation | Secured header length can be configured to be represented in bytes or bits. The representation in bits is not AUTOSAR compliant and is used to handle padding at the end of Authentic PDU.
            integer SecOCRxAuthenticPduId: 0..65535, multiplicity set at , set at pre-compile, symbolic-name-value=true  # SecOC identifier of authentic PDU | PDU identifier of the Authentic I-PDU assigned by SecOC module. Used by PduR for SecOC_PduRRxIndication.
            reference SecOCRxAuthenticPduRef: multiplicity set at , set at pre-compile, destination=Pdu  # Reference to authentic PDU | Reference to the global Pdu.
          container SecOCRxCryptographicPdu  # SecOC configuration of SecOCRxCryptographicPdu
            integer SecOCRxCryptographicPduId: 0..65535, multiplicity set at , set at pre-compile, symbolic-name-value=true  # SecOC identifier of Cryptographic PDU | PDU identifier of the Cryptographic I-PDU assigned by SecOC module. Used by PduR for SecOC_PduRRxIndication.
            boolean SecOCRbDynamicLength [0..1]: multiplicity set at pre-compile, origin=RB, set at pre-compile, default-value=true  # SecOC dynamic length | This parameter defines whether the Pdu has dynamic length (true) or not (false). This parameter is an alternative configuration possibility in SeOC to configure dynamic PDUs. Normally this configuratin is done in EcuC and if it is available this parameter in SecOC is ignored. But if the parameter is not available in EcuC you can use this Rb specific parameter in SecOC.
            reference SecOCRxCryptographicPduRef: multiplicity set at , set at pre-compile, destination=Pdu  # Reference to cryptographic PDU | Reference to the global Pdu.
          container SecOCUseMessageLink [0..1]  # Message linker of authentic and cryptographic PDU
            integer SecOCMessageLinkLen: 0..65535, multiplicity set at , set at pre-compile  # Length of message linker | Length of the message linker inside the Authentic PDU in bits.
            integer SecOCMessageLinkPos: 0..65535, multiplicity set at , set at pre-compile  # Position of message linker | The position of message linker inside the Authentic PDU in bits.
      container SecOCRxAuthenticPduLayer  # SecOC configuration of authentic PDU
        enumeration SecOCPduType [0..1]: {SECOC_IFPDU, SECOC_TPPDU}, multiplicity set at pre-compile, set at pre-compile, default-value=SECOC_IFPDU  # SecOC Pdu Type | This parameter defines the API Type to use for communication with PduR. SECOC_IFPDU --> Interface communication API SECOC_TPPDU --> Transport Protocol communication API
        boolean SecOCRbDynamicLength [0..1]: multiplicity set at pre-compile, origin=RB, set at pre-compile, default-value=true  # SecOC dynamic length | This parameter defines whether the Pdu has dynamic length (true) or not (false). This parameter is an alternative configuration possibility in SeOC to configure dynamic PDUs. Normally this configuratin is done in EcuC and if it is available this parameter in SecOC is ignored. But if the parameter is not available in EcuC you can use this Rb specific parameter in SecOC. In this case you have to set parameter SecOCRbDynamicLengthSupport to 'SecOC'.
        reference SecOCRxAuthenticLayerPduRef [0..1]: multiplicity set at pre-compile, set at pre-compile, destination=Pdu  # Reference to authentic PDU | Reference to the global Pdu.
    container SecOCTxPduProcessing [0..*]  # SecOC configuration of transmitted PDUs to be secured
      integer SecOCAuthenticationBuildAttempts [0..1]: 0..65535, multiplicity set at pre-compile, set at pre-compile, default-value=0  # SecOC number of authentication build attempts | This parameter specifies the number of authentication build attempts.
      integer SecOCAuthInfoTxLength: 1..65535, multiplicity set at , set at pre-compile, default-value=4  # SecOC authentication length | This parameter defines the length in bits of the authentication code to be included in the payload of the Secured I-PDU.
      integer SecOCDataId: 0..65535, multiplicity set at , set at pre-compile  # SecOC data identifier | This parameter defines a unique numerical identifier for the Secured I-PDU.
      integer SecOCFreshnessValueId: 0..65535, multiplicity set at , set at pre-compile  # SecOC freshness value id | This parameter specifies the local freshness identifier used to generate the freshness value used to generate or verify a MAC.
      integer SecOCFreshnessValueLength: 0..64, multiplicity set at , set at pre-compile, default-value=0  # SecOC freshness value length | This parameter defines the length in bits of the Freshness Value.
      integer SecOCFreshnessValueTxLength: 0..64, multiplicity set at , set at pre-compile, default-value=0  # SecOC freshness value payload length | This parameter defines the length in bits of the Freshness Value to be included in the payload of the Secured I-PDU. This length is specific to the least significant bits of the complete Freshness Counter. If the parameter is 0 no Fresh-ness Value is included in the Secured I-PDU.
      boolean SecOCProvideTxTruncatedFreshnessValue: multiplicity set at , set at pre-compile, default-value=false  # SecOC provide Tx truncated freshness value | This parameter specifies if the Tx query freshness function provides the truncated freshness info instead of generating this by SecOC. In this case, SecOC shall add this data to the Authentic PDU instead of truncating the freshness value.
      boolean SecOCUseTxConfirmation [0..1]: multiplicity set at pre-compile, set at pre-compile, default-value=false  # SecOC use SPduTxConfirmation | If this parameter is set to TRUE, the function SecOC_SPduTxConfirmation shall be called to indicate that the Secured I-PDU has been initiated for transmission.
      boolean SecOCRbClearBufferAfterTransmit [0..1]: multiplicity set at pre-compile, origin=RB, set at pre-compile, default-value=false  # SecOCRB Clear buffers after transmit | If this parameter is set to true, SecOC doesn't wait for TxConfirmation to clear the buffers and instead clears the buffers and resets the PDU state to idle directly after passing the secured PDU to the PduR.
      enumeration SecOCRbTxPduCryptIF [0..1]: {Csm_rba_CryptoBCL, Csm_rba_CryptoCCL, Csm_rba_CryptoHSM, None, Csm_Crypto}, multiplicity set at pre-compile, origin=RB, set at pre-compile  # SecOC cryptographic interface | Selects the default cryptographic interface. It is set if the mac calculation is done via the cryptographic library (value Csm_rba_CryptoBCL or value Csm_rba_CryptoCCL ) or via hardware security module (value Csm_rba_CryptoHSM). If value 'None' is selected no cryptographic interface is called. Nevertheless the PDUs are forwarded to the PduR for further routing. This pdu specific configuration overwrites the global setting in container SecOCGeneral.
      enumeration SecOCRbTxCryptAlgoFamily [0..1]: {AES, POLY1305, SIPHASH}, multiplicity set at pre-compile, origin=RB, set at pre-compile, default-value=AES  # SecOC cryptographic algorithm family | Selects the algorithm family used for generation and verification of MAC.*At least the following AlgoFam, Mode, 2ndFam combinations are support:*AES, CMAC, AES*POLY1305, NOT_SET, POLY1305 (Poly1305 algorithm hasn't got different modes)*SIPHASH, SIPHASH_2_4, SPIHASH
      enumeration SecOCRbTxCryptAlgoMode [0..1]: {CMAC, NOT_SET, SIPHASH_2_4}, multiplicity set at pre-compile, origin=RB, set at pre-compile, default-value=CMAC  # SecOC cryptographic algorithm mode | Selects the algorithm mode used for generation and verification of MAC.*At least the following AlgoFam, Mode, 2ndFam combinations are support:*AES, CMAC, AES*POLY1305, NOT_SET, POLY1305 (Poly1305 algorithm hasn't got different modes)*SIPHASH, SIPHASH_2_4, SPIHASH
      enumeration SecOCRbTxCryptAlgoSecondFamily [0..1]: {AES, POLY1305, SIPHASH}, multiplicity set at pre-compile, origin=RB, set at pre-compile, default-value=AES  # SecOC cryptographic algorithm secondary family | Selects the algorithm secondary family used for generation and verification of MAC.*At least the following AlgoFam, Mode, 2ndFam combinations are support:*AES, CMAC, AES*POLY1305, NOT_SET, POLY1305 (Poly1305 algorithm hasn't got different modes)*SIPHASH, SIPHASH_2_4, SPIHASH
      enumeration SecOCRbTxCryptMode [0..1]: {asynchronous, synchronous}, multiplicity set at pre-compile, origin=RB, set at pre-compile  # SecOC cryptographic mode | SecOC can call the cryptographic services synchronous or asynchronous. Both are done in the cyclic main functions but in case of asynchronous mode the result is received via callbacks. AR defines the asynchronous mode. This pdu specific configuration overwrites the global setting in container SecOCGeneral.
      reference SecOCSameBufferPduRef [0..1]: multiplicity set at pre-compile, set at pre-compile, destination=SecOCSameBufferPduCollection  # Reference to Buffer collection | This reference is used to collect Pdus that are using the same SecOC buffer.
      reference SecOCTxAuthServiceConfigRef [0..1]: multiplicity set at pre-compile, set at pre-compile, destination=CsmJob  # Reference to Csm Job | This reference is used to define which crypto service function is called for authentication.
      container SecOCTxPduSecuredArea [0..1]  # SecOC Tx Pdu secured area
        integer SecOCSecuredTxPduLength: 0..4294967295, multiplicity set at , set at pre-compile  # Length of Tx secured area | This parameter defines the length (in bytes) of the area within the Pdu which shall be secured.
        integer SecOCSecuredTxPduOffset: 0..4294967295, multiplicity set at , set at pre-compile, default-value=0  # Start position of Tx secured area | This parameter defines the start position (offset in bytes) of the area within the Pdu which shall be secured.
      container SecOCTxAuthenticPduLayer  # SecOC configuration of authentic PDU
        enumeration SecOCPduType [0..1]: {SECOC_IFPDU, SECOC_TPPDU}, multiplicity set at pre-compile, set at pre-compile, default-value=SECOC_IFPDU  # SecOC Pdu Type | This parameter defines the API Type to use for communication with PduR. SECOC_IFPDU --> Interface communication API SECOC_TPPDU --> Transport Protocol communication API
        integer SecOCTxAuthenticLayerPduId: 0..65535, multiplicity set at , set at pre-compile, symbolic-name-value=true  # SecOC identifier of authentic PDU | PDU identifier assigned by SecOC module. Used by PduR for SecOC_PduRTransmit.
        reference SecOCTxAuthenticLayerPduRef [0..1]: multiplicity set at pre-compile, set at pre-compile, destination=Pdu  # Reference to authentic PDU | Reference to the global Pdu.
      choice container SecOCTxSecuredPduLayer: multiplicity set at   # SecOC configuration of transmitted PDU to PduR | This is a choice container
        container SecOCTxSecuredPdu [0..1]  # SecOC configuration of SecOCTxSecuredPdu
          integer SecOCAuthPduHeaderLength [0..1]: 0..4, multiplicity set at pre-compile, set at pre-compile, default-value=0  # Length of secured PDU header | This parameter indicates the length in bytes of the Secured I-PDU Header in the Secured I-PDU. The length of zero means there is no header in the secured PDU.
          enumeration SecOCRbSecuredHeaderRepresentation [0..1]: {HEADER_IN_BYTES, HEADER_IN_BITS}, multiplicity set at pre-compile, origin=RB, set at pre-compile, default-value=HEADER_IN_BYTES  # SecOC secured header representation | Secured header length can be configured to be represented in bytes or bits. The representation in bits is not AUTOSAR compliant and is used to handle padding at the end of secured PDU. HEADER_IN_BYTES --> The length of authentic PDU given in the secured header is in bytes HEADER_IN_BITS --> The length of authentic PDU given in the secured header is in bits
          integer SecOCTxSecuredLayerPduId: 0..65535, multiplicity set at , set at pre-compile, symbolic-name-value=true  # SecOC identifier of secured PDU | PDU identifier assigned by SecOC module. Used by PduR for confirmation (SecOC_PduRTxConfirmation) and for TriggerTransmit.
          reference SecOCTxSecuredLayerPduRef: multiplicity set at , set at pre-compile, destination=Pdu  # Reference to secured PDU | Reference to the global Pdu.
        container SecOCTxSecuredPduCollection [0..1]  # SecOC configuration of SecOCTxSecuredPduCollection
          container SecOCTxAuthenticPdu  # SecOC configuration of SecOCTxAuthenticPdu
            integer SecOCAuthPduHeaderLength [0..1]: 0..4, multiplicity set at pre-compile, set at pre-compile, default-value=0  # Length of secured PDU header | This parameter indicates the length in bytes of the Secured I-PDU Header in the Authentic I-PDU. The length of zero means there is no header in the secured PDU.
            enumeration SecOCRbSecuredHeaderRepresentation [0..1]: {HEADER_IN_BYTES, HEADER_IN_BITS}, multiplicity set at pre-compile, origin=RB, set at pre-compile, default-value=HEADER_IN_BYTES  # SecOC secured header representation | Secured header length can be configured to be represented in bytes or bits. The representation in bits is not AUTOSAR compliant and is used to handle padding at the end of Authentic PDU.
            integer SecOCTxAuthenticPduId: 0..65535, multiplicity set at , set at pre-compile, symbolic-name-value=true  # SecOC identifier of authentic PDU | PDU identifier of the Authentic I-PDU assigned by SecOC module. Used by PduR for confirmation (SecOC_PduRTxConfirmation) and for TriggerTransmit.
            reference SecOCTxAuthenticPduRef: multiplicity set at , set at pre-compile, destination=Pdu  # Reference to authentic PDU | Reference to the global Pdu.
          container SecOCTxCryptographicPdu  # SecOC configuration of SecOCTxCryptographicPdu
            integer SecOCTxCryptographicPduId: 0..65535, multiplicity set at , set at pre-compile, symbolic-name-value=true  # SecOC identifier of Cryptographic PDU | PDU identifier of the Cryptographic I-PDU assigned by SecOC module. Used by PduR for confirmation (SecOC_PduRTxConfirmation) and for TriggerTransmit.
            reference SecOCTxCryptographicPduRef: multiplicity set at , set at pre-compile, destination=Pdu  # Reference to cryptographic PDU | Reference to the global Pdu.
          container SecOCUseMessageLink [0..1]  # Message linker of authentic and cryptographic PDU
            integer SecOCMessageLinkLen: 0..65535, multiplicity set at , set at pre-compile  # Length of message linker | Length of the message linker inside the Authentic PDU in bits.
            integer SecOCMessageLinkPos: 0..65535, multiplicity set at , set at pre-compile  # Position of message linker | The position of message linker inside the Authentic PDU in bits.

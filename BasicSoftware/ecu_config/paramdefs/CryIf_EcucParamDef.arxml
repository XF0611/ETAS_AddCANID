AUTOSAR XML (schema 4-2-2)
package /AUTOSAR_CryIf/EcucModuleDefs
  module definition CryIf [0..1]: category=VENDOR_SPECIFIC_MODULE_DEFINITION, refined-module-def=CryIf, variants pre-compile  # Configuration of the Crypto Interface.
    container CryIfChannel [0..*]: multiplicity set at pre-compile  # Container for incorporation of CryIfChannel.
      integer CryIfChannelId [0..1]: 0..4294967295, multiplicity set at pre-compile, set at pre-compile, symbolic-name-value=true  # Identifier of the crypto channel. | Specifies to which crypto channel the CSM queue is connected to.
      symbolic name reference CryIfDriverObjectRef: multiplicity set at , set at pre-compile, destination=CryptoDriverObject  # This parameter refers to a Crypto Driver Object. | Specifies to which Crypto Driver Object the crypto channel is connected to
    container CryIfGeneral: multiplicity set at   # Container for incorporation of CryIfGeneral.
      boolean CryIfDevErrorDetect: multiplicity set at , set at pre-compile, default-value=false  # Switches the development error detection and notification on or off. | true: detection and notification is enabled. false: detection and notification is disabled.
      boolean CryIfVersionInfoApi: multiplicity set at , set at pre-compile, default-value=false  # Pre-processor switch to enable and disable availability of the API CryIf_GetVersionInfo(). | True: API CryIf_GetVersionInfo() is available False: API CryIf_GetVersionInfo() is not available.
      integer CryIfRbCopyPartialElementMaxSize [0..1]: 0..65535, multiplicity set at pre-compile, origin=RB, set at pre-compile, symbolic-name-value=true  # This parameter should be used to limit the size of the buffers used in CryIf to perform partial copies of key elements between diferent crypto drivers.
    container CryIfKey [0..*]: multiplicity set at pre-compile  # Container for incorporation of CryIfKey.
      integer CryIfKeyId [0..1]: 0..4294967295, multiplicity set at pre-compile, set at pre-compile, symbolic-name-value=true  # Identifier of the CryIf key. | Specifies to which CryIf key the CSM key is mapped to.
      symbolic name reference CryIfKeyRef: multiplicity set at , set at pre-compile, destination=CryptoKey  # This parameter refers to the crypto driver key. | Specifies to which crypto driver key the CryIf key is mapped to.

AUTOSAR XML (schema 4-0-2)
package /ETAS_Options
  module definition ETAS [0..1]: category=VENDOR_SPECIFIC_MODULE_DEFINITION, variants pre-compile
    container Options
      string CanIfFormat [0..1]: value=Can_CanHardwareObject_%MailboxId, set at pre-compile, origin=ETAS  # The naming format used for compatibility with the chosen MCAL generator. Available shortcuts are: Wildcard Meaning %MailboxId The current mailbox identifier to be created for the CanIf For instance (taking $MailboxId as an example CANNODE_0_Mailbox_0): CanIfFormat Output Can_CanHardwareObject_%MailboxId Can_CanHardwareObject_CANNODE_0_Mailbox_0 %MailboxId_Can_CanHardwareObject CANNODE_0_Mailbox_0_Can_CanHardwareObject Default value (empty) = Can_CanHardwareObject_%MailboxId Note: If not using default value, %MailboxId has to be defined on the expression. Otherwise, the same identifier will be created on the generated code.
      enumeration FlsEraseValue [0..1]: {0x00, 0xFF}  # The value set by the Fls when a call to erase occurs

AUTOSAR XML (schema 4-2-2)
package /AUTOSAR_Crypto/EcucModuleDefs
  module definition Crypto [0..*]: category=VENDOR_SPECIFIC_MODULE_DEFINITION, refined-module-def=Crypto, variants pre-compile  # Configuration of the Crypto (CryptoDriver) module
    container CryptoDriverObjects: multiplicity set at   # Container for CRYPTO Objects
      container CryptoDriverObject [0..*]  # Configuration of a CryptoDriverObject
        integer CryptoDriverObjectId [0..1]: 0..4294967295, multiplicity set at pre-compile, set at pre-compile, symbolic-name-value=true  # Identifier of the Crypto Driver Object. The Crypto Driver Object offers different crypto primitives.
        integer CryptoQueueSize: 0..4294967295, multiplicity set at , set at pre-compile  # Size of the queue in the Crypto Driver. Defines the maximum number of jobs in the Crypto Driver Object queue. If it is set to 0, queueing is disabled in the Crypto Driver Object.
        reference CryptoDriverObjectEcucPartitionRef [0..*]: multiplicity set at pre-compile, set at pre-compile, destination=EcucPartition  # Maps a crypto driver object to zero or multiple ECUC partitions. The ECUC partition referenced is a subset of the ECUC partitions where the Crypto driver is mapped to. | Note: CryptoDriverObjects such as a HSM shall be mapped to one partition only.
        reference CryptoPrimitiveRef: multiplicity set at , set at pre-compile, destination=CryptoPrimitive  # Refers to primitive in the CRYPTO. | The CryptoPrimitive is a pre-configured container of the crypto service that shall be used.
    container CryptoGeneral: multiplicity set at   # Container for common configuration options
      boolean CryptoDevErrorDetect: multiplicity set at , set at pre-compile, default-value=false  # Switches the development error detection and notification on or off. | true: detection and notification is enabled. false: detection and notification is disabled
      integer CryptoInstanceId [0..1]: 0..255, multiplicity set at pre-compile, set at pre-compile, with-auto=true  # Instance ID of the crypto driver. This ID is used to discern several crypto drivers in case more than one driver is used in the same ECU.
      float CryptoMainFunctionPeriod [0..1]: multiplicity set at pre-compile, set at pre-compile  # Specifies the period of main function Crypto_MainFunction in seconds.
      boolean CryptoVersionInfoApi: multiplicity set at , set at pre-compile, default-value=false  # Pre-processor switch to enable and disable availability of the API Crypto_GetVersionInfo(). | True: API Crypto_GetVersionInfo() is available False: API Cryptosm_GetVersionInfo() is not available.
      boolean CryptoRbBclPreCalculateK1_K2 [0..1]: multiplicity set at pre-compile, origin=RB, set at pre-compile, default-value=false  # True: Enable the precalculation of K1 and K2 for CMAC generation. This option results in a faster generation but safety is threatened because the keys are stored within global variables and will not be cleared. False: Disable the precalculation of K1 and K2 for CMAC generation. The keys are calculated for each CMAC generation and are cleared when CMAC generation was completed (safety is enhanced = default).
      boolean CryptoRbCclPreCalculateK1_K2 [0..1]: multiplicity set at pre-compile, origin=RB, set at pre-compile, default-value=false  # True: Enable the precalculation of K1 and K2 for CMAC generation. This option results in a faster generation but safety is threatened because the keys are stored within global variables and will not be cleared. False: Disable the precalculation of K1 and K2 for CMAC generation. The keys are calculated for each CMAC generation and are cleared when CMAC generation was completed (safety is enhanced = default).
      boolean CryptoRbReturnInvalidStatusOnGet [0..1]: multiplicity set at pre-compile, origin=RB, set at pre-compile, default-value=true  # True: Csm_KeyElementGet returns E_NOT_OK when the element containing key status is invalid. False: Csm_KeyElementGet return value is independent from the key valid status.
      boolean CryptoRbHsmOutputBuffering [0..1]: multiplicity set at pre-compile, origin=RB, set at pre-compile, default-value=true  # True: Cryptodriver creates extra output buffers (for the results written by the HSM module) as a safety separation in case of HSM driver library cannot access the ouput memory area provided by Cryptostack. False: HSM Output extra buffers will not be created (in case of HSM can access the output memory areas provided by the Cryptostack).
      boolean CryptoRbHsmTimeoutMonitoringEnabled [0..1]: multiplicity set at pre-compile, origin=RB, set at pre-compile, default-value=false  # TRUE: Enables timeout monitoring for HSM operations, whereby jobs are cancelled if the timeout duration for a given primitive is exceeded.
      integer CryptoRbHsmTimeout [0..1]: 1..4294967295, multiplicity set at pre-compile, origin=RB, set at pre-compile  # Maximum timeout for the HSM in ticks.When CryptoRbHsmTimeoutMonitoringEnabled is FALSE, the tick duration is 1 millisecond.When CryptoRbHsmTimeoutMonitoringEnabled is TRUE, the tick duration is set by the integrators timer configuration for timeout monitoring.
      integer CryptoRbHsmCancelTimeout [0..1]: 1..4294967295, multiplicity set at pre-compile, origin=RB, set at pre-compile  # Maximum timeout duration to wait for a HSM timeout monitoring cancel operation to complete in ticks.This parameter is only valid when CryptoRbHsmTimeoutMonitoringEnabled is enabled.The tick duration is set by the integrators timer configuration for timeout monitoring.
      integer CryptoRbHsmRandomTimeout [0..1]: 1..4294967295, multiplicity set at pre-compile, origin=RB, set at pre-compile  # Maximum timeout for HSM random primitive operations in ticks.When CryptoRbHsmTimeoutMonitoringEnabled is FALSE, the tick duration is 1 millisecond.When CryptoRbHsmTimeoutMonitoringEnabled is TRUE, the tick duration is set by the integrators timer configuration for timeout monitoring.
      integer CryptoRbHsmSheTimeout [0..1]: 1..4294967295, multiplicity set at pre-compile, origin=RB, set at pre-compile  # Maximum timeout for HSM SHE primitive operations in ticks.When CryptoRbHsmTimeoutMonitoringEnabled is FALSE, the tick duration is 1 millisecond.When CryptoRbHsmTimeoutMonitoringEnabled is TRUE, the tick duration is set by the integrators timer configuration for timeout monitoring.
      integer CryptoRbHsmSignatureTimeout [0..1]: 1..4294967295, multiplicity set at pre-compile, origin=RB, set at pre-compile  # Maximum timeout for the HSM in ms.
      integer CryptoRbHsmMacTimeout [0..1]: 1..4294967295, multiplicity set at pre-compile, origin=RB, set at pre-compile  # Maximum timeout for the MAC primitive operations in ticks.When CryptoRbHsmTimeoutMonitoringEnabled is FALSE, the tick duration is 1 millisecond.When CryptoRbHsmTimeoutMonitoringEnabled is TRUE, the tick duration is set by the integrators timer configuration for timeout monitoring.
      integer CryptoRbHsmCipherTimeout [0..1]: 1..4294967295, multiplicity set at pre-compile, origin=RB, set at pre-compile  # Maximum timeout for the Cipher (Encrypt and Decrypt) primitive operations in ticks.When CryptoRbHsmTimeoutMonitoringEnabled is FALSE, the tick duration is 1 millisecond.When CryptoRbHsmTimeoutMonitoringEnabled is TRUE, the tick duration is set by the integrators timer configuration for timeout monitoring.
      integer CryptoRbHsmKeyExchangeTimeout [0..1]: 1..4294967295, multiplicity set at pre-compile, origin=RB, set at pre-compile  # Maximum timeout for the KEYEXCHANGE operations in ms.
      integer CryptoRbHsmKeyGenerateTimeout [0..1]: 1..4294967295, multiplicity set at pre-compile, origin=RB, set at pre-compile  # Maximum timeout for the KEYGENERATE operations in ms.
      integer CryptoRbHsmAsyncTimeoutCount [0..1]: 1..4294967295, multiplicity set at pre-compile, origin=RB, set at pre-compile, default-value=4294967295  # Maximum timeout to wait for asynchronous HSM job operations measured in counts of the main function.This parameter is only valid when CryptoRbHsmTimeoutMonitoringEnabled is enabled.
      integer CryptoRbHsmCancelAsyncTimeoutCount [0..1]: 0..4294967295, multiplicity set at pre-compile, origin=RB, set at pre-compile  # Maximum timeout to wait for asynchronous HSM cancellation operations measured in counts of the main function.This parameter is only valid when CryptoRbHsmTimeoutMonitoringEnabled is enabled.
      integer CryptoRbHsmVkmsTimeout [0..1]: 1..4294967295, multiplicity set at pre-compile, origin=RB, set at pre-compile  # Maximum timeout for the HSM in ms.
      boolean CryptoRbKeyExchangeApi: multiplicity set at , origin=RB, set at pre-compile  # Pre-processor switch to enable and disable availability of the API Crypto_KeyExchangeCalcPubVal() and Crypto_KeyExchangeCalcSecret().
      boolean CryptoRbWaitForNvMRead [0..1]: multiplicity set at pre-compile, origin=RB, set at pre-compile, default-value=true  # True: In Crypto Init wait for NvM Read to be completed for required NvM block. (Calls Memstack Mainfunctions intern). False: Cyclically check NvM Read status in Crypto Mainfunction if read not already finished before Crypto Init.
      integer CryptoRbBclSignatureLoopCounter [0..1]: 1..4294967295, multiplicity set at pre-compile, origin=RB, set at pre-compile  # Holds the number of iterations to be performed internally by the signature primitive (update). This parameter can be used to increase or reduce the runtime of a single signature (update) call.
      integer CryptoRbCclSignatureLoopCounter [0..1]: 1..4294967295, multiplicity set at pre-compile, origin=RB, set at pre-compile  # Holds the number of iterations to be performed internally by the signature primitive (update). This parameter can be used to increase or reduce the runtime of a single signature (update) call.
      integer CryptoRbBclKeyExchangeLoopCounter [0..1]: 1..4294967295, multiplicity set at pre-compile, origin=RB, set at pre-compile, default-value=4294967295  # Holds the number of iterations to be performed internally by the key exchange primitive. This parameter can be used to increase or reduce the runtime of a single key exchange call.
      integer CryptoRbCclKeyExchangeLoopCounter [0..1]: 1..4294967295, multiplicity set at pre-compile, origin=RB, set at pre-compile, default-value=4294967295  # Holds the number of iterations to be performed internally by the key exchange primitive. This parameter can be used to increase or reduce the runtime of a single key exchange call.
      boolean CryptoRbHsmInitializeKeyElements [0..1]: multiplicity set at pre-compile, origin=RB, set at pre-compile, default-value=true  # True: Enable the initialization of HSM key elements with configured initialization data on startup and if the persistent storage was never used before by the HSM. False: Disable the initialization of HSM key elements on startup (True = default).
      integer CryptoRbMainFunctionLoopCounter [0..1]: 1..4294967295, multiplicity set at pre-compile, origin=RB, set at pre-compile, default-value=1  # Holds the number of iterations to be performed internally by the main function. This parameter can be used to increase or reduce the runtime of a single main function call.
      enumeration CryptoRbHsmMainFunctionMacMode [0..1]: {NON_BLOCKING, BLOCKING}, multiplicity set at pre-compile, origin=RB, set at pre-compile, default-value=NON_BLOCKING  # Determines whether the MainTask should wait for the HSM mac generation/verification until the corresponding process is finished (BLOCKING) or whether only the status should be queried without waiting (NON_BLOCKING). In combination with the parameter CryptoRbMainFunctionLoopCounter, the wait mode can be used to process several jobs directly one after the other and thus reduce the waiting time until all asynchronous jobs have been processed. The BLOCKING mode is also required whenever several queues are used within the Cryptostack for the mac generation/verification, since the HSM cannot process jobs in parallel.
      enumeration CryptoRbHsmMainFunctionAEADMode [0..1]: {NON_BLOCKING, BLOCKING}, multiplicity set at pre-compile, origin=RB, set at pre-compile, default-value=NON_BLOCKING  # Determines whether the MainTask should wait for the HSM AEAD encryption/decryption until the corresponding process is finished (BLOCKING) or whether only the status should be queried without waiting (NON_BLOCKING). In combination with the parameter CryptoRbMainFunctionLoopCounter, the wait mode can be used to process several jobs directly one after the other and thus reduce the waiting time until all asynchronous jobs have been processed. The BLOCKING mode is also required whenever several queues are used within the Cryptostack for the AEAD encryption/decryption, since the HSM cannot process jobs in parallel.
      enumeration CryptoRbHsmMainFunctionCipherMode [0..1]: {NON_BLOCKING, BLOCKING}, multiplicity set at pre-compile, origin=RB, set at pre-compile, default-value=NON_BLOCKING  # Determines whether the MainTask should wait for the HSM cipher encryption/decryption until the corresponding process is finished (BLOCKING) or whether only the status should be queried without waiting (NON_BLOCKING). In combination with the parameter CryptoRbMainFunctionLoopCounter, the wait mode can be used to process several jobs directly one after the other and thus reduce the waiting time until all asynchronous jobs have been processed. The BLOCKING mode is also required whenever several queues are used within the Cryptostack for the cipher encryption/decryption, since the HSM cannot process jobs in parallel.
      enumeration CryptoRbHsmMainFunctionHashMode [0..1]: {NON_BLOCKING, BLOCKING}, multiplicity set at pre-compile, origin=RB, set at pre-compile, default-value=NON_BLOCKING  # Determines whether the MainTask should wait for the HSM hash generation until the corresponding process is finished (BLOCKING) or whether only the status should be queried without waiting (NON_BLOCKING). In combination with the parameter CryptoRbMainFunctionLoopCounter, the wait mode can be used to process several jobs directly one after the other and thus reduce the waiting time until all asynchronous jobs have been processed. The BLOCKING mode is also required whenever several queues are used within the Cryptostack for the hash generation, since the HSM cannot process jobs in parallel.
      enumeration CryptoRbHsmMainFunctionSignatureMode [0..1]: {NON_BLOCKING, BLOCKING}, multiplicity set at pre-compile, origin=RB, set at pre-compile, default-value=NON_BLOCKING  # Determines whether the MainTask should wait for the HSM signature generation/verification until the corresponding process is finished (BLOCKING) or whether only the status should be queried without waiting (NON_BLOCKING). In combination with the parameter CryptoRbMainFunctionLoopCounter, the wait mode can be used to process several jobs directly one after the other and thus reduce the waiting time until all asynchronous jobs have been processed. The BLOCKING mode is also required whenever several queues are used within the Cryptostack for the signature generation/verification, since the HSM cannot process jobs in parallel.
      enumeration CryptoRbHsmMainFunctionRandomMode [0..1]: {NON_BLOCKING, BLOCKING}, multiplicity set at pre-compile, origin=RB, set at pre-compile, default-value=NON_BLOCKING  # Determines whether the MainTask should wait for the HSM random generation until the corresponding process is finished (BLOCKING) or whether only the status should be queried without waiting (NON_BLOCKING). In combination with the parameter CryptoRbMainFunctionLoopCounter, the wait mode can be used to process several jobs directly one after the other and thus reduce the waiting time until all asynchronous jobs have been processed. The BLOCKING mode is also required whenever several queues are used within the Cryptostack for the random generation, since the HSM cannot process jobs in parallel.
      enumeration CryptoRbHsmMainFunctionRandomSeedMode [0..1]: {NON_BLOCKING, BLOCKING}, multiplicity set at pre-compile, origin=RB, set at pre-compile, default-value=NON_BLOCKING  # Determines whether the MainTask should wait for the HSM random seed operation until the corresponding process is finished (BLOCKING) or whether only the status should be queried without waiting (NON_BLOCKING). In combination with the parameter CryptoRbMainFunctionLoopCounter, the wait mode can be used to process several jobs directly one after the other and thus reduce the waiting time until all asynchronous jobs have been processed. The BLOCKING mode is also required whenever several queues are used within the Cryptostack for the random seed operation, since the HSM cannot process jobs in parallel.
      enumeration CryptoRbHsmMainFunctionKeyExchangeMode [0..1]: {NON_BLOCKING, BLOCKING}, multiplicity set at pre-compile, origin=RB, set at pre-compile, default-value=NON_BLOCKING  # Determines whether the MainTask should wait for the HSM key exchange operation until the corresponding process is finished (BLOCKING) or whether only the status should be queried without waiting (NON_BLOCKING). In combination with the parameter CryptoRbMainFunctionLoopCounter, the wait mode can be used to process several jobs directly one after the other and thus reduce the waiting time until all asynchronous jobs have been processed. The BLOCKING mode is also required whenever several queues are used within the Cryptostack for the key exchange opeartion, since the HSM cannot process jobs in parallel.
      enumeration CryptoRbHsmMainFunctionKeyGenerateMode [0..1]: {NON_BLOCKING, BLOCKING}, multiplicity set at pre-compile, origin=RB, set at pre-compile, default-value=NON_BLOCKING  # Determines whether the MainTask should wait for the HSM key generate operation until the corresponding process is finished (BLOCKING) or whether only the status should be queried without waiting (NON_BLOCKING). In combination with the parameter CryptoRbMainFunctionLoopCounter, the wait mode can be used to process several jobs directly one after the other and thus reduce the waiting time until all asynchronous jobs have been processed. The BLOCKING mode is also required whenever several queues are used within the Cryptostack for the key exchange opeartion, since the HSM cannot process jobs in parallel.
      boolean CryptoRbHsmMacBulk [0..1]: multiplicity set at pre-compile, origin=RB, set at pre-compile, default-value=false  # True: Enable the bulk mode of the HSM for any mac generation/verification. Increase the memory footprint significantly but can increase the throughput of mac jobs. False: Disable the bulk mode of the HSM for any mac generation/verification (FALSE = default).
      integer CryptoRbHsmMacBulkMaxGenerateJobs [0..1]: 2..4294967295, multiplicity set at pre-compile, origin=RB, set at pre-compile  # Holds the maximum number of mac generate jobs to be performed my one HSM bulk job. The total number of all configured mac generate jobs will be used automatically if this configuration value is unset.
      integer CryptoRbHsmMacBulkMaxVerifyJobs [0..1]: 2..4294967295, multiplicity set at pre-compile, origin=RB, set at pre-compile  # Holds the maximum number of mac verify jobs to be performed my one HSM bulk job. The total number of all configured mac verify jobs will be used automatically if this configuration value is unset.
      boolean CryptoRbHsmKeyExchangeWithHandle [0..1]: multiplicity set at pre-compile, origin=RB, set at pre-compile, default-value=false  # True: Enable the key exchange mode to use the key handle of an existing Priv key element for calculating the shared secret. False: The Priv key element for calculating the shared secret is a generated random number (FALSE = default).
      boolean CryptoRbHsmCsaiErrorPropagationEnabled [0..1]: multiplicity set at pre-compile, origin=RB, set at pre-compile, default-value=false  # TRUE: Enables the propagation of CSAI error codes for specific cryptographic primitives executed on HSM. The propagation is performed via the rba_CryptoHSM_CsaiErrorCallback function call and only for specific primitives(MAC Generate/Verify, Encrypt/Decrypt with ECB/CBC, Random Generate/Seed, SHE Load Key Slot/Load Plain Key, SHE Export RAM key). FALSE: The error propagation is disabled and the rba_CryptoHSM_CsaiErrorCallback function call is not compiled.
    container CryptoKeyElements [0..1]  # Container for Crypto key elements
      container CryptoKeyElement [1..*]  # Configuration of a CryptoKeyElement
        boolean CryptoKeyElementAllowPartialAccess: multiplicity set at , set at pre-compile, default-value=false  # Enable or disable writing and reading the key element with data smaller than the size of the element. | True: enable partial access of the key element False: disable partial access of the key element
        enumeration CryptoKeyElementFormat [0..1]: {CRYPTO_KE_FORMAT_BIN_CERT_CVC, CRYPTO_KE_FORMAT_BIN_CERT_X509_V3, CRYPTO_KE_FORMAT_BIN_IDENT_PRIVATEKEY_PKCS8, CRYPTO_KE_FORMAT_BIN_IDENT_PUBLICKEY, CRYPTO_KE_FORMAT_BIN_OCTET, CRYPTO_KE_FORMAT_BIN_RSA_PRIVATEKEY, CRYPTO_KE_FORMAT_BIN_RSA_PUBLICKEY, CRYPTO_KE_FORMAT_BIN_SHEKEYS}, multiplicity set at pre-compile, set at pre-compile, default-value=CRYPTO_KE_FORMAT_BIN_OCTET  # Defines the format for the key element. This is the format used to provide or extract the key data from the driver.
        integer CryptoKeyElementId: 0..4294967295, multiplicity set at , set at pre-compile, symbolic-name-value=true  # Identifier of the CRYPTO key element
        string CryptoKeyElementInitValue [0..1]: multiplicity set at pre-compile, set at pre-compile  # Value which will be used to fill the key element during startup | (i) for all non-persistent key elements, and (ii) for those persistent key elements that have never been written.
        boolean CryptoKeyElementPersist: multiplicity set at , set at pre-compile, default-value=false  # Enable or disable persisting of the key element in non-volatile storage. | True: enable persisting of the key element. False: disable persisting of the key element.
        enumeration CryptoKeyElementReadAccess: {CRYPTO_RA_ALLOWED, CRYPTO_RA_DENIED, CRYPTO_RA_ENCRYPTED, CRYPTO_RA_INTERNAL_COPY}, multiplicity set at , set at pre-compile  # Define the reading access rights of the key element. | CRYPTO_RA_DENIED = key element cannot be read from outside the Crypto Driver CRYPTO_RA INTERNAL_COPY = key element can be copied to another key element in the same crypto driver. CRYPTO_RA_ALLOWED = key element can be read as plaintext CRYPTO_RA_ENCRYPTED = key element can be read encrypted. E.g. SHE Ram-Key export.
        integer CryptoKeyElementSize: 1..4294967295, multiplicity set at , set at pre-compile  # Maximum Size size of a CRYPTO key element in bytes
        enumeration CryptoKeyElementWriteAccess: {CRYPTO_WA_ALLOWED, CRYPTO_WA_DENIED, CRYPTO_WA_ENCRYPTED, CRYPTO_WA_INTERNAL_COPY}, multiplicity set at , set at pre-compile  # Define the writing access rights of the key element | CRYPTO_WA_DENIED = key element can not be written from outside the Crypto Driver CRYPTO_WA INTERNAL_COPY = key element can be filled with another key element in the same crypto driver. CRYPTO_WA_ALLOWED = key element can be rwritten as plaintext CRYPTO_WA_ENCRYPTED = key element can be written encrypted. E.g. SHE load key.
        enumeration CryptoRbKeyElementType [0..1]: {CRYPTO_ELEMENT_TYPE_SYMMETRIC_128, CRYPTO_ELEMENT_TYPE_EDDSA_ED25519_PRIV_KEY, CRYPTO_ELEMENT_TYPE_EDDSA_ED25519_PUB_KEY, CRYPTO_ELEMENT_TYPE_ECDSA_SECP384R1_PRIV_KEY, CRYPTO_ELEMENT_TYPE_ECDSA_SECP384R1_PUB_KEY, CRYPTO_ELEMENT_TYPE_ECDSA_SECP384R1_KEYPAIR, CRYPTO_ELEMENT_TYPE_ECDSA_SECP256R1_PRIV_KEY, CRYPTO_ELEMENT_TYPE_ECDSA_SECP256R1_PUB_KEY, CRYPTO_ELEMENT_TYPE_RSASSA_PSS_RSA2048_PRIV_KEY, CRYPTO_ELEMENT_TYPE_RSASSA_PSS_RSA2048_PUB_KEY, CRYPTO_ELEMENT_TYPE_RSASSA_PSS_RSA3072_PRIV_KEY, CRYPTO_ELEMENT_TYPE_RSASSA_PSS_RSA3072_PUB_KEY, CRYPTO_ELEMENT_TYPE_CERT_X509, CRYPTO_ELEMENT_TYPE_VKMS_GET_KEY, CRYPTO_ELEMENT_TYPE_VKMS_GET_METADATA, CRYPTO_ELEMENT_TYPE_VKMS_GET_STATUS, CRYPTO_ELEMENT_TYPE_VKMS_GET_TRAININGCOUNTER, CRYPTO_ELEMENT_TYPE_VKMS_GET_VIN}, multiplicity set at pre-compile, origin=RB, set at pre-compile  # Define the type of a key element. This parameter is optional and can be used to overrule the process to discover the type automatically.CRYPTO_ELEMENT_TYPE_SYMMETRIC_128: default type (16 byte)CRYPTO_ELEMENT_TYPE_EDDSA_ED25519_PRIV_KEY: ED25519: element to be used for signature generation (32 byte)CRYPTO_ELEMENT_TYPE_EDDSA_ED25519_PUB_KEY: ED25519: element to be used for signature verification (32 byte)CRYPTO_ELEMENT_TYPE_ECDSA_SECP384R1_PRIV_KEY: SECP384R1: element to be used for signature generation (48 bytes)CRYPTO_ELEMENT_TYPE_ECDSA_SECP384R1_PUB_KEY: SECP384R1: element to be used for signature verification (96 bytes)CRYPTO_ELEMENT_TYPE_ECDSA_SECP384R1_KEYPAIR: SECP384R1: element to be used for signature generation and verification (144 bytes)CRYPTO_ELEMENT_TYPE_ECDSA_SECP256R1_PRIV_KEY: SECP256R1: element to be used for signature generation (32 bytes)CRYPTO_ELEMENT_TYPE_ECDSA_SECP256R1_PUB_KEY: SECP256R1: element to be used for signature verification (64 bytes)CRYPTO_ELEMENT_TYPE_RSASSA_PSS_RSA2048_PRIV_KEY: RSASSA PSS RSA2048: element to be used for signature generation (512 bytes)CRYPTO_ELEMENT_TYPE_RSASSA_PSS_RSA2048_PUB_KEY: RSASSA PSS RSA2048: element to be used for signature verification (260 bytes)CRYPTO_ELEMENT_TYPE_RSASSA_PSS_RSA3072_PRIV_KEY: RSASSA PSS RSA3072: element to be used for signature generation (768 bytes)CRYPTO_ELEMENT_TYPE_RSASSA_PSS_RSA3072_PUB_KEY: RSASSA PSS RSA3072: element to be used for signature verification (388 bytes)CRYPTO_ELEMENT_TYPE_CERT_X509: element to be used for certificate X509CRYPTO_ELEMENT_TYPE_HSM_VKMS_GET_KEY: element to be used for VKMS Key retrievalCRYPTO_ELEMENT_TYPE_HSM_VKMS_GET_META_DATA: element to be used for VKMS Key meta data retrieval"CRYPTO_ELEMENT_TYPE_HSM_VKMS_GET_STATUS: element to be used for VKMS Status retrieval"CRYPTO_ELEMENT_TYPE_HSM_VKMS_GET_TRAINING_COUNTER: element to be used for VKMS Training counter retrieval"CRYPTO_ELEMENT_TYPE_HSM_VKMS_GET_VKMS_VIN: element to be used for VKMS VIN retrieval
        string CryptoRbHsmKeySlotId [0..1]: multiplicity set at pre-compile, origin=RB, set at pre-compile  # This parameter explicitly maps the given cryptokey element into a specified key slot inside the HSM secure flash. If left empty, then an available key slot automatically assigned to it. The name of the key slot (DYNAMIC_CFG_CRYPTO_AES_KEY_BASE_0) can be provided, or the enumerator representation of the key slot (ecy_hsm_CSAI_KEYID_AES_KEY_DYNAMIC_CFG_CRYPTO_AES_KEY_BASE_0) can be provided.
        reference CryptoKeyElementVirtualTargetRef [0..1]: multiplicity set at pre-compile, post-build-variant-value=true, set at pre-compile, destination=CryptoKeyElement  # Refers to a key element which will contain the actual data. If the Reference is configured, the key element will be a virtual key element.
    container CryptoKeyTypes [0..1]: multiplicity set at pre-compile  # Container for CRYPTO key types
      container CryptoKeyType [1..*]  # Configuration of a CryptoKeyType
        reference CryptoKeyElementRef [1..*]: multiplicity set at pre-compile, set at pre-compile, destination=CryptoKeyElement  # Refers to a pointer in the CRYPTOCrypto Key Element, which holds the data of the crypto key element.
    container CryptoKeys [0..1]  # Container for CRYPTO keys
      container CryptoKey [1..*]: multiplicity set at pre-compile  # Configuration of a CryptoKey
        integer CryptoKeyId [0..1]: 0..4294967295, multiplicity set at pre-compile, set at pre-compile, symbolic-name-value=true  # Identifier of the CRYPTO Key
        integer CryptoRbKeyPersistentGroupId [0..1]: 0..65534, multiplicity set at pre-compile, origin=RB, set at pre-compile, symbolic-name-value=true, default-value=0  # Persistent group ID of the CRYPTO Key for persistent storage of this key. All keys with the same Persistent Group ID will be grouped into the same NvM block that has a persistent ID equal to this value. All keys without a Persistent Group ID will be grouped into a single default NvM block.
        integer CryptoRbHsmVkmsKeyTypeId [0..1]: 0..65534, multiplicity set at pre-compile, origin=RB, set at pre-compile, symbolic-name-value=true  # This parameter maps the given cryptokey into a specified VKMS KeyTypeId specified inside HSM VKMS Core (to be used in VKMS GetKey and GetMetaData requests).
        reference CryptoKeyTypeRef: multiplicity set at , set at pre-compile, destination=CryptoKeyType  # Refers to a pointer in the CRYPTO to a CryptoKeyType. The CryptoKeyType provides the information which key elements are contained in a CryptoKey.
    container CryptoPrimitives [0..*]: multiplicity set at pre-compile  # Container for CRYPTO primitives
      container CryptoPrimitive [0..*]: multiplicity set at pre-compile  # Configuration of a CryptoPrimitive
        enumeration CryptoPrimitiveAlgorithmFamily: {CRYPTO_ALGOFAM_3DES, CRYPTO_ALGOFAM_AES, CRYPTO_ALGOFAM_BLAKE_1_256, CRYPTO_ALGOFAM_BLAKE_1_512, CRYPTO_ALGOFAM_BLAKE_2s_256, CRYPTO_ALGOFAM_BLAKE_2s_512, CRYPTO_ALGOFAM_BRAINPOOL, CRYPTO_ALGOFAM_CHACHA, CRYPTO_ALGOFAM_CUSTOM, CRYPTO_ALGOFAM_DH, CRYPTO_ALGOFAM_DRBG, CRYPTO_ALGOFAM_ECCANSI, CRYPTO_ALGOFAM_ECCNIST, CRYPTO_ALGOFAM_ECCSEC, CRYPTO_ALGOFAM_ECIES, CRYPTO_ALGOFAM_ED25519, CRYPTO_ALGOFAM_FIPS186, CRYPTO_ALGOFAM_KDFX963, CRYPTO_ALGOFAM_HKDF, CRYPTO_ALGOFAM_NOT_SET, CRYPTO_ALGOFAM_PADDING_ONEWITHZEROS, CRYPTO_ALGOFAM_PADDING_PKCS7, CRYPTO_ALGOFAM_PBKDF2, CRYPTO_ALGOFAM_POLY1305, CRYPTO_ALGOFAM_RIPEMD160, CRYPTO_ALGOFAM_RNG, CRYPTO_ALGOFAM_RSA, CRYPTO_ALGOFAM_SHA1, CRYPTO_ALGOFAM_SHA2_224, CRYPTO_ALGOFAM_SHA2_256, CRYPTO_ALGOFAM_SHA2_384, CRYPTO_ALGOFAM_SHA2_512, CRYPTO_ALGOFAM_SHA2_512_224, CRYPTO_ALGOFAM_SHA2_512_256, CRYPTO_ALGOFAM_SHA3_224, CRYPTO_ALGOFAM_SHA3_256, CRYPTO_ALGOFAM_SHA3_384, CRYPTO_ALGOFAM_SHA3_512, CRYPTO_ALGOFAM_SHAKE128, CRYPTO_ALGOFAM_SHAKE256, CRYPTO_ALGOFAM_SIPHASH, CRYPTO_ALGOFAM_VKMS_GET_IDENTITY_HASH, CRYPTO_ALGOFAM_VKMS_GET_PSS_HASH, CRYPTO_ALGOFAM_VKMS_GET_VERIFICATION_HASH, CRYPTO_ALGOFAM_VKMS_HANDLE_DLC_FINISH, CRYPTO_ALGOFAM_VKMS_HANDLE_DLC_START, CRYPTO_ALGOFAM_ECDH, CRYPTO_ALGOFAM_ECDSA_SECP384R1, CRYPTO_ALGOFAM_DETERMINISTIC_ECDSA_SECP384R1, CRYPTO_ALGOFAM_ECDSA_SECP256R1}, multiplicity set at , set at pre-compile  # Determines the algorithm family used for the crypto service
        enumeration CryptoPrimitiveAlgorithmMode: {CRYPTO_ALGOMODE_12ROUNDS, CRYPTO_ALGOMODE_20ROUNDS, CRYPTO_ALGOMODE_8ROUNDS, CRYPTO_ALGOMODE_CBC, CRYPTO_ALGOMODE_CBC_NIST_SP800_38A, CRYPTO_ALGOMODE_CBC_NONE, CRYPTO_ALGOMODE_CBC_PKCS7_v1_5, CRYPTO_ALGOMODE_CBC_ZERO, CRYPTO_ALGOMODE_CFB, CRYPTO_ALGOMODE_CMAC, CRYPTO_ALGOMODE_CTR, CRYPTO_ALGOMODE_CTRDRBG, CRYPTO_ALGOMODE_CUSTOM, CRYPTO_ALGOMODE_ECB, CRYPTO_ALGOMODE_ECB_NONE, CRYPTO_ALGOMODE_ECB_PKCS7_v1_5, CRYPTO_ALGOMODE_GCM, CRYPTO_ALGOMODE_GMAC, CRYPTO_ALGOMODE_HMAC, CRYPTO_ALGOMODE_NOT_SET, CRYPTO_ALGOMODE_OFB, CRYPTO_ALGOMODE_PXXXR, CRYPTO_ALGOMODE_RSAES_OAEP, CRYPTO_ALGOMODE_RSAES_PKCS1_v1_5, CRYPTO_ALGOMODE_RSASSA_PKCS1_v1_5, CRYPTO_ALGOMODE_RSASSA_PSS, CRYPTO_ALGOMODE_SIPHASH_2_4, CRYPTO_ALGOMODE_SIPHASH_4_8, CRYPTO_ALGOMODE_XTS}, multiplicity set at , set at pre-compile  # Determines the algorithm mode used for the crypto service
        enumeration CryptoPrimitiveAlgorithmSecondaryFamily: {CRYPTO_ALGOFAM_3DES, CRYPTO_ALGOFAM_AES, CRYPTO_ALGOFAM_BLAKE_1_256, CRYPTO_ALGOFAM_BLAKE_1_512, CRYPTO_ALGOFAM_BLAKE_2s_256, CRYPTO_ALGOFAM_BLAKE_2s_512, CRYPTO_ALGOFAM_BRAINPOOL, CRYPTO_ALGOFAM_CHACHA, CRYPTO_ALGOFAM_CUSTOM, CRYPTO_ALGOFAM_DRBG, CRYPTO_ALGOFAM_ECCANSI, CRYPTO_ALGOFAM_ECCNIST, CRYPTO_ALGOFAM_ECCSEC, CRYPTO_ALGOFAM_ECIES, CRYPTO_ALGOFAM_ED25519, CRYPTO_ALGOFAM_FIPS186, CRYPTO_ALGOFAM_NOT_SET, CRYPTO_ALGOFAM_PADDING_ONEWITHZEROS, CRYPTO_ALGOFAM_PADDING_PKCS7, CRYPTO_ALGOFAM_POLY1305, CRYPTO_ALGOFAM_RIPEMD160, CRYPTO_ALGOFAM_RNG, CRYPTO_ALGOFAM_RSA, CRYPTO_ALGOFAM_SHA1, CRYPTO_ALGOFAM_SHA2_224, CRYPTO_ALGOFAM_SHA2_256, CRYPTO_ALGOFAM_SHA2_384, CRYPTO_ALGOFAM_SHA2_512, CRYPTO_ALGOFAM_SHA2_512_224, CRYPTO_ALGOFAM_SHA2_512_256, CRYPTO_ALGOFAM_SHA3_224, CRYPTO_ALGOFAM_SHA3_256, CRYPTO_ALGOFAM_SHA3_384, CRYPTO_ALGOFAM_SHA3_512, CRYPTO_ALGOFAM_SHAKE128, CRYPTO_ALGOFAM_SHAKE256, CRYPTO_ALGOFAM_SIPHASH, CRYPTO_ALGOFAM_EC_CURVE25519, CRYPTO_ALGOFAM_EC_SECP384R1, CRYPTO_ALGOFAM_EC_SECP256R1}, multiplicity set at , set at pre-compile  # Determines the algorithm secondary family used for the crypto service
        enumeration CryptoPrimitiveService: {AEAD_DECRYPT, AEAD_ENCRYPT, DECRYPT, ENCRYPT, HASH, MAC_GENERATE, MAC_VERIFY, RANDOM, RANDOMSEED, SIGNATURE_GENERATE, SIGNATURE_VERIFY, KEYEXCHANGECALCPUBVAL, KEYEXCHANGECALCSECRET, KEYSETVALID, KEYDERIVE, KEYGENERATE, SHE_GETID, SHE_LOADKEY, SHE_LOADKEYSLOT, SHE_LOADPLAINKEY, SHE_EXPORTRAMKEY}, multiplicity set at , set at pre-compile  # Determines the crypto service used for defining the capabilities
    container CryptoRbNvMMappings [0..1]: multiplicity set at pre-compile  # Container for CryptoRbNvMMapping Objects
      container CryptoRbNvMMapping [0..*]: multiplicity set at pre-compile  # Container for CryptoRbNvMMapping configuraton parameters
        integer CryptoRbPersistentGroupId: 0..4294967295, multiplicity set at , origin=RB, set at pre-compile, symbolic-name-value=true  # GroupId of Persistent key group which will be stored in the referenced NvM block.
        reference CryptoRbNvMBlockDescriptorRef: multiplicity set at , origin=RB, set at pre-compile, destination=NvMBlockDescriptor  # Refers to a NvM Block descriptor in NvM.
    container CryptoRbPersistentDataMappings [0..1]: multiplicity set at pre-compile  # Container for CryptoRbPersistentDataMapping Objects
      container CryptoRbPersistentDataMapping [0..*]: multiplicity set at pre-compile  # Container for CryptoRbPersistentDataMapping configuraton parameters
        string CryptoRbMappingTag: multiplicity set at , origin=RB, set at pre-compile, symbolic-name-value=true  # Unique string tag of data mapping. This links key valid flags and key element data to offsets in the NvM data array they will be stored in or, in the case of secured keys stored in HSM, it links the keys to ecy_hsm Key ID's. There is a strict correlation between the CryptoRbMappingTag and the short name of a key or key element it is linked to. The CryptoRbMappingTag is constructured as follows: [Key ShortName]_[Persistent Group Id]_[Length]_[*Key Element ID*] * The Key Element ID will only be present for mappings linked to Key Elements. Example 1: There is a key with short name 'CryptoKey_AesEncrypt' and group ID 0. To link this key to this mapping, the CryptoRbMappingTag must be 'CryptoKey_AesEncrypt_0_1'. CryptoKeys by themselves contain no data except their valid flag, hence the length is always 1. Example 2: There is a key element with size 32, key element id 1 and short name 'CryptoKeyElement_AesEncrypt' and it is linked through a CryptoKeyType to CryptoKey 'CryptoKey_AesEncrypt' that is in peristent group 1. To link this key element to this mapping, the CryptoRbMappingTag must be 'CryptoKey_AesEncrypt_1_32_1'.
        integer CryptoRbPersistentOffset [0..1]: 0..4294967295, multiplicity set at pre-compile, origin=RB, set at pre-compile, symbolic-name-value=true  # Offset (in bytes) of key data or key valid flag into its corresponding NvM Block data array.
        string CryptoRbPersistentHsmKeySlot [0..1]: multiplicity set at pre-compile, origin=RB, set at pre-compile, symbolic-name-value=true  # String representation of ecy_hsm key ID to use for this key element. This field is valid only for data mappings linked to rba_CryptoHSM key elements that will be stored in the HSM. The name of the key slot (DYNAMIC_CFG_CRYPTO_AES_KEY_BASE_0) can be provided, or the enumerator representation of the key slot (ecy_hsm_CSAI_KEYID_AES_KEY_DYNAMIC_CFG_CRYPTO_AES_KEY_BASE_0) can be provided.

AUTOSAR XML (schema 4-2-2)
# The material contained in this specification is protected by copyright and
# other types of Intellectual Property Rights. The commercial exploitation of the
# material contained in this specification requires a license to such
# Intellectual Property Rights.
# This specification may be utilized or reproduced without any modification, in
# any form or by any means, for informational purposes only. For any other
# purpose, no part of the specification may be utilized or reproduced, in any
# form or by any means, without permission in writing from the publisher.
# licensed under the same rules as applicable to the AUTOSAR Standard.
package /AUTOSAR_FrNm/EcucModuleDefs
  module definition FrNm [0..1]: category=VENDOR_SPECIFIC_MODULE_DEFINITION, refined-module-def=FrNm, variants link-time/post-build/pre-compile  # The Flexray Nm module
    container FrNmChannelConfig  # This container contains the configuration parameters for all FlexRay NM channels.
      container FrNmChannel [1..*]: multiplicity set at pre-compile  # This container contains the configuration parameters for a FlexRay NM Channel.
        container FrNmChannelIdentifiers  # This container contains instance specific identifiers related to the respective FlexRay Channel.
          boolean FrNmActiveWakeupBitEnabled [0..1]: multiplicity set at link in variant link-time+post-build / pre-compile in variant pre-compile, set at link in variant link-time+post-build / pre-compile in variant pre-compile, default-value=false  # Enables/Disables the handling of the Active Wakeup Bit in the FrNm module.
          integer FrNmCarWakeUpBitPosition [0..0]: 0..7, multiplicity set at link in variant link-time+post-build / pre-compile in variant pre-compile, set at link in variant link-time+post-build / pre-compile in variant pre-compile  # Specifies the Bit position of the CWU within the NM-Message.NOT_USED
          integer FrNmCarWakeUpBytePosition [0..0]: 2..7, multiplicity set at link in variant link-time+post-build / pre-compile in variant pre-compile, set at link in variant link-time+post-build / pre-compile in variant pre-compile  # Specifies the Byte position of the CWU within the NM-Message.NOT_USED
          boolean FrNmCarWakeUpFilterEnabled [0..0]: multiplicity set at link in variant link-time+post-build / pre-compile in variant pre-compile, set at link in variant link-time+post-build / pre-compile in variant pre-compile  # If CWU filtering is supported, only the CWU bit within the NM message with source node identifier.NOT_USED | FrNmCarWakeUpFilterNodeId is considered as CWU request. FALSE - CWU Filtering is not supported TRUE - CWU Filtering is supported
          integer FrNmCarWakeUpFilterNodeId [0..0]: 0..255, multiplicity set at link in variant link-time+post-build / pre-compile in variant pre-compile, set at link in variant link-time+post-build / pre-compile in variant pre-compile  # Source node identifier for CWU filtering. If CWU filtering is supported, only the CWU bit within the NM | message with source node identifier FrNmCarWakeUpFilterNodeId is considered as CWU request.NOT_USED
          boolean FrNmCarWakeUpRxEnabled [0..0]: set at link in variant link-time+post-build / pre-compile in variant pre-compile  # Enables or disables support of CarWakeUp bit evaluation in received NM messages.NOT_USED | FALSE - CarWakeUp not supported TRUE - CarWakeUp supported
          boolean FrNmControlBitVectorActive: set at link in variant link-time+post-build / pre-compile in variant pre-compile  # This parameter is used to activate or deactivate the control bit vector support for a Fr Nm Channel.
          boolean FrNmNodeDetectionEnabled: set at pre-compile  # Pre-processor switch for enabling node detection support. | FrNmSourceNodeIdentifierEnabled needs to be TRUE to use this feature for the corresponding FrNm Channel.calculationFormula = If (FrNmPassiveModeEnabled == False) then Equal(NmNodeDetectionEnabled) else Equal(False)
          integer FrNmNodeId: 0..255, post-build-variant-value=true, set at link in variant link-time / post-build in variant post-build / pre-compile in variant pre-compile  # NM node identifier configured for the respective FlexRay Channel. | It is used for identifying the respective NM node in the NM-cluster. It must be unique for each NM node within one NM cluster.
          enumeration FrNmPduScheduleVariant: {FRNM_PDU_SCHEDULE_VARIANT_1, FRNM_PDU_SCHEDULE_VARIANT_2, FRNM_PDU_SCHEDULE_VARIANT_3, FRNM_PDU_SCHEDULE_VARIANT_4, FRNM_PDU_SCHEDULE_VARIANT_5, FRNM_PDU_SCHEDULE_VARIANT_6, FRNM_PDU_SCHEDULE_VARIANT_7}, origin=ECUC_AUTOSAR, set at link in variant link-time+post-build / pre-compile in variant pre-compile  # This parameter defines the PDU scheduling variant that should be used for this channel. | Option 1 NM-Vote and NM-Data in static segment (one PDU) Option 2 NM-Vote and NM-Data in dynamic segment (one PDU) Option 3 NM-Vote and NM-Data in static segment (separate PDU) Option 4 NM-Vote in static segment and NM-Data in dynamic segment Option 5 NM-Vote in dynamic segment and NM-Data in static segment Option 6 NM-Vote and NM-Data in dynamic segment (separate PDU) Option 7 Combined NM-Vote and CBV in static segment and NM-Data in dynamic segment
          boolean FrNmPnEnabled: post-build-variant-value=true, set at link in variant link-time / post-build in variant post-build / pre-compile in variant pre-compile, default-value=false  # Enables or disables support of partial networking. | false: Partial networking Range not supported true: Partial networking supported
          boolean FrNmPnEraCalcEnabled [0..1]: multiplicity set at link in variant link-time+post-build / pre-compile in variant pre-compile, set at link in variant link-time+post-build / pre-compile in variant pre-compile, default-value=false  # Specifies if FrNm calculates the PN request information for external requests. (ERA) | false: PN request are not calculated true: PN request are calculated
          boolean FrNmRepeatMessageBitActive: set at link in variant link-time+post-build / pre-compile in variant pre-compile  # This parameter is used to activate or deactivate the repeat message bit support for a Fr Nm Channel.
          boolean FrNmSourceNodeIdentifierEnabled: set at pre-compile  # Pre-processor switch for enabling SourceNodeIdentifier support.
          boolean FrNmSynchronizationPointEnabled: set at link in variant link-time+post-build / pre-compile in variant pre-compile  # This parameter defines if this channel shall provide the synchronization point indication to the NM Interface.
          symbolic name reference FrNmChannelHandle: scope=ECU, post-build-variant-value=true, set at link in variant link-time / post-build in variant post-build / pre-compile in variant pre-compile, destination=FrIfCluster  # Channel identifier configured for the respective instance of the NM. | The FrNmChannelHandle shall be encoded in the FrNmRxPduId parameter which is passed to FrNm_RxIndication() function called by the FrIf.
          symbolic name reference FrNmComMNetworkHandleRef: post-build-variant-value=true, set at link in variant link-time / post-build in variant post-build / pre-compile in variant pre-compile, destination=ComMChannel  # This reference points to the unique channel defined by the ComMChannel and provides access to the unique channel index value in ComMChannelId.
          reference FrNmPnEraRxNSduRef [0..1]: multiplicity set at link in variant link-time+post-build / pre-compile in variant pre-compile, set at link in variant link-time+post-build / pre-compile in variant pre-compile, destination=Pdu  # Reference to a global Pdu. The SduRef is required for every FrNm Channel, because ERA is reported per channel.
          container FrNmRxPdu [1..*]  # This container describes the FlexRay NM RX PDU:s.
            boolean FrNmRxPduContainsData: post-build-variant-value=true, set at link in variant link-time / post-build in variant post-build / pre-compile in variant pre-compile  # This parameter defines if the PDU contains NM Data.
            boolean FrNmRxPduContainsVote: post-build-variant-value=true, set at link in variant link-time / post-build in variant post-build / pre-compile in variant pre-compile  # This parameter defines if the PDU contains NM Vote information.
            integer FrNmRxPduId: -1..65535, set at pre-compile, symbolic-name-value=true  # PDU identifier configured for the respective FlexRay Channel. | It is used for referring to the FlexRay Interface receive function. It must be consistent with the value configured in the FlexRay Interface. This ID is used for the combined reception of NM Vote and NM Data or for the reception of the NM Vote if NM Data is received in a separate PDU. ImplementationType: PduIdType
            reference FrNmRxPduRef: scope=ECU, post-build-variant-value=true, set at link in variant link-time / post-build in variant post-build / pre-compile in variant pre-compile, destination=Pdu  # The reference to a PDU in the global PDU structure described in the AUTOSAR ECU Configuration Specification. This reference will be used by the FrIf module to derive the PDU Id.
          container FrNmTxPdu [0..4]  # This container describes the FlexRay NM TX PDU:s.
            integer FrNmTxConfirmationPduId: -1..65535, set at pre-compile, symbolic-name-value=true  # Handle Id used by the Lower Layer when calling FrNm_TriggerTransmit() or FrNm_TxConfirmation().
            boolean FrNmTxPduContainsData: post-build-variant-value=true, set at link in variant link-time / post-build in variant post-build / pre-compile in variant pre-compile  # This parameted defines if the PDU contains NM Data.
            boolean FrNmTxPduContainsVote: post-build-variant-value=true, set at link in variant link-time / post-build in variant post-build / pre-compile in variant pre-compile  # This parameted defines if the PDU contains NM Vote information.
            reference FrNmTxPduRef: scope=ECU, post-build-variant-value=true, set at link in variant link-time / post-build in variant post-build / pre-compile in variant pre-compile, destination=Pdu  # The reference to a PDU in the global PDU structure described in the AUTOSAR ECU Configuration Specification. This reference is used to derive the PDU Id that is defined by the FrIf module.
          container FrNmUserDataTxPdu [0..1]  # This optional container is used to configure the UserNm PDU. This container is only available if FrNmComUserDataSupport is enabled.
            integer FrNmTxUserDataPduId: 0..65535, set at pre-compile, symbolic-name-value=true  # This parameter defines the Handle ID of the NM User Data I-PDU.
            reference FrNmTxUserDataPduRef: post-build-variant-value=true, set at link in variant link-time / post-build in variant post-build / pre-compile in variant pre-compile, destination=Pdu  # Reference to the NM User Data I-PDU in the global PDU collection.
        container FrNmChannelTiming  # This container contains instance-specific timing related to the respective FlexRay Channel.
          enumeration FrNmDataCycle: {FRNM_CYCLE_VALUE_1, FRNM_CYCLE_VALUE_16, FRNM_CYCLE_VALUE_2, FRNM_CYCLE_VALUE_32, FRNM_CYCLE_VALUE_4, FRNM_CYCLE_VALUE_64, FRNM_CYCLE_VALUE_8}, set at link in variant link-time+post-build / pre-compile in variant pre-compile  # Number of FlexRay Schedule Cycles needed to transmit the NM Data of all ECUs on the FlexRay bus
          float FrNmMainFunctionPeriod [0..1]: 0.001..0.02, set at link in variant link-time+post-build / pre-compile in variant pre-compile  # This parameter defines the processing cycle of the main function of FrNm module in seconds.
          float FrNmMainFunctionPeriodTx [0..1]: 0.001..0.02, set at link in variant link-time+post-build / pre-compile in variant pre-compile  # This parameter defines the processing cycle of the main function of FrNm module in seconds.
          enumeration FrNmMainFunctionExecEntityCategory: origin=RB:1.0.0:2013-05-22, set at pre-compile  # Category | Categorizes this executable entity. Schedulable entities are designed to be scheduled by the RTE. Called entities are designed to be called from another BSW module or cluster. Since the BswEntity and the BswEvent are generated in one go, the schedulable entities can have one of the following five types: schedulable entity either triggered by BswTimingEvent or BswBackgroundEvent, schedulable entity triggered by BswInternalTriggerOccurredEvent, schedulable entity triggered by BswExternalTriggerOccurredEvent, schedulable entity triggered by BswModeSwitchEvent or schedulable entity triggered by BswModeSwitchedAckEvent.
            Schedulable  # Schedulable entity
            Called  # Called entity
            Interrupt  # Interrupt entity
            SchedulableWithInternalTrigger  # Schedulable entity with internal triggering event
            SchedulableWithExternalTrigger  # Schedulable entity with external triggering event
            SchedulableWithModeSwitch  # Schedulable entity with mode switch event
            SchedulableWithModeSwitchedAck  # Schedulable entity with mode switched ack event
          enumeration FrNmMainFunctionTxExecEntityCategory: origin=RB:1.0.0:2013-05-22, set at pre-compile  # Category | Categorizes this executable entity. Schedulable entities are designed to be scheduled by the RTE. Called entities are designed to be called from another BSW module or cluster. Since the BswEntity and the BswEvent are generated in one go, the schedulable entities can have one of the following five types: schedulable entity either triggered by BswTimingEvent or BswBackgroundEvent, schedulable entity triggered by BswInternalTriggerOccurredEvent, schedulable entity triggered by BswExternalTriggerOccurredEvent, schedulable entity triggered by BswModeSwitchEvent or schedulable entity triggered by BswModeSwitchedAckEvent.
            Schedulable  # Schedulable entity
            Called  # Called entity
            Interrupt  # Interrupt entity
            SchedulableWithInternalTrigger  # Schedulable entity with internal triggering event
            SchedulableWithExternalTrigger  # Schedulable entity with external triggering event
            SchedulableWithModeSwitch  # Schedulable entity with mode switch event
            SchedulableWithModeSwitchedAck  # Schedulable entity with mode switched ack event
          float FrNmMsgTimeoutTime [0..1]: 0..65.535, multiplicity set at link in variant link-time / post-build in variant post-build / pre-compile in variant pre-compile, post-build-variant-multiplicity=true, post-build-variant-value=true, set at link in variant link-time / post-build in variant post-build / pre-compile in variant pre-compile, default-value=0  # Timeout of a NM-message. It determines in seconds how long the NM shall wait with notification of transmission failure while communication errors occur on the bus.
          float FrNmNodeDetectionLock [0..0]: 0..10, set at link in variant link-time+post-build / pre-compile in variant pre-compile  # The time for which a node will not set the repeat message request bit even in the presence of a repeat message request (in seconds).
          integer FrNmReadySleepCnt: 1..65535, set at link in variant link-time+post-build / pre-compile in variant pre-compile  # Numbers of repetitions in the ready sleep state before NM switches to bus sleep mode.On a value of "1", the NM-State Machine will leave the Ready Sleep State after one NM Repetition Cycle with no "keep awake" votes.this is a deviation from 4.2 specification
          float FrNmRemoteSleepIndTime: 0..65.535, set at link in variant link-time+post-build / pre-compile in variant pre-compile  # Timeout for Remote Sleep Indication. It defines the time in seconds how long it shall take to recognize that all other nodes are ready to sleep. | The value "0" denotes that no Remote Sleep Indication functionality is configured.
          float FrNmRepeatMessageTime: 0..65.535, scope=ECU, set at link in variant link-time+post-build / pre-compile in variant pre-compile  # Timeout for Repeat Message State. Defines the time in seconds how long the NM shall stay in the Repeat Message State. | The value "0" denotes that no Repeat Message State is configured, which means that Repeat Message State is transient and implies that it is left immediately after entry and consequently no startup stability is guaranteed and no node detection procedure is possible.
          enumeration FrNmRepetitionCycle: {FRNM_CYCLE_VALUE_1, FRNM_CYCLE_VALUE_16, FRNM_CYCLE_VALUE_2, FRNM_CYCLE_VALUE_32, FRNM_CYCLE_VALUE_4, FRNM_CYCLE_VALUE_64, FRNM_CYCLE_VALUE_8}, set at link in variant link-time+post-build / pre-compile in variant pre-compile  # Number of Flexray Schedule Cycles used to repeat the transmission of the Nm vote of all ECUs on the Flexray Bus.
          boolean FrNmVoteInhibitionEnabled [0..0]: set at pre-compile  # Pre-processor switch for enabling the inhibition of vote changes from the next-to-last repetition cycle to the last repetition cycle before the Ready Sleep Counter expires.
          enumeration FrNmVotingCycle: {FRNM_CYCLE_VALUE_1, FRNM_CYCLE_VALUE_16, FRNM_CYCLE_VALUE_2, FRNM_CYCLE_VALUE_32, FRNM_CYCLE_VALUE_4, FRNM_CYCLE_VALUE_64, FRNM_CYCLE_VALUE_8}, set at link in variant link-time+post-build / pre-compile in variant pre-compile  # Number of FlexRay Schedule Cycles needed to transmit the Nm vote of all ECUs on the FlexRay Bus.
    container FrNmGlobalConfig  # This container contains all global configuration parameters for the FrNm module.
      container FrNmGlobalFeatures  # This container contains module features related to the FlexRay NM functionality.
        boolean FrNmBusSynchronizationEnabled: set at pre-compile  # Pre-processor switch for enabling the bus synchronization.This feature is currently not supported
        boolean FrNmComControlEnabled [0..1]: origin=BOSCH, set at pre-compile  # Pre-processor switch for enabling i14229 Communication Control support.
        boolean FrNmComUserDataSupport: set at pre-compile  # Enable/disable the user data support.
        boolean FrNmControlBitVectorEnabled: set at pre-compile  # Pre-processor switch for enabling control bit vector support. | calculationFormula = If (FrNmNodeDetectionEnabled == False) then Equal(False) else Equal(False or True)
        boolean FrNmCoordinatorSyncSupport: set at pre-compile  # Enables/disables the coordinator synchronization support.
        boolean FrNmCycleCounterEmulation: set at pre-compile  # Pre-processor switch for enabling the cycle counter emulation.
        boolean FrNmDualChannelPduEnable: set at pre-compile  # Pre-processor switch for enabling the support of dual channel transmission and reception of NM messages.
        boolean FrNmExtraReadySleepCount [0..1]: origin=BOSCH, set at pre-compile  # Pre-processor switch for enabling state change indication.
        boolean FrNmHwVoteEnable: set at pre-compile  # Pre-processor switch for enabling the processing of FlexRay Hardware aggregated NM-Votes. This switch enables/disables the optional API FrIf_GetNmVector.
        boolean FrNmNodeDetectionEnabled [0..1]: set at pre-compile, default-value=false  # Pre-processor switch for enabling node detection support. | calculationFormula = If (FrNmPassiveModeEnabled == False) then Equal(NmNodeDetectionEnabled) else Equal(False)
        boolean FrNmPassiveModeEnabled: set at pre-compile  # Pre-processor switch for enabling Passive Node Configuration support. | calculationFormula = Equal(NmPassiveModeEnabled)
        boolean FrNmPduRxIndicationEnabled: set at pre-compile  # Pre-processor switch for enabling PDU reception indication.
        boolean FrNmPnEiraCalcEnabled [0..1]: multiplicity set at link in variant link-time+post-build / pre-compile in variant pre-compile, set at link in variant link-time+post-build / pre-compile in variant pre-compile, default-value=false  # Specifies if FrNm calculates the PN request information for internal an external requests. (EIRA) | true: PN request are calculated false: PN request are not calculated
        float FrNmPnResetTime [0..1]: 0.001..65.535, multiplicity set at link in variant link-time+post-build / pre-compile in variant pre-compile, set at link in variant link-time+post-build / pre-compile in variant pre-compile  # Specifies the runtime of the reset timer in seconds. This reset time is valid for the reset of PN requests in the EIRA and in the ERA. The value shall be the same for every channel. Thus it is a global config parameter.
        boolean FrNmRemoteSleepIndicationEnabled: set at pre-compile  # Pre-processor switch for enabling remote sleep indication. | calculationFormula = If (FrNmPassiveModeEnabled == True) then Equal(False) else Equal(False or True)
        boolean FrNmRepeatMessageBitEnabled: set at pre-compile  # Pre-processor switch for enabling the repeat message bit support.
        boolean FrNmSourceNodeIdentifierEnabled [0..1]: set at pre-compile, default-value=false  # Pre-processor switch for enabling SourceNodeIdentifier support.
        boolean FrNmStateChangeIndicationEnabled: set at pre-compile  # Pre-processor switch for enabling state change indication.(It is advised to set it as TRUE)
        boolean FrNmUserDataEnabled: set at pre-compile  # Pre-processor switch for enabling user data support.
        boolean FrNmVotingNextToLastRepetitionCycleDisable: set at pre-compile  # Pre-processor switch for disabling vote changes in the last two | repetition cycles before the Ready Sleep Counter expires.
        reference FrNmPnEiraRxNSduRef [0..1]: multiplicity set at link in variant link-time+post-build / pre-compile in variant pre-compile, set at link in variant link-time+post-build / pre-compile in variant pre-compile, destination=Pdu  # Reference to a Pdu in the COM-Stack. | Only one SduRef is required for FrNm because the EIRA is the aggregation over all FlexRay Channels.
        container FrNmPnInfo [0..1]  # PN information configuration
          integer FrNmMaxNumberOfPnsConfigurableAtPostBuildTime [0..1]: 0..56, origin=BOSCH, set at link in variant link-time+post-build / pre-compile in variant pre-compile, default-value=0  # Specifies the maximum number of the PNs can be configured during post build time.This parameter should be configured during pre compile time itself.
          integer FrNmPnInfoLength: 1..7, set at link in variant link-time+post-build / pre-compile in variant pre-compile, default-value=1  # Specifies the length of the PN request information in the NM message.
          integer FrNmPnInfoOffset: 1..7, set at link in variant link-time+post-build / pre-compile in variant pre-compile, default-value=1  # Specifies the offset of the PN request information in the NM message.
          container FrNmPnFilterMaskByte [0..7]  # Filter mask byte configuration
            integer FrNmPnFilterMaskByteIndex: 0..6, set at link in variant link-time+post-build / pre-compile in variant pre-compile  # Index of the filter mask byte. Specifies the position within the filter mask byte array.
            integer FrNmPnFilterMaskByteValue: 0..255, post-build-variant-value=true, set at link in variant link-time / post-build in variant post-build / pre-compile in variant pre-compile, default-value=0  # Parameter to configure the filter mask byte.
      container FrNmGlobalProperties  # This container contains module properties related to the FlexRay NM functionality.
        boolean FrNmDevErrorDetect: set at pre-compile  # Switches the Default Error Tracer (Det) detection and notification ON or OFF. | * true: enabled (ON). * false: disabled (OFF).
        boolean FrNmMainAcrossFrCycle: set at link in variant link-time+post-build / pre-compile in variant pre-compile  # If the FlexRay NM MainFunction is executed completely within the FlexRay communication cycle where the last NM vote of the current vote cycle is received, the FrNmMainAcrossFrCycle shall be configured to FALSE. | If the FlexRay NM MainFunction is executed completely within the FlexRay communication cycle subsequent to the one where the last NM vote of the current vote cycle is received, the FrNmMainAcrossFrCycle shall be configured to TRUE.
        boolean FrNmVersionInfoApi: set at pre-compile  # Pre-processor switch for enabling version info API support.

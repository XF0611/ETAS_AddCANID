[part 1 of 2: package /AUTOSAR_Mfx/EcucModuleDefs]
AUTOSAR XML (schema 4-2-2)
package /AUTOSAR_Mfx/EcucModuleDefs
  module definition Mfx [0..1]: category=VENDOR_SPECIFIC_MODULE_DEFINITION, refined-module-def=Mfx, variants pre-compile  # Fixed Point Math Library
    container MfxGeneral  # General settings for Mfx | General settings for Mfx with selections for used controller and activation of GetVersionInfo interface
      enumeration MfxRbOptimization [0..1]: multiplicity set at pre-compile, origin=RB:1.0.0:2010-12-15, set at pre-compile  # Select for which controller optimized implementations shall be used
        TC17xx  # Tricore TC17xx controller
        TC27xx  # Tricore TC27xx controller
        MPC57xx  # JDP MPC57xx controller
        MPCCut2  # JDP MPC Cut2 controller
        ARMV8X32  # ARMV8X32 controllers
        NO_OPTIMIZATION  # No optimization, standard C implementations shall be used
      boolean MfxRbOptimizationMcuExtract [0..1]: multiplicity set at pre-compile, origin=RB:10.0.0:2015-06-18, set at pre-compile, default-value=false  # Select whether to fetch machine type from MCU and configure for controller optimized implementation | If MfxRbOptimizationMcuExtract is chosen as "True", then the controller information will be extracted from MCU.Based on this, optimized implementations will be selected.Hence the user should not configure "MfxRbOptimization".If MfxRbOptimizationMcuExtract is chosen as "False", the controller information will not be extracted from MCU and so the user needs to configure "MfxRbOptimization" manually.
      enumeration Mfx_VersionInfoAPI: origin=RB:1.0.0:2010-12-15, set at pre-compile  # Configuration parameter for activation of Mfx_GetVersionInfo function. | If MfxVersionInfoAPI is set to "ON", the function MfxGetVersionInfo shall return the version information of the Mfx library. If MfxVersionInfoAPI is set to "OFF", the Mfx library shall not provide the function Mfx_GetVersionInfo
        ON  # Activate MfxGetVersionInfo function.
        OFF  # Deactivate MfxGetVersionInfo function.
    container MfxRbMemoryLocations  # Memory locations | Choose memory location settings for each single service
      enumeration mfxRbMemLocAbsDiffP2s16s16s16: origin=RB:4.0.0:, set at pre-compile  # Mfx_AbsDiffP2_s16s16_s16 | Select one of following values: NORMAL for location in normal flash, FAST for location in fast flash, SLOW for location in slow flash, INLINE for inlining of the service
        NORMAL  # Location in normal flash
        FAST  # Location in fast flash
        SLOW  # Location in slow flash
        INLINE  # Service is inlined
      enumeration mfxRbMemLocAbsDiffP2s16s16u16: origin=RB:4.0.0:, set at pre-compile  # Mfx_AbsDiffP2_s16s16_u16 | Select one of following values: NORMAL for location in normal flash, FAST for location in fast flash, SLOW for location in slow flash, INLINE for inlining of the service
        NORMAL  # Location in normal flash
        FAST  # Location in fast flash
        SLOW  # Location in slow flash
        INLINE  # Service is inlined
      enumeration mfxRbMemLocAbsDiffP2u16s16s16: origin=RB:4.0.0:, set at pre-compile  # Mfx_AbsDiffP2_u16s16_s16 | Select one of following values: NORMAL for location in normal flash, FAST for location in fast flash, SLOW for location in slow flash, INLINE for inlining of the service
        NORMAL  # Location in normal flash
        FAST  # Location in fast flash
        SLOW  # Location in slow flash
        INLINE  # Service is inlined
      enumeration mfxRbMemLocAbsDiffP2u16s16u16: origin=RB:4.0.0:, set at pre-compile  # Mfx_AbsDiffP2_u16s16_u16 | Select one of following values: NORMAL for location in normal flash, FAST for location in fast flash, SLOW for location in slow flash, INLINE for inlining of the service
        NORMAL  # Location in normal flash
        FAST  # Location in fast flash
        SLOW  # Location in slow flash
        INLINE  # Service is inlined
      enumeration mfxRbMemLocAbsDiffP2u16u16s16: origin=RB:4.0.0:, set at pre-compile  # Mfx_AbsDiffP2_u16u16_s16 | Select one of following values: NORMAL for location in normal flash, FAST for location in fast flash, SLOW for location in slow flash, INLINE for inlining of the service
        NORMAL  # Location in normal flash
        FAST  # Location in fast flash
        SLOW  # Location in slow flash
        INLINE  # Service is inlined
      enumeration mfxRbMemLocAbsDiffP2u16u16u16: origin=RB:4.0.0:, set at pre-compile  # Mfx_AbsDiffP2_u16u16_u16 | Select one of following values: NORMAL for location in normal flash, FAST for location in fast flash, SLOW for location in slow flash, INLINE for inlining of the service
        NORMAL  # Location in normal flash
        FAST  # Location in fast flash
        SLOW  # Location in slow flash
        INLINE  # Service is inlined
      enumeration mfxRbMemLocAbsDiffs16s16s16: origin=RB:5.0.0:2012-12-17, set at pre-compile  # Mfx_AbsDiff_s16s16_s16 | Select one of following values: NORMAL for location in normal flash, FAST for location in fast flash, SLOW for location in slow flash, INLINE for inlining of the service
        NORMAL  # Location in normal flash
        FAST  # Location in fast flash
        SLOW  # Location in slow flash
        INLINE  # Service is inlined
      enumeration mfxRbMemLocAbsDiffs16s16s8: origin=RB:5.0.0:2012-12-17, set at pre-compile  # Mfx_AbsDiff_s16s16_s8 | Select one of following values: NORMAL for location in normal flash, FAST for location in fast flash, SLOW for location in slow flash, INLINE for inlining of the service
        NORMAL  # Location in normal flash
        FAST  # Location in fast flash
        SLOW  # Location in slow flash
        INLINE  # Service is inlined
      enumeration mfxRbMemLocAbsDiffs16s16u16: origin=RB:2.0.0:2011-06-30, set at pre-compile  # Mfx_AbsDiff_s16s16_u16 | Select one of following values: NORMAL for location in normal flash, FAST for location in fast flash, SLOW for location in slow flash, INLINE for inlining of the service
        NORMAL  # Location in normal flash
        FAST  # Location in fast flash
        SLOW  # Location in slow flash
        INLINE  # Service is inlined
      enumeration mfxRbMemLocAbsDiffs16s16u8: origin=RB:2.0.0:2011-06-30, set at pre-compile  # Mfx_AbsDiff_s16s16_u8 | Select one of following values: NORMAL for location in normal flash, FAST for location in fast flash, SLOW for location in slow flash, INLINE for inlining of the service
        NORMAL  # Location in normal flash
        FAST  # Location in fast flash
        SLOW  # Location in slow flash
        INLINE  # Service is inlined
      enumeration mfxRbMemLocAbsDiffs32s32s16: origin=RB:1.0.0:2010-12-17, set at pre-compile  # Mfx_AbsDiff_s32s32_s16 | Select one of following values: NORMAL for location in normal flash, FAST for location in fast flash, SLOW for location in slow flash, INLINE for inlining of the service
        NORMAL  # Location in normal flash
        FAST  # Location in fast flash
        SLOW  # Location in slow flash
        INLINE  # Service is inlined
      enumeration mfxRbMemLocAbsDiffs32s32s32: origin=RB:1.0.0:2010-12-17, set at pre-compile  # Mfx_AbsDiff_s32s32_s32 | Select one of following values: NORMAL for location in normal flash, FAST for location in fast flash, SLOW for location in slow flash, INLINE for inlining of the service
        NORMAL  # Location in normal flash
        FAST  # Location in fast flash
        SLOW  # Location in slow flash
        INLINE  # Service is inlined
      enumeration mfxRbMemLocAbsDiffs32s32s8: origin=RB:1.0.0:2010-12-17, set at pre-compile  # Mfx_AbsDiff_s32s32_s8 | Select one of following values: NORMAL for location in normal flash, FAST for location in fast flash, SLOW for location in slow flash, INLINE for inlining of the service
        NORMAL  # Location in normal flash
        FAST  # Location in fast flash
        SLOW  # Location in slow flash
        INLINE  # Service is inlined
      enumeration mfxRbMemLocAbsDiffs32s32u16: origin=RB:1.0.0:2010-12-17, set at pre-compile  # Mfx_AbsDiff_s32s32_u16 | Select one of following values: NORMAL for location in normal flash, FAST for location in fast flash, SLOW for location in slow flash, INLINE for inlining of the service
        NORMAL  # Location in normal flash
        FAST  # Location in fast flash
        SLOW  # Location in slow flash
        INLINE  # Service is inlined
      enumeration mfxRbMemLocAbsDiffs32s32u32: origin=RB:1.0.0:2010-12-17, set at pre-compile  # Mfx_AbsDiff_s32s32_u32 | Select one of following values: NORMAL for location in normal flash, FAST for location in fast flash, SLOW for location in slow flash, INLINE for inlining of the service
        NORMAL  # Location in normal flash
        FAST  # Location in fast flash
        SLOW  # Location in slow flash
        INLINE  # Service is inlined
      enumeration mfxRbMemLocAbsDiffs32s32u8: origin=RB:1.0.0:2010-12-17, set at pre-compile  # Mfx_AbsDiff_s32s32_u8 | Select one of following values: NORMAL for location in normal flash, FAST for location in fast flash, SLOW for location in slow flash, INLINE for inlining of the service
        NORMAL  # Location in normal flash
        FAST  # Location in fast flash
        SLOW  # Location in slow flash
        INLINE  # Service is inlined
      enumeration mfxRbMemLocAbsDiffs8s8s8: origin=RB:5.0.0:2012-12-17, set at pre-compile  # Mfx_AbsDiff_s8s8_s8 | Select one of following values: NORMAL for location in normal flash, FAST for location in fast flash, SLOW for location in slow flash, INLINE for inlining of the service
        NORMAL  # Location in normal flash
        FAST  # Location in fast flash
        SLOW  # Location in slow flash
        INLINE  # Service is inlined
      enumeration mfxRbMemLocAbsDiffs8s8u8: origin=RB:5.0.0:2012-12-17, set at pre-compile  # Mfx_AbsDiff_s8s8_u8 | Select one of following values: NORMAL for location in normal flash, FAST for location in fast flash, SLOW for location in slow flash, INLINE for inlining of the service
        NORMAL  # Location in normal flash
        FAST  # Location in fast flash
        SLOW  # Location in slow flash
        INLINE  # Service is inlined
      enumeration mfxRbMemLocAbsDiffu16s16s16: origin=RB:5.0.0:2012-12-17, set at pre-compile  # Mfx_AbsDiff_u16s16_s16 | Select one of following values: NORMAL for location in normal flash, FAST for location in fast flash, SLOW for location in slow flash, INLINE for inlining of the service
        NORMAL  # Location in normal flash
        FAST  # Location in fast flash
        SLOW  # Location in slow flash
        INLINE  # Service is inlined
      enumeration mfxRbMemLocAbsDiffu16s16s8: origin=RB:5.0.0:2012-12-17, set at pre-compile  # Mfx_AbsDiff_u16s16_s8 | Select one of following values: NORMAL for location in normal flash, FAST for location in fast flash, SLOW for location in slow flash, INLINE for inlining of the service
        NORMAL  # Location in normal flash
        FAST  # Location in fast flash
        SLOW  # Location in slow flash
        INLINE  # Service is inlined
      enumeration mfxRbMemLocAbsDiffu16s16u16: origin=RB:5.0.0:2012-12-17, set at pre-compile  # Mfx_AbsDiff_u16s16_u16 | Select one of following values: NORMAL for location in normal flash, FAST for location in fast flash, SLOW for location in slow flash, INLINE for inlining of the service
        NORMAL  # Location in normal flash
        FAST  # Location in fast flash
        SLOW  # Location in slow flash
        INLINE  # Service is inlined
      enumeration mfxRbMemLocAbsDiffu16s16u8: origin=RB:5.0.0:2012-12-17, set at pre-compile  # Mfx_AbsDiff_u16s16_u8 | Select one of following values: NORMAL for location in normal flash, FAST for location in fast flash, SLOW for location in slow flash, INLINE for inlining of the service
        NORMAL  # Location in normal flash
        FAST  # Location in fast flash
        SLOW  # Location in slow flash
        INLINE  # Service is inlined
      enumeration mfxRbMemLocAbsDiffu16u16s16: origin=RB:5.0.0:2012-12-17, set at pre-compile  # Mfx_AbsDiff_u16u16_s16 | Select one of following values: NORMAL for location in normal flash, FAST for location in fast flash, SLOW for location in slow flash, INLINE for inlining of the service
        NORMAL  # Location in normal flash
        FAST  # Location in fast flash
        SLOW  # Location in slow flash
        INLINE  # Service is inlined
      enumeration mfxRbMemLocAbsDiffu16u16s8: origin=RB:5.0.0:2012-12-17, set at pre-compile  # Mfx_AbsDiff_u16u16_s8 | Select one of following values: NORMAL for location in normal flash, FAST for location in fast flash, SLOW for location in slow flash, INLINE for inlining of the service
        NORMAL  # Location in normal flash
        FAST  # Location in fast flash
        SLOW  # Location in slow flash
        INLINE  # Service is inlined
      enumeration mfxRbMemLocAbsDiffu16u16u16: origin=RB:2.0.0:2011-06-30, set at pre-compile  # Mfx_AbsDiff_u16u16_u16 | Select one of following values: NORMAL for location in normal flash, FAST for location in fast flash, SLOW for location in slow flash, INLINE for inlining of the service
        NORMAL  # Location in normal flash
        FAST  # Location in fast flash
        SLOW  # Location in slow flash
        INLINE  # Service is inlined
      enumeration mfxRbMemLocAbsDiffu16u16u8: origin=RB:5.0.0:2012-12-17, set at pre-compile  # Mfx_AbsDiff_u16u16_u8 | Select one of following values: NORMAL for location in normal flash, FAST for location in fast flash, SLOW for location in slow flash, INLINE for inlining of the service
        NORMAL  # Location in normal flash
        FAST  # Location in fast flash
        SLOW  # Location in slow flash
        INLINE  # Service is inlined
      enumeration mfxRbMemLocAbsDiffu32s32u16: origin=RB:1.0.0:2010-12-17, set at pre-compile  # Mfx_AbsDiff_u32s32_u16 | Select one of following values: NORMAL for location in normal flash, FAST for location in fast flash, SLOW for location in slow flash, INLINE for inlining of the service
        NORMAL  # Location in normal flash
        FAST  # Location in fast flash
        SLOW  # Location in slow flash
        INLINE  # Service is inlined
      enumeration mfxRbMemLocAbsDiffu32s32u32: origin=RB:1.0.0:2010-12-17, set at pre-compile  # Mfx_AbsDiff_u32s32_u32 | Select one of following values: NORMAL for location in normal flash, FAST for location in fast flash, SLOW for location in slow flash, INLINE for inlining of the service
        NORMAL  # Location in normal flash
        FAST  # Location in fast flash
        SLOW  # Location in slow flash
        INLINE  # Service is inlined
      enumeration mfxRbMemLocAbsDiffu32s32u8: origin=RB:1.0.0:2010-12-17, set at pre-compile  # Mfx_AbsDiff_u32s32_u8 | Select one of following values: NORMAL for location in normal flash, FAST for location in fast flash, SLOW for location in slow flash, INLINE for inlining of the service
        NORMAL  # Location in normal flash
        FAST  # Location in fast flash
        SLOW  # Location in slow flash
        INLINE  # Service is inlined
      enumeration mfxRbMemLocAbsDiffu32u32u16: origin=RB:1.0.0:2010-12-17, set at pre-compile  # Mfx_AbsDiff_u32u32_u16 | Select one of following values: NORMAL for location in normal flash, FAST for location in fast flash, SLOW for location in slow flash, INLINE for inlining of the service
        NORMAL  # Location in normal flash
        FAST  # Location in fast flash
        SLOW  # Location in slow flash
        INLINE  # Service is inlined
      enumeration mfxRbMemLocAbsDiffu32u32u32: origin=RB:1.0.0:2010-12-17, set at pre-compile  # Mfx_AbsDiff_u32u32_u32 | Select one of following values: NORMAL for location in normal flash, FAST for location in fast flash, SLOW for location in slow flash, INLINE for inlining of the service
        NORMAL  # Location in normal flash
        FAST  # Location in fast flash
        SLOW  # Location in slow flash
        INLINE  # Service is inlined
      enumeration mfxRbMemLocAbsDiffu32u32u8: origin=RB:1.0.0:2010-12-17, set at pre-compile  # Mfx_AbsDiff_u32u32_u8 | Select one of following values: NORMAL for location in normal flash, FAST for location in fast flash, SLOW for location in slow flash, INLINE for inlining of the service
        NORMAL  # Location in normal flash
        FAST  # Location in fast flash
        SLOW  # Location in slow flash
        INLINE  # Service is inlined
      enumeration mfxRbMemLocAbsDiffu8s8s8: origin=RB:5.0.0:2012-12-17, set at pre-compile  # Mfx_AbsDiff_u8s8_s8 | Select one of following values: NORMAL for location in normal flash, FAST for location in fast flash, SLOW for location in slow flash, INLINE for inlining of the service
        NORMAL  # Location in normal flash
        FAST  # Location in fast flash
        SLOW  # Location in slow flash
        INLINE  # Service is inlined
      enumeration mfxRbMemLocAbsDiffu8s8u8: origin=RB:5.0.0:2012-12-17, set at pre-compile  # Mfx_AbsDiff_u8s8_u8 | Select one of following values: NORMAL for location in normal flash, FAST for location in fast flash, SLOW for location in slow flash, INLINE for inlining of the service
        NORMAL  # Location in normal flash
        FAST  # Location in fast flash
        SLOW  # Location in slow flash
        INLINE  # Service is inlined
      enumeration mfxRbMemLocAbsDiffu8u8s8: origin=RB:5.0.0:2012-12-17, set at pre-compile  # Mfx_AbsDiff_u8u8_s8 | Select one of following values: NORMAL for location in normal flash, FAST for location in fast flash, SLOW for location in slow flash, INLINE for inlining of the service
        NORMAL  # Location in normal flash
        FAST  # Location in fast flash
        SLOW  # Location in slow flash
        INLINE  # Service is inlined
      enumeration mfxRbMemLocAbsDiffu8u8u8: origin=RB:2.0.0:2011-06-30, set at pre-compile  # Mfx_AbsDiff_u8u8_u8 | Select one of following values: NORMAL for location in normal flash, FAST for location in fast flash, SLOW for location in slow flash, INLINE for inlining of the service
        NORMAL  # Location in normal flash
        FAST  # Location in fast flash
        SLOW  # Location in slow flash
        INLINE  # Service is inlined
      enumeration mfxRbMemLocAbsP2s16s16: origin=RB:4.0.0:, set at pre-compile  # Mfx_AbsP2_s16_s16 | Select one of following values: NORMAL for location in normal flash, FAST for location in fast flash, SLOW for location in slow flash, INLINE for inlining of the service
        NORMAL  # Location in normal flash
        FAST  # Location in fast flash
        SLOW  # Location in slow flash
        INLINE  # Service is inlined
      enumeration mfxRbMemLocAbsP2s16u16: origin=RB:4.0.0:, set at pre-compile  # Mfx_AbsP2_s16_u16 | Select one of following values: NORMAL for location in normal flash, FAST for location in fast flash, SLOW for location in slow flash, INLINE for inlining of the service
        NORMAL  # Location in normal flash
        FAST  # Location in fast flash
        SLOW  # Location in slow flash
        INLINE  # Service is inlined
      enumeration mfxRbMemLocAbsP2s32s32: origin=RB:4.0.0:, set at pre-compile  # Mfx_AbsP2_s32_s32 | Select one of following values: NORMAL for location in normal flash, FAST for location in fast flash, SLOW for location in slow flash, INLINE for inlining of the service
        NORMAL  # Location in normal flash
        FAST  # Location in fast flash
        SLOW  # Location in slow flash
        INLINE  # Service is inlined
      enumeration mfxRbMemLocAbsP2s32u32: origin=RB:4.0.0:, set at pre-compile  # Mfx_AbsP2_s32_u32 | Select one of following values: NORMAL for location in normal flash, FAST for location in fast flash, SLOW for location in slow flash, INLINE for inlining of the service
        NORMAL  # Location in normal flash
        FAST  # Location in fast flash
        SLOW  # Location in slow flash
        INLINE  # Service is inlined
      enumeration mfxRbMemLocAbsdiffu32s32s16: origin=RB:2.0.0:2011-06-30, set at pre-compile  # Mfx_Absdiff_u32s32_s16 | Select one of following values: NORMAL for location in normal flash, FAST for location in fast flash, SLOW for location in slow flash, INLINE for inlining of the service
        NORMAL  # Location in normal flash
        FAST  # Location in fast flash
        SLOW  # Location in slow flash
        INLINE  # Service is inlined
      enumeration mfxRbMemLocAbsdiffu32s32s32: origin=RB:2.0.0:2011-06-30, set at pre-compile  # Mfx_Absdiff_u32s32_s32 | Select one of following values: NORMAL for location in normal flash, FAST for location in fast flash, SLOW for location in slow flash, INLINE for inlining of the service
        NORMAL  # Location in normal flash
        FAST  # Location in fast flash
        SLOW  # Location in slow flash
        INLINE  # Service is inlined
      enumeration mfxRbMemLocAbsdiffu32s32s8: origin=RB:2.0.0:2011-06-30, set at pre-compile  # Mfx_Absdiff_u32s32_s8 | Select one of following values: NORMAL for location in normal flash, FAST for location in fast flash, SLOW for location in slow flash, INLINE for inlining of the service
        NORMAL  # Location in normal flash
        FAST  # Location in fast flash
        SLOW  # Location in slow flash
        INLINE  # Service is inlined
      enumeration mfxRbMemLocAbsdiffu32u32s16: origin=RB:2.0.0:2011-06-30, set at pre-compile  # Mfx_Absdiff_u32u32_s16 | Select one of following values: NORMAL for location in normal flash, FAST for location in fast flash, SLOW for location in slow flash, INLINE for inlining of the service
        NORMAL  # Location in normal flash
        FAST  # Location in fast flash
        SLOW  # Location in slow flash
        INLINE  # Service is inlined
      enumeration mfxRbMemLocAbsdiffu32u32s32: origin=RB:2.0.0:2011-06-30, set at pre-compile  # Mfx_Absdiff_u32u32_s32 | Select one of following values: NORMAL for location in normal flash, FAST for location in fast flash, SLOW for location in slow flash, INLINE for inlining of the service
        NORMAL  # Location in normal flash
        FAST  # Location in fast flash
        SLOW  # Location in slow flash
        INLINE  # Service is inlined
      enumeration mfxRbMemLocAbsdiffu32u32s8: origin=RB:2.0.0:2011-06-30, set at pre-compile  # Mfx_Absdiff_u32u32_s8 | Select one of following values: NORMAL for location in normal flash, FAST for location in fast flash, SLOW for location in slow flash, INLINE for inlining of the service
        NORMAL  # Location in normal flash
        FAST  # Location in fast flash
        SLOW  # Location in slow flash
        INLINE  # Service is inlined
      enumeration mfxRbMemLocAbss16s16: origin=RB:2.0.0:2011-06-30, set at pre-compile  # Mfx_Abs_s16_s16 | Select one of following values: NORMAL for location in normal flash, FAST for location in fast flash, SLOW for location in slow flash, INLINE for inlining of the service
        NORMAL  # Location in normal flash
        FAST  # Location in fast flash
        SLOW  # Location in slow flash
        INLINE  # Service is inlined
      enumeration mfxRbMemLocAbss16u16: origin=RB:2.0.0:2011-06-30, set at pre-compile  # Mfx_Abs_s16_u16 | Select one of following values: NORMAL for location in normal flash, FAST for location in fast flash, SLOW for location in slow flash, INLINE for inlining of the service
        NORMAL  # Location in normal flash
        FAST  # Location in fast flash
        SLOW  # Location in slow flash
        INLINE  # Service is inlined
      enumeration mfxRbMemLocAbss32s16: origin=RB:1.0.0:2010-12-17, set at pre-compile  # Mfx_Abs_s32_s16 | Select one of following values: NORMAL for location in normal flash, FAST for location in fast flash, SLOW for location in slow flash, INLINE for inlining of the service
        NORMAL  # Location in normal flash
        FAST  # Location in fast flash
        SLOW  # Location in slow flash
        INLINE  # Service is inlined
      enumeration mfxRbMemLocAbss32s32: origin=RB:1.0.0:2010-12-17, set at pre-compile  # Mfx_Abs_s32_s32 | Select one of following values: NORMAL for location in normal flash, FAST for location in fast flash, SLOW for location in slow flash, INLINE for inlining of the service
        NORMAL  # Location in normal flash
        FAST  # Location in fast flash
        SLOW  # Location in slow flash
        INLINE  # Service is inlined
      enumeration mfxRbMemLocAbss32s8: origin=RB:1.0.0:2010-12-17, set at pre-compile  # Mfx_Abs_s32_s8 | Select one of following values: NORMAL for location in normal flash, FAST for location in fast flash, SLOW for location in slow flash, INLINE for inlining of the service
        NORMAL  # Location in normal flash
        FAST  # Location in fast flash
        SLOW  # Location in slow flash
        INLINE  # Service is inlined
      enumeration mfxRbMemLocAbss32u16: origin=RB:1.0.0:2010-12-17, set at pre-compile  # Mfx_Abs_s32_u16 | Select one of following values: NORMAL for location in normal flash, FAST for location in fast flash, SLOW for location in slow flash, INLINE for inlining of the service
        NORMAL  # Location in normal flash
        FAST  # Location in fast flash
        SLOW  # Location in slow flash
        INLINE  # Service is inlined
      enumeration mfxRbMemLocAbss32u32: origin=RB:1.0.0:2010-12-17, set at pre-compile  # Mfx_Abs_s32_u32 | Select one of following values: NORMAL for location in normal flash, FAST for location in fast flash, SLOW for location in slow flash, INLINE for inlining of the service
        NORMAL  # Location in normal flash
        FAST  # Location in fast flash
        SLOW  # Location in slow flash
        INLINE  # Service is inlined
      enumeration mfxRbMemLocAbss32u8: origin=RB:1.0.0:2010-12-17, set at pre-compile  # Mfx_Abs_s32_u8 | Select one of following values: NORMAL for location in normal flash, FAST for location in fast flash, SLOW for location in slow flash, INLINE for inlining of the service
        NORMAL  # Location in normal flash
        FAST  # Location in fast flash
        SLOW  # Location in slow flash
        INLINE  # Service is inlined
      enumeration mfxRbMemLocAbss8s8: origin=RB:2.0.0:2011-06-30, set at pre-compile  # Mfx_Abs_s8_s8 | Select one of following values: NORMAL for location in normal flash, FAST for location in fast flash, SLOW for location in slow flash, INLINE for inlining of the service
        NORMAL  # Location in normal flash
        FAST  # Location in fast flash
        SLOW  # Location in slow flash
        INLINE  # Service is inlined
      enumeration mfxRbMemLocAbss8u8: origin=RB:2.0.0:2011-06-30, set at pre-compile  # Mfx_Abs_s8_u8 | Select one of following values: NORMAL for location in normal flash, FAST for location in fast flash, SLOW for location in slow flash, INLINE for inlining of the service
        NORMAL  # Location in normal flash
        FAST  # Location in fast flash
        SLOW  # Location in slow flash
        INLINE  # Service is inlined
      enumeration mfxRbMemLocAddP2s16s16s16: origin=RB:4.0.0:, set at pre-compile  # Mfx_AddP2_s16s16_s16 | Select one of following values: NORMAL for location in normal flash, FAST for location in fast flash, SLOW for location in slow flash, INLINE for inlining of the service
        NORMAL  # Location in normal flash
        FAST  # Location in fast flash
        SLOW  # Location in slow flash
        INLINE  # Service is inlined
      enumeration mfxRbMemLocAddP2s16s16u16: origin=RB:4.0.0:, set at pre-compile  # Mfx_AddP2_s16s16_u16 | Select one of following values: NORMAL for location in normal flash, FAST for location in fast flash, SLOW for location in slow flash, INLINE for inlining of the service
        NORMAL  # Location in normal flash
        FAST  # Location in fast flash
        SLOW  # Location in slow flash
        INLINE  # Service is inlined
      enumeration mfxRbMemLocAddP2s32s32s32: origin=RB:4.0.0:, set at pre-compile  # Mfx_AddP2_s32s32_s32 | Select one of following values: NORMAL for location in normal flash, FAST for location in fast flash, SLOW for location in slow flash, INLINE for inlining of the service
        NORMAL  # Location in normal flash
        FAST  # Location in fast flash
        SLOW  # Location in slow flash
        INLINE  # Service is inlined
      enumeration mfxRbMemLocAddP2s32s32u32: origin=RB:4.0.0:, set at pre-compile  # Mfx_AddP2_s32s32_u32 | Select one of following values: NORMAL for location in normal flash, FAST for location in fast flash, SLOW for location in slow flash, INLINE for inlining of the service
        NORMAL  # Location in normal flash
        FAST  # Location in fast flash
        SLOW  # Location in slow flash
        INLINE  # Service is inlined
      enumeration mfxRbMemLocAddP2u16s16s16: origin=RB:4.0.0:, set at pre-compile  # Mfx_AddP2_u16s16_s16 | Select one of following values: NORMAL for location in normal flash, FAST for location in fast flash, SLOW for location in slow flash, INLINE for inlining of the service
        NORMAL  # Location in normal flash
        FAST  # Location in fast flash
        SLOW  # Location in slow flash
        INLINE  # Service is inlined
      enumeration mfxRbMemLocAddP2u16s16u16: origin=RB:4.0.0:, set at pre-compile  # Mfx_AddP2_u16s16_u16 | Select one of following values: NORMAL for location in normal flash, FAST for location in fast flash, SLOW for location in slow flash, INLINE for inlining of the service
        NORMAL  # Location in normal flash
        FAST  # Location in fast flash
        SLOW  # Location in slow flash
        INLINE  # Service is inlined
      enumeration mfxRbMemLocAddP2u16u16s16: origin=RB:4.0.0:, set at pre-compile  # Mfx_AddP2_u16u16_s16 | Select one of following values: NORMAL for location in normal flash, FAST for location in fast flash, SLOW for location in slow flash, INLINE for inlining of the service
        NORMAL  # Location in normal flash
        FAST  # Location in fast flash
        SLOW  # Location in slow flash
        INLINE  # Service is inlined
      enumeration mfxRbMemLocAddP2u16u16u16: origin=RB:4.0.0:, set at pre-compile  # Mfx_AddP2_u16u16_u16 | Select one of following values: NORMAL for location in normal flash, FAST for location in fast flash, SLOW for location in slow flash, INLINE for inlining of the service
        NORMAL  # Location in normal flash
        FAST  # Location in fast flash
        SLOW  # Location in slow flash
        INLINE  # Service is inlined
      enumeration mfxRbMemLocAddP2u32s32s32: origin=RB:4.0.0:, set at pre-compile  # Mfx_AddP2_u32s32_s32 | Select one of following values: NORMAL for location in normal flash, FAST for location in fast flash, SLOW for location in slow flash, INLINE for inlining of the service
        NORMAL  # Location in normal flash
        FAST  # Location in fast flash
        SLOW  # Location in slow flash
        INLINE  # Service is inlined
      enumeration mfxRbMemLocAddP2u32s32u32: origin=RB:4.0.0:, set at pre-compile  # Mfx_AddP2_u32s32_u32 | Select one of following values: NORMAL for location in normal flash, FAST for location in fast flash, SLOW for location in slow flash, INLINE for inlining of the service
        NORMAL  # Location in normal flash
        FAST  # Location in fast flash
        SLOW  # Location in slow flash
        INLINE  # Service is inlined
      enumeration mfxRbMemLocAddP2u32u32s32: origin=RB:4.0.0:, set at pre-compile  # Mfx_AddP2_u32u32_s32 | Select one of following values: NORMAL for location in normal flash, FAST for location in fast flash, SLOW for location in slow flash, INLINE for inlining of the service
        NORMAL  # Location in normal flash
        FAST  # Location in fast flash
        SLOW  # Location in slow flash
        INLINE  # Service is inlined
      enumeration mfxRbMemLocAddP2u32u32u32: origin=RB:4.0.0:, set at pre-compile  # Mfx_AddP2_u32u32_u32 | Select one of following values: NORMAL for location in normal flash, FAST for location in fast flash, SLOW for location in slow flash, INLINE for inlining of the service
        NORMAL  # Location in normal flash
        FAST  # Location in fast flash
        SLOW  # Location in slow flash
        INLINE  # Service is inlined
      enumeration mfxRbMemLocAdds16s16s16: origin=RB:2.0.0:2011-06-30, set at pre-compile  # Mfx_Add_s16s16_s16 | Select one of following values: NORMAL for location in normal flash, FAST for location in fast flash, SLOW for location in slow flash, INLINE for inlining of the service
        NORMAL  # Location in normal flash
        FAST  # Location in fast flash
        SLOW  # Location in slow flash
        INLINE  # Service is inlined
      enumeration mfxRbMemLocAdds16s16s8: origin=RB:2.0.0:2011-06-30, set at pre-compile  # Mfx_Add_s16s16_s8 | Select one of following values: NORMAL for location in normal flash, FAST for location in fast flash, SLOW for location in slow flash, INLINE for inlining of the service
        NORMAL  # Location in normal flash
        FAST  # Location in fast flash
        SLOW  # Location in slow flash
        INLINE  # Service is inlined
      enumeration mfxRbMemLocAdds16s16u16: origin=RB:2.0.0:2011-06-30, set at pre-compile  # Mfx_Add_s16s16_u16 | Select one of following values: NORMAL for location in normal flash, FAST for location in fast flash, SLOW for location in slow flash, INLINE for inlining of the service
        NORMAL  # Location in normal flash
        FAST  # Location in fast flash
        SLOW  # Location in slow flash
        INLINE  # Service is inlined
      enumeration mfxRbMemLocAdds16s16u8: origin=RB:2.0.0:2011-06-30, set at pre-compile  # Mfx_Add_s16s16_u8 | Select one of following values: NORMAL for location in normal flash, FAST for location in fast flash, SLOW for location in slow flash, INLINE for inlining of the service
        NORMAL  # Location in normal flash
        FAST  # Location in fast flash
        SLOW  # Location in slow flash
        INLINE  # Service is inlined
      enumeration mfxRbMemLocAdds32s32s16: origin=RB:1.0.0:2010-12-17, set at pre-compile  # Mfx_Add_s32s32_s16 | Select one of following values: NORMAL for location in normal flash, FAST for location in fast flash, SLOW for location in slow flash, INLINE for inlining of the service
        NORMAL  # Location in normal flash
        FAST  # Location in fast flash
        SLOW  # Location in slow flash
        INLINE  # Service is inlined
      enumeration mfxRbMemLocAdds32s32s32: origin=RB:1.0.0:2010-12-17, set at pre-compile  # Mfx_Add_s32s32_s32 | Select one of following values: NORMAL for location in normal flash, FAST for location in fast flash, SLOW for location in slow flash, INLINE for inlining of the service
        NORMAL  # Location in normal flash
        FAST  # Location in fast flash
        SLOW  # Location in slow flash
        INLINE  # Service is inlined
      enumeration mfxRbMemLocAdds32s32s8: origin=RB:1.0.0:2010-12-17, set at pre-compile  # Mfx_Add_s32s32_s8 | Select one of following values: NORMAL for location in normal flash, FAST for location in fast flash, SLOW for location in slow flash, INLINE for inlining of the service
        NORMAL  # Location in normal flash
        FAST  # Location in fast flash
        SLOW  # Location in slow flash
        INLINE  # Service is inlined
      enumeration mfxRbMemLocAdds32s32u16: origin=RB:1.0.0:2010-12-17, set at pre-compile  # Mfx_Add_s32s32_u16 | Select one of following values: NORMAL for location in normal flash, FAST for location in fast flash, SLOW for location in slow flash, INLINE for inlining of the service
        NORMAL  # Location in normal flash
        FAST  # Location in fast flash
        SLOW  # Location in slow flash
        INLINE  # Service is inlined
      enumeration mfxRbMemLocAdds32s32u32: origin=RB:1.0.0:2010-12-17, set at pre-compile  # Mfx_Add_s32s32_u32 | Select one of following values: NORMAL for location in normal flash, FAST for location in fast flash, SLOW for location in slow flash, INLINE for inlining of the service
        NORMAL  # Location in normal flash
        FAST  # Location in fast flash
        SLOW  # Location in slow flash
        INLINE  # Service is inlined
      enumeration mfxRbMemLocAdds32s32u8: origin=RB:1.0.0:2010-12-17, set at pre-compile  # Mfx_Add_s32s32_u8 | Select one of following values: NORMAL for location in normal flash, FAST for location in fast flash, SLOW for location in slow flash, INLINE for inlining of the service
        NORMAL  # Location in normal flash
        FAST  # Location in fast flash
        SLOW  # Location in slow flash
        INLINE  # Service is inlined
      enumeration mfxRbMemLocAdds8s8s8: origin=RB:2.0.0:2011-06-30, set at pre-compile  # Mfx_Add_s8s8_s8 | Select one of following values: NORMAL for location in normal flash, FAST for location in fast flash, SLOW for location in slow flash, INLINE for inlining of the service
        NORMAL  # Location in normal flash
        FAST  # Location in fast flash
        SLOW  # Location in slow flash
        INLINE  # Service is inlined
      enumeration mfxRbMemLocAdds8s8u8: origin=RB:2.0.0:2011-06-30, set at pre-compile  # Mfx_Add_s8s8_u8 | Select one of following values: NORMAL for location in normal flash, FAST for location in fast flash, SLOW for location in slow flash, INLINE for inlining of the service
        NORMAL  # Location in normal flash
        FAST  # Location in fast flash
        SLOW  # Location in slow flash
        INLINE  # Service is inlined
      enumeration mfxRbMemLocAddu16s16s16: origin=RB:2.0.0:2011-06-30, set at pre-compile  # Mfx_Add_u16s16_s16 | Select one of following values: NORMAL for location in normal flash, FAST for location in fast flash, SLOW for location in slow flash, INLINE for inlining of the service
        NORMAL  # Location in normal flash
        FAST  # Location in fast flash
        SLOW  # Location in slow flash
        INLINE  # Service is inlined
      enumeration mfxRbMemLocAddu16s16s8: origin=RB:5.0.0:2012-12-17, set at pre-compile  # Mfx_Add_u16s16_s8 | Select one of following values: NORMAL for location in normal flash, FAST for location in fast flash, SLOW for location in slow flash, INLINE for inlining of the service
        NORMAL  # Location in normal flash
        FAST  # Location in fast flash
        SLOW  # Location in slow flash
        INLINE  # Service is inlined
      enumeration mfxRbMemLocAddu16s16u16: origin=RB:2.0.0:2011-06-30, set at pre-compile  # Mfx_Add_u16s16_u16 | Select one of following values: NORMAL for location in normal flash, FAST for location in fast flash, SLOW for location in slow flash, INLINE for inlining of the service
        NORMAL  # Location in normal flash
        FAST  # Location in fast flash
        SLOW  # Location in slow flash
        INLINE  # Service is inlined
      enumeration mfxRbMemLocAddu16s16u8: origin=RB:5.0.0:2012-12-17, set at pre-compile  # Mfx_Add_u16s16_u8 | Select one of following values: NORMAL for location in normal flash, FAST for location in fast flash, SLOW for location in slow flash, INLINE for inlining of the service
        NORMAL  # Location in normal flash
        FAST  # Location in fast flash
        SLOW  # Location in slow flash
        INLINE  # Service is inlined
      enumeration mfxRbMemLocAddu16u16s16: origin=RB:5.0.0:2012-12-17, set at pre-compile  # Mfx_Add_u16u16_s16 | Select one of following values: NORMAL for location in normal flash, FAST for location in fast flash, SLOW for location in slow flash, INLINE for inlining of the service
        NORMAL  # Location in normal flash
        FAST  # Location in fast flash
        SLOW  # Location in slow flash
        INLINE  # Service is inlined
      enumeration mfxRbMemLocAddu16u16s8: origin=RB:5.0.0:2012-12-17, set at pre-compile  # Mfx_Add_u16u16_s8 | Select one of following values: NORMAL for location in normal flash, FAST for location in fast flash, SLOW for location in slow flash, INLINE for inlining of the service
        NORMAL  # Location in normal flash
        FAST  # Location in fast flash
        SLOW  # Location in slow flash
        INLINE  # Service is inlined
      enumeration mfxRbMemLocAddu16u16u16: origin=RB:2.0.0:2011-06-30, set at pre-compile  # Mfx_Add_u16u16_u16 | Select one of following values: NORMAL for location in normal flash, FAST for location in fast flash, SLOW for location in slow flash, INLINE for inlining of the service
        NORMAL  # Location in normal flash
        FAST  # Location in fast flash
        SLOW  # Location in slow flash
        INLINE  # Service is inlined
      enumeration mfxRbMemLocAddu16u16u8: origin=RB:5.0.0:2012-12-17, set at pre-compile  # Mfx_Add_u16u16_u8 | Select one of following values: NORMAL for location in normal flash, FAST for location in fast flash, SLOW for location in slow flash, INLINE for inlining of the service
        NORMAL  # Location in normal flash
        FAST  # Location in fast flash
        SLOW  # Location in slow flash
        INLINE  # Service is inlined
      enumeration mfxRbMemLocAddu32s32s16: origin=RB:1.0.0:2010-12-17, set at pre-compile  # Mfx_Add_u32s32_s16 | Select one of following values: NORMAL for location in normal flash, FAST for location in fast flash, SLOW for location in slow flash, INLINE for inlining of the service
        NORMAL  # Location in normal flash
        FAST  # Location in fast flash
        SLOW  # Location in slow flash
        INLINE  # Service is inlined
      enumeration mfxRbMemLocAddu32s32s32: origin=RB:1.0.0:2010-12-17, set at pre-compile  # Mfx_Add_u32s32_s32 | Select one of following values: NORMAL for location in normal flash, FAST for location in fast flash, SLOW for location in slow flash, INLINE for inlining of the service
        NORMAL  # Location in normal flash
        FAST  # Location in fast flash
        SLOW  # Location in slow flash
        INLINE  # Service is inlined
      enumeration mfxRbMemLocAddu32s32s8: origin=RB:1.0.0:2010-12-17, set at pre-compile  # Mfx_Add_u32s32_s8 | Select one of following values: NORMAL for location in normal flash, FAST for location in fast flash, SLOW for location in slow flash, INLINE for inlining of the service
        NORMAL  # Location in normal flash
        FAST  # Location in fast flash
        SLOW  # Location in slow flash
        INLINE  # Service is inlined
      enumeration mfxRbMemLocAddu32s32u16: origin=RB:1.0.0:2010-12-17, set at pre-compile  # Mfx_Add_u32s32_u16 | Select one of following values: NORMAL for location in normal flash, FAST for location in fast flash, SLOW for location in slow flash, INLINE for inlining of the service
        NORMAL  # Location in normal flash
        FAST  # Location in fast flash
        SLOW  # Location in slow flash
        INLINE  # Service is inlined
      enumeration mfxRbMemLocAddu32s32u32: origin=RB:1.0.0:2010-12-17, set at pre-compile  # Mfx_Add_u32s32_u32 | Select one of following values: NORMAL for location in normal flash, FAST for location in fast flash, SLOW for location in slow flash, INLINE for inlining of the service
        NORMAL  # Location in normal flash
        FAST  # Location in fast flash
        SLOW  # Location in slow flash
        INLINE  # Service is inlined
      enumeration mfxRbMemLocAddu32s32u8: origin=RB:1.0.0:2010-12-17, set at pre-compile  # Mfx_Add_u32s32_u8 | Select one of following values: NORMAL for location in normal flash, FAST for location in fast flash, SLOW for location in slow flash, INLINE for inlining of the service
        NORMAL  # Location in normal flash
        FAST  # Location in fast flash
        SLOW  # Location in slow flash
        INLINE  # Service is inlined
      enumeration mfxRbMemLocAddu32u32s16: origin=RB:1.0.0:2010-12-17, set at pre-compile  # Mfx_Add_u32u32_s16 | Select one of following values: NORMAL for location in normal flash, FAST for location in fast flash, SLOW for location in slow flash, INLINE for inlining of the service
        NORMAL  # Location in normal flash
        FAST  # Location in fast flash
        SLOW  # Location in slow flash
        INLINE  # Service is inlined
      enumeration mfxRbMemLocAddu32u32s32: origin=RB:1.0.0:2010-12-17, set at pre-compile  # Mfx_Add_u32u32_s32 | Select one of following values: NORMAL for location in normal flash, FAST for location in fast flash, SLOW for location in slow flash, INLINE for inlining of the service
        NORMAL  # Location in normal flash
        FAST  # Location in fast flash
        SLOW  # Location in slow flash
        INLINE  # Service is inlined
      enumeration mfxRbMemLocAddu32u32s8: origin=RB:1.0.0:2010-12-17, set at pre-compile  # Mfx_Add_u32u32_s8 | Select one of following values: NORMAL for location in normal flash, FAST for location in fast flash, SLOW for location in slow flash, INLINE for inlining of the service
        NORMAL  # Location in normal flash
        FAST  # Location in fast flash
        SLOW  # Location in slow flash
        INLINE  # Service is inlined
      enumeration mfxRbMemLocAddu32u32u16: origin=RB:1.0.0:2010-12-17, set at pre-compile  # Mfx_Add_u32u32_u16 | Select one of following values: NORMAL for location in normal flash, FAST for location in fast flash, SLOW for location in slow flash, INLINE for inlining of the service
        NORMAL  # Location in normal flash
        FAST  # Location in fast flash
        SLOW  # Location in slow flash
        INLINE  # Service is inlined
      enumeration mfxRbMemLocAddu32u32u32: origin=RB:1.0.0:2010-12-17, set at pre-compile  # Mfx_Add_u32u32_u32 | Select one of following values: NORMAL for location in normal flash, FAST for location in fast flash, SLOW for location in slow flash, INLINE for inlining of the service
        NORMAL  # Location in normal flash
        FAST  # Location in fast flash
        SLOW  # Location in slow flash
        INLINE  # Service is inlined
      enumeration mfxRbMemLocAddu32u32u8: origin=RB:1.0.0:2010-12-17, set at pre-compile  # Mfx_Add_u32u32_u8 | Select one of following values: NORMAL for location in normal flash, FAST for location in fast flash, SLOW for location in slow flash, INLINE for inlining of the service
        NORMAL  # Location in normal flash
        FAST  # Location in fast flash
        SLOW  # Location in slow flash
        INLINE  # Service is inlined
      enumeration mfxRbMemLocAddu8s8s8: origin=RB:2.0.0:2011-06-30, set at pre-compile  # Mfx_Add_u8s8_s8 | Select one of following values: NORMAL for location in normal flash, FAST for location in fast flash, SLOW for location in slow flash, INLINE for inlining of the service
        NORMAL  # Location in normal flash
        FAST  # Location in fast flash
        SLOW  # Location in slow flash
        INLINE  # Service is inlined
      enumeration mfxRbMemLocAddu8s8u8: origin=RB:2.0.0:2011-06-30, set at pre-compile  # Mfx_Add_u8s8_u8 | Select one of following values: NORMAL for location in normal flash, FAST for location in fast flash, SLOW for location in slow flash, INLINE for inlining of the service
        NORMAL  # Location in normal flash
        FAST  # Location in fast flash
        SLOW  # Location in slow flash
        INLINE  # Service is inlined
      enumeration mfxRbMemLocAddu8u8s8: origin=RB:5.0.0:2012-12-17, set at pre-compile  # Mfx_Add_u8u8_s8 | Select one of following values: NORMAL for location in normal flash, FAST for location in fast flash, SLOW for location in slow flash, INLINE for inlining of the service
        NORMAL  # Location in normal flash
        FAST  # Location in fast flash
        SLOW  # Location in slow flash
        INLINE  # Service is inlined
      enumeration mfxRbMemLocAddu8u8u8: origin=RB:2.0.0:2011-06-30, set at pre-compile  # Mfx_Add_u8u8_u8 | Select one of following values: NORMAL for location in normal flash, FAST for location in fast flash, SLOW for location in slow flash, INLINE for inlining of the service
        NORMAL  # Location in normal flash
        FAST  # Location in fast flash
        SLOW  # Location in slow flash
        INLINE  # Service is inlined
      enumeration mfxRbMemLocConvertP2s16s32: origin=RB:4.0.0:, set at pre-compile  # Mfx_ConvertP2_s16_s32 | Select one of following values: NORMAL for location in normal flash, FAST for location in fast flash, SLOW for location in slow flash, INLINE for inlining of the service
        NORMAL  # Location in normal flash
        FAST  # Location in fast flash
        SLOW  # Location in slow flash
        INLINE  # Service is inlined
      enumeration mfxRbMemLocConvertP2s16s8: origin=RB:4.0.0:, set at pre-compile  # Mfx_ConvertP2_s16_s8 | Select one of following values: NORMAL for location in normal flash, FAST for location in fast flash, SLOW for location in slow flash, INLINE for inlining of the service
        NORMAL  # Location in normal flash
        FAST  # Location in fast flash
        SLOW  # Location in slow flash
        INLINE  # Service is inlined
      enumeration mfxRbMemLocConvertP2s32s16: origin=RB:4.0.0:, set at pre-compile  # Mfx_ConvertP2_s32_s16 | Select one of following values: NORMAL for location in normal flash, FAST for location in fast flash, SLOW for location in slow flash, INLINE for inlining of the service
        NORMAL  # Location in normal flash
        FAST  # Location in fast flash
        SLOW  # Location in slow flash
        INLINE  # Service is inlined
      enumeration mfxRbMemLocConvertP2s8s16: origin=RB:4.0.0:, set at pre-compile  # Mfx_ConvertP2_s8_s16 | Select one of following values: NORMAL for location in normal flash, FAST for location in fast flash, SLOW for location in slow flash, INLINE for inlining of the service
        NORMAL  # Location in normal flash
        FAST  # Location in fast flash
        SLOW  # Location in slow flash
        INLINE  # Service is inlined
      enumeration mfxRbMemLocConvertP2u16u32: origin=RB:4.0.0:, set at pre-compile  # Mfx_ConvertP2_u16_u32 | Select one of following values: NORMAL for location in normal flash, FAST for location in fast flash, SLOW for location in slow flash, INLINE for inlining of the service
        NORMAL  # Location in normal flash
        FAST  # Location in fast flash
        SLOW  # Location in slow flash
        INLINE  # Service is inlined
      enumeration mfxRbMemLocConvertP2u16u8: origin=RB:4.0.0:, set at pre-compile  # Mfx_ConvertP2_u16_u8 | Select one of following values: NORMAL for location in normal flash, FAST for location in fast flash, SLOW for location in slow flash, INLINE for inlining of the service
        NORMAL  # Location in normal flash
        FAST  # Location in fast flash
        SLOW  # Location in slow flash
        INLINE  # Service is inlined
      enumeration mfxRbMemLocConvertP2u32u16: origin=RB:4.0.0:, set at pre-compile  # Mfx_ConvertP2_u32_u16 | Select one of following values: NORMAL for location in normal flash, FAST for location in fast flash, SLOW for location in slow flash, INLINE for inlining of the service
        NORMAL  # Location in normal flash
        FAST  # Location in fast flash
        SLOW  # Location in slow flash
        INLINE  # Service is inlined
      enumeration mfxRbMemLocConvertP2u8u16: origin=RB:4.0.0:, set at pre-compile  # Mfx_ConvertP2_u8_u16 | Select one of following values: NORMAL for location in normal flash, FAST for location in fast flash, SLOW for location in slow flash, INLINE for inlining of the service
        NORMAL  # Location in normal flash
        FAST  # Location in fast flash
        SLOW  # Location in slow flash
        INLINE  # Service is inlined
      enumeration mfxRbMemLocDivP2s16s16s16: origin=RB:4.0.0:, set at pre-compile  # Mfx_DivP2_s16s16_s16 | Select one of following values: NORMAL for location in normal flash, FAST for location in fast flash, SLOW for location in slow flash, INLINE for inlining of the service
        NORMAL  # Location in normal flash
        FAST  # Location in fast flash
        SLOW  # Location in slow flash
        INLINE  # Service is inlined
      enumeration mfxRbMemLocDivP2s16s16u16: origin=RB:4.0.0:, set at pre-compile  # Mfx_DivP2_s16s16_u16 | Select one of following values: NORMAL for location in normal flash, FAST for location in fast flash, SLOW for location in slow flash, INLINE for inlining of the service
        NORMAL  # Location in normal flash
        FAST  # Location in fast flash
        SLOW  # Location in slow flash
        INLINE  # Service is inlined
      enumeration mfxRbMemLocDivP2s16u16s16: origin=RB:4.0.0:, set at pre-compile  # Mfx_DivP2_s16u16_s16 | Select one of following values: NORMAL for location in normal flash, FAST for location in fast flash, SLOW for location in slow flash, INLINE for inlining of the service
        NORMAL  # Location in normal flash
        FAST  # Location in fast flash
        SLOW  # Location in slow flash
        INLINE  # Service is inlined
      enumeration mfxRbMemLocDivP2s16u16u16: origin=RB:4.0.0:, set at pre-compile  # Mfx_DivP2_s16u16_u16 | Select one of following values: NORMAL for location in normal flash, FAST for location in fast flash, SLOW for location in slow flash, INLINE for inlining of the service
        NORMAL  # Location in normal flash
        FAST  # Location in fast flash
        SLOW  # Location in slow flash
        INLINE  # Service is inlined
      enumeration mfxRbMemLocDivP2s32s32s32: origin=RB:4.0.0:, set at pre-compile  # Mfx_DivP2_s32s32_s32 | Select one of following values: NORMAL for location in normal flash, FAST for location in fast flash, SLOW for location in slow flash, INLINE for inlining of the service
        NORMAL  # Location in normal flash
        FAST  # Location in fast flash
        SLOW  # Location in slow flash
        INLINE  # Service is inlined
      enumeration mfxRbMemLocDivP2s32s32u32: origin=RB:4.0.0:, set at pre-compile  # Mfx_DivP2_s32s32_u32 | Select one of following values: NORMAL for location in normal flash, FAST for location in fast flash, SLOW for location in slow flash, INLINE for inlining of the service
        NORMAL  # Location in normal flash
        FAST  # Location in fast flash
        SLOW  # Location in slow flash
        INLINE  # Service is inlined
      enumeration mfxRbMemLocDivP2s32u32s32: origin=RB:4.0.0:, set at pre-compile  # Mfx_DivP2_s32u32_s32 | Select one of following values: NORMAL for location in normal flash, FAST for location in fast flash, SLOW for location in slow flash, INLINE for inlining of the service
        NORMAL  # Location in normal flash
        FAST  # Location in fast flash
        SLOW  # Location in slow flash
        INLINE  # Service is inlined
      enumeration mfxRbMemLocDivP2s32u32u32: origin=RB:4.0.0:, set at pre-compile  # Mfx_DivP2_s32u32_u32 | Select one of following values: NORMAL for location in normal flash, FAST for location in fast flash, SLOW for location in slow flash, INLINE for inlining of the service
        NORMAL  # Location in normal flash
        FAST  # Location in fast flash
        SLOW  # Location in slow flash
        INLINE  # Service is inlined
      enumeration mfxRbMemLocDivP2u16s16s16: origin=RB:4.0.0:, set at pre-compile  # Mfx_DivP2_u16s16_s16 | Select one of following values: NORMAL for location in normal flash, FAST for location in fast flash, SLOW for location in slow flash, INLINE for inlining of the service
        NORMAL  # Location in normal flash
        FAST  # Location in fast flash
        SLOW  # Location in slow flash
        INLINE  # Service is inlined
      enumeration mfxRbMemLocDivP2u16s16u16: origin=RB:4.0.0:, set at pre-compile  # Mfx_DivP2_u16s16_u16 | Select one of following values: NORMAL for location in normal flash, FAST for location in fast flash, SLOW for location in slow flash, INLINE for inlining of the service
        NORMAL  # Location in normal flash
        FAST  # Location in fast flash
        SLOW  # Location in slow flash
        INLINE  # Service is inlined
      enumeration mfxRbMemLocDivP2u16u16s16: origin=RB:4.0.0:, set at pre-compile  # Mfx_DivP2_u16u16_s16 | Select one of following values: NORMAL for location in normal flash, FAST for location in fast flash, SLOW for location in slow flash, INLINE for inlining of the service
        NORMAL  # Location in normal flash
        FAST  # Location in fast flash
        SLOW  # Location in slow flash
        INLINE  # Service is inlined
      enumeration mfxRbMemLocDivP2u16u16u16: origin=RB:4.0.0:, set at pre-compile  # Mfx_DivP2_u16u16_u16 | Select one of following values: NORMAL for location in normal flash, FAST for location in fast flash, SLOW for location in slow flash, INLINE for inlining of the service
        NORMAL  # Location in normal flash
        FAST  # Location in fast flash
        SLOW  # Location in slow flash
        INLINE  # Service is inlined
      enumeration mfxRbMemLocDivP2u32s32s32: origin=RB:4.0.0:, set at pre-compile  # Mfx_DivP2_u32s32_s32 | Select one of following values: NORMAL for location in normal flash, FAST for location in fast flash, SLOW for location in slow flash, INLINE for inlining of the service
        NORMAL  # Location in normal flash
        FAST  # Location in fast flash
        SLOW  # Location in slow flash
        INLINE  # Service is inlined
      enumeration mfxRbMemLocDivP2u32s32u32: origin=RB:4.0.0:, set at pre-compile  # Mfx_DivP2_u32s32_u32 | Select one of following values: NORMAL for location in normal flash, FAST for location in fast flash, SLOW for location in slow flash, INLINE for inlining of the service
        NORMAL  # Location in normal flash
        FAST  # Location in fast flash
        SLOW  # Location in slow flash
        INLINE  # Service is inlined
      enumeration mfxRbMemLocDivP2u32u32s32: origin=RB:4.0.0:, set at pre-compile  # Mfx_DivP2_u32u32_s32 | Select one of following values: NORMAL for location in normal flash, FAST for location in fast flash, SLOW for location in slow flash, INLINE for inlining of the service
        NORMAL  # Location in normal flash
        FAST  # Location in fast flash
        SLOW  # Location in slow flash
        INLINE  # Service is inlined
      enumeration mfxRbMemLocDivP2u32u32u32: origin=RB:4.0.0:, set at pre-compile  # Mfx_DivP2_u32u32_u32 | Select one of following values: NORMAL for location in normal flash, FAST for location in fast flash, SLOW for location in slow flash, INLINE for inlining of the service
        NORMAL  # Location in normal flash
        FAST  # Location in fast flash
        SLOW  # Location in slow flash
        INLINE  # Service is inlined
      enumeration mfxRbMemLocDivShLefts16s16u8s16: origin=RB:4.0.0:, set at pre-compile  # Mfx_DivShLeft_s16s16u8_s16 | Select one of following values: NORMAL for location in normal flash, FAST for location in fast flash, SLOW for location in slow flash, INLINE for inlining of the service
        NORMAL  # Location in normal flash
        FAST  # Location in fast flash
        SLOW  # Location in slow flash
        INLINE  # Service is inlined
      enumeration mfxRbMemLocDivShLefts16u16u8s16: origin=RB:4.0.0:, set at pre-compile  # Mfx_DivShLeft_s16u16u8_s16 | Select one of following values: NORMAL for location in normal flash, FAST for location in fast flash, SLOW for location in slow flash, INLINE for inlining of the service
        NORMAL  # Location in normal flash
        FAST  # Location in fast flash
        SLOW  # Location in slow flash
        INLINE  # Service is inlined
      enumeration mfxRbMemLocDivShLefts32s32u8s16: origin=RB:4.0.0:, set at pre-compile  # Mfx_DivShLeft_s32s32u8_s16 | Select one of following values: NORMAL for location in normal flash, FAST for location in fast flash, SLOW for location in slow flash, INLINE for inlining of the service
        NORMAL  # Location in normal flash
        FAST  # Location in fast flash
        SLOW  # Location in slow flash
        INLINE  # Service is inlined
      enumeration mfxRbMemLocDivShLefts32s32u8s32: origin=RB:4.0.0:, set at pre-compile  # Mfx_DivShLeft_s32s32u8_s32 | Select one of following values: NORMAL for location in normal flash, FAST for location in fast flash, SLOW for location in slow flash, INLINE for inlining of the service
        NORMAL  # Location in normal flash
        FAST  # Location in fast flash
        SLOW  # Location in slow flash
        INLINE  # Service is inlined
      enumeration mfxRbMemLocDivShLefts32s32u8s8: origin=RB:4.0.0:, set at pre-compile  # Mfx_DivShLeft_s32s32u8_s8 | Select one of following values: NORMAL for location in normal flash, FAST for location in fast flash, SLOW for location in slow flash, INLINE for inlining of the service
        NORMAL  # Location in normal flash
        FAST  # Location in fast flash
        SLOW  # Location in slow flash
        INLINE  # Service is inlined
      enumeration mfxRbMemLocDivShLefts32s32u8u16: origin=RB:4.0.0:, set at pre-compile  # Mfx_DivShLeft_s32s32u8_u16 | Select one of following values: NORMAL for location in normal flash, FAST for location in fast flash, SLOW for location in slow flash, INLINE for inlining of the service
        NORMAL  # Location in normal flash
        FAST  # Location in fast flash
        SLOW  # Location in slow flash
        INLINE  # Service is inlined
      enumeration mfxRbMemLocDivShLefts32s32u8u32: origin=RB:4.0.0:, set at pre-compile  # Mfx_DivShLeft_s32s32u8_u32 | Select one of following values: NORMAL for location in normal flash, FAST for location in fast flash, SLOW for location in slow flash, INLINE for inlining of the service
        NORMAL  # Location in normal flash
        FAST  # Location in fast flash
        SLOW  # Location in slow flash
        INLINE  # Service is inlined
      enumeration mfxRbMemLocDivShLefts32s32u8u8: origin=RB:4.0.0:, set at pre-compile  # Mfx_DivShLeft_s32s32u8_u8 | Select one of following values: NORMAL for location in normal flash, FAST for location in fast flash, SLOW for location in slow flash, INLINE for inlining of the service
        NORMAL  # Location in normal flash
        FAST  # Location in fast flash
        SLOW  # Location in slow flash
        INLINE  # Service is inlined
      enumeration mfxRbMemLocDivShLefts32u32u8s16: origin=RB:4.0.0:, set at pre-compile  # Mfx_DivShLeft_s32u32u8_s16 | Select one of following values: NORMAL for location in normal flash, FAST for location in fast flash, SLOW for location in slow flash, INLINE for inlining of the service
        NORMAL  # Location in normal flash
        FAST  # Location in fast flash
        SLOW  # Location in slow flash
        INLINE  # Service is inlined
      enumeration mfxRbMemLocDivShLefts32u32u8s32: origin=RB:4.0.0:, set at pre-compile  # Mfx_DivShLeft_s32u32u8_s32 | Select one of following values: NORMAL for location in normal flash, FAST for location in fast flash, SLOW for location in slow flash, INLINE for inlining of the service
        NORMAL  # Location in normal flash
        FAST  # Location in fast flash
        SLOW  # Location in slow flash
        INLINE  # Service is inlined
      enumeration mfxRbMemLocDivShLefts32u32u8s8: origin=RB:4.0.0:, set at pre-compile  # Mfx_DivShLeft_s32u32u8_s8 | Select one of following values: NORMAL for location in normal flash, FAST for location in fast flash, SLOW for location in slow flash, INLINE for inlining of the service
        NORMAL  # Location in normal flash
        FAST  # Location in fast flash
        SLOW  # Location in slow flash
        INLINE  # Service is inlined
      enumeration mfxRbMemLocDivShLefts32u32u8u16: origin=RB:4.0.0:, set at pre-compile  # Mfx_DivShLeft_s32u32u8_u16 | Select one of following values: NORMAL for location in normal flash, FAST for location in fast flash, SLOW for location in slow flash, INLINE for inlining of the service
        NORMAL  # Location in normal flash
        FAST  # Location in fast flash
        SLOW  # Location in slow flash
        INLINE  # Service is inlined
      enumeration mfxRbMemLocDivShLefts32u32u8u32: origin=RB:4.0.0:, set at pre-compile  # Mfx_DivShLeft_s32u32u8_u32 | Select one of following values: NORMAL for location in normal flash, FAST for location in fast flash, SLOW for location in slow flash, INLINE for inlining of the service
        NORMAL  # Location in normal flash
        FAST  # Location in fast flash
        SLOW  # Location in slow flash
        INLINE  # Service is inlined
      enumeration mfxRbMemLocDivShLefts32u32u8u8: origin=RB:4.0.0:, set at pre-compile  # Mfx_DivShLeft_s32u32u8_u8 | Select one of following values: NORMAL for location in normal flash, FAST for location in fast flash, SLOW for location in slow flash, INLINE for inlining of the service
        NORMAL  # Location in normal flash
        FAST  # Location in fast flash
        SLOW  # Location in slow flash
        INLINE  # Service is inlined
      enumeration mfxRbMemLocDivShLeftu16u16u8u16: origin=RB:4.0.0:, set at pre-compile  # Mfx_DivShLeft_u16u16u8_u16 | Select one of following values: NORMAL for location in normal flash, FAST for location in fast flash, SLOW for location in slow flash, INLINE for inlining of the service
        NORMAL  # Location in normal flash
        FAST  # Location in fast flash
        SLOW  # Location in slow flash
        INLINE  # Service is inlined
      enumeration mfxRbMemLocDivShLeftu16u16u8u8: origin=RB:4.0.0:, set at pre-compile  # Mfx_DivShLeft_u16u16u8_u8 | Select one of following values: NORMAL for location in normal flash, FAST for location in fast flash, SLOW for location in slow flash, INLINE for inlining of the service
        NORMAL  # Location in normal flash
        FAST  # Location in fast flash
        SLOW  # Location in slow flash
        INLINE  # Service is inlined
      enumeration mfxRbMemLocDivShLeftu32s32u8s16: origin=RB:4.0.0:, set at pre-compile  # Mfx_DivShLeft_u32s32u8_s16 | Select one of following values: NORMAL for location in normal flash, FAST for location in fast flash, SLOW for location in slow flash, INLINE for inlining of the service
        NORMAL  # Location in normal flash
        FAST  # Location in fast flash
        SLOW  # Location in slow flash
        INLINE  # Service is inlined
      enumeration mfxRbMemLocDivShLeftu32s32u8s32: origin=RB:4.0.0:, set at pre-compile  # Mfx_DivShLeft_u32s32u8_s32 | Select one of following values: NORMAL for location in normal flash, FAST for location in fast flash, SLOW for location in slow flash, INLINE for inlining of the service
        NORMAL  # Location in normal flash
        FAST  # Location in fast flash
        SLOW  # Location in slow flash
        INLINE  # Service is inlined
      enumeration mfxRbMemLocDivShLeftu32s32u8s8: origin=RB:4.0.0:, set at pre-compile  # Mfx_DivShLeft_u32s32u8_s8 | Select one of following values: NORMAL for location in normal flash, FAST for location in fast flash, SLOW for location in slow flash, INLINE for inlining of the service
        NORMAL  # Location in normal flash
        FAST  # Location in fast flash
        SLOW  # Location in slow flash
        INLINE  # Service is inlined
      enumeration mfxRbMemLocDivShLeftu32s32u8u16: origin=RB:4.0.0:, set at pre-compile  # Mfx_DivShLeft_u32s32u8_u16 | Select one of following values: NORMAL for location in normal flash, FAST for location in fast flash, SLOW for location in slow flash, INLINE for inlining of the service
        NORMAL  # Location in normal flash
        FAST  # Location in fast flash
        SLOW  # Location in slow flash
        INLINE  # Service is inlined
      enumeration mfxRbMemLocDivShLeftu32s32u8u32: origin=RB:4.0.0:, set at pre-compile  # Mfx_DivShLeft_u32s32u8_u32 | Select one of following values: NORMAL for location in normal flash, FAST for location in fast flash, SLOW for location in slow flash, INLINE for inlining of the service
        NORMAL  # Location in normal flash
        FAST  # Location in fast flash
        SLOW  # Location in slow flash
        INLINE  # Service is inlined
      enumeration mfxRbMemLocDivShLeftu32s32u8u8: origin=RB:4.0.0:, set at pre-compile  # Mfx_DivShLeft_u32s32u8_u8 | Select one of following values: NORMAL for location in normal flash, FAST for location in fast flash, SLOW for location in slow flash, INLINE for inlining of the service
        NORMAL  # Location in normal flash
        FAST  # Location in fast flash
        SLOW  # Location in slow flash
        INLINE  # Service is inlined
      enumeration mfxRbMemLocDivShLeftu32u32u8s16: origin=RB:4.0.0:, set at pre-compile  # Mfx_DivShLeft_u32u32u8_s16 | Select one of following values: NORMAL for location in normal flash, FAST for location in fast flash, SLOW for location in slow flash, INLINE for inlining of the service
        NORMAL  # Location in normal flash
        FAST  # Location in fast flash
        SLOW  # Location in slow flash
        INLINE  # Service is inlined
      enumeration mfxRbMemLocDivShLeftu32u32u8s32: origin=RB:4.0.0:, set at pre-compile  # Mfx_DivShLeft_u32u32u8_s32 | Select one of following values: NORMAL for location in normal flash, FAST for location in fast flash, SLOW for location in slow flash, INLINE for inlining of the service
        NORMAL  # Location in normal flash
        FAST  # Location in fast flash
        SLOW  # Location in slow flash
        INLINE  # Service is inlined
      enumeration mfxRbMemLocDivShLeftu32u32u8s8: origin=RB:4.0.0:, set at pre-compile  # Mfx_DivShLeft_u32u32u8_s8 | Select one of following values: NORMAL for location in normal flash, FAST for location in fast flash, SLOW for location in slow flash, INLINE for inlining of the service
        NORMAL  # Location in normal flash
        FAST  # Location in fast flash
        SLOW  # Location in slow flash
        INLINE  # Service is inlined
      enumeration mfxRbMemLocDivShLeftu32u32u8u16: origin=RB:4.0.0:, set at pre-compile  # Mfx_DivShLeft_u32u32u8_u16 | Select one of following values: NORMAL for location in normal flash, FAST for location in fast flash, SLOW for location in slow flash, INLINE for inlining of the service
        NORMAL  # Location in normal flash
        FAST  # Location in fast flash
        SLOW  # Location in slow flash
        INLINE  # Service is inlined
      enumeration mfxRbMemLocDivShLeftu32u32u8u32: origin=RB:4.0.0:, set at pre-compile  # Mfx_DivShLeft_u32u32u8_u32 | Select one of following values: NORMAL for location in normal flash, FAST for location in fast flash, SLOW for location in slow flash, INLINE for inlining of the service
        NORMAL  # Location in normal flash
        FAST  # Location in fast flash
        SLOW  # Location in slow flash
        INLINE  # Service is inlined
      enumeration mfxRbMemLocDivShLeftu32u32u8u8: origin=RB:4.0.0:, set at pre-compile  # Mfx_DivShLeft_u32u32u8_u8 | Select one of following values: NORMAL for location in normal flash, FAST for location in fast flash, SLOW for location in slow flash, INLINE for inlining of the service
        NORMAL  # Location in normal flash
        FAST  # Location in fast flash
        SLOW  # Location in slow flash
        INLINE  # Service is inlined
      enumeration mfxRbMemLocDivShLeftu8u8u8u8: origin=RB:4.0.0:, set at pre-compile  # Mfx_DivShLeft_u8u8u8_u8 | Select one of following values: NORMAL for location in normal flash, FAST for location in fast flash, SLOW for location in slow flash, INLINE for inlining of the service
        NORMAL  # Location in normal flash
        FAST  # Location in fast flash
        SLOW  # Location in slow flash
        INLINE  # Service is inlined
      enumeration mfxRbMemLocDivs16s16s16: origin=RB:2.0.0:2011-06-30, set at pre-compile  # Mfx_Div_s16s16_s16 | Select one of following values: NORMAL for location in normal flash, FAST for location in fast flash, SLOW for location in slow flash, INLINE for inlining of the service
        NORMAL  # Location in normal flash
        FAST  # Location in fast flash
        SLOW  # Location in slow flash
        INLINE  # Service is inlined
      enumeration mfxRbMemLocDivs16s16s8: origin=RB:2.0.0:2011-06-30, set at pre-compile  # Mfx_Div_s16s16_s8 | Select one of following values: NORMAL for location in normal flash, FAST for location in fast flash, SLOW for location in slow flash, INLINE for inlining of the service
        NORMAL  # Location in normal flash
        FAST  # Location in fast flash
        SLOW  # Location in slow flash
        INLINE  # Service is inlined
      enumeration mfxRbMemLocDivs16s16u16: origin=RB:2.0.0:2011-06-30, set at pre-compile  # Mfx_Div_s16s16_u16 | Select one of following values: NORMAL for location in normal flash, FAST for location in fast flash, SLOW for location in slow flash, INLINE for inlining of the service
        NORMAL  # Location in normal flash
        FAST  # Location in fast flash
        SLOW  # Location in slow flash
        INLINE  # Service is inlined
      enumeration mfxRbMemLocDivs16s16u8: origin=RB:2.0.0:2011-06-30, set at pre-compile  # Mfx_Div_s16s16_u8 | Select one of following values: NORMAL for location in normal flash, FAST for location in fast flash, SLOW for location in slow flash, INLINE for inlining of the service
        NORMAL  # Location in normal flash
        FAST  # Location in fast flash
        SLOW  # Location in slow flash
        INLINE  # Service is inlined
      enumeration mfxRbMemLocDivs16u16s16: origin=RB:2.0.0:2011-06-30, set at pre-compile  # Mfx_Div_s16u16_s16 | Select one of following values: NORMAL for location in normal flash, FAST for location in fast flash, SLOW for location in slow flash, INLINE for inlining of the service
        NORMAL  # Location in normal flash
        FAST  # Location in fast flash
        SLOW  # Location in slow flash
        INLINE  # Service is inlined
      enumeration mfxRbMemLocDivs16u16s8: origin=RB:5.0.0:2012-12-17, set at pre-compile  # Mfx_Div_s16u16_s8 | Select one of following values: NORMAL for location in normal flash, FAST for location in fast flash, SLOW for location in slow flash, INLINE for inlining of the service
        NORMAL  # Location in normal flash
        FAST  # Location in fast flash
        SLOW  # Location in slow flash
        INLINE  # Service is inlined
      enumeration mfxRbMemLocDivs16u16u16: origin=RB:2.0.0:2011-06-30, set at pre-compile  # Mfx_Div_s16u16_u16 | Select one of following values: NORMAL for location in normal flash, FAST for location in fast flash, SLOW for location in slow flash, INLINE for inlining of the service
        NORMAL  # Location in normal flash
        FAST  # Location in fast flash
        SLOW  # Location in slow flash
        INLINE  # Service is inlined
      enumeration mfxRbMemLocDivs16u16u8: origin=RB:5.0.0:2012-12-17, set at pre-compile  # Mfx_Div_s16u16_u8 | Select one of following values: NORMAL for location in normal flash, FAST for location in fast flash, SLOW for location in slow flash, INLINE for inlining of the service
        NORMAL  # Location in normal flash
        FAST  # Location in fast flash
        SLOW  # Location in slow flash
        INLINE  # Service is inlined
      enumeration mfxRbMemLocDivs32s16s16: origin=RB:2.0.0:2011-06-30, set at pre-compile  # Mfx_Div_s32s16_s16 | Select one of following values: NORMAL for location in normal flash, FAST for location in fast flash, SLOW for location in slow flash, INLINE for inlining of the service
        NORMAL  # Location in normal flash
        FAST  # Location in fast flash
        SLOW  # Location in slow flash
        INLINE  # Service is inlined
      enumeration mfxRbMemLocDivs32s32s16: origin=RB:1.0.0:2010-12-17, set at pre-compile  # Mfx_Div_s32s32_s16 | Select one of following values: NORMAL for location in normal flash, FAST for location in fast flash, SLOW for location in slow flash, INLINE for inlining of the service
        NORMAL  # Location in normal flash
        FAST  # Location in fast flash
        SLOW  # Location in slow flash
        INLINE  # Service is inlined
      enumeration mfxRbMemLocDivs32s32s32: origin=RB:1.0.0:2010-12-17, set at pre-compile  # Mfx_Div_s32s32_s32 | Select one of following values: NORMAL for location in normal flash, FAST for location in fast flash, SLOW for location in slow flash, INLINE for inlining of the service
        NORMAL  # Location in normal flash
        FAST  # Location in fast flash
        SLOW  # Location in slow flash
        INLINE  # Service is inlined
      enumeration mfxRbMemLocDivs32s32s8: origin=RB:1.0.0:2010-12-17, set at pre-compile  # Mfx_Div_s32s32_s8 | Select one of following values: NORMAL for location in normal flash, FAST for location in fast flash, SLOW for location in slow flash, INLINE for inlining of the service
        NORMAL  # Location in normal flash
        FAST  # Location in fast flash
        SLOW  # Location in slow flash
        INLINE  # Service is inlined
      enumeration mfxRbMemLocDivs32s32u16: origin=RB:1.0.0:2010-12-17, set at pre-compile  # Mfx_Div_s32s32_u16 | Select one of following values: NORMAL for location in normal flash, FAST for location in fast flash, SLOW for location in slow flash, INLINE for inlining of the service
        NORMAL  # Location in normal flash
        FAST  # Location in fast flash
        SLOW  # Location in slow flash
        INLINE  # Service is inlined
      enumeration mfxRbMemLocDivs32s32u32: origin=RB:1.0.0:2010-12-17, set at pre-compile  # Mfx_Div_s32s32_u32 | Select one of following values: NORMAL for location in normal flash, FAST for location in fast flash, SLOW for location in slow flash, INLINE for inlining of the service
        NORMAL  # Location in normal flash
        FAST  # Location in fast flash
        SLOW  # Location in slow flash
        INLINE  # Service is inlined
      enumeration mfxRbMemLocDivs32s32u8: origin=RB:1.0.0:2010-12-17, set at pre-compile  # Mfx_Div_s32s32_u8 | Select one of following values: NORMAL for location in normal flash, FAST for location in fast flash, SLOW for location in slow flash, INLINE for inlining of the service
        NORMAL  # Location in normal flash
        FAST  # Location in fast flash
        SLOW  # Location in slow flash
        INLINE  # Service is inlined
      enumeration mfxRbMemLocDivs32u16u16: origin=RB:2.0.0:2011-06-30, set at pre-compile  # Mfx_Div_s32u16_u16 | Select one of following values: NORMAL for location in normal flash, FAST for location in fast flash, SLOW for location in slow flash, INLINE for inlining of the service
        NORMAL  # Location in normal flash
        FAST  # Location in fast flash
        SLOW  # Location in slow flash
        INLINE  # Service is inlined
      enumeration mfxRbMemLocDivs32u32s16: origin=RB:1.0.0:2010-12-17, set at pre-compile  # Mfx_Div_s32u32_s16 | Select one of following values: NORMAL for location in normal flash, FAST for location in fast flash, SLOW for location in slow flash, INLINE for inlining of the service
        NORMAL  # Location in normal flash
        FAST  # Location in fast flash
        SLOW  # Location in slow flash
        INLINE  # Service is inlined
      enumeration mfxRbMemLocDivs32u32s32: origin=RB:1.0.0:2010-12-17, set at pre-compile  # Mfx_Div_s32u32_s32 | Select one of following values: NORMAL for location in normal flash, FAST for location in fast flash, SLOW for location in slow flash, INLINE for inlining of the service
        NORMAL  # Location in normal flash
        FAST  # Location in fast flash
        SLOW  # Location in slow flash
        INLINE  # Service is inlined
      enumeration mfxRbMemLocDivs32u32s8: origin=RB:1.0.0:2010-12-17, set at pre-compile  # Mfx_Div_s32u32_s8 | Select one of following values: NORMAL for location in normal flash, FAST for location in fast flash, SLOW for location in slow flash, INLINE for inlining of the service
        NORMAL  # Location in normal flash
        FAST  # Location in fast flash
        SLOW  # Location in slow flash
        INLINE  # Service is inlined
      enumeration mfxRbMemLocDivs32u32u16: origin=RB:1.0.0:2010-12-17, set at pre-compile  # Mfx_Div_s32u32_u16 | Select one of following values: NORMAL for location in normal flash, FAST for location in fast flash, SLOW for location in slow flash, INLINE for inlining of the service
        NORMAL  # Location in normal flash
        FAST  # Location in fast flash
        SLOW  # Location in slow flash
        INLINE  # Service is inlined
      enumeration mfxRbMemLocDivs32u32u32: origin=RB:1.0.0:2010-12-17, set at pre-compile  # Mfx_Div_s32u32_u32 | Select one of following values: NORMAL for location in normal flash, FAST for location in fast flash, SLOW for location in slow flash, INLINE for inlining of the service
        NORMAL  # Location in normal flash
        FAST  # Location in fast flash
        SLOW  # Location in slow flash
        INLINE  # Service is inlined
      enumeration mfxRbMemLocDivs32u32u8: origin=RB:1.0.0:2010-12-17, set at pre-compile  # Mfx_Div_s32u32_u8 | Select one of following values: NORMAL for location in normal flash, FAST for location in fast flash, SLOW for location in slow flash, INLINE for inlining of the service
        NORMAL  # Location in normal flash
        FAST  # Location in fast flash
        SLOW  # Location in slow flash
        INLINE  # Service is inlined
      enumeration mfxRbMemLocDivs8s8s8: origin=RB:2.0.0:2011-06-30, set at pre-compile  # Mfx_Div_s8s8_s8 | Select one of following values: NORMAL for location in normal flash, FAST for location in fast flash, SLOW for location in slow flash, INLINE for inlining of the service
        NORMAL  # Location in normal flash
        FAST  # Location in fast flash
        SLOW  # Location in slow flash
        INLINE  # Service is inlined
      enumeration mfxRbMemLocDivs8s8u8: origin=RB:2.0.0:2011-06-30, set at pre-compile  # Mfx_Div_s8s8_u8 | Select one of following values: NORMAL for location in normal flash, FAST for location in fast flash, SLOW for location in slow flash, INLINE for inlining of the service
        NORMAL  # Location in normal flash
        FAST  # Location in fast flash
        SLOW  # Location in slow flash
        INLINE  # Service is inlined
      enumeration mfxRbMemLocDivs8u8s8: origin=RB:2.0.0:2011-06-30, set at pre-compile  # Mfx_Div_s8u8_s8 | Select one of following values: NORMAL for location in normal flash, FAST for location in fast flash, SLOW for location in slow flash, INLINE for inlining of the service
        NORMAL  # Location in normal flash
        FAST  # Location in fast flash
        SLOW  # Location in slow flash
        INLINE  # Service is inlined
      enumeration mfxRbMemLocDivs8u8u8: origin=RB:2.0.0:2011-06-30, set at pre-compile  # Mfx_Div_s8u8_u8 | Select one of following values: NORMAL for location in normal flash, FAST for location in fast flash, SLOW for location in slow flash, INLINE for inlining of the service
        NORMAL  # Location in normal flash
        FAST  # Location in fast flash
        SLOW  # Location in slow flash
        INLINE  # Service is inlined
      enumeration mfxRbMemLocDivu16s16s16: origin=RB:2.0.0:2011-06-30, set at pre-compile  # Mfx_Div_u16s16_s16 | Select one of following values: NORMAL for location in normal flash, FAST for location in fast flash, SLOW for location in slow flash, INLINE for inlining of the service
        NORMAL  # Location in normal flash
        FAST  # Location in fast flash
        SLOW  # Location in slow flash
        INLINE  # Service is inlined
      enumeration mfxRbMemLocDivu16s16s8: origin=RB:5.0.0:2012-12-17, set at pre-compile  # Mfx_Div_u16s16_s8 | Select one of following values: NORMAL for location in normal flash, FAST for location in fast flash, SLOW for location in slow flash, INLINE for inlining of the service
        NORMAL  # Location in normal flash
        FAST  # Location in fast flash
        SLOW  # Location in slow flash
        INLINE  # Service is inlined
      enumeration mfxRbMemLocDivu16s16u16: origin=RB:2.0.0:2011-06-30, set at pre-compile  # Mfx_Div_u16s16_u16 | Select one of following values: NORMAL for location in normal flash, FAST for location in fast flash, SLOW for location in slow flash, INLINE for inlining of the service
        NORMAL  # Location in normal flash
        FAST  # Location in fast flash
        SLOW  # Location in slow flash
        INLINE  # Service is inlined
      enumeration mfxRbMemLocDivu16s16u8: origin=RB:5.0.0:2012-12-17, set at pre-compile  # Mfx_Div_u16s16_u8 | Select one of following values: NORMAL for location in normal flash, FAST for location in fast flash, SLOW for location in slow flash, INLINE for inlining of the service
        NORMAL  # Location in normal flash
        FAST  # Location in fast flash
        SLOW  # Location in slow flash
        INLINE  # Service is inlined
      enumeration mfxRbMemLocDivu16u16s16: origin=RB:5.0.0:2012-12-17, set at pre-compile  # Mfx_Div_u16u16_s16 | Select one of following values: NORMAL for location in normal flash, FAST for location in fast flash, SLOW for location in slow flash, INLINE for inlining of the service
        NORMAL  # Location in normal flash
        FAST  # Location in fast flash
        SLOW  # Location in slow flash
        INLINE  # Service is inlined
      enumeration mfxRbMemLocDivu16u16s8: origin=RB:5.0.0:2012-12-17, set at pre-compile  # Mfx_Div_u16u16_s8 | Select one of following values: NORMAL for location in normal flash, FAST for location in fast flash, SLOW for location in slow flash, INLINE for inlining of the service
        NORMAL  # Location in normal flash
        FAST  # Location in fast flash
        SLOW  # Location in slow flash
        INLINE  # Service is inlined
      enumeration mfxRbMemLocDivu16u16u16: origin=RB:2.0.0:2011-06-30, set at pre-compile  # Mfx_Div_u16u16_u16 | Select one of following values: NORMAL for location in normal flash, FAST for location in fast flash, SLOW for location in slow flash, INLINE for inlining of the service
        NORMAL  # Location in normal flash
        FAST  # Location in fast flash
        SLOW  # Location in slow flash
        INLINE  # Service is inlined
      enumeration mfxRbMemLocDivu16u16u8: origin=RB:5.0.0:2012-12-17, set at pre-compile  # Mfx_Div_u16u16_u8 | Select one of following values: NORMAL for location in normal flash, FAST for location in fast flash, SLOW for location in slow flash, INLINE for inlining of the service
        NORMAL  # Location in normal flash
        FAST  # Location in fast flash
        SLOW  # Location in slow flash
        INLINE  # Service is inlined
      enumeration mfxRbMemLocDivu32s32s16: origin=RB:1.0.0:2010-12-17, set at pre-compile  # Mfx_Div_u32s32_s16 | Select one of following values: NORMAL for location in normal flash, FAST for location in fast flash, SLOW for location in slow flash, INLINE for inlining of the service
        NORMAL  # Location in normal flash
        FAST  # Location in fast flash
        SLOW  # Location in slow flash
        INLINE  # Service is inlined
      enumeration mfxRbMemLocDivu32s32s32: origin=RB:1.0.0:2010-12-17, set at pre-compile  # Mfx_Div_u32s32_s32 | Select one of following values: NORMAL for location in normal flash, FAST for location in fast flash, SLOW for location in slow flash, INLINE for inlining of the service
        NORMAL  # Location in normal flash
        FAST  # Location in fast flash
        SLOW  # Location in slow flash
        INLINE  # Service is inlined
      enumeration mfxRbMemLocDivu32s32s8: origin=RB:1.0.0:2010-12-17, set at pre-compile  # Mfx_Div_u32s32_s8 | Select one of following values: NORMAL for location in normal flash, FAST for location in fast flash, SLOW for location in slow flash, INLINE for inlining of the service
        NORMAL  # Location in normal flash
        FAST  # Location in fast flash
        SLOW  # Location in slow flash
        INLINE  # Service is inlined
      enumeration mfxRbMemLocDivu32s32u16: origin=RB:1.0.0:2010-12-17, set at pre-compile  # Mfx_Div_u32s32_u16 | Select one of following values: NORMAL for location in normal flash, FAST for location in fast flash, SLOW for location in slow flash, INLINE for inlining of the service
        NORMAL  # Location in normal flash
        FAST  # Location in fast flash
        SLOW  # Location in slow flash
        INLINE  # Service is inlined
      enumeration mfxRbMemLocDivu32s32u32: origin=RB:1.0.0:2010-12-17, set at pre-compile  # Mfx_Div_u32s32_u32 | Select one of following values: NORMAL for location in normal flash, FAST for location in fast flash, SLOW for location in slow flash, INLINE for inlining of the service
        NORMAL  # Location in normal flash
        FAST  # Location in fast flash
        SLOW  # Location in slow flash
        INLINE  # Service is inlined
      enumeration mfxRbMemLocDivu32s32u8: origin=RB:1.0.0:2010-12-17, set at pre-compile  # Mfx_Div_u32s32_u8 | Select one of following values: NORMAL for location in normal flash, FAST for location in fast flash, SLOW for location in slow flash, INLINE for inlining of the service
        NORMAL  # Location in normal flash
        FAST  # Location in fast flash
        SLOW  # Location in slow flash
        INLINE  # Service is inlined
      enumeration mfxRbMemLocDivu32u16u16: origin=RB:2.0.0:2011-06-30, set at pre-compile  # Mfx_Div_u32u16_u16 | Select one of following values: NORMAL for location in normal flash, FAST for location in fast flash, SLOW for location in slow flash, INLINE for inlining of the service
        NORMAL  # Location in normal flash
        FAST  # Location in fast flash
        SLOW  # Location in slow flash
        INLINE  # Service is inlined
      enumeration mfxRbMemLocDivu32u16u32: origin=RB:2.0.0:2011-06-30, set at pre-compile  # Mfx_Div_u32u16_u32 | Select one of following values: NORMAL for location in normal flash, FAST for location in fast flash, SLOW for location in slow flash, INLINE for inlining of the service
        NORMAL  # Location in normal flash
        FAST  # Location in fast flash
        SLOW  # Location in slow flash
        INLINE  # Service is inlined
      enumeration mfxRbMemLocDivu32u32s16: origin=RB:1.0.0:2010-12-17, set at pre-compile  # Mfx_Div_u32u32_s16 | Select one of following values: NORMAL for location in normal flash, FAST for location in fast flash, SLOW for location in slow flash, INLINE for inlining of the service
        NORMAL  # Location in normal flash
        FAST  # Location in fast flash
        SLOW  # Location in slow flash
        INLINE  # Service is inlined
      enumeration mfxRbMemLocDivu32u32s32: origin=RB:1.0.0:2010-12-17, set at pre-compile  # Mfx_Div_u32u32_s32 | Select one of following values: NORMAL for location in normal flash, FAST for location in fast flash, SLOW for location in slow flash, INLINE for inlining of the service
        NORMAL  # Location in normal flash
        FAST  # Location in fast flash
        SLOW  # Location in slow flash
        INLINE  # Service is inlined
      enumeration mfxRbMemLocDivu32u32s8: origin=RB:1.0.0:2010-12-17, set at pre-compile  # Mfx_Div_u32u32_s8 | Select one of following values: NORMAL for location in normal flash, FAST for location in fast flash, SLOW for location in slow flash, INLINE for inlining of the service
        NORMAL  # Location in normal flash
        FAST  # Location in fast flash
        SLOW  # Location in slow flash
        INLINE  # Service is inlined
      enumeration mfxRbMemLocDivu32u32u16: origin=RB:1.0.0:2010-12-17, set at pre-compile  # Mfx_Div_u32u32_u16 | Select one of following values: NORMAL for location in normal flash, FAST for location in fast flash, SLOW for location in slow flash, INLINE for inlining of the service
        NORMAL  # Location in normal flash
        FAST  # Location in fast flash
        SLOW  # Location in slow flash
        INLINE  # Service is inlined
      enumeration mfxRbMemLocDivu32u32u32: origin=RB:1.0.0:2010-12-17, set at pre-compile  # Mfx_Div_u32u32_u32 | Select one of following values: NORMAL for location in normal flash, FAST for location in fast flash, SLOW for location in slow flash, INLINE for inlining of the service
        NORMAL  # Location in normal flash
        FAST  # Location in fast flash
        SLOW  # Location in slow flash
        INLINE  # Service is inlined
      enumeration mfxRbMemLocDivu32u32u8: origin=RB:1.0.0:2010-12-17, set at pre-compile  # Mfx_Div_u32u32_u8 | Select one of following values: NORMAL for location in normal flash, FAST for location in fast flash, SLOW for location in slow flash, INLINE for inlining of the service
        NORMAL  # Location in normal flash
        FAST  # Location in fast flash
        SLOW  # Location in slow flash
        INLINE  # Service is inlined
      enumeration mfxRbMemLocDivu8s8s8: origin=RB:2.0.0:2011-06-30, set at pre-compile  # Mfx_Div_u8s8_s8 | Select one of following values: NORMAL for location in normal flash, FAST for location in fast flash, SLOW for location in slow flash, INLINE for inlining of the service
        NORMAL  # Location in normal flash
        FAST  # Location in fast flash
        SLOW  # Location in slow flash
        INLINE  # Service is inlined
      enumeration mfxRbMemLocDivu8s8u8: origin=RB:2.0.0:2011-06-30, set at pre-compile  # Mfx_Div_u8s8_u8 | Select one of following values: NORMAL for location in normal flash, FAST for location in fast flash, SLOW for location in slow flash, INLINE for inlining of the service
        NORMAL  # Location in normal flash
        FAST  # Location in fast flash
        SLOW  # Location in slow flash
        INLINE  # Service is inlined
      enumeration mfxRbMemLocDivu8u8s8: origin=RB:5.0.0:2012-12-17, set at pre-compile  # Mfx_Div_u8u8_s8 | Select one of following values: NORMAL for location in normal flash, FAST for location in fast flash, SLOW for location in slow flash, INLINE for inlining of the service
        NORMAL  # Location in normal flash
        FAST  # Location in fast flash
        SLOW  # Location in slow flash
        INLINE  # Service is inlined
      enumeration mfxRbMemLocDivu8u8u8: origin=RB:2.0.0:2011-06-30, set at pre-compile  # Mfx_Div_u8u8_u8 | Select one of following values: NORMAL for location in normal flash, FAST for location in fast flash, SLOW for location in slow flash, INLINE for inlining of the service
        NORMAL  # Location in normal flash
        FAST  # Location in fast flash
        SLOW  # Location in slow flash
        INLINE  # Service is inlined
      enumeration mfxRbMemLocLimits16: origin=RB:1.0.0:2010-12-17, set at pre-compile  # Mfx_Limit_s16 | Select one of following values: NORMAL for location in normal flash, FAST for location in fast flash, SLOW for location in slow flash, INLINE for inlining of the service
        NORMAL  # Location in normal flash
        FAST  # Location in fast flash
        SLOW  # Location in slow flash
        INLINE  # Service is inlined
      enumeration mfxRbMemLocLimits32: origin=RB:1.0.0:2010-12-17, set at pre-compile  # Mfx_Limit_s32 | Select one of following values: NORMAL for location in normal flash, FAST for location in fast flash, SLOW for location in slow flash, INLINE for inlining of the service
        NORMAL  # Location in normal flash
        FAST  # Location in fast flash
        SLOW  # Location in slow flash
        INLINE  # Service is inlined
      enumeration mfxRbMemLocLimits8: origin=RB:1.0.0:2010-12-17, set at pre-compile  # Mfx_Limit_s8 | Select one of following values: NORMAL for location in normal flash, FAST for location in fast flash, SLOW for location in slow flash, INLINE for inlining of the service
        NORMAL  # Location in normal flash
        FAST  # Location in fast flash
        SLOW  # Location in slow flash
        INLINE  # Service is inlined
      enumeration mfxRbMemLocLimitu16: origin=RB:1.0.0:2010-12-17, set at pre-compile  # Mfx_Limit_u16 | Select one of following values: NORMAL for location in normal flash, FAST for location in fast flash, SLOW for location in slow flash, INLINE for inlining of the service
        NORMAL  # Location in normal flash
        FAST  # Location in fast flash
        SLOW  # Location in slow flash
        INLINE  # Service is inlined
      enumeration mfxRbMemLocLimitu32: origin=RB:1.0.0:2010-12-17, set at pre-compile  # Mfx_Limit_u32 | Select one of following values: NORMAL for location in normal flash, FAST for location in fast flash, SLOW for location in slow flash, INLINE for inlining of the service
        NORMAL  # Location in normal flash
        FAST  # Location in fast flash
        SLOW  # Location in slow flash
        INLINE  # Service is inlined
      enumeration mfxRbMemLocLimitu8: origin=RB:1.0.0:2010-12-17, set at pre-compile  # Mfx_Limit_u8 | Select one of following values: NORMAL for location in normal flash, FAST for location in fast flash, SLOW for location in slow flash, INLINE for inlining of the service
        NORMAL  # Location in normal flash
        FAST  # Location in fast flash
        SLOW  # Location in slow flash
        INLINE  # Service is inlined
      enumeration mfxRbMemLocMaxs16: origin=RB:1.0.0:2010-12-17, set at pre-compile  # Mfx_Max_s16 | Select one of following values: NORMAL for location in normal flash, FAST for location in fast flash, SLOW for location in slow flash, INLINE for inlining of the service
        NORMAL  # Location in normal flash
        FAST  # Location in fast flash
        SLOW  # Location in slow flash
        INLINE  # Service is inlined
      enumeration mfxRbMemLocMaxs32: origin=RB:1.0.0:2010-12-17, set at pre-compile  # Mfx_Max_s32 | Select one of following values: NORMAL for location in normal flash, FAST for location in fast flash, SLOW for location in slow flash, INLINE for inlining of the service
        NORMAL  # Location in normal flash
        FAST  # Location in fast flash
        SLOW  # Location in slow flash
        INLINE  # Service is inlined
      enumeration mfxRbMemLocMaxs8: origin=RB:1.0.0:2010-12-17, set at pre-compile  # Mfx_Max_s8 | Select one of following values: NORMAL for location in normal flash, FAST for location in fast flash, SLOW for location in slow flash, INLINE for inlining of the service
        NORMAL  # Location in normal flash
        FAST  # Location in fast flash
        SLOW  # Location in slow flash
        INLINE  # Service is inlined
      enumeration mfxRbMemLocMaxu16: origin=RB:1.0.0:2010-12-17, set at pre-compile  # Mfx_Max_u16 | Select one of following values: NORMAL for location in normal flash, FAST for location in fast flash, SLOW for location in slow flash, INLINE for inlining of the service
        NORMAL  # Location in normal flash
        FAST  # Location in fast flash
        SLOW  # Location in slow flash
        INLINE  # Service is inlined
      enumeration mfxRbMemLocMaxu32: origin=RB:1.0.0:2010-12-17, set at pre-compile  # Mfx_Max_u32 | Select one of following values: NORMAL for location in normal flash, FAST for location in fast flash, SLOW for location in slow flash, INLINE for inlining of the service
        NORMAL  # Location in normal flash
        FAST  # Location in fast flash
        SLOW  # Location in slow flash
        INLINE  # Service is inlined
      enumeration mfxRbMemLocMaxu8: origin=RB:1.0.0:2010-12-17, set at pre-compile  # Mfx_Max_u8 | Select one of following values: NORMAL for location in normal flash, FAST for location in fast flash, SLOW for location in slow flash, INLINE for inlining of the service
        NORMAL  # Location in normal flash
        FAST  # Location in fast flash
        SLOW  # Location in slow flash
        INLINE  # Service is inlined
      enumeration mfxRbMemLocMinmaxs16: origin=RB:3.0.0:2011-12-16, set at pre-compile  # Mfx_Minmax_s16 | Select one of following values: NORMAL for location in normal flash, FAST for location in fast flash, SLOW for location in slow flash, INLINE for inlining of the service
        NORMAL  # Location in normal flash
        FAST  # Location in fast flash
        SLOW  # Location in slow flash
        INLINE  # Service is inlined
      enumeration mfxRbMemLocMinmaxs32: origin=RB:3.0.0:2011-12-16, set at pre-compile  # Mfx_Minmax_s32 | Select one of following values: NORMAL for location in normal flash, FAST for location in fast flash, SLOW for location in slow flash, INLINE for inlining of the service
        NORMAL  # Location in normal flash
        FAST  # Location in fast flash
        SLOW  # Location in slow flash
        INLINE  # Service is inlined
      enumeration mfxRbMemLocMinmaxs8: origin=RB:3.0.0:2011-12-16, set at pre-compile  # Mfx_Minmax_s8 | Select one of following values: NORMAL for location in normal flash, FAST for location in fast flash, SLOW for location in slow flash, INLINE for inlining of the service
        NORMAL  # Location in normal flash
        FAST  # Location in fast flash
        SLOW  # Location in slow flash
        INLINE  # Service is inlined
      enumeration mfxRbMemLocMinmaxu16: origin=RB:3.0.0:2011-12-16, set at pre-compile  # Mfx_Minmax_u16 | Select one of following values: NORMAL for location in normal flash, FAST for location in fast flash, SLOW for location in slow flash, INLINE for inlining of the service
        NORMAL  # Location in normal flash
        FAST  # Location in fast flash
        SLOW  # Location in slow flash
        INLINE  # Service is inlined
      enumeration mfxRbMemLocMinmaxu32: origin=RB:3.0.0:2011-12-16, set at pre-compile  # Mfx_Minmax_u32 | Select one of following values: NORMAL for location in normal flash, FAST for location in fast flash, SLOW for location in slow flash, INLINE for inlining of the service
        NORMAL  # Location in normal flash
        FAST  # Location in fast flash
        SLOW  # Location in slow flash
        INLINE  # Service is inlined
      enumeration mfxRbMemLocMinmaxu8: origin=RB:3.0.0:2011-12-16, set at pre-compile  # Mfx_Minmax_u8 | Select one of following values: NORMAL for location in normal flash, FAST for location in fast flash, SLOW for location in slow flash, INLINE for inlining of the service
        NORMAL  # Location in normal flash
        FAST  # Location in fast flash
        SLOW  # Location in slow flash
        INLINE  # Service is inlined
      enumeration mfxRbMemLocMins16: origin=RB:1.0.0:2010-12-17, set at pre-compile  # Mfx_Min_s16 | Select one of following values: NORMAL for location in normal flash, FAST for location in fast flash, SLOW for location in slow flash, INLINE for inlining of the service
        NORMAL  # Location in normal flash
        FAST  # Location in fast flash
        SLOW  # Location in slow flash
        INLINE  # Service is inlined
      enumeration mfxRbMemLocMins32: origin=RB:1.0.0:2010-12-17, set at pre-compile  # Mfx_Min_s32 | Select one of following values: NORMAL for location in normal flash, FAST for location in fast flash, SLOW for location in slow flash, INLINE for inlining of the service
        NORMAL  # Location in normal flash
        FAST  # Location in fast flash
        SLOW  # Location in slow flash
        INLINE  # Service is inlined
      enumeration mfxRbMemLocMins8: origin=RB:1.0.0:2010-12-17, set at pre-compile  # Mfx_Min_s8 | Select one of following values: NORMAL for location in normal flash, FAST for location in fast flash, SLOW for location in slow flash, INLINE for inlining of the service
        NORMAL  # Location in normal flash
        FAST  # Location in fast flash
        SLOW  # Location in slow flash
        INLINE  # Service is inlined
      enumeration mfxRbMemLocMinu16: origin=RB:1.0.0:2010-12-17, set at pre-compile  # Mfx_Min_u16 | Select one of following values: NORMAL for location in normal flash, FAST for location in fast flash, SLOW for location in slow flash, INLINE for inlining of the service
        NORMAL  # Location in normal flash
        FAST  # Location in fast flash
        SLOW  # Location in slow flash
        INLINE  # Service is inlined
      enumeration mfxRbMemLocMinu32: origin=RB:1.0.0:2010-12-17, set at pre-compile  # Mfx_Min_u32 | Select one of following values: NORMAL for location in normal flash, FAST for location in fast flash, SLOW for location in slow flash, INLINE for inlining of the service
        NORMAL  # Location in normal flash
        FAST  # Location in fast flash
        SLOW  # Location in slow flash
        INLINE  # Service is inlined
      enumeration mfxRbMemLocMinu8: origin=RB:1.0.0:2010-12-17, set at pre-compile  # Mfx_Min_u8 | Select one of following values: NORMAL for location in normal flash, FAST for location in fast flash, SLOW for location in slow flash, INLINE for inlining of the service
        NORMAL  # Location in normal flash
        FAST  # Location in fast flash
        SLOW  # Location in slow flash
        INLINE  # Service is inlined
      enumeration mfxRbMemLocMods16: origin=RB:2.0.0:2011-06-30, set at pre-compile  # Mfx_Mod_s16 | Select one of following values: NORMAL for location in normal flash, FAST for location in fast flash, SLOW for location in slow flash, INLINE for inlining of the service
        NORMAL  # Location in normal flash
        FAST  # Location in fast flash
        SLOW  # Location in slow flash
        INLINE  # Service is inlined
      enumeration mfxRbMemLocMods32: origin=RB:1.0.0:2010-12-17, set at pre-compile  # Mfx_Mod_s32 | Select one of following values: NORMAL for location in normal flash, FAST for location in fast flash, SLOW for location in slow flash, INLINE for inlining of the service
        NORMAL  # Location in normal flash
        FAST  # Location in fast flash
        SLOW  # Location in slow flash
        INLINE  # Service is inlined
      enumeration mfxRbMemLocMods32s32s16: origin=RB:7.0.0:, set at pre-compile  # Mfx_Mod_s32s32_s16 | Select one of following values: NORMAL for location in normal flash, FAST for location in fast flash, SLOW for location in slow flash, INLINE for inlining of the service
        NORMAL  # Location in normal flash
        FAST  # Location in fast flash
        SLOW  # Location in slow flash
        INLINE  # Service is inlined
      enumeration mfxRbMemLocMods32s32s8: origin=RB:7.0.0:, set at pre-compile  # Mfx_Mod_s32s32_s8 | Select one of following values: NORMAL for location in normal flash, FAST for location in fast flash, SLOW for location in slow flash, INLINE for inlining of the service
        NORMAL  # Location in normal flash
        FAST  # Location in fast flash
        SLOW  # Location in slow flash
        INLINE  # Service is inlined
      enumeration mfxRbMemLocMods8: origin=RB:2.0.0:2011-06-30, set at pre-compile  # Mfx_Mod_s8 | Select one of following values: NORMAL for location in normal flash, FAST for location in fast flash, SLOW for location in slow flash, INLINE for inlining of the service
        NORMAL  # Location in normal flash
        FAST  # Location in fast flash
        SLOW  # Location in slow flash
        INLINE  # Service is inlined
      enumeration mfxRbMemLocModu16: origin=RB:2.0.0:2011-06-30, set at pre-compile  # Mfx_Mod_u16 | Select one of following values: NORMAL for location in normal flash, FAST for location in fast flash, SLOW for location in slow flash, INLINE for inlining of the service
        NORMAL  # Location in normal flash
        FAST  # Location in fast flash
        SLOW  # Location in slow flash
        INLINE  # Service is inlined
      enumeration mfxRbMemLocModu32: origin=RB:1.0.0:2010-12-17, set at pre-compile  # Mfx_Mod_u32 | Select one of following values: NORMAL for location in normal flash, FAST for location in fast flash, SLOW for location in slow flash, INLINE for inlining of the service
        NORMAL  # Location in normal flash
        FAST  # Location in fast flash
        SLOW  # Location in slow flash
        INLINE  # Service is inlined
      enumeration mfxRbMemLocModu32u32u16: origin=RB:7.0.0:, set at pre-compile  # Mfx_Mod_u32u32_u16 | Select one of following values: NORMAL for location in normal flash, FAST for location in fast flash, SLOW for location in slow flash, INLINE for inlining of the service
        NORMAL  # Location in normal flash
        FAST  # Location in fast flash
        SLOW  # Location in slow flash
        INLINE  # Service is inlined
      enumeration mfxRbMemLocModu32u32u8: origin=RB:7.0.0:, set at pre-compile  # Mfx_Mod_u32u32_u8 | Select one of following values: NORMAL for location in normal flash, FAST for location in fast flash, SLOW for location in slow flash, INLINE for inlining of the service
        NORMAL  # Location in normal flash
        FAST  # Location in fast flash
        SLOW  # Location in slow flash
        INLINE  # Service is inlined
      enumeration mfxRbMemLocModu8: origin=RB:2.0.0:2011-06-30, set at pre-compile  # Mfx_Mod_u8 | Select one of following values: NORMAL for location in normal flash, FAST for location in fast flash, SLOW for location in slow flash, INLINE for inlining of the service
        NORMAL  # Location in normal flash
        FAST  # Location in fast flash
        SLOW  # Location in slow flash
        INLINE  # Service is inlined
      enumeration mfxRbMemLocMulDivs16s16s16s16: origin=RB:2.0.0:2011-06-30, set at pre-compile  # Mfx_MulDiv_s16s16s16_s16 | Select one of following values: NORMAL for location in normal flash, FAST for location in fast flash, SLOW for location in slow flash, INLINE for inlining of the service
        NORMAL  # Location in normal flash
        FAST  # Location in fast flash
        SLOW  # Location in slow flash
        INLINE  # Service is inlined
      enumeration mfxRbMemLocMulDivs16s16u16s16: origin=RB:2.0.0:2011-06-30, set at pre-compile  # Mfx_MulDiv_s16s16u16_s16 | Select one of following values: NORMAL for location in normal flash, FAST for location in fast flash, SLOW for location in slow flash, INLINE for inlining of the service
        NORMAL  # Location in normal flash
        FAST  # Location in fast flash
        SLOW  # Location in slow flash
        INLINE  # Service is inlined
      enumeration mfxRbMemLocMulDivs16u16s16s16: origin=RB:2.0.0:2011-06-30, set at pre-compile  # Mfx_MulDiv_s16u16s16_s16 | Select one of following values: NORMAL for location in normal flash, FAST for location in fast flash, SLOW for location in slow flash, INLINE for inlining of the service
        NORMAL  # Location in normal flash
        FAST  # Location in fast flash
        SLOW  # Location in slow flash
        INLINE  # Service is inlined
      enumeration mfxRbMemLocMulDivs16u16s16u16: origin=RB:2.0.0:2011-06-30, set at pre-compile  # Mfx_MulDiv_s16u16s16_u16 | Select one of following values: NORMAL for location in normal flash, FAST for location in fast flash, SLOW for location in slow flash, INLINE for inlining of the service
        NORMAL  # Location in normal flash
        FAST  # Location in fast flash
        SLOW  # Location in slow flash
        INLINE  # Service is inlined

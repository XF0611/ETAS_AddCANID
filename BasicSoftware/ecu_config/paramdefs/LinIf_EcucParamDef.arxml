AUTOSAR XML (schema 4-2-2)
package /AUTOSAR_LinIf/EcucModuleDefs
  module definition LinIf [0..1]: category=VENDOR_SPECIFIC_MODULE_DEFINITION, post-build-variant-support=true, refined-module-def=LinIf, variants pre-compile/post-build-selectable  # Lin Interface Module | Configuration of the LinIf (LIN Interface) module(with vendor specific enhancements of RB).
    container LinIfGeneral  # This container contains the general parameters of LIN Interface module.
      boolean LinIfCancelTransmitSupported: set at pre-compile  # Global Pre-Compile Switch to reliably prevent the generation of the dummy LinIf_CancelTransmit API.
      boolean LinIfDSMReInitEnabled [0..1]: origin=RB:2017-04-18, set at pre-compile, default-value=false  # Enables or disables the reporting of DEM events to DSM after DSM_Reinit occurs.
      boolean LinIfDevErrorDetect: set at pre-compile  # Switches the Development Error Detection and Notification ON or OFF. | * true: enabled (ON). * false: disabled (OFF).
      boolean LinIfErrorRecovery: origin=RB:2015-04-10, set at pre-compile, default-value=false  # Enables/Disables the LINIF_ERROR_RECOVERY_SUPPORT. If LINIF_ERROR_RECOVERY_SUPPORT is enabled, LinIf reports DEM_EVENT_STATUS_PREPASSED and DEM_EVENT_STATUS_PREFAILED. If LINIF_ERROR_RECOVERY_SUPPORT is disabled, LinIf reports DEM_EVENT_STATUS_PASSED and DEM_EVENT_STATUS_FAILED.
      boolean LinIfMultipleDriversSupported: set at pre-compile  # States if multiple drivers are included in the LIN Interface or not. The reason for this parameter is to reduce the size of LIN Interface if multiple drivers are not used.
      boolean LinIfMultipleTrcvDriverSupported [0..0]: set at pre-compile  # States if LIN Transceivers are supported by the LIN Interface or not. The reason for this parameter is to reduce the size of LIN Interface if LIN Transceivers are not used
      boolean LinIfNcOptionalRequestSupported: set at pre-compile  # States if the node configuration commands Assign NAD and Conditional Change NAD are supported.
      string LinIfPublicCddHeaderFile [0..*]: scope=ECU, multiplicity set at pre-compile, set at pre-compile, max-length=32, min-length=1  # Defines header files for callback functions which shall be included in case of CDDs. Range of characters is 1.. 32. This parameter is not supported
      boolean LinIfRbLastEntryOfSchelTblConfrm [0..1]: origin=RB:2019-03-30, set at pre-compile, default-value=false  # Switches the Schedule table end notification callback ON or OFF. Schedule table end notification callback functions are enabled when this parameter is set to true and disabled when set to false. | * true: enabled (ON). * false: disabled (OFF).
      boolean LinIfTpSupported: set at pre-compile  # States if the TP is included in the LIN Interface or not. The reason for this parameter is to reduce the size of LIN Interface if the TP is not used.
      boolean LinIfTrcvDriverSupported: set at pre-compile  # States if LIN Transceivers are supported by the LIN Interface or not. The reason for this parameter is to reduce the size of LIN Interface if LIN Transceivers are not used
      boolean LinIfVersionInfoApi: set at pre-compile  # Switches the LinIf_GetVersionInfo function ON or OFF.
      boolean LinIfidCalibrationSupport [0..1]: origin=RB:2017-08-30, set at pre-compile, default-value=false  # Switches the Calibration of LinIf id (The id for Lin frames is provided from calibration tool) ON or OFF. | * true: enabled (ON). * false: disabled (OFF).
    container LinIfGlobalConfig  # This container contains the global configuration parameter of the LinIf.It is a MultipleConfigurationContainer, i.e. this container and its sub-containers exit once per configuration set.
      float LinIfTimeBase: 0..0.255, set at link in variant link-time / post-build in variant post-build / pre-compile in variant pre-compile  # The delay between processing two frames is a multiple of the LIN Interface time-base in seconds.
      container LinIfChannel [1..*]: multiplicity set at pre-compile  # Describes each LIN channel the LinIf is connected to.
        integer LinIfChannelId: 0..255, origin=RB:2017-01-17, set at pre-compile, symbolic-name-value=true, with-auto=true  # This parameter holds the unique channel index value. The value shall be the same as the ComMChannelId of the ComMChannel referenced by LinIfComMNetworkHandleRef. Implementation Type: NetworkHandleType
        enumeration LinIfGotoSleepConfirmationUL: {CDD, LIN_SM}, scope=ECU, post-build-variant-value=true, set at link in variant link-time+post-build / pre-compile in variant pre-compile  # This parameter defines the upper layer (UL) module to which the confirmation of the goto-sleep command shall be sent.
        function name LinIfGotoSleepConfirmationULName [0..1]: origin=RB:2015-04-10, set at pre-compile, max-length=32, min-length=1  # This parameter defines the name of the "User_GotoSleepConfirmation()" LinIfGotoSleepConfirmationULName
        integer LinIfMaxFrameCnt [0..1]: 0..65535, multiplicity set at link in variant link-time+post-build / pre-compile in variant pre-compile, set at link in variant link-time+post-build / pre-compile in variant pre-compile  # Maximum number of Frames. This parameter is needed only in case of post-build loadable implementation using static memory allocation.
        boolean LinIfRbDiagMonHookSupport [0..1]: origin=RB:2018-06-08, set at pre-compile, default-value=false  # Enables or disables the Monitoring Hook function notification updation in case of Diagnostic frames.
        boolean LinIfScheduleChangeNextTimeBase [0..1]: origin=RB: 2019-11-28, post-build-variant-value=true, set at pre-compile, default-value=false  # Enables/disables the switch to a new schedule table at the start of the next time base after status check. True: LinIf selects a new schedule table in next main function. The default value is set to False and the schedule table switch happens when the schedule entry is due. | * true: enabled (ON). * false: disabled (OFF).
        enumeration LinIfScheduleRequestConfirmationUL: {CDD, LIN_SM}, scope=ECU, post-build-variant-value=true, set at link in variant link-time+post-build / pre-compile in variant pre-compile  # This parameter defines the upper layer (UL) module to which the confirmation of the successfully performed schedule table change.
        function name LinIfScheduleRequestConfirmationULName [0..1]: origin=RB:2015-04-10, set at pre-compile, max-length=32, min-length=1  # This parameter defines the name of the "User_ScheduleRequestConfirmation()" LinIfScheduleRequestConfirmationULName.
        enumeration LinIfStartupState: {NORMAL, SLEEP}, set at link in variant link-time+post-build / pre-compile in variant pre-compile  # Defines the state of each LIN channel after startup
        enumeration LinIfWakeupConfirmationUL: {CDD, LIN_SM}, scope=ECU, post-build-variant-value=true, set at link in variant link-time+post-build / pre-compile in variant pre-compile  # This parameter defines the upper layer (UL) module to which the confirmation of the wake-up shall be sent.
        function name LinIfWakeupConfirmationULName [0..1]: origin=RB:2015-04-10, set at pre-compile, max-length=32, min-length=1  # This parameter defines the name of the "User_WakeupConfirmation()" LinIfWakeupConfirmationULName
        foreign reference LinIfCddRef [0..0]: multiplicity set at pre-compile, set at pre-compile, destination-type=ECUC-MODULE-CONFIGURATION-VALUES  # Reference to the CDD module description. This parameter is only required when LinIfWakeupConfirmationUL, LinIfScheduleRequestConfirmationUL, and/or LinIfGotoSleepConfirmationUL is set to CDD. This parameter is not supported
        symbolic name reference LinIfChannelRef: scope=ECU, set at link in variant link-time+post-build / pre-compile in variant pre-compile, destination=LinChannel  # Reference to the used channel in Lin.Replaces LINIF_CHANNEL_INDEX
        symbolic name reference LinIfComMNetworkHandleRef: set at link in variant link-time+post-build / pre-compile in variant pre-compile, destination=ComMChannel  # Unique handle to identify one certain LIN network. Reference to one of the network handles configured for the ComM.
        symbolic name reference LinIfDriverRef: origin=RB:2015-04-10, set at pre-compile, destination=Lin  # Reference to the LIN Driver
        container LinIfFrame [0..*]: multiplicity set at link in variant link-time / post-build in variant post-build / pre-compile in variant pre-compile, post-build-variant-multiplicity=true  # Generic container for all types of LIN frames. The shortName of this container is used as LinIfFrameName.
          enumeration LinIfChecksumType: {CLASSIC, ENHANCED}, post-build-variant-value=true, set at link in variant link-time / post-build in variant post-build / pre-compile in variant pre-compile  # Type of checksum that the frame is using.
          integer LinIfFrameId [0..0]: 0..255, multiplicity set at link in variant link-time / post-build in variant post-build / pre-compile in variant pre-compile, post-build-variant-multiplicity=true, post-build-variant-value=true, set at link in variant link-time / post-build in variant post-build / pre-compile in variant pre-compile  # ID of the LIN frame. The Protected ID including parity is calculated by the generation tool. This parameter is not supported
          enumeration LinIfFrameType: {ASSIGN, ASSIGN_FRAME_ID_RANGE, ASSIGN_NAD, CONDITIONAL, EVENT_TRIGGERED, FREE, MRF, SAVE_CONFIGURATION, SPORADIC, SRF, UNASSIGN, UNCONDITIONAL}, post-build-variant-value=true, set at link in variant link-time / post-build in variant post-build / pre-compile in variant pre-compile  # Type of frame that is described (e.g. sporadic frame).The sporadic slot is not found among the frame types. A sporadic slot is a set of sporadic frames.
          integer LinIfLength: 1..8, origin=RB:2017-01-15, set at pre-compile  # Length of the LIN SDU in bytes.
          integer LinIfPid [0..1]: 0..255, origin=RB:2017-01-15, set at pre-compile  # Protected ID of the LIN frame. There is no reason to calculate the Parity in run-time.This parameter is mandatory for frame types other than "sporadic"
          container LinIfFixedFrameSdu [0..1]  # In case this is a fixed frame this is the SDU (response).This container represent an eight byte array. The Byte order shall be MSB first. | This container represents an eight byte array. The Byte order shall be MSB first.
            container LinIfFixedFrameSduByte [8..8]  # This container represents a byte within the 8 byte array.
              integer LinIfFixedFrameSduBytePos: 0..7, post-build-variant-value=true, set at link in variant link-time / post-build in variant post-build / pre-compile in variant pre-compile  # Index of the Byte in the SDU (response) 8 byte array.
              integer LinIfFixedFrameSduByteVal: 0..255, post-build-variant-value=true, set at link in variant link-time / post-build in variant post-build / pre-compile in variant pre-compile  # Byte value in the SDU (response) 8-byte array.
          container LinIfFrameDemEventParameterRefs [0..1]  # Container for the references to DemEventParameter elements which shall be invoked using the API Dem_ReportErrorStatus API in case the corresponding error occurs. The EventId is taken from the referenced DemEventParameter's DemEventId value. The standardized errors are provided in the container and can be extended by vendor specific error references.
            enumeration LinIfRbDynCreate_LINIF_E_RESPONSE [0..1]: {Disabled, Standard}, origin=RB:2015-04-10, set at pre-compile, default-value=Disabled  # Dynamically create LINIF_E_RESPONSE event | Selects the way how the LinIf DemEvents are created in Dem and referenced in LinIf module. If not set or set to "Disabled", no such DemEvent is automatically/dynamically created in Dem. If the dynamic creation of this DemEvent is standard, then this DemEvent (in parameter LINIF_E_RESPONSE) is dynamically created in Dem and referenced in LinIf module and hence shall not be set manually.
            symbolic name reference LINIF_E_RESPONSE [0..1]: origin=RB:2017-06-30, set at pre-compile, destination=DemEventParameter  # Reference to the DemEventParameter which shall be issued when the error "LIN frame error detected" has occured and when there is no response for Node Configuration requests.
          choice container LinIfPduDirection  # Direction of the frame
            container LinIfInternalPdu [0..1]  # Represents a Diagnostic or Configuration frame : no Message ID (no PduId).
            container LinIfRxPdu [0..1]  # represents a received PDU/frame
              function name LinIfRxIndicationUL [0..1]: scope=ECU, multiplicity set at link in variant link-time+post-build / pre-compile in variant pre-compile, post-build-variant-multiplicity=true, post-build-variant-value=true, set at link in variant link-time+post-build / pre-compile in variant pre-compile  # This parameter defines the name of the <User_RxIndication>. This parameter depends on the parameter LinIfUserRxIndicationUL. | If LinIfUserRxIndicationUL equals PDUR, the name of the <User_RxIndication> is fixed. If LinIfUserRxIndicationUL equals CDD, the name of the <User_RxIndication> is selectable.
              enumeration LinIfUserRxIndicationUL: {CDD, PDUR}, scope=ECU, post-build-variant-value=true, set at link in variant link-time+post-build / pre-compile in variant pre-compile  # This parameter defines the upper layer (UL) module to which the indication of the successfully received LINRXPDUID has to be routed via <User_LinIfRxIndication>.This <User_LinIfRxIndication> has to be invoked when the indication of the configured LINRXPDUID will be received by a Rx indication event from the LIN Driver module.
              integer LinIfUserTargetRxPduId [0..1]: 0.., origin=RB:2015-04-10, set at pre-compile, symbolic-name-value=true  # Defines the target Id of the CDD for Rx Pdus.
              reference LinIfRxPduRef: scope=ECU, post-build-variant-value=true, set at link in variant link-time / post-build in variant post-build / pre-compile in variant pre-compile, destination=Pdu  # Reference to the PDU that is received in this frame.
            container LinIfSlaveToSlavePdu [0..0]  # represents a slave-to-slave PDU/frame. Master does only send the header but doesn't receive the response.Added for completeness
            container LinIfTxPdu [0..1]: post-build-variant-multiplicity=true  # represents a transmitted PDU/frame
              function name LinIfTxConfirmationUL [0..1]: scope=ECU, multiplicity set at link in variant link-time+post-build / pre-compile in variant pre-compile, post-build-variant-multiplicity=true, post-build-variant-value=true, set at link in variant link-time+post-build / pre-compile in variant pre-compile  # This parameter defines the name of the <User_TxConfirmation>. This parameter depends on the parameter LinIfUserTxUL. | If LinIfUserTxUL equals PDUR, the name of the <User_TxConfirmation> is fixed. If LinIfUserTxUL equals CDD, the name of the <User_TxConfirmation> is selectable.
              integer LinIfTxPduId: 0..65535, set at pre-compile, symbolic-name-value=true  # Identifier of the Pdu for the upper layer.
              function name LinIfTxTriggerTransmitUL [0..1]: scope=ECU, multiplicity set at link in variant link-time+post-build / pre-compile in variant pre-compile, post-build-variant-multiplicity=true, post-build-variant-value=true, set at link in variant link-time+post-build / pre-compile in variant pre-compile  # This parameter defines the name of the <User_TriggerTransmit>. This parameter depends on the parameter LinIfUserTxUL. If LinIfUserTxUL equals PDUR than the name of the <User_TriggerTransmit> is fixed. If LinIfUserTxUL equals CDD, the name of the <User_TriggerTransmit> is selectable. | If LinIfUserTxUL equals CDD, the name of the <User_TriggerTransmit> is selectable.
              integer LinIfUserTargetTxPduId [0..1]: 0.., origin=RB:2015-04-10, set at pre-compile, symbolic-name-value=true  # Defines the target Id of the CDD for Tx Pdus.
              enumeration LinIfUserTxUL [0..1]: {CDD, PDUR}, scope=ECU, post-build-variant-value=true, set at link in variant link-time+post-build / pre-compile in variant pre-compile  # This parameter defines the upper layer (UL) module to which the trigger of the transmitted LinTxPdu (via the <User_TriggerTransmit>) or the confirmation of the successfully transmitted LinTxPdu has to be routed (via the <User_TxConfirmation>).This parameter is mandatory for frametypes other than "sporadic"
              reference LinIfTxPduRef: scope=ECU, post-build-variant-value=true, set at link in variant link-time / post-build in variant post-build / pre-compile in variant pre-compile, destination=Pdu  # Reference to the PDU that is transmitted in this frame.
          container LinIfSubstitutionFrames [0..*]  # List of unconditional Frames that can be sent in a sporadic Frame slot. | sporadic frame slot.
            integer LinIfFramePriority: 0..255, post-build-variant-value=true, set at link in variant link-time / post-build in variant post-build / pre-compile in variant pre-compile  # Priority of an unconditional frame if used as a sporadic frame.
            reference LinIfSubstitutionFrameRef: post-build-variant-value=true, set at link in variant link-time / post-build in variant post-build / pre-compile in variant pre-compile, destination=LinIfFrame  # Reference to an unconditional Frame that can be sent in a sporadic Frame slot.
        container LinIfMaster [0..0]  # Each Master can only be connected to one physical channel. This could be compared to the Node parameter in a LDF file.
          float LinIfJitter [0..0]: 0..0.255, set at pre-compile  # The jitter specifies the differences between the maximum and minimum delay from time base tick to the header sending start point in seconds.
        container LinIfScheduleTable [1..*]: multiplicity set at link in variant link-time / post-build in variant post-build / pre-compile in variant pre-compile, post-build-variant-multiplicity=true  # Describes a schedule table. Each LinIfChannel may have several schedule tables. Each schedule table can only be connected to one channel. | The SHORT-NAME of the LinIfScheduleTable container represents the symbolic name of the schedule table.
          enumeration LinIfResumePosition: {CONTINUE_AT_IT_POINT, START_FROM_BEGINNING}, post-build-variant-value=true, set at link in variant link-time / post-build in variant post-build / pre-compile in variant pre-compile  # Defines, where a schedule table shall be proceeded in case if it has been interrupted by a RUN-ONCE table.
          enumeration LinIfRunMode: {RUN_CONTINUOUS, RUN_ONCE}, post-build-variant-value=true, set at link in variant link-time / post-build in variant post-build / pre-compile in variant pre-compile  # The schedule table can be executed in two different modes.
          integer LinIfScheduleTableIndex: 0..255, set at pre-compile, symbolic-name-value=true  # This is the unique index used by upper layers to identify a schedule. Note that the NULL_SCHEDULE for each channel has index 0.
          container LinIfEntry [0..*]: multiplicity set at link in variant link-time / post-build in variant post-build / pre-compile in variant pre-compile, post-build-variant-multiplicity=true  # Describes an entry in the schedule table (also known as Frame Slot).
            float LinIfDelay: 0..0.255, post-build-variant-value=true, set at link in variant link-time / post-build in variant post-build / pre-compile in variant pre-compile  # Delay to next entry in schedule table in seconds.
            integer LinIfEntryIndex: 0..255, post-build-variant-value=true, set at link in variant link-time / post-build in variant post-build / pre-compile in variant pre-compile  # Position of the Frame Entry in the Schedule Table. The first entry index in the schedule table is 0.
            reference LinIfCollisionResolvingRef [0..0]: post-build-variant-value=true, set at link in variant link-time / post-build in variant post-build / pre-compile in variant pre-compile, destination=LinIfScheduleTable  # Reference to the schedule table, which resolves the collision.
            reference LinIfFrameRef: post-build-variant-value=true, set at link in variant link-time / post-build in variant post-build / pre-compile in variant pre-compile, destination=LinIfFrame  # Reference to the frames that belong to this schedule table entry.
        container LinIfSlave [0..0]  # The Node attributes of the Slaves are provided with these parameter. The ShortName of this container is used as LinIfNodeName.
          integer LinIfConfiguredNad: 0..255, origin=RB:2016-09-19, set at pre-compile  # Definition of the initial node address
          integer LinIfFunctionId: 0..255, origin=RB:2016-09-19, set at pre-compile  # LIN function ID
          enumeration LinIfProtocolVersion: {LINIF_1_2, LINIF_1_3, LINIF_2_0, LINIF_2_1}, origin=RB:2015-04-10, set at pre-compile  # Parameter to select the LIN protocol version to be used.
          boolean LinIfResponseErrBitCheckEnable: origin=RB:2015-04-10, set at pre-compile  # Switches the Development Error Detection and Notification ON or OFF.
          integer LinIfResponseErrorBitPos: 0..63, origin=RB:2016-09-19, set at pre-compile  # Specifies the frame and the position in the frame
          integer LinIfSupplierId: 0..65535, origin=RB:2016-09-19, set at pre-compile  # LIN Supplier ID
          integer LinIfVariant: 0..255, origin=RB:2016-09-19, set at pre-compile  # Specifies the Variant ID
          reference LinIfResponseErrorEventRef: origin=RB:2015-04-10, set at pre-compile, destination=DemEventParameter  # Reference to DEM Event.
          reference LinIfResponseErrorFrameRef: origin=RB:2016-09-19, set at pre-compile, destination=LinIfFrame  # Reference to the frame which contains the response error bit.
          container LinIfNodeComposition  # Generic container that describes the node composition
            string LinIfNodeName: origin=RB:2015-04-10, set at pre-compile  # Optional schedule name used to cross-reference with a LDF. This parameter shall always be accompanied by LIN_IF_SCHEDULE_INDEX.
        container LinIfSlaveDemEventParameterRefs [0..1]  # Container for the references to DemEventParameter elements which shall be invoked using the API Dem_ReportErrorStatus API in case the corresponding error occurs. The EventId is taken from the referenced DemEventParameter's DemEventId value. The standardized errors are provided in the container and can be extended by vendor specific error references.
          symbolic name reference LINIF_E_CHANNEL_X_SLAVE_Y [0..1]: origin=RB:2016-09-19, set at pre-compile, destination=DemEventParameter  # Reference to the DemEventParameter which shall be issued when the error "LIN response error detected" has occured.
          symbolic name reference LINIF_E_NC_NO_RESPONSE_CHANNEL_X_SLAVE_Y [0..1]: set at pre-compile, destination=DemEventParameter  # Reference to the DemEventParameter which shall be issued when the error "slave did not answer on a node configuration request" has occured.
        container LinIfTransceiverDrvConfig [0..1]  # This container contains the configuration parameters of each underlying LIN Transceiver Driver.
          boolean LinIfTrcvWakeupNotification: origin=RB:2017-01-16, set at pre-compile, default-value=false  # Selects whether wakeup indication notification is supported.True: Enabled False: Disabled
          symbolic name reference LinIfTrcvIdRef: scope=ECU, set at link in variant link-time+post-build / pre-compile in variant pre-compile, destination=LinTrcvChannel  # Logical handle of the underlying LIN transceiver to be served by the LIN Interface.

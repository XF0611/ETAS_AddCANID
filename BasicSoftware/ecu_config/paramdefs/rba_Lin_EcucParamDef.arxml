AUTOSAR XML (schema 4-2-2)
package /AUTOSAR_Lin/EcucModuleDefs
  module definition Lin [0..*]: category=VENDOR_SPECIFIC_MODULE_DEFINITION, post-build-variant-support=true, refined-module-def=Lin, variants pre-compile  # Lin Module | Configuration of the Lin (LIN driver) module with vendor specific enhancements of RB.
    container LinGeneral  # This container contains the parameters related to each LIN Driver Unit.
      boolean LinDevErrorDetect: set at pre-compile  # Switches the Development Error Detection and Notification ON or OFF.
      integer LinIndex: 0..255, set at pre-compile  # Specifies the InstanceId of this module instance. If only one instance is present it shall have the Id 0.
      integer LinTimeoutDuration [0..0]: 0..65535, set at pre-compile  # Specifies the maximum number of loops for blocking function until a timeout is raised in short term wait loops
      boolean LinVersionInfoApi: set at pre-compile  # Switches the Lin_GetVersionInfo function ON or OFF.
      integer LinWakeupPatternByte [0..1]: 0..255, origin=RB:v20.0.0:2015-12-10, set at pre-compile  # Specifies the wakeup pattern byte. If this parameter is not configured then, we will consider this as 0x80. If the project expect specific duration of low phase then corresponding value can be configured
      boolean LinHardwareErrorDetect [0..1]: origin=RB:v1.0.0:2016-09-30, set at pre-compile, default-value=false  # This parameter monitors reporting the error "Timeout caused by hardware error" through MonHook function, when Dem is not configured.
      boolean LinDSMReInitEnabled [0..1]: origin=RB:v1.0.0:2017-08-02, set at pre-compile, default-value=false  # Enables or disables the reporting of DEM events to DSM after the Re-initialisation of DSM has occured
      float LinDSMReInitProcessingPeriod [0..1]: 0.001..0.255, origin=RB:v1.0.0:2017-08-02, set at pre-compile  # The period between the successive call of api Lin_DSMReinit_ProcEntity in seconds.
    container LinGlobalConfig: multiplicity set at pre-compile  # This container contains the global configuration parameter of the Lin driver.
      container LinChannel [1..*]: multiplicity set at pre-compile  # This container contains the configuration (parameters) of the LIN Controller(s).
        integer LinChannelBaudRate: 1000..20000, post-build-variant-value=true, set at pre-compile  # Specifies the baud rate of the LIN channel
        integer LinChannelId: 0..65535, set at pre-compile, symbolic-name-value=true  # Identifies the LIN channel. Replaces LIN_CHANNEL_INDEX_NAME from the LIN SWS.
        integer LinHardwareChannelId: 0..65535, origin=RB:v1.0.0:2016-09-30, set at pre-compile, symbolic-name-value=true  # Identifies the LIN hardware channel. Ex: ASCLIN0, ASCLIN1 for Tricore, LMA0, LMA1 for NEC etc.
        integer LinBreakLength: 13..20, origin=RB:v1.0.0:2016-09-30, post-build-variant-value=true, set at pre-compile, symbolic-name-value=true  # Specifies the Sync Break Length in bits allowed range is 13 to 20
        integer LinBreakDelLength: 1..7, origin=RB:v20.0.0:2015-12-10, post-build-variant-value=true, set at pre-compile, symbolic-name-value=true  # Specifies the Sync Break Delimiter Length in bits allowed value is 1 to 7
        boolean LinChannelWakeupSupport: set at pre-compile  # Specifies if the LIN hardware channel supports wake up functionality
        integer LinGotoSleepFrameCounter: 1..3, origin=RB:v1.0.0:2016-09-30, set at pre-compile, symbolic-name-value=true  # Specifies the number of LIN sleep frames to be sent
        integer LinInterByteSpace [0..1]: 0..7, multiplicity set at pre-compile, origin=RB:v21.0.0:2016-06-16, post-build-variant-multiplicity=true, post-build-variant-value=true, set at pre-compile, symbolic-name-value=true  # Specifies the inter byte spacing. If this parameter is not configured then, it will be considered as 0. Interbyte spacing is applicable for both Header and response part
        reference LinClockRef [0..0]: set at pre-compile, destination=McuClockReferencePoint  # Reference to the LIN clock source configuration, which is set in the MCU driver configuration.
        reference rba_LinRxHwConnectionRef [0..1]: origin=RB:v1.0.0:2016-09-30, set at pre-compile, destination=PortPin  # Reference to the Lin Rx Port configuration, which is set in the Port module configuration. If the Lin communication is not requied on Channel, then Configure a dummy Port in Port module("Hadware connector" field in Port moule should be configured as "NULL_XX") and same should be referenced here.
        symbolic name reference LinChannelEcuMWakeupSource [0..1]: multiplicity set at pre-compile, set at pre-compile, destination=EcuMWakeupSource  # This parameter contains a reference to the Wakeup Source for this controller as defined in the ECU State Manager.
    container LinDemEventParameterRefs [0..1]  # Container for the references to DemEventParameter elements which shall be invoked using the API Dem_ReportErrorStatus API in case the corresponding error occurs. The EventId is taken from the referenced DemEventParameter's DemEventId value. The standardized errors are provided in the container and can be extended by vendor specific error references.
      enumeration LinRbDynCreate_LIN_E_TIMEOUT [0..1]: {Disabled, Standard}, origin=RB:v1.0.0:2016-09-30, set at pre-compile, default-value=Disabled  # Selects the way how the Lin DemEvent is created. If not set or set to "Disabled", no such DemEvent is automatically created. If the dynamic creation of this DemEvent is enabled, the reference to this DemEvent (in parameter LIN_E_TIMEOUT) is also automatically created and shall therefore not be set manually.
      symbolic name reference LIN_E_TIMEOUT [0..1]: multiplicity set at pre-compile, set at pre-compile, destination=DemEventParameter  # Reference to the DemEventParameter which shall be issued when the error "Timeout caused by hardware error" has occured.

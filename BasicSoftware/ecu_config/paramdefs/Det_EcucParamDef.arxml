AUTOSAR XML (schema 4-2-2)
package /AUTOSAR_Det/EcucModuleDefs
  module definition Det [0..1]: category=VENDOR_SPECIFIC_MODULE_DEFINITION, refined-module-def=Det, variants pre-compile  # Det configuration includes the functions to be called at notification. On one side the application functions are specified and in general it can be decided whether Dlt shall be called at each call of Det.
    container DetConfigSet [0..1]  # Configuration set container for Det.
      container DetModule [0..*]  # This container describes a non BSW module that is using the Det via Service Interface.
        integer DetModuleId: 4096..65535, set at pre-compile  # The ModuleId is the identification number of a calling module.
    container DetGeneral  # Generic configuration parameters of the Det module.
      boolean DetForwardToDlt [0..1]: multiplicity set at pre-compile, set at pre-compile, default-value=false  # Only if the parameter is present and set to true, the Det requires the Dlt interface and forwards it's call to the function Dlt_DetForwardErrorTrace. In this case the optional interface to Dlt_Det is required.
      boolean DetRbCheckApiConsistency [0..1]: origin=RB:AR42.2.0.0:2017-04-20, set at pre-compile, default-value=true  # The RTE generates some of the APIs which are already provided by Det itself. This results in redundant redeclarations of these functions, which is wanted to ensure consistency between generated and normal APIs. Important:If no RTE is used, this parameter needs to be TRUE TRUE Consistency check which results in compiler warnings if RTE is used FALSE Only RTE-generated APIs are used
      function name DetReportRuntimeErrorCallout [0..1]: set at pre-compile  # This parameter defines the existence and the name of a callout function for the corresponding runtime error handler.
      function name DetReportTransientFaultCallout [0..1]: set at pre-compile  # This parameter defines the existence and the name of a callout function for the corresponding transient fault handler.
      boolean DetVersionInfoApi: set at pre-compile  # Pre-processor switch to enable / disable the API to read out the modules version information. | true: Version info API enabled. false: Version info API disabled.
      container DetRbBuffer [0..1]  # Contains Robert Bosch specific configuration parameters for the error entry buffer.
        integer DetRbErrorBufferSize: 1..65536, origin=RB:AR42.1.0.0:2016-02-20, symbolic-name-value=true  # Parameter to set the size of the error buffer. | If the buffer is enabled the min size is 1 and the max size is 65536.
        boolean DetRbFilterDuplicateBufferEntries [0..1]: origin=RB:AR42.4.0.0:2018-02-20, set at pre-compile, default-value=false  # Parameter to filter duplicate error entires in Det buffer. | TRUE: Duplicate error entries in the buffer are filtered. FALSE: Duplicate error entries in the buffer are not filtered.
        boolean DetRbUseErrorBufferApi: origin=RB:AR42.1.0.0:2016-02-20, set at pre-compile  # Pre-processor switch to enable / disable the API for error buffer handling. | TRUE: Buffer handler APIs enabled. FALSE: Buffer handler APIs disabled.
    container DetNotification [0..1]  # Configuration of the notification functions.
      function name DetErrorHook [0..*]: multiplicity set at pre-compile, set at pre-compile  # Optional list of functions to be called by the Default Error Tracer in context of each call of Det_ReportError. | The type of these functions shall be identical the type of Det_ReportError itself: Std_ReturnType (*f)(uint16, uint8, uint8, uint8).

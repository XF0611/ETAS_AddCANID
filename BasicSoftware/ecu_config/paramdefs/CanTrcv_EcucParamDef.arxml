AUTOSAR XML (schema 4-2-2)
package /AUTOSAR_CanTrcv/EcucModuleDefs
  module definition CanTrcv [0..*]: category=VENDOR_SPECIFIC_MODULE_DEFINITION, post-build-variant-support=true, refined-module-def=CanTrcv, variants post-build/pre-compile  # Configuration of the CanTrcv (CAN Transceiver driver) module.
    container CanTrcvConfigSet  # This container contains the configuration parameters and sub containers of the AUTOSAR WdgM module.
      integer CanTrcvRbTja1145SpiRbDevDelayInact [0..1]: origin=RB, set at pre-compile, default-value=1100  # Optional Parameter. Only used if TJA1145 SPI-Forwarding is used. If parameter is left empty, the default value is used. TJA1145 Spi-Timing parameter SpiRbDevDelayInact which will be forwarded to SPI during configuration. It is a general parameter for all TJA1145 used for all configured TJA1145/ATA6570.
      integer CanTrcvRbTja1145SpiRbDevDelayLead [0..1]: origin=RB, set at pre-compile, default-value=200  # Optional Parameter. Only used if TJA1145 SPI-Forwarding is used. If parameter is left empty, the default value is used. TJA1145 Spi-Timing parameter SpiRbDevDelayLead which will be forwarded to SPI during configuration.It is a general parameter for all TJA1145 used for all configured TJA1145/ATA6570
      integer CanTrcvRbTja1145SpiRbDevDelayTrail [0..1]: origin=RB, set at pre-compile, default-value=200  # Optional Parameter. Only used if TJA1145 SPI-Forwarding is used. If parameter is left empty, the default value is used. TJA1145 Spi-Timing parameter SpiRbDevDelayTrail which will be forwarded to SPI during configuration.It is a general parameter for all TJA1145 used for all configured TJA1145/ATA6570
      integer CanTrcvSPICommRetries [0..0]: 0..255, post-build-variant-value=true, set at post-build in variant post-build / pre-compile in variant pre-compile, default-value=0  # Indicates the maximum number of communication retries in case of a failed SPI communication (applies both to timed out communication and to errors/NACK in the response data). The parameter is not used. | If configured value is '0', no retry is allowed (communication is expected to succeed at first try).
      integer CanTrcvSPICommTimeout [0..0]: 0..100, post-build-variant-value=true, set at post-build in variant post-build / pre-compile in variant pre-compile, default-value=0  # Indicates the maximum time allowed to the CanTrcv for replying (either positively or negatively) to a SPI command. | Timeout is configured in milliseconds. Timeout value of '0' means that no specific timeout is to be used by CanTrcv and the communication is executed at the best of the SPI HW capacity. The parameter is not used.
      container CanTrcvChannel [1..*]  # Container gives CAN transceiver driver information about a single CAN | transceiver (channel).
        string CanTrcvCddId [0..1]: origin=RB, set at pre-compile  # For each CDD-type an unique identifier of the CAN Transceiver Channel. This parameter is only required for CDD transceiver driver like CS9xx. At these drivers the CanTrcv calls the CDD functions (e.g. rbWAU or rba_IoExt) with the parameter configed here. To be able to use enum values a string is used here. So either an numeric value (like 0) or an enum value (like RBWAU_Client_FrTrcv) can be choosen. The value is generated in file canTrcv_Cfg.c in array CanTrcv_CddIdMapping_au8 and is casted to uint8.
        string CanTrcvCddName [0..1]: origin=RB, set at pre-compile  # Only used if CDD is choosen as HardwareType. A separate freetext field which is used to generate function calls out of CanTrcv into the CDD and to include the corresponding .h file. E:G. if "rba_IoExtCy321" is configured, the CanTrcv code generator generates function calls "rba_IoExtCy321_CanTrcvSetOpMode", "rba_IoExtCy321_CanTrcvGetOpMode", "rba_IoExtCy321_CanTrcvGetBusWuReason", "rba_IoExtCy321_CanTrcvSetWakeupMode" and includes the file rba_IoExtCy321.h.
        integer CanTrcvChannelId: 0..255, scope=ECU, set at pre-compile, symbolic-name-value=true  # Unique identifier of the CAN Transceiver Channel.
        boolean CanTrcvChannelUsed: set at pre-compile, default-value=true  # Shall the related CAN transceiver channel be used?
        boolean CanTrcvControlsPowerSupply: set at pre-compile, default-value=false  # Is ECU power supply controlled by this transceiver? | TRUE = Controlled by transceiver. FALSE = Not controlled by transceiver.
        enumeration CanTrcvHardwareType: {TJA1040, TJA1041, TJA1042, TJA1044GT, TJA1043, TJA1463, TJA1046TK, TJA1048, TJA1059, TJA1145, ATA6570, ATA6571, ATA6572, TLE6250G, TLE6250GV33, TLE6251, TLE8250GVIO, TLE9255, CY327, CS9XX, CDD}, scope=ECU, origin=RB, post-build-variant-value=true, set at pre-compile  # Type of the used Hardware
        boolean CanTrcvHwPnSupport: set at pre-compile, default-value=false  # Indicates whether the HW supports the selective wake-up function | TRUE = Selective wakeup feature is supported by the transceiver FALSE = Selective wakeup functionality is not available in transceiver
        enumeration CanTrcvInitState: {CANTRCV_OP_MODE_NORMAL, CANTRCV_OP_MODE_SLEEP, CANTRCV_OP_MODE_STANDBY}, set at pre-compile, default-value=CANTRCV_OP_MODE_NORMAL  # State of CAN transceiver after call to CanTrcv_Init.
        integer CanTrcvMaxBaudrate: 0..1000, set at pre-compile  # Max baudrate for transceiver hardware type. Only used for validation purposes. Value shall be configured by configuration tool based on | transceiver hardware type.
        integer CanTrcvRbCddModeChangeDelay [0..1]: 1..255, origin=RB, set at pre-compile, default-value=1  # This parameter need to be configured only if unexpected Mode Propogation monitoring for CDD type of Transceiver is enabled. Here user need to specify the minimum delay required to set the requested mode of transcier. User have to enter the number in the multiples of main fucntion duration. For example if Main funtion is scheduled in 10ms task and minimum time required to change the transceiver mode is 20ms then configure this parameter as 2 .
        boolean CanTrcvWakeupByBusUsed [0..1]: multiplicity set at pre-compile, set at pre-compile, default-value=false  # Is wake up by bus supported? If CAN transceiver hardware does not support wake up by bus value is always FALSE. If CAN transceiver hardware supports wake up by bus value is TRUE or FALSE depending whether it is used or not. | TRUE = Is used. FALSE = Is not used.
        reference CanTrcvIcuChannelRef [0..1]: multiplicity set at pre-compile, set at pre-compile, destination=IcuChannel  # Reference to the IcuChannel to enable/disable the interrupts | for wakeups.
        symbolic name reference CanTrcvPorWakeupSourceRef [0..1]: scope=ECU, multiplicity set at pre-compile, set at pre-compile, destination=EcuMWakeupSource  # Currently unused parameter. Autosardefinition: Symbolic name reference to specify the wakeup sources that should be used in the calls to EcuM_SetWakeupEvent as specified in [SWS_CanTrcv_00183] and [SWS_CanTrcv_00184]. | This reference is mandatory if the HW supports POR or SYSERR flags
        symbolic name reference CanTrcvSyserrWakeupSourceRef [0..1]: scope=ECU, multiplicity set at pre-compile, set at pre-compile, destination=EcuMWakeupSource  # Currently unused parameter. Autosardefinition: Symbolic name reference to specify the wakeup sources that should be used in the calls to EcuM_SetWakeupEvent as specified in [SWS_CanTrcv_00183] and [SWS_CanTrcv_00184] | This reference is mandatory if the HW supports POR or SYSERR flags
        reference CanTrcvWakeupSourceRef [0..1]: scope=ECU, multiplicity set at pre-compile, set at pre-compile, destination=EcuMWakeupSource  # Reference to a wakeup source in the EcuM configuration. | This reference is only needed if CanTrcvWakeupByBusUsed is true.
        container CanTrcvAccess  # Container gives CanTrcv Driver information about access to a single CAN transceiver.
          container CanTrcvDioAccess [0..1]: post-build-variant-multiplicity=true  # Container gives CAN transceiver driver information about accessing ports and port pins. In addition relation between CAN transceiver hardware pin names and Dio port access information is given. | If a CAN transceiver hardware has no Dio interface, there is no instance of this container.
            container CanTrcvDioChannelAccess [1..*]: post-build-variant-multiplicity=true  # Container gives DIO channel access by single Can transceiver channel.
              enumeration CanTrcvDioHardwareInterfaceType: {Enable, Standby, ErrorPin, WakeupSignalisation, Inhibit}, set at pre-compile  # Type of functionalty of this pin. The trcv-software uses this parameter to know what functionality is located at the referenced Dio Pin conneted to the Trcv-HW. | CANTRCV_DIO_PORT_SYMBOLIC_NAME or CANTRCV_DIO_CHANNEL_SYMBOLIC_NAME or CANTRCV_DIO_CHANNEL_GROUP_SYMBOLIC_NAME shall reference a Dio configuration. The CAN transceiver driver implementation description shall list up this name for the appropriate CAN transceiver hardware.
              string CanTrcvHardwareInterfaceName: set at pre-compile  # CAN transceiver hardware interface name. It is typically the name of a pin. From a Dio point of view it is usually a port. The name is written as comment inside the generated file for reference only. No functionality is related to this parameter.
              string CanTrcvRbDioSymName [0..1]: origin=RB:v4.1.0:2018-02-28, post-build-variant-value=true, set at pre-compile  # This parameter have to be configured only if Dio component is not available in the Project. In this case Macro to access Dio will be generated based on the name given here. Macro is generated by attaching the symbolic name pattern. If third party macro is not matching with the generated macro , then a mapping macro should by created by integrator. If project has Autosar Dio then no need to configure this parameter.
              boolean CanTrcvRbHardwarePinInvert [0..1]: multiplicity set at pre-compile, origin=RB, set at pre-compile, default-value=false  # Parameter depends on hardware: Describes, if a inverter is between transceiver pin and micro controller. If the transceiver is directly connected to the Controller, 'false' should be configured. If there is an inverter between transceiver and micro controller, 'yes' should be configured. | false: No inverter between Micro Controller and transceiver yes: Inverter between Micro Controller and transceiver
              choice reference CanTrcvDioSymNameRef [0..1]: post-build-variant-value=true, set at pre-compile, destination=DioChannel  # Choice Reference to a DIO Channel. This reference replaces the CANTRCV_DIO_CHANNEL_SYM_NAME references in the Can Trcv SWS.
          container CanTrcvSpiAccess [0..1]  # Container gives CAN transceiver driver information about accessing Spi. If a CAN transceiver hardware has no Spi interface, there is no instance of this container.
            container CanTrcvSpiSequence [1..*]  # Container gives CAN transceiver driver information about one SPI sequence. | One SPI sequence used by CAN transceiver driver is in exclusive use for it. No other driver is allowed to access this sequence. CAN transceiver driver may use one sequence to access n CAN transceiver hardwares chips of the same type or n sequences are used to access one single CAN transceiver hardware chip. If a CAN transceiver hardware has no SPI interface, there is no instance of this container.
              string CanTrcvRbSpiChnlStrgName [0..1]: origin=RB:v4.1.0:2018-02-28, set at pre-compile  # This parameter have to be configured only if SPI component is not available in the Project. In this case Macro to access SPI will be generated based on the name given here.Macro is generated by attachig the symbloic name patter. If generated macro name is not matching with third party macro then integrator should provide the mapping macro .If project has Autosar SPI then no need to configure this parameter.
              string CanTrcvRbSpiSeqStrgName [0..1]: origin=RB:v4.1.0:2018-02-28, set at pre-compile  # This parameter have to be configured only if SPI component is not available in the Project. In this case Macro to access SPI will be generated based on the name given here.Macro is generated by attachig the symbloic name patter. If generated macro name is not matching with third party macro then integrator should provide the mapping macro .If project has Autosar SPI then no need to configure this parameter.
              boolean CanTrcvSpiAccessSynchronous [0..1]: multiplicity set at pre-compile, set at pre-compile, default-value=false  # This parameter is used to define whether the access to the Spi sequence is synchronous or asynchronous. | true: SPI access is synchronous. false: SPI access is asynchronous.
              symbolic name reference CanTrcvSpiSequenceName [0..*]: multiplicity set at pre-compile, set at pre-compile, destination=SpiSequence  # Reference to a Spi sequence configuration container.
        container CanTrcvDemEventParameterRefs [0..1]  # Container for the references to DemEventParameter elements which shall be invoked using the API Dem_ReportErrorStatus in case the corresponding error occurs. The EventId is taken from the referenced DemEventParameter's DemEventId value.
          enumeration CanTrcvRbDynCreate_CANTRCV_X_Y_E_NO_TRCV_CONTROL_Z [0..1]: {Disabled, Standard}, origin=RB, set at pre-compile, default-value=Disabled  # Dynamically create DemEvent | Selects the way how the example DemEvent is created. If not set or set to Disabled, no such DemEvent is automatically created. If the dynamic creation of this DemEvent is enabled, the reference to this DemEvent (in parameter rba_Example_DemEventRef) is also automatically created and shall therefore not be set manually.
          reference CANTRCV_E_BUS_ERROR [0..1]: scope=ECU, multiplicity set at pre-compile, set at pre-compile, destination=DemEventParameter  # Reference to the DemEventParameter which shall be issued when bus error has occurred.
          reference CANTRCV_RB_E_UNEXPECTED_MODE_PROP [0..1]: scope=ECU, multiplicity set at pre-compile, origin=RB:v4.1.0:2018-2-28, set at pre-compile, destination=DemEventParameter  # Reference to the DemEventParameter which shall be issued when the unexpected mode propogation is detcted in Transceiver HW.
          reference CANTRCV_X_Y_E_NO_TRCV_CONTROL_Z [0..1]: scope=ECU, multiplicity set at pre-compile, origin=RB, set at pre-compile, destination=DemEventParameter  # Reference to the DemEventParameter which shall be issued when the error &quot;No/incorrect communication to transceiver&quot; has occured. The CanTrcv shall report for each configured Transceiver (channel), one specific error event which shall follow the below naming convention for the production error events: CANTRCV_X_Y_E_NO_TRCV_CONTROL_Z where: | X is the respective Vendor Identifier, Y is the respective CanTrcv type, Z is the respective Channel Identifier
        container CanTrcvPartialNetwork [0..1]  # Container gives CAN transceiver driver information about the configuration of Partial Networking functionality.
          integer CanTrcvBaudRate: 0..1000, post-build-variant-value=true, set at post-build in variant post-build / pre-compile in variant pre-compile  # Indicates the CAN Bus communication baud rate in kbps.
          boolean CanTrcvBusErrFlag: post-build-variant-value=true, set at post-build in variant post-build / pre-compile in variant pre-compile, default-value=false  # Indicates if the Bus Error (BUSERR) flag is managed by the BSW. This flag is set if a bus failure is detected by the transceiver. | TRUE = Supported by transceiver and managed by BSW. FALSE = Not managed by BSW.
          boolean CanTrcvPnCanIdIsExtended: post-build-variant-value=true, set at post-build in variant post-build / pre-compile in variant pre-compile, default-value=false  # Indicates whether extended or standard ID is used. | TRUE = Extended Can identifier is used. FALSE = Standard Can identifier is used
          boolean CanTrcvPnEnabled: post-build-variant-value=true, set at post-build in variant post-build / pre-compile in variant pre-compile, default-value=false  # Indicates whether the selective wake-up function is enabled or disabled in HW. | TRUE = Selective wakeup feature is enabled in the transceiver hardware FALSE = Selective wakeup feature is disabled in the transceiver hardware
          integer CanTrcvPnFrameCanId: 0..4294967295, post-build-variant-value=true, set at post-build in variant post-build / pre-compile in variant pre-compile  # CAN ID of the Wake-up Frame (WUF).
          integer CanTrcvPnFrameCanIdMask: 0..4294967295, post-build-variant-value=true, set at post-build in variant post-build / pre-compile in variant pre-compile  # ID Mask for the selective activation of the transceiver. It is used to enableFrame Wake-up (WUF) on a group of IDs.
          integer CanTrcvPnFrameDlc: 0..8, post-build-variant-value=true, set at post-build in variant post-build / pre-compile in variant pre-compile  # Data Length of the Wake-up Frame (WUF).
          boolean CanTrcvPowerOnFlag: post-build-variant-value=true, set at post-build in variant post-build / pre-compile in variant pre-compile, default-value=false  # Description: Indicates if the Power On Reset (POR) flag is available and is managed by the transceiver. | TRUE = Supported by Hardware. FALSE = Not supported by Hardware
          container CanTrcvPnFrameDataMaskSpec [0..8]  # Defines data payload mask to be used on the received payload in order to determine if the transceiver must be woken up by the received Wake-up Frame (WUF).
            integer CanTrcvPnFrameDataMask: 0..255, post-build-variant-value=true, set at post-build in variant post-build / pre-compile in variant pre-compile  # Defines the n byte (Byte0 = LSB) of the data payload mask to be used on the received payload in order to determine if the transceiver must be woken up by the received Wake-up Frame (WUF).
            integer CanTrcvPnFrameDataMaskIndex: 0..7, post-build-variant-value=true, set at post-build in variant post-build / pre-compile in variant pre-compile  # holds the position n in frame of the mask-part
        container CanTrcvTja1145Param [0..1]  # Special parameters for TJA1145
          boolean CanTrcvTja1145CBSE [0..1]: origin=RB, set at pre-compile, default-value=false  # false: CAN bus silence detection disabled true CAN bus silence detection enabled
          boolean CanTrcvTja1145CFDC [0..1]: origin=RB, set at pre-compile, default-value=false  # false: CAN FD tolerance enabled (true) or disabled (false)
          boolean CanTrcvTja1145CFE [0..1]: origin=RB, set at pre-compile, default-value=true  # false: CAN failure detection disabled true CAN failure detection enabled
          boolean CanTrcvTja1145CMC [0..1]: origin=RB, set at pre-compile, default-value=true  # false: CMC=01; At CanOffline CANH and CANL are terminated to 2.5V. At CAN active with undervolt detection. true: CMC=10; At CanOffline CANH nad CANL are terminated to GND; at CAN active without undervolt detection
          boolean CanTrcvTja1145Diag01ModeControl [0..1]: origin=RB, set at pre-compile, default-value=false  # true: This register is read out in CanTrcv_MainFunction and content is stored in CanTrcv_SpiSeq1DiagRxBuf_ao false: register is not read out in CanTrcv_MainFunction
          boolean CanTrcvTja1145Diag03MainStatus [0..1]: origin=RB, set at pre-compile, default-value=false  # true: This register is read out in CanTrcv_MainFunction and content is stored in CanTrcv_SpiSeq1DiagRxBuf_ao false: register is not read out in CanTrcv_MainFunction
          boolean CanTrcvTja1145Diag04SystemEventEnable [0..1]: origin=RB, set at pre-compile, default-value=false  # true: This register is read out in CanTrcv_MainFunction and content is stored in CanTrcv_SpiSeq1DiagRxBuf_ao false: register is not read out in CanTrcv_MainFunction
          boolean CanTrcvTja1145Diag06Memory0 [0..1]: origin=RB, set at pre-compile, default-value=false  # true: This register is read out in CanTrcv_MainFunction and content is stored in CanTrcv_SpiSeq1DiagRxBuf_ao false: register is not read out in CanTrcv_MainFunction
          boolean CanTrcvTja1145Diag07Memory1 [0..1]: origin=RB, set at pre-compile, default-value=false  # true: This register is read out in CanTrcv_MainFunction and content is stored in CanTrcv_SpiSeq1DiagRxBuf_ao false: register is not read out in CanTrcv_MainFunction
          boolean CanTrcvTja1145Diag08Memory2 [0..1]: origin=RB, set at pre-compile, default-value=false  # true: This register is read out in CanTrcv_MainFunction and content is stored in CanTrcv_SpiSeq1DiagRxBuf_ao false: register is not read out in CanTrcv_MainFunction
          boolean CanTrcvTja1145Diag09Memory3 [0..1]: origin=RB, set at pre-compile, default-value=false  # true: This register is read out in CanTrcv_MainFunction and content is stored in CanTrcv_SpiSeq1DiagRxBuf_ao false: register is not read out in CanTrcv_MainFunction
          boolean CanTrcvTja1145Diag0ALockControl [0..1]: origin=RB, set at pre-compile, default-value=false  # true: This register is read out in CanTrcv_MainFunction and content is stored in CanTrcv_SpiSeq1DiagRxBuf_ao false: register is not read out in CanTrcv_MainFunction
          boolean CanTrcvTja1145Diag20CANControl [0..1]: origin=RB, set at pre-compile, default-value=false  # true: This register is read out in CanTrcv_MainFunction and content is stored in CanTrcv_SpiSeq1DiagRxBuf_ao false: register is not read out in CanTrcv_MainFunction
          boolean CanTrcvTja1145Diag22TransceiverStatus [0..1]: origin=RB, set at pre-compile, default-value=false  # true: This register is read out in CanTrcv_MainFunction and content is stored in CanTrcv_SpiSeq1DiagRxBuf_ao false: register is not read out in CanTrcv_MainFunction
          boolean CanTrcvTja1145Diag23TransceiverEventEnable [0..1]: origin=RB, set at pre-compile, default-value=false  # true: This register is read out in CanTrcv_MainFunction and content is stored in CanTrcv_SpiSeq1DiagRxBuf_ao false: register is not read out in CanTrcv_MainFunction
          boolean CanTrcvTja1145Diag26DataRate [0..1]: origin=RB, set at pre-compile, default-value=false  # true: This register is read out in CanTrcv_MainFunction and content is stored in CanTrcv_SpiSeq1DiagRxBuf_ao false: register is not read out in CanTrcv_MainFunction
          boolean CanTrcvTja1145Diag27Identifier0 [0..1]: origin=RB, set at pre-compile, default-value=false  # true: This register is read out in CanTrcv_MainFunction and content is stored in CanTrcv_SpiSeq1DiagRxBuf_ao false: register is not read out in CanTrcv_MainFunction
          boolean CanTrcvTja1145Diag28Identifier1 [0..1]: origin=RB, set at pre-compile, default-value=false  # true: This register is read out in CanTrcv_MainFunction and content is stored in CanTrcv_SpiSeq1DiagRxBuf_ao false: register is not read out in CanTrcv_MainFunction
          boolean CanTrcvTja1145Diag29Identifier2 [0..1]: origin=RB, set at pre-compile, default-value=false  # true: This register is read out in CanTrcv_MainFunction and content is stored in CanTrcv_SpiSeq1DiagRxBuf_ao false: register is not read out in CanTrcv_MainFunction
          boolean CanTrcvTja1145Diag2AIdentifier3 [0..1]: origin=RB, set at pre-compile, default-value=false  # true: This register is read out in CanTrcv_MainFunction and content is stored in CanTrcv_SpiSeq1DiagRxBuf_ao false: register is not read out in CanTrcv_MainFunction
          boolean CanTrcvTja1145Diag2BMask0 [0..1]: origin=RB, set at pre-compile, default-value=false  # true: This register is read out in CanTrcv_MainFunction and content is stored in CanTrcv_SpiSeq1DiagRxBuf_ao false: register is not read out in CanTrcv_MainFunction
          boolean CanTrcvTja1145Diag2CMask1 [0..1]: origin=RB, set at pre-compile, default-value=false  # true: This register is read out in CanTrcv_MainFunction and content is stored in CanTrcv_SpiSeq1DiagRxBuf_ao false: register is not read out in CanTrcv_MainFunction
          boolean CanTrcvTja1145Diag2DMask2 [0..1]: origin=RB, set at pre-compile, default-value=false  # true: This register is read out in CanTrcv_MainFunction and content is stored in CanTrcv_SpiSeq1DiagRxBuf_ao false: register is not read out in CanTrcv_MainFunction
          boolean CanTrcvTja1145Diag2EMask3 [0..1]: origin=RB, set at pre-compile, default-value=false  # true: This register is read out in CanTrcv_MainFunction and content is stored in CanTrcv_SpiSeq1DiagRxBuf_ao false: register is not read out in CanTrcv_MainFunction
          boolean CanTrcvTja1145Diag2FFrameControl [0..1]: origin=RB, set at pre-compile, default-value=false  # true: This register is read out in CanTrcv_MainFunction and content is stored in CanTrcv_SpiSeq1DiagRxBuf_ao false: register is not read out in CanTrcv_MainFunction
          boolean CanTrcvTja1145Diag4BWakePinStatus [0..1]: origin=RB, set at pre-compile, default-value=false  # true: This register is read out in CanTrcv_MainFunction and content is stored in CanTrcv_SpiSeq1DiagRxBuf_ao false: register is not read out in CanTrcv_MainFunction
          boolean CanTrcvTja1145Diag4CWakePinEnable [0..1]: origin=RB, set at pre-compile, default-value=false  # true: This register is read out in CanTrcv_MainFunction and content is stored in CanTrcv_SpiSeq1DiagRxBuf_ao false: register is not read out in CanTrcv_MainFunction
          boolean CanTrcvTja1145Diag60EventCaptureStatus [0..1]: origin=RB, set at pre-compile, default-value=false  # true: This register is read out in CanTrcv_MainFunction and content is stored in CanTrcv_SpiSeq1DiagRxBuf_ao false: register is not read out in CanTrcv_MainFunction
          boolean CanTrcvTja1145Diag61SystemEventStatus [0..1]: origin=RB, set at pre-compile, default-value=false  # true: This register is read out in CanTrcv_MainFunction and content is stored in CanTrcv_SpiSeq1DiagRxBuf_ao false: register is not read out in CanTrcv_MainFunction
          boolean CanTrcvTja1145Diag63TransceiverEventStatus [0..1]: origin=RB, set at pre-compile, default-value=false  # true: This register is read out in CanTrcv_MainFunction and content is stored in CanTrcv_SpiSeq1DiagRxBuf_ao false: register is not read out in CanTrcv_MainFunction
          boolean CanTrcvTja1145Diag64WakePinEventStatus [0..1]: origin=RB, set at pre-compile, default-value=false  # true: This register is read out in CanTrcv_MainFunction and content is stored in CanTrcv_SpiSeq1DiagRxBuf_ao false: register is not read out in CanTrcv_MainFunction
          boolean CanTrcvTja1145Diag68DataMask0 [0..1]: origin=RB, set at pre-compile, default-value=false  # true: This register is read out in CanTrcv_MainFunction and content is stored in CanTrcv_SpiSeq1DiagRxBuf_ao false: register is not read out in CanTrcv_MainFunction
          boolean CanTrcvTja1145Diag69DataMask1 [0..1]: origin=RB, set at pre-compile, default-value=false  # true: This register is read out in CanTrcv_MainFunction and content is stored in CanTrcv_SpiSeq1DiagRxBuf_ao false: register is not read out in CanTrcv_MainFunction
          boolean CanTrcvTja1145Diag6ADataMask2 [0..1]: origin=RB, set at pre-compile, default-value=false  # true: This register is read out in CanTrcv_MainFunction and content is stored in CanTrcv_SpiSeq1DiagRxBuf_ao false: register is not read out in CanTrcv_MainFunction
          boolean CanTrcvTja1145Diag6BDataMask3 [0..1]: origin=RB, set at pre-compile, default-value=false  # true: This register is read out in CanTrcv_MainFunction and content is stored in CanTrcv_SpiSeq1DiagRxBuf_ao false: register is not read out in CanTrcv_MainFunction
          boolean CanTrcvTja1145Diag6CDataMask4 [0..1]: origin=RB, set at pre-compile, default-value=false  # true: This register is read out in CanTrcv_MainFunction and content is stored in CanTrcv_SpiSeq1DiagRxBuf_ao false: register is not read out in CanTrcv_MainFunction
          boolean CanTrcvTja1145Diag6DDataMask5 [0..1]: origin=RB, set at pre-compile, default-value=false  # true: This register is read out in CanTrcv_MainFunction and content is stored in CanTrcv_SpiSeq1DiagRxBuf_ao false: register is not read out in CanTrcv_MainFunction
          boolean CanTrcvTja1145Diag6EDataMask6 [0..1]: origin=RB, set at pre-compile, default-value=false  # true: This register is read out in CanTrcv_MainFunction and content is stored in CanTrcv_SpiSeq1DiagRxBuf_ao false: register is not read out in CanTrcv_MainFunction
          boolean CanTrcvTja1145Diag6FDataMask7 [0..1]: origin=RB, set at pre-compile, default-value=false  # true: This register is read out in CanTrcv_MainFunction and content is stored in CanTrcv_SpiSeq1DiagRxBuf_ao false: register is not read out in CanTrcv_MainFunction
          boolean CanTrcvTja1145Diag7EIdentification [0..1]: origin=RB, set at pre-compile, default-value=false  # true: This register is read out in CanTrcv_MainFunction and content is stored in CanTrcv_SpiSeq1DiagRxBuf_ao false: register is not read out in CanTrcv_MainFunction
          boolean CanTrcvTja1145OTWE [0..1]: origin=RB, set at pre-compile, default-value=false  # false: overtemperature warning disabled true overtemperature warning enabled
          boolean CanTrcvTja1145SPIFE [0..1]: origin=RB, set at pre-compile, default-value=false  # false: SPI failure detection disabled true SPI failure detection enabled
          boolean CanTrcvTja1145WPFE [0..1]: origin=RB, set at pre-compile, default-value=true  # false: falling-edge detection on WAKE pin disabled true falling-edge detection on WAKE pin enabled
          boolean CanTrcvTja1145WPRE [0..1]: origin=RB, set at pre-compile, default-value=true  # false: rising-edge detection on WAKE pin disabled true rising-edge detection on WAKE pin enabled
        container CanTrcvTle9255Param [0..1]  # Special parameters for TLE9255
          boolean CanTrcvTle9255STTS_EN [0..1]: origin=RB, set at pre-compile, default-value=false  # State transition to Sleep WUP Sub-Mode if a VCC is below VCC_UV AND t is greater than tVCC_UV_T AND tSilence has expired false: State transition will not be performed
          boolean CanTrcvTle9255LWU_NEG [0..1]: origin=RB, set at pre-compile, default-value=false  # Local wake-up on the negative edge enabled (true) or disabled (false)
          boolean CanTrcvTle9255LWU_POS [0..1]: origin=RB, set at pre-compile, default-value=false  # Local wake-up on the positive edge enabled (true) or disabled (false)
          boolean CanTrcvTle9255WAKE_TOG [0..1]: origin=RB, set at pre-compile, default-value=false  # true: Toggle RxD Pin if a wake-up event is detected false: The RxD Pin will be constant "low" if wake-up event is detected
          boolean CanTrcvTle9255VBAT_CON [0..1]: origin=RB, set at pre-compile, default-value=false  # true: INH pin will be switched off by entering the sleep mode false: INH pin will not be switched off by entering the sleep mode
          enumeration CanTrcvTle9255TXD_TO [0..1]: {1-4ms, 2-8ms, 5-10ms, disabled}, scope=ECU, origin=RB, set at pre-compile, default-value=disabled  # TXD Timeout (min - max)
          enumeration CanTrcvTle9255VIO_UV_T [0..1]: {100ms, 200ms, 300ms, 400ms, 500ms, 600ms, 700ms, 800ms, 900ms, 1000ms, 1100ms, 1200ms, 1300ms, 1400ms, 1500ms}, scope=ECU, origin=RB, set at pre-compile, default-value=1500ms  # VIO Undervoltage Detection Timer
          enumeration CanTrcvTle9255VCC_UV_T [0..1]: {100ms, 200ms, 300ms, 400ms, 500ms, 600ms, 700ms, 800ms, 900ms, 1000ms, 1100ms, 1200ms, 1300ms, 1400ms, 1500ms}, scope=ECU, origin=RB, set at pre-compile, default-value=1500ms  # VCC Undervoltage Detection Timer
          enumeration CanTrcvTle9255BR_RATIO [0..1]: scope=ECU, origin=RB, set at pre-compile, default-value=Ratio 4  # Baudrate ratio from arbitration phase to CAN FD data phase
            Ratio 4  # Ratio_4
            Ratio 10  # Ratio_10
    container CanTrcvGeneral  # Container gives CAN transceiver driver basic information.
      enumeration CanTrcvAutosarVersion [0..1]: {Legacy, AR4_0_2, AR4_0_3}, origin=RB, set at pre-compile, default-value=AR4_0_3  # Naming convention for symbolic names are generated according autosar version: Lecacy: no prefix AR4.0.2: Dio_ (ecuc_sws_2108) AR4.0.3: DioConf_DioChannel_ | >Naming convention for symbolic names are generated according autosar version: Lecacy: no prefix AR4.0.2: Dio_ AR4.0.3: DioConf_DioChannel_
      boolean CanTrcvClearWupReasonInSetWakeupMode: origin=RB, set at pre-compile  # On true, the wakeup reason is cleared in function CanTrcv_SetWakeupMode with Parameter CANTRCV_WUMODE_CLEAR. With other parameters or 'false' at this configuration parameter, the wakeup reason is not cleared in function CanTrcv_SetWakeupMode. The wakeup reason is cleard always init-function and on transition to sleep mode. If this parameter is set to true in one Can Trcv it will be used in all CanTrcv
      boolean CanTrcvDevErrorDetect: set at pre-compile  # Switches the Default Error Tracer (Det) detection and notification ON or OFF. | * true: enabled (ON). * false: disabled (OFF). If enabled, #define CANTRCV_DEV _ERROR_DETECT ON shall be generated. If disabled, #define CANTRCV_DEV_ERROR _DETECT OFF shall be generated. Define shall be part of file CanTrcv_Cfg.h.
      boolean CanTrcvGetVersionInfo: set at pre-compile, default-value=false  # Switches version information API on and off. If switched off, function need not be present in compiled code.
      integer CanTrcvIndex: 0..255, set at pre-compile  # Specifies the InstanceId of this module instance. If only one instance is present it shall have the Id 0.
      float CanTrcvMainFunctionDiagnosticsPeriod [0..1]: 0.001..65.535, multiplicity set at pre-compile, set at pre-compile  # This parameter describes the period for cyclic call to CanTrcv_MainFunctionDiagnostics. Unit is seconds.
      float CanTrcvMainFunctionPeriod [0..1]: 0.001..65.535, multiplicity set at pre-compile, set at pre-compile  # This parameter describes the period for cyclic call to CanTrcv_MainFunction. Unit is seconds.
      enumeration CanTrcvRbCheckWakeupAsyncMode [0..1]: {CANTRCV_CFG_CHECKWAKEUP_ASYNC, CANTRCV_CFG_CHECKWAKEUP_SYNC}, origin=RB, set at pre-compile, default-value=CANTRCV_CFG_CHECKWAKEUP_ASYNC  # Only used for asyncron/SPI transceiver like TJA1145/ATA6570/ATA6572/TLE9255. SYNC: Previously in main-function read out wakeup-register-values are immediatelly returned. At least 3 main-cycles are required to get the HW-Info after startup to get correct wakeup-information. ASYNC. After function call CheckWakeup a flag is set to read out wakeupinformation in next main-cycle. In another main-cycle the read out register values are evaluated and wakeupinformation is given to ECUM. So with configuration as ASYNC, at least two main-cycles are needed to get the latest wakeup information during normal runtime.
      boolean CanTrcvRbCheckWakeupReturnVal [0..1]: origin=RB:v5.0.0:2018-5-22, set at pre-compile, default-value=false  # Configures the meaning of the return value of function CanTrcv_CheckWakeup False: The function CanTrcv_CheckWakeup behaves as described in Autosar 4.2.2 and returns the state of the function. True: The function CanTrcv_CheckWakeup behaves as desribed in Autosar 4.0 and returns the wakeup information. Returnvalue <false> means: no wakeup detected., Returnvalue <true> means: wakeup detected.
      enumeration CanTrcvRbIndicationBehaviour: {CANTRCV_INDICATION_ASYNC, CANTRCV_INDICATION_IMMEDIATELY}, multiplicity set at pre-compile, origin=RB, set at pre-compile, default-value=CANTRCV_INDICATION_ASYNC  # For TJA1145/TLE9255. For all other transceivers please use default value. Configuration for TJA1145/TLE9255: FIRST POSSIBILITY: IMMEDIATELY: the indication function CanIf_TrcvModeIndication and CanIf_ClearTrcvWufFlagIndication are called immediately in called function. SECOND POSSIBILITY: ASYNC: the indication function CanIf_TrcvModeIndication and CanIf_ClearTrcvWufFlagIndication are called when states are really reached.
      boolean CanTrcvRbUnderVoltageRecovery [0..1]: origin=RB:v1.0.0:2019-4-15, set at pre-compile, default-value=false  # CanTrcv is forced to Sleep when under voltage is detected at Vcc/Vio or when overtemperature warning is detected. Selective wake-up is disabled, Standard wake-up and local wake-up via the WAKE pin are enabled. When True: The transceiver is reconfigured and is put back to its previous mode. When False: The transceiver remains in Sleep with Selective wake-up disabled, Standard wake-up and local wake-up via the WAKE pin enabled.
      enumeration CanTrcvRbWakeupReasonBusAndPin [0..1]: {CANTRCV_WU_BY_BUS, CANTRCV_WU_BY_PIN}, multiplicity set at pre-compile, origin=RB, set at pre-compile  # If this parameter is used, if wakeupreason by Bus (remote) and by Pin (local) and by Power On occur at the same time, then the configured wakeupreason is given back in function CanTrcv_GetBusWuReason This parameter is global for all configured CanTrcv. If this parameter is set for one transceiver it is used for all CanTrcv. | For TJA1145/TLE9255. For all other transceivers please use default value. Configuration for TJA1145/TLE9255: FIRST POSSIBILITY: IMMEDIATELY: the indication function CanIf_TrcvModeIndication and CanIf_ClearTrcvWufFlagIndication are called immediately in called function. SECOND POSSIBILITY: ASYNC: the indication function CanIf_TrcvModeIndication and CanIf_ClearTrcvWufFlagIndication are called when states are really reached.
      enumeration CanTrcvRbWakeupReasonBusAndPinAndPower [0..1]: {CANTRCV_WU_BY_BUS, CANTRCV_WU_BY_PIN, CANTRCV_WU_POWER_ON}, multiplicity set at pre-compile, origin=RB, set at pre-compile  # If this parameter is used, if wakeupreason by Bus (remote) and by Pin (local) and by Power On occur at the same time, then the configured wakeupreason is given back in function CanTrcv_GetBusWuReason This parameter is global for all configured CanTrcv. If this parameter is set for one transceiver it is used for all CanTrcv. | For TJA1145/TLE9255. For all other transceivers please use default value. Configuration for TJA1145/TLE9255: FIRST POSSIBILITY: IMMEDIATELY: the indication function CanIf_TrcvModeIndication and CanIf_ClearTrcvWufFlagIndication are called immediately in called function. SECOND POSSIBILITY: ASYNC: the indication function CanIf_TrcvModeIndication and CanIf_ClearTrcvWufFlagIndication are called when states are really reached.
      enumeration CanTrcvRbWakeupReasonBusAndPower [0..1]: {CANTRCV_WU_BY_BUS, CANTRCV_WU_POWER_ON}, multiplicity set at pre-compile, origin=RB, set at pre-compile  # If this parameter is used, if wakeupreason by Bus (remote) and by Power On occur at the same time, then the configured wakeupreason is given back in function CanTrcv_GetBusWuReason This parameter is global for all configured CanTrcv. If this parameter is set for one transceiver it is used for all CanTrcv. | For TJA1145/TLE9255. For all other transceivers please use default value. Configuration for TJA1145/TLE9255: FIRST POSSIBILITY: IMMEDIATELY: the indication function CanIf_TrcvModeIndication and CanIf_ClearTrcvWufFlagIndication are called immediately in called function. SECOND POSSIBILITY: ASYNC: the indication function CanIf_TrcvModeIndication and CanIf_ClearTrcvWufFlagIndication are called when states are really reached.
      enumeration CanTrcvRbWakeupReasonPinAndPower [0..1]: {CANTRCV_WU_BY_PIN, CANTRCV_WU_POWER_ON}, multiplicity set at pre-compile, origin=RB, set at pre-compile  # If this parameter is used, if wakeupreason by Pin (local) and by Power On occur at the same time, then the configured wakeupreason is given back in function CanTrcv_GetBusWuReason This parameter is global for all configured CanTrcv. If this parameter is set for one transceiver it is used for all CanTrcv. | For TJA1145/TLE9255. For all other transceivers please use default value. Configuration for TJA1145/TLE9255: FIRST POSSIBILITY: IMMEDIATELY: the indication function CanIf_TrcvModeIndication and CanIf_ClearTrcvWufFlagIndication are called immediately in called function. SECOND POSSIBILITY: ASYNC: the indication function CanIf_TrcvModeIndication and CanIf_ClearTrcvWufFlagIndication are called when states are really reached.
      enumeration CanTrcvTimerType [0..1]: {None, Timer_1us16bit}, multiplicity set at pre-compile, set at pre-compile  # Type of the Time Service Predefined Timer.
      boolean CanTrcvUseAsr31Api: set at pre-compile, default-value=false  # If switched on, #define CANTRCV_DEV _ERROR_DETECT ON shall be generated. If switched off, #define CANTRCV_DEV_ERROR _DETECT OFF shall be generated. Define shall be part of file CanTrcv_Cfg.h.
      float CanTrcvWaitTime [0..1]: 0..0.000255, multiplicity set at pre-compile, set at pre-compile  # Wait time for transceiver state changes in seconds.
      enumeration CanTrcvWakeUpSupport: {CANTRCV_WAKEUP_BY_POLLING, CANTRCV_WAKEUP_NOT_SUPPORTED}, set at pre-compile  # Informs whether wake up is supported by polling or not supported. In case no | wake up is supported by the hardware, setting has to be NOT_SUPPORTED. Only in the case of wake up supported by polling, function CanTrcv_MainFunction has to be present and to be invoked by the scheduler.

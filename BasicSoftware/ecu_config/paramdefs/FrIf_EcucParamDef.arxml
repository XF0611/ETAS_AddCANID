AUTOSAR XML (schema 4-2-2)
# The material contained in this specification is protected by copyright and
# other types of Intellectual Property Rights. The commercial exploitation of the
# material contained in this specification requires a license to such
# Intellectual Property Rights.
# This specification may be utilized or reproduced without any modification, in
# any form or by any means, for informational purposes only. For any other
# purpose, no part of the specification may be utilized or reproduced, in any
# form or by any means, without permission in writing from the publisher.
# licensed under the same rules as applicable to the AUTOSAR Standard.
package /AUTOSAR_FrIf/EcucModuleDefs
  module definition FrIf [0..1]: category=VENDOR_SPECIFIC_MODULE_DEFINITION, post-build-variant-support=true, refined-module-def=FrIf, variants link-time/post-build/pre-compile  # Configuration of the FrIf (FlexRay Interface) module.
    container FrIfConfig  # This container contains the configuration parameters and sub containers of the AUTOSAR FrIf module.
      integer FrIfMaxPduCnt [0..0]: 0..18446744073709551615, multiplicity set at link in variant link-time+post-build / pre-compile in variant pre-compile, set at link in variant link-time+post-build / pre-compile in variant pre-compile  # Maximum number of Pdus. This parameter is needed only in case of post-build loadable implementation using static memory allocation.
      container FrIfCluster [1..*]: multiplicity set at pre-compile  # This container specifies a FrIf Cluster and all related data which is required to enable communication of the Cluster. A Cluster may consist of more than one Controller.
        integer FrIfClstIdx: 0..63, set at pre-compile, symbolic-name-value=true, with-auto=true  # This parameter provides a zero-based consecutive index of the FlexRay Clusters. Upper layer BSW modules and the FrIf itself use this index to identify a FlexRay Cluster.
        boolean FrIfDetectNITError [0..1]: post-build-variant-value=true, set at link in variant link-time / post-build in variant post-build / pre-compile in variant pre-compile  # Indicates whether NIT error status of each cluster shall be detected or not. Since this parameter is not used, the lower multiplicity value of this parameter is changed to 0. This is to remove the BCT validation warnings.
        enumeration FrIfGChannels: {FR_CHANNEL_A, FR_CHANNEL_AB, FR_CHANNEL_B}, post-build-variant-value=true, set at link in variant link-time / post-build in variant post-build / pre-compile in variant pre-compile  # The channels that are used by the cluster. Implementation Type: Fr_ChannelType | Implementation Type: Fr_ChannelType
        integer FrIfGColdStartAttempts: 2..31, post-build-variant-value=true, set at link in variant link-time / post-build in variant post-build / pre-compile in variant pre-compile  # Maximum number of times a node in the cluster is permitted to attempt to start the cluster by initiating schedule synchronization
        integer FrIfGCycleCountMax [0..1]: 7..63, post-build-variant-value=true, set at link in variant link-time / post-build in variant post-build / pre-compile in variant pre-compile  # Maximum cycle counter value in a given cluster. Remark: Set to 63 for FlexRay Protocol 2.1 Rev. A compliance. Since this parameter is not used, the lower multiplicity value of this parameter is changed to 0. This is to remove the BCT validation warnings | Remark: Set to 63 for FlexRay Protocol 2.1 Rev. A compliance.
        integer FrIfGListenNoise: 2..16, post-build-variant-value=true, set at link in variant link-time / post-build in variant post-build / pre-compile in variant pre-compile  # Upper limit for the start up listen timeout and wake up listen timeout in the presence of noise. It is used as a multiplier of the node parameter pdListenTimeout. | parameter pdListenTimeout.
        integer FrIfGMacroPerCycle: 8..16000, post-build-variant-value=true, set at link in variant link-time / post-build in variant post-build / pre-compile in variant pre-compile  # Number of macroticks in a communication cycle. Note: Lower limit 10 for FlexRay Protocol 2.1 Rev. A compliance | Note: Lower limit 10 for FlexRay Protocol 2.1 Rev. A compliance
        integer FrIfGMaxWithoutClockCorrectFatal: 1..15, post-build-variant-value=true, set at link in variant link-time / post-build in variant post-build / pre-compile in variant pre-compile  # Threshold used for testing the vClockCorrectionFailed counter. Defines the number of consecutive even/odd Cycle pairs with missing clock correction terms that will cause the protocol to transition from the POC:normal active or POC:normal passive state into the POC:halt state. [Even/odd cycle pairs].
        integer FrIfGMaxWithoutClockCorrectPassive: 1..15, post-build-variant-value=true, set at link in variant link-time / post-build in variant post-build / pre-compile in variant pre-compile  # Threshold used for testing the vClockCorrectionFailed counter. Defines the number of consecutive even/odd Cycle pairs with missing clock correction terms that will cause the protocol to transition from the POC:normal active state to the POC:normal passive state. [Even/Odd cycle pairs]
        integer FrIfGNetworkManagementVectorLength: 0..12, post-build-variant-value=true, set at link in variant link-time / post-build in variant post-build / pre-compile in variant pre-compile  # Length of the Network Management vector in a cluster [bytes]
        integer FrIfGNumberOfMinislots: 0..7988, post-build-variant-value=true, set at link in variant link-time / post-build in variant post-build / pre-compile in variant pre-compile  # Number of minislots in the dynamic segment. Remark: Upper limit 7986 for FlexRay Protocol 2.1 Rev. A compliance | Remark: Upper limit 7986 for FlexRay Protocol 2.1 Rev. A compliance
        integer FrIfGNumberOfStaticSlots: 2..1023, post-build-variant-value=true, set at link in variant link-time / post-build in variant post-build / pre-compile in variant pre-compile  # Number of static slots in the static segment
        integer FrIfGPayloadLengthStatic: 0..127, post-build-variant-value=true, set at link in variant link-time / post-build in variant post-build / pre-compile in variant pre-compile  # Payload length of a static frame [16 bit words]
        integer FrIfGSyncFrameIDCountMax: 2..15, post-build-variant-value=true, set at link in variant link-time / post-build in variant post-build / pre-compile in variant pre-compile  # Maximum number of distinct syncframe identifiers present in a given cluster. This parameter maps to FlexRay Protocol 2.1 Rev. A parameter gSyncNodeMax.
        integer FrIfGdActionPointOffset: 1..63, scope=ECU, post-build-variant-value=true, set at link in variant link-time / post-build in variant post-build / pre-compile in variant pre-compile  # Number of macroticks the action point is offset from the beginning of a static slot.
        float FrIfGdBit: origin=BOSCH, post-build-variant-value=true, set at link in variant link-time / post-build in variant post-build / pre-compile in variant pre-compile  # Nominal bit time in seconds. Autosar 422 defines the parameter as an enumeration parameter but float type is used here.
        integer FrIfGdCasRxLowMax: 28..254, post-build-variant-value=true, set at link in variant link-time / post-build in variant post-build / pre-compile in variant pre-compile  # Upper limit of the CAS acceptance windows [gdBit]. Remark: Range 67 to 99 for FlexRay Protocol 2.1 Rev. A compliance | Remark: Range 67 to 99 for FlexRay Protocol 2.1 Rev. A compliance
        float FrIfGdCycle: 2.4E-5..0.016, post-build-variant-value=true, set at link in variant link-time / post-build in variant post-build / pre-compile in variant pre-compile  # Length of the cycle, expressed in [s]. Remark: Lower limit 0.000024 for FlexRay Protocol 3.0 compliance. | Remark: Lower limit 0.000024 for FlexRay Protocol 3.0 compliance.
        integer FrIfGdDynamicSlotIdlePhase: 0..2, post-build-variant-value=true, set at link in variant link-time / post-build in variant post-build / pre-compile in variant pre-compile  # Duration of the idle phase within a dynamic slot [Minislots].
        integer FrIfGdIgnoreAfterTx [0..1]: 0..15, post-build-variant-value=true, set at link in variant link-time / post-build in variant post-build / pre-compile in variant pre-compile  # Duration for which the bitstrobing is paused after transmission [gdBit]. Remark: Set to 0 for FlexRay Protocol 2.1 Rev. A compliance. Since this parameter is not used, the lower multiplicity value of this parameter is changed to 0. This is to remove the BCT validation warnings | Remark: Set to 0 for FlexRay Protocol 2.1 Rev. A compliance.
        float FrIfGdMacrotick: 1E-6..6E-6, post-build-variant-value=true, set at link in variant link-time / post-build in variant post-build / pre-compile in variant pre-compile  # Duration of the cluster wide nominal macrotick, expressed in s
        integer FrIfGdMiniSlotActionPointOffset: 1..31, post-build-variant-value=true, set at link in variant link-time / post-build in variant post-build / pre-compile in variant pre-compile  # Number of Macroticks the Minislot action point is offset from the beginning of a Minislot [Macroticks].
        integer FrIfGdMinislot: 2..63, scope=ECU, post-build-variant-value=true, set at link in variant link-time / post-build in variant post-build / pre-compile in variant pre-compile  # Duration of a minislot [Macroticks]
        integer FrIfGdNit: 2..15978, post-build-variant-value=true, set at link in variant link-time / post-build in variant post-build / pre-compile in variant pre-compile  # Duration of the Network Idle Time [Macroticks]. Remark: Upper limit 805 for FlexRay Protocol 2.1 Rev. A compliance. | Remark: Upper limit 805 for FlexRay Protocol 2.1 Rev. A compliance.
        enumeration FrIfGdSampleClockPeriod: {T12_5NS, T25NS, T50NS}, post-build-variant-value=true, set at link in variant link-time / post-build in variant post-build / pre-compile in variant pre-compile  # Sample clock period
        integer FrIfGdStaticSlot: 3..664, post-build-variant-value=true, set at link in variant link-time / post-build in variant post-build / pre-compile in variant pre-compile  # Duration of a static slot [Macroticks]. Remark: Range 4-661 for FlexRay Protocol 2.1 Rev. A compliance. | Remark: Range 4-661 for FlexRay Protocol 2.1 Rev. A compliance.
        integer FrIfGdSymbolWindow: 0..162, post-build-variant-value=true, set at link in variant link-time / post-build in variant post-build / pre-compile in variant pre-compile  # Duration of the symbol window [Macroticks]. Range 0-142 for FlexRay Protocol 2.1 Rev. A compliance. | Remark: Range 0-142 for FlexRay Protocol 2.1 Rev. A compliance.
        integer FrIfGdSymbolWindowActionPointOffset [0..1]: 1..63, post-build-variant-value=true, set at link in variant link-time / post-build in variant post-build / pre-compile in variant pre-compile  # Number of macroticks the action point offset is from the beginning of the symbol window [Macroticks]. Remark: Set to GdActionPointOffset for FlexRay Protocol 2.1 Rev. A compliance. Since this parameter is not used, the lower multiplicity value of this parameter is changed to 0. This is to remove the BCT validation warnings. | Remark: Set to GdActionPointOffset for FlexRay Protocol 2.1 Rev. A compliance.
        integer FrIfGdTSSTransmitter: 1..15, post-build-variant-value=true, set at link in variant link-time / post-build in variant post-build / pre-compile in variant pre-compile  # Number of bits in the Transmission Start Sequence [gdBits]. Remark: Lower limit 3 for FlexRay Protocol 2.1 Rev. A compliance. | Remark: Lower limit 3 for FlexRay Protocol 2.1 Rev. A compliance.
        integer FrIfGdWakeupRxIdle: 8..59, post-build-variant-value=true, set at link in variant link-time / post-build in variant post-build / pre-compile in variant pre-compile  # Number of bits used by the node to test the duration of the 'idle' or HIGH phase of a received wakeup [gdBit]. Remarks: This parameter maps to FlexRay Protocol 2.1 Rev. A parameter gdWakeupSymbolRxIdle. Lower limit 14 for FlexRay Protocol 2.1 Rev. A compliance.
        integer FrIfGdWakeupRxLow: 8..59, post-build-variant-value=true, set at link in variant link-time / post-build in variant post-build / pre-compile in variant pre-compile  # Number of bits used by the node to test the duration of the LOW phase of a received wakeup [gdBit]. Remarks: This parameter maps to FlexRay Protocol 2.1 Rev. A parameter gdWakeupSymbolRxLow. Lower limit 11 for FlexRay Protocol 2.1 Rev. A compliance. | Remarks: This parameter maps to FlexRay Protocol 2.1 Rev. A parameter gdWakeupSymbolRxLow. Lower limit 11 for FlexRay Protocol 2.1 Rev. A compliance.
        integer FrIfGdWakeupRxWindow: 76..485, post-build-variant-value=true, set at link in variant link-time / post-build in variant post-build / pre-compile in variant pre-compile  # The size of the window used to detect wakeups [gdBit]. Remarks: This parameter maps to FlexRay Protocol 2.1 Rev. A parameter gdWakeupSymbolRxWindow. Upper limit 301 for FlexRay Protocol 2.1 Rev. A compliance. | Remarks: This parameter maps to FlexRay Protocol 2.1 Rev. A parameter gdWakeupSymbolRxWindow. Upper limit 301 for FlexRay Protocol 2.1 Rev. A compliance.
        integer FrIfGdWakeupTxActive: 15..60, post-build-variant-value=true, set at link in variant link-time / post-build in variant post-build / pre-compile in variant pre-compile  # Number of bits used by the node to transmit the LOW phase of awakeup symbol and the HIGH and LOW phases of a WUDOP [gdBit]. Remarks: This parameter maps to FlexRay Protocol 2.1 Rev. A parameter gdWakeupSymbolTxLow. | Remarks: This parameter maps to FlexRay Protocol 2.1 Rev. A parameter gdWakeupSymbolTxLow.
        integer FrIfGdWakeupTxIdle: 45..180, post-build-variant-value=true, set at link in variant link-time / post-build in variant post-build / pre-compile in variant pre-compile  # Number of bits used by the node to transmit the 'idle' part of a wakeup symbol [gdBit]. Remarks: This parameter maps to FlexRay Protocol 2.1 Rev. A parameter gdWakeupSymbolTxIdle. | wakeup symbol [gdBit]. Remarks: This parameter maps to FlexRay Protocol 2.1 Rev. A parameter gdWakeupSymbolTxIdle.
        float FrIfMainFunctionPeriod: 0..Inf, set at link in variant link-time+post-build / pre-compile in variant pre-compile  # The execution cycle of the FrIf_MainFunction_<cluster>() in seconds. The FrIf does not require this information but the BSW scheduler, which invokes the cluster main functions, needs it in order to plan its tasks.
        float FrIfJobListExecFunctionPeriod [0..1]: 0..Inf, origin=BOSCH, set at link in variant link-time+post-build / pre-compile in variant pre-compile  # The execution cycle of the FrIf_JobListExec_<cluster>() in seconds. This parameter should be configured by the user to forward the value of the calling period of schedulable entity 'BSWSE_JobListExec_0'. The FrIf does not require this information but the BSW scheduler, which invokes the cluster main functions, needs it in order to plan its tasks.
        enumeration FrIfJobListExecEntityCategory: origin=RB:1.0.0:2013-05-22, set at pre-compile  # Category | Categorizes this executable entity. Schedulable entities are designed to be scheduled by the RTE. Called entities are designed to be called from another BSW module or cluster. Since the BswEntity and the BswEvent are generated in one go, the schedulable entities can have one of the following five types: schedulable entity either triggered by BswTimingEvent or BswBackgroundEvent, schedulable entity triggered by BswInternalTriggerOccurredEvent, schedulable entity triggered by BswExternalTriggerOccurredEvent, schedulable entity triggered by BswModeSwitchEvent or schedulable entity triggered by BswModeSwitchedAckEvent.
          Schedulable  # Schedulable entity
          Called  # Called entity
          Interrupt  # Interrupt entity
          SchedulableWithInternalTrigger  # Schedulable entity with internal triggering event
          SchedulableWithExternalTrigger  # Schedulable entity with external triggering event
          SchedulableWithModeSwitch  # Schedulable entity with mode switch event
          SchedulableWithModeSwitchedAck  # Schedulable entity with mode switched ack event
        integer FrIfMaxIsrDelay: 0..10240000, origin=BOSCH, set at link in variant link-time / post-build in variant post-build / pre-compile in variant pre-compile  # The maximum delay in macroticks the FrIf_JoblistExec_<cluster>() function is processed after the absolute timer interrupt was triggered.
        integer FrIfSafetyMargin [0..0]: 0..1024000, post-build-variant-value=true, set at link in variant link-time / post-build in variant post-build / pre-compile in variant pre-compile  # Additional timespan in macroticks which takes jitter into account to be able to set the JobListPointer to the next possible job which can be executed in case the FlexRay Job List Execution Function has be resynchronized. Since this parameter is not used, the lower multiplicity value of this parameter is changed to 0. This is to remove the BCT validation warnings.
        integer GClusterDriftDamping: 0..5, origin=BOSCH, set at link in variant link-time / post-build in variant post-build / pre-compile in variant pre-compile  # The cluster drift damping factor, based on the longest microtick gdMaxMicrotick used in the cluster. Used to compute the local cluster drift damping factor pClusterDriftDamping [Micrroticks].
        integer GOffsetCorrectionStart: 7..15999, origin=BOSCH, set at post-build in variant post-build / pre-compile in variant pre-compile  # Start of the offset correction phase within the NIT, expressed as the number of macroticks from the start of cycle [Macroticks].
        container FrIfClusterDemEventParameterRefs [0..1]  # Container for the references to DemEventParameter elements which shall be invoked using the API Dem_ReportErrorStatus API in case the corresponding error occurs. The EventId is taken from the referenced DemEventParameter's DemEventId value. The standardized errors are provided in the container and can be extended by vendor specific error references.
          enumeration FrIfRbDynCreate_FRIF_E_ACS_CH_A [0..1]: {Disabled, Standard}, origin=BOSCH, set at pre-compile, default-value=Disabled  # Selects the way how the FrIf DemEvents are created. If not set or set to "Disabled", no such DemEvent is automatically created. If the dynamic creation of this DemEvent is enabled, the reference to this DemEvent (in parameter FRIF_E_ACS_CH_A) is also automatically created and shall therefore not be set manually.
          enumeration FrIfRbDynCreate_FRIF_E_ACS_CH_B [0..1]: {Disabled, Standard}, origin=BOSCH, set at pre-compile, default-value=Disabled  # Selects the way how the FrIf DemEvents are created. If not set or set to "Disabled", no such DemEvent is automatically created. If the dynamic creation of this DemEvent is enabled, the reference to this DemEvent (in parameter FRIF_E_ACS_CH_B) is also automatically created and shall therefore not be set manually.
          enumeration FrIfRbDynCreate_FRIF_E_NIT_CH_A [0..1]: {Disabled, Standard}, origin=BOSCH, set at pre-compile, default-value=Disabled  # Selects the way how the FrIf DemEvents are created. If not set or set to "Disabled", no such DemEvent is automatically created. If the dynamic creation of this DemEvent is enabled, the reference to this DemEvent (in parameter FRIF_E_NIT_CH_A) is also automatically created and shall therefore not be set manually.
          enumeration FrIfRbDynCreate_FRIF_E_NIT_CH_B [0..1]: {Disabled, Standard}, origin=BOSCH, set at pre-compile, default-value=Disabled  # Selects the way how the FrIf DemEvents are created. If not set or set to "Disabled", no such DemEvent is automatically created. If the dynamic creation of this DemEvent is enabled, the reference to this DemEvent (in parameter FRIF_E_NIT_CH_B) is also automatically created and shall therefore not be set manually.
          enumeration FrIfRbDynCreate_FRIF_E_SW_CH_A [0..1]: {Disabled, Standard}, origin=BOSCH, set at pre-compile, default-value=Disabled  # Selects the way how the FrIf DemEvents are created. If not set or set to "Disabled", no such DemEvent is automatically created. If the dynamic creation of this DemEvent is enabled, the reference to this DemEvent (in parameter FRIF_E_SW_CH_A) is also automatically created and shall therefore not be set manually.
          enumeration FrIfRbDynCreate_FRIF_E_SW_CH_B [0..1]: {Disabled, Standard}, origin=BOSCH, set at pre-compile, default-value=Disabled  # Selects the way how the FrIf DemEvents are created. If not set or set to "Disabled", no such DemEvent is automatically created. If the dynamic creation of this DemEvent is enabled, the reference to this DemEvent (in parameter FRIF_E_SW_CH_B) is also automatically created and shall therefore not be set manually.
          symbolic name reference FRIF_E_ACS_CH_A [0..1]: multiplicity set at link in variant link-time / post-build in variant post-build / pre-compile in variant pre-compile, post-build-variant-multiplicity=true, post-build-variant-value=true, set at link in variant link-time / post-build in variant post-build / pre-compile in variant pre-compile, destination=DemEventParameter  # Reference to the DemEventParameter which shall be issued when an error in ACS on channel A was detected. If the reference is not configured the error shall not be reported (neither to DET nor to DEM).
          symbolic name reference FRIF_E_ACS_CH_B [0..1]: multiplicity set at link in variant link-time / post-build in variant post-build / pre-compile in variant pre-compile, post-build-variant-multiplicity=true, post-build-variant-value=true, set at link in variant link-time / post-build in variant post-build / pre-compile in variant pre-compile, destination=DemEventParameter  # Reference to the DemEventParameter which shall be issued when an error in ACS on channel B was detected. If the reference is not configured the error shall not be reported (neither to DET nor to DEM).
          symbolic name reference FRIF_E_NIT_CH_A [0..1]: multiplicity set at link in variant link-time / post-build in variant post-build / pre-compile in variant pre-compile, post-build-variant-multiplicity=true, post-build-variant-value=true, set at link in variant link-time / post-build in variant post-build / pre-compile in variant pre-compile, destination=DemEventParameter  # Reference to the DemEventParameter which shall be issued when an error in NIT on channel A was detected. If the reference is not configured the error shall not be reported (neither to DET nor to DEM).
          symbolic name reference FRIF_E_NIT_CH_B [0..1]: multiplicity set at link in variant link-time / post-build in variant post-build / pre-compile in variant pre-compile, post-build-variant-multiplicity=true, post-build-variant-value=true, set at link in variant link-time / post-build in variant post-build / pre-compile in variant pre-compile, destination=DemEventParameter  # Reference to the DemEventParameter which shall be issued when an error in NIT on channel B was detected. If the reference is not configured the error shall not be reported (neither to DET nor to DEM).
          symbolic name reference FRIF_E_SW_CH_A [0..1]: multiplicity set at link in variant link-time / post-build in variant post-build / pre-compile in variant pre-compile, post-build-variant-multiplicity=true, post-build-variant-value=true, set at link in variant link-time / post-build in variant post-build / pre-compile in variant pre-compile, destination=DemEventParameter  # Reference to the DemEventParameter which shall be issued when an error in SW on channel A was detected. If the reference is not configured the error shall not be reported (neither to DET nor to DEM).
          symbolic name reference FRIF_E_SW_CH_B [0..1]: multiplicity set at link in variant link-time / post-build in variant post-build / pre-compile in variant pre-compile, post-build-variant-multiplicity=true, post-build-variant-value=true, set at link in variant link-time / post-build in variant post-build / pre-compile in variant pre-compile, destination=DemEventParameter  # Reference to the DemEventParameter which shall be issued when an error in SW on channel B was detected. If the reference is not configured the error shall not be reported (neither to DET nor to DEM).
        container FrIfController [1..*]: multiplicity set at pre-compile  # This container contains the configuration of FlexRay CC.
          integer FrIfCtrlIdx: 0..31, scope=ECU, set at pre-compile, symbolic-name-value=true, with-auto=true  # This parameter provides a zero-based consecutive index of the FlexRay Communication Controllers. Upper layer BSW modules and the FrIf itself use this index to identify a FlexRay CC.
          symbolic name reference FrIfFrCtrlRef: scope=ECU, post-build-variant-value=true, set at link in variant link-time / post-build in variant post-build / pre-compile in variant pre-compile, destination=FrController  # Reference to a Controller, which is handled by a specific Driver. This reference is unique for the ECU.
          container FrIfAbsTimer [1..*]  # This container contains the configuration of an absolute timer of a FlexRay CC.
            integer FrIfAbsTimerIdx: 0.., origin=BOSCH, set at link in variant link-time / post-build in variant post-build / pre-compile in variant pre-compile, symbolic-name-value=true, with-auto=true  # This parameter provides a zero-based consecutive index of the absolute timers. Upper layer BSW modules use this index to identify an absolute timer.
            reference FrIfFrAbsTimerRef [0..1]: origin=ORIGIN, set at link in variant link-time / post-build in variant post-build / pre-compile in variant pre-compile, destination=FrAbsoluteTimer  # Reference to an absolute timer, which is handled by a specific FlexRay Driver. This reference is unique for the ECU, therefore, an explicit reference to the FlexRay Driver is not necessary. Since this parameter is not used, the lower multiplicity value of this parameter is changed to 0. This is to remove the BCT validation warnings.
          container FrIfFrameTriggering [1..*]: multiplicity set at link in variant link-time / post-build in variant post-build / pre-compile in variant pre-compile, post-build-variant-multiplicity=true  # A Frame triggering contains the communication parameters of the FlexRay Frame as well as a reference to the Frame Construction Plan.
            boolean FrIfAllowDynamicLSduLength: post-build-variant-value=true, set at link in variant link-time / post-build in variant post-build / pre-compile in variant pre-compile  # Allows L-PDU length reduction ('FrIfLSduLength' defines max. length) and indicates that the related CC buffer has to be reconfigured for the actual length and Header-CRC before transmission of the L-PDU.
            boolean FrIfAlwaysTransmit: post-build-variant-value=true, set at link in variant link-time / post-build in variant post-build / pre-compile in variant pre-compile  # Defines whether the driver's API function Fr_TransmitTxLPdu() shall always be called for this L-PDU.
            integer FrIfBaseCycle: 0..63, post-build-variant-value=true, set at link in variant link-time / post-build in variant post-build / pre-compile in variant pre-compile  # This parameter contains the FlexRay Base Cycle used to transmit this FlexRay Frame.
            enumeration FrIfChannel: {FRIF_CHANNEL_A, FRIF_CHANNEL_AB, FRIF_CHANNEL_B}, post-build-variant-value=true, set at link in variant link-time / post-build in variant post-build / pre-compile in variant pre-compile  # This parameter contains the FlexRay Channel used to transmit this FlexRay Frame.
            integer FrIfCycleRepetition: 1..64, post-build-variant-value=true, set at link in variant link-time / post-build in variant post-build / pre-compile in variant pre-compile  # This parameter contains the FlexRay Cycle Repetition used to transmit this FlexRay Frame. possible Values: 1,2,4,8,16,32,64. | possible Values: 1,2,4,8,16,32,64
            integer FrIfLSduLength: 0..254, post-build-variant-value=true, set at link in variant link-time / post-build in variant post-build / pre-compile in variant pre-compile  # The payload length of the Frame is given here. This parameter is required for validation if configured PDUs and update information fits into the Frame at configuration time [bytes].
            integer FrIfMessageId [0..1]: 0..65535, multiplicity set at link in variant link-time / post-build in variant post-build / pre-compile in variant pre-compile, post-build-variant-multiplicity=true, post-build-variant-value=true, set at link in variant link-time / post-build in variant post-build / pre-compile in variant pre-compile  # The first two bytes of the payload segment of the FlexRay frame format for frames transmitted in the | dynamic segment can be used as receiver filterable data called the message ID.
            boolean FrIfNoneMode: origin=BOSCH, post-build-variant-value=true, set at link in variant link-time / post-build in variant post-build / pre-compile in variant pre-compile  # Using the "None-Mode" which means that there is no API FrIf_Transmit call of the upper layer for this PDU.
            boolean FrIfPayloadPreamble: post-build-variant-value=true, set at link in variant link-time / post-build in variant post-build / pre-compile in variant pre-compile  # Switching the Payload Preamble bit.
            boolean FrIfReconfigurable [0..1]: multiplicity set at link in variant link-time / post-build in variant post-build / pre-compile in variant pre-compile, origin=BOSCH, post-build-variant-multiplicity=true, post-build-variant-value=true, set at link in variant link-time / post-build in variant post-build / pre-compile in variant pre-compile, default-value=false  # Enable/Disable reconfiguration and disabling of this LPdu during runtime via FrIf_ReconfigLPdu() and FrIf_DisableLPdu() APIs repectively.
            integer FrIfSlotId: 1..2047, post-build-variant-value=true, set at link in variant link-time / post-build in variant post-build / pre-compile in variant pre-compile  # This parameter contains the FlexRay Slot ID used to transmit this FlexRay Frame.
            reference FrIfFrameStructureRef: post-build-variant-value=true, set at link in variant link-time / post-build in variant post-build / pre-compile in variant pre-compile, destination=FrIfFrameStructure  # Reference to the Construction Plan of the FlexRay Frame.
            container FrIfFrameTriggeringDemEventParameterRefs [0..1]  # Container for the references to DemEventParameter elements which shall be invoked using the API Dem_ReportErrorStatus API in case the corresponding error occurs. The EventId is taken from the referenced DemEventParameter's DemEventId value. The standardized errors are provided in the container and can be extended by vendor specific error references.
              symbolic name reference FRIF_E_LPDU_SLOTSTATUS [0..1]: multiplicity set at link in variant link-time / post-build in variant post-build / pre-compile in variant pre-compile, post-build-variant-multiplicity=true, post-build-variant-value=true, set at link in variant link-time / post-build in variant post-build / pre-compile in variant pre-compile, destination=DemEventParameter  # Reference to DEM event Id that is reported when FlexRay driver module detects slot errors. If this parameter is not configured, no event reporting happens.
          container FrIfLPdu [1..*]: multiplicity set at link in variant link-time / post-build in variant post-build / pre-compile in variant pre-compile, post-build-variant-multiplicity=true  # Reference to a L-PDU index
            integer FrIfLPduIdx: 0..4095, set at pre-compile, symbolic-name-value=true  # This parameter identifies the L-PDU in the interaction between FlexRay Interface and FlexRay Driver.
            boolean FrIfReconfigurable [0..1]: post-build-variant-value=true, set at link in variant link-time / post-build in variant post-build / pre-compile in variant pre-compile  # This parameter specifies that this LPdu is reconfigurable using FrIf_ReconfigLPdu. This means that this LPdu can be assigned to a different FrameTriggering at runtime. However, this reconfiguration is limited by hardware constraints. The direction of the LPdu cannot be reconfigured. Since this parameter is not used, the lower multiplicity value of this parameter is changed to 0. This is to remove the BCT validation warnings. This parameter is not related to FrIf_ReconfigLPdu() and/or FrIf_DisableLPdu() APIs. To enable this LPdu to be used with FrIf_ReconfigLPdu() and/or FrIf_DisableLPdu() APIs, refer FrIfReconfigurable parameter under FrIfFrameTriggering container.
            reference FrIfVBTriggeringRef: post-build-variant-value=true, set at link in variant link-time / post-build in variant post-build / pre-compile in variant pre-compile, destination=FrIfFrameTriggering  # Reference to the assigned Frame triggering.
          container FrIfTransceiver [0..2]  # Up to two FlexRay Transceivers may connect a Controller to a Cluster. This container realizes a Controller-Transceiver assignment.
            enumeration FrIfClusterChannel: {FRIF_CHANNEL_A, FRIF_CHANNEL_B}, post-build-variant-value=true, set at link in variant link-time / post-build in variant post-build / pre-compile in variant pre-compile  # This parameter identifies to which one of the two Channels (A, B, A and B) of the Cluster the Transceiver is connected. FrIfClusterChannel shall map to Fr_ChannelType: FRIF_CHANNEL_A == FR_CHANNEL_A FRIF_CHANNEL_B == FR_CHANNEL_B FR_CHANNEL_AB shall not be used.
            symbolic name reference FrIfFrTrcvChannelRef: scope=ECU, post-build-variant-value=true, set at link in variant link-time / post-build in variant post-build / pre-compile in variant pre-compile, destination=FrTrcvChannel  # Reference to a Transceiver Driver Channel. This reference is unique for the ECU.
        container FrIfJobList  # This container specifies a list of all FlexRay Jobs of the Cluster to be performed by FrIf_JobListExec_<ClstIdx>().
          symbolic name reference FrIfAbsTimerRef [0..1]: post-build-variant-value=true, set at link in variant link-time / post-build in variant post-build / pre-compile in variant pre-compile, destination=FrAbsoluteTimer  # Reference to the absolute timer to be used to trigger the interrupt whose ISR contains the FrIf_JobListExec_<ClstIdx>() function. Since this parameter is not used, the lower multiplicity value of this parameter is changed to 0. This is to remove the BCT validation warnings.
          container FrIfJob [1..*]: multiplicity set at link in variant link-time / post-build in variant post-build / pre-compile in variant pre-compile, post-build-variant-multiplicity=true  # A job may contain more than one operation that are executed at a specific point in time.
            integer FrIfCycle: 0..63, post-build-variant-value=true, set at link in variant link-time / post-build in variant post-build / pre-compile in variant pre-compile  # The FlexRay Cycle in which the communication operation will execute this job
            function name FrIfJobListCallbackName [0..1]: origin=BOSCH, set at link in variant link-time / post-build in variant post-build / pre-compile in variant pre-compile  # This parameter defines the name of the user callback function name, which needs to be called after the execution of RxIndication and TxConfirmation but before deCouple Transmission.
            integer FrIfMacrotick: 0..10240000, post-build-variant-value=true, set at link in variant link-time / post-build in variant post-build / pre-compile in variant pre-compile  # Macrotick offset in the Cycle [Macrotick]
            integer FrIfMaxIsrDelay [0..0]: 0..10240000, post-build-variant-value=true, set at link in variant link-time / post-build in variant post-build / pre-compile in variant pre-compile  # The maximum delay in macroticks the FrIf_JoblistExec_<cluster>() function is processed after the absolute timer interrupt was triggered. Since this parameter is not supported, the lower multiplicity value of this parameter is changed to 0. This is to remove the BCT validation warnings.
            container FrIfCommunicationOperation [0..*]: multiplicity set at link in variant link-time / post-build in variant post-build / pre-compile in variant pre-compile, post-build-variant-multiplicity=true  # A separate operation which is part of a FlexRay Job and defines what type of action is executed. The parameter multiplicity has been changed to 0 to avoid BCT warning.
              enumeration FrIfCommunicationAction: {DECOUPLED_TRANSMISSION, FREE_OP_A, FREE_OP_B, PREPARE_LPDU, RECEIVE_AND_INDICATE, RECEIVE_AND_STORE, RX_INDICATION, TX_CONFIRMATION}, post-build-variant-value=true, set at link in variant link-time / post-build in variant post-build / pre-compile in variant pre-compile  # The action to be performed in the FlexRay Operation
              integer FrIfCommunicationOperationIdx: 0..255, post-build-variant-value=true, set at link in variant link-time / post-build in variant post-build / pre-compile in variant pre-compile  # For each FlexRay Communication Job, this index spans a range of zero-based consecutive values and thus defines the order of the FlexRay Communication Operation in the respective FlexRay Communication Job.
              integer FrIfRxComOpMaxLoop [0..0]: 1..512, multiplicity set at link in variant link-time / post-build in variant post-build / pre-compile in variant pre-compile, post-build-variant-multiplicity=true, post-build-variant-value=true, set at link in variant link-time / post-build in variant post-build / pre-compile in variant pre-compile  # Defines the maximum number of loops for the receive RECEIVE_AND_INDICATE (Use case: emptying a FIFO). Please note that the parameter is mandatory if FrIfCommunicationAction parameter is set to RECEIVE_AND_INDICATE. For all other operations this parameter can be ignored. Since this parameter is not used, the lower multiplicity value of this parameter is changed to 0. This is to remove the BCT validation warnings. | Please note that the parameter is mandatory if FrIfCommunicationAction parameter is set to RECEIVE_AND_INDICATE. For all other operations this parameter can be ignored.
              reference FrIfLPduIdxRef: post-build-variant-value=true, set at link in variant link-time / post-build in variant post-build / pre-compile in variant pre-compile, destination=FrIfLPdu  # Reference to a L-PDu index
          container FrifJobListWizard [0..1]  # Container to configure the number of job entries per FlexRay cycle.
            integer FrIfJobDelay: origin=BOSCH, post-build-variant-value=true, set at pre-compile, default-value=0  # Delay between the current job and the next job in the FlexRay joblist.
            enumeration FrIfJobListCFGType: {ESP, STANDARD}, origin=BOSCH, post-build-variant-value=true, set at pre-compile, default-value=ESP  # Note : The joblist algorithm type AR31 name has been replaced by STANDARD
            container FrIfJobEntry [1..*]: multiplicity set at link in variant link-time / post-build in variant post-build / pre-compile in variant pre-compile, post-build-variant-multiplicity=true  # Entry for the job interrupt in the FlexRay cycle.
              integer FrIfBaseCycle: 0..63, origin=BOSCH, post-build-variant-value=true, set at pre-compile, default-value=0  # This parameter contains the FlexRay Base Cycle used to transmit this FlexRay Frame.
              integer FrIfCycleRepetition: 1..64, origin=BOSCH, post-build-variant-value=true, set at pre-compile, default-value=1  # This parameter contains the FlexRay Cycle Repetition used to transmit this FlexRay Frame.possible Values: 1,2,4,8,16,32,64.
              integer FrIfExecutionOffset [0..1]: 0..16000, origin=BOSCH, post-build-variant-value=true, set at pre-compile, default-value=0  # This value is the offset provided for the excution of the job entry. It will be used only for job entries in the dynamic segment. Value is configured in macroticks
              function name FrIfJobListCallback [0..*]: origin=BOSCH, post-build-variant-value=true, set at link in variant link-time / post-build in variant post-build / pre-compile in variant pre-compile  # This parameter defines the name of the user callback function name, which will be called after Receive and Indicate, Tx confirmation and before Decoupled Tx. Supports Multiple callbacks FrIfJobListCallback is not supported for the implementation configuration variant Post Build Loadable.
              integer FrIfMacroTick: 0..16000, origin=BOSCH, post-build-variant-value=true, set at pre-compile, default-value=0  # Macrotick offset in the Cycle [Macrotick].
              symbolic name reference FrIfFrames [0..*]: origin=BOSCH, post-build-variant-value=true, set at link in variant link-time / post-build in variant post-build / pre-compile in variant pre-compile, destination=FrIfFrameTriggering  # This is the expert joblist configuration. This field should be configured by someone who has knowledge in FlexRay. No validation is provided for the additional frames configured here.
      container FrIfFrameStructure [1..*]: multiplicity set at link in variant link-time / post-build in variant post-build / pre-compile in variant pre-compile, post-build-variant-multiplicity=true  # The Frame structure specifies a Construction Plan how a Frame is assembled with PDUs and their respective Update-Bits.
        enumeration FrIfByteOrder [0..1]: {BIG_ENDIAN, LITTLE_ENDIAN}, post-build-variant-value=true, set at link in variant link-time / post-build in variant post-build / pre-compile in variant pre-compile  # This parameter defines the ByteOrder of all Pdus that are mapped into the Frame. The absolute position of a Pdu in the Frame is determined by the definition of the ByteOrder parameter: If BIG_ENDIAN is specified, the FrIfPduOffset indicates the position of the most significant bit in the Frame. If LITTLE_ENDIAN is specified, the FrIfPduOffset indicates the position of the least significant bit in the Frame. Since this parameter is not used, the lower multiplicity value of this parameter is changed to 0. This is to remove the BCT validation warnings. | The absolute position of a Pdu in the Frame is determined by the definition of the ByteOrder parameter: If BIG_ENDIAN is specified, the FrIfPduOffset indicates the position of the most significant bit in the Frame. If LITTLE_ENDIAN is specified, the FrIfPduOffset indicates the position of the least significant bit in the Frame.
        container FrIfPdusInFrame [1..*]: multiplicity set at link in variant link-time / post-build in variant post-build / pre-compile in variant pre-compile, post-build-variant-multiplicity=true  # This container holds all the information about a PDU in a FlexRay Frame.
          integer FrIfPduOffset: 0..253, post-build-variant-value=true, set at link in variant link-time / post-build in variant post-build / pre-compile in variant pre-compile  # The value specifies the offset of the PDU within the Frame [bytes].
          integer FrIfPduUpdateBitOffset [0..1]: -1..2031, multiplicity set at link in variant link-time / post-build in variant post-build / pre-compile in variant pre-compile, post-build-variant-multiplicity=true, post-build-variant-value=true, set at link in variant link-time / post-build in variant post-build / pre-compile in variant pre-compile, default-value=-1  # This value specifies where the PDU's Update-Bit is stored in the Frame (bit location of PDU's Update-Bit in the FlexRay Frame).
          reference FrIfPduRef: post-build-variant-value=true, set at link in variant link-time / post-build in variant post-build / pre-compile in variant pre-compile, destination=FrIfPdu  # This is the reference to the local definition of a PDU.
      container FrIfPdu [1..*]: multiplicity set at link in variant link-time / post-build in variant post-build / pre-compile in variant pre-compile, post-build-variant-multiplicity=true  # Contains PDU information. A PDU may be either a transmission PDU or a reception PDU.
        choice container FrIfPduDirection  # A PDU is either transmit or receive
          container FrIfRxPdu [0..1]  # Receive PDU
            function name FrIfRxIndicationName [0..1]: scope=ECU, multiplicity set at link in variant link-time / post-build in variant post-build / pre-compile in variant pre-compile, post-build-variant-multiplicity=true, post-build-variant-value=true, set at link in variant link-time / post-build in variant post-build / pre-compile in variant pre-compile  # This parameter defines the name of the <User_RxIndication>. This parameter depends on the parameter FRIF_USERRXINDICATION_UL. If FRIF_USERRXINDICATION_UL equals FR_TP, FR_NM, PDUR or XCP, the name of the <User_RxIndication> is fixed. If FRIF_USERRXINDICATION_UL equals CDD, the name of the <User_RxIndication> is selectable.
            enumeration FrIfUserRxIndicationUL [0..0]: {CDD, FR_AR_TP, FR_NM, FR_TP, PDUR, XCP, FR_TSYN}, scope=ECU, post-build-variant-value=true, set at link in variant link-time / post-build in variant post-build / pre-compile in variant pre-compile  # This parameter defines the upper layer (UL) module to which the indication of the successfully received FRIFRXPDU has to be routed via <User_RxIndication>. This <User_RxIndication> has to be invoked when the indication of the configured FRIFRXPDU will be received by a Rx indication event from the FR Driver module. If no upper layer (UL) module is configured, no <User_RxIndication> has to be called in case of a Rx indication event of the FRIFRXPDU from the FR Driver module. The current software does not support this parameter.
            integer FrIfUserTargetRxPduId [0..0]: 0.., origin=BOSCH, set at link in variant link-time / post-build in variant post-build / pre-compile in variant pre-compile  # Defines the target Id of the CDD for Rx Pdus. The current software does not support this parameter.
            reference FrIfRxPduRef: scope=ECU, post-build-variant-value=true, set at link in variant link-time / post-build in variant post-build / pre-compile in variant pre-compile, destination=Pdu  # Reference to the external PDU definition.
          container FrIfTxPdu [0..1]  # This container specifies transmission PDUs.
            boolean FrIfConfirm: post-build-variant-value=true, set at link in variant link-time / post-build in variant post-build / pre-compile in variant pre-compile  # Defines whether the transmission of a PDU should be checked and confirmed to the PDU owning BSW module.
            integer FrIfCounterLimit: 1..255, post-build-variant-value=true, set at link in variant link-time / post-build in variant post-build / pre-compile in variant pre-compile  # This value states the maximum number of indication of ready PDU data to the FrIf (i.e. maximum number of invocations of FrIf_Transmit) without an intermediate transmission of the PDU.
            boolean FrIfImmediate: scope=ECU, post-build-variant-value=true, set at link in variant link-time / post-build in variant post-build / pre-compile in variant pre-compile  # Defines whether the PDU is transmitted immediate or decoupled.
            boolean FrIfNoneMode [0..0]: multiplicity set at link in variant link-time / post-build in variant post-build / pre-compile in variant pre-compile, post-build-variant-multiplicity=true, post-build-variant-value=true, set at link in variant link-time / post-build in variant post-build / pre-compile in variant pre-compile, default-value=false  # Using the "None-Mode" which means that there is no API FrIf_Transmit call of the upper layer for this PDU.
            string FrIfSyncTxPduNotification [0..1]: origin=BOSCH, set at link in variant link-time / pre-compile in variant pre-compile  # Name of function to be called before I-PDU content is assembled into L-PDU during FrIf JobListExec. Intension: Allow realtime provision of I-PDU data content, reduce latency and avoid sporadic miss of transmission time slot due to jitter in operating system tasks not synchronized to FlexRay.
            function name FrIfTxConfirmationName [0..1]: scope=ECU, multiplicity set at link in variant link-time / post-build in variant post-build / pre-compile in variant pre-compile, post-build-variant-multiplicity=true, post-build-variant-value=true, set at link in variant link-time / post-build in variant post-build / pre-compile in variant pre-compile  # This parameter defines the name of the <User_TxConfirmation>. This parameter depends on the parameter FrIfUserTxUL. If FrIfUserTxUL equals FR_TP, FR_AR_TP, FR_NM, PDUR, FR_TSYN or XCP, the name of the <User_TxConfirmation> is fixed. If FrIfUserTxUL equals CDD, the name of the <User_TxConfirmation> is selectable.
            integer FrIfTxPduId: 0..65535, scope=ECU, set at pre-compile, symbolic-name-value=true, with-auto=true  # The global PDU identifier, which has to be used by the upper layer BSW module. The identifier has to be zero based and consecutive.
            integer FrIfUserTargetTxPduId [0..0]: 0.., origin=BOSCH, set at link in variant link-time / post-build in variant post-build / pre-compile in variant pre-compile  # Defines the target Id of the CDD for Tx Pdus. The current software does not support this parameter.
            function name FrIfUserTriggerTransmitName [0..1]: scope=ECU, multiplicity set at link in variant link-time / post-build in variant post-build / pre-compile in variant pre-compile, post-build-variant-multiplicity=true, post-build-variant-value=true, set at link in variant link-time / post-build in variant post-build / pre-compile in variant pre-compile  # This parameter defines the name of the <User_TriggerTransmit>. This parameter depends on the parameter FrIfUserTxUL. If FrIfUserTxUL equals FR_TP, FR_NM, PDUR, FR_TSYN or XCP the name of the <User_TriggerTransmit> is fixed. If FrIfUserTxUL equals CDD, the name of the <User_TriggerTransmit> is selectable.
            enumeration FrIfUserTxUL [0..0]: {CDD, FR_AR_TP, FR_NM, FR_TP, FR_TSYN, PDUR, XCP}, scope=ECU, post-build-variant-value=true, set at link in variant link-time / post-build in variant post-build / pre-compile in variant pre-compile  # This parameter defines the upper layer (UL) module to which the trigger of the Pdu to be transmitted (via the <User_TriggerTransmit>) or the confirmation of the successfully transmitted Pdu has to be routed (via the <User_TxConfirmation>). Please note that handle IDs which are used in callback functions are defined by the upper layer module. The current software does not support this parameter.
            reference FrIfTxPduRef: scope=ECU, post-build-variant-value=true, set at link in variant link-time / post-build in variant post-build / pre-compile in variant pre-compile, destination=Pdu  # Reference to the external PDU definition.
    container FrIfGeneral  # This container contains the general configuration parameters of the FlexRay Interface.
      integer FrIfAbsTimerIdx [0..0]: 1..15, set at pre-compile, with-auto=true  # Maximum number of supported absolute timers. Since this parameter is not supported, the lower multiplicity value of this parameter is changed to 0. This is to remove the BCT validation warnings.
      enumeration FrIfAdditionalFrameCallPosition [0..1]: {FROM_START, FROM_END}, origin=BOSCH, set at link in variant link-time / post-build in variant post-build / pre-compile in variant pre-compile  # This parameter will indicate from which position the frames selected for each job entry should be called. This parameter must be configured if there is any additional frames configured in FrIfJobEntry container. If the selected configuration variant is PostBuild Loadable, then it is mandatory to configure this parameter.
      boolean FrIfAllSlotsSupport: set at pre-compile  # Configuration parameter to enable/disable FrIf support to enable/disable of switching from key-slot / single-slot mode to all slot mode.
      boolean FrIfCancelTransmitSupport [0..0]: set at pre-compile  # Configuration parameter to enable/disable FrIf support to request the cancellation of the I-PDU transmission to FrDrv. The current software does not support this parameter. The multiplicity is made 0 to remove BCT warnings.
      boolean FrIfDevErrorDetect: set at pre-compile  # Switches the Default Error Tracer (Det) detection and notification ON or OFF. | * true: enabled (ON). * false: disabled (OFF).
      boolean FrIfDisableLPduSupport: set at pre-compile  # Configuration parameter to enable/disable FrIf support to disables the hardware resource of a LPdu for transmission/reception. Note: Currently only reconfigurable static frame can be disabled.
      boolean FrIfDisableTransceiverBranchSupport [0..0]: set at pre-compile  # Configuration parameter to enable/disable FrIf support to disable branches of an active star. The current software does not support this parameter. The multiplicity is made 0 to remove BCT warnings.
      boolean FrIfEnableCallbackSorting: origin=BOSCH, set at pre-compile, default-value=true  # This Parameter is to sort the Tx confirmations and Rx indications Callbacks based on the corresponding Slot IDs of Flexray frames. If this Parameter is set to False,then the Tx confirmations and Rx indications will be provided based on the configred list of FrIfFrameTriggerings.
      boolean FrIfEnableTransceiverBranchSupport [0..0]: set at pre-compile  # Configuration parameter to enable/disable FrIf support to enable branches of an active star. The current software does not support this parameter. The multiplicity is made 0 to remove BCT warnings.
      string FrIfFreeOpAApiName [0..0]: multiplicity set at pre-compile, set at pre-compile  # API name that is called when FREE_OP_A is selected as communication operation. See also chapter 8.8.3 Configurable Interfaces. The current software does not support this parameter.
      string FrIfFreeOpBApiName [0..0]: multiplicity set at pre-compile, set at pre-compile  # API name that is called when FREE_OP_B is selected as communication operation. See also chapter 8.8.3 Configurable Interfaces. The current software does not support this parameter.
      string FrIfFreeOpsHeader [0..0]: multiplicity set at pre-compile, set at pre-compile  # Defines header file for configurable FREE_OP_A / FREE_OP_B functions. The current software does not support this parameter.
      boolean FrIfGetClockCorrectionSupport: set at pre-compile  # Configuration parameter to enable/disable FrIf support to enable/disable of polling the FlexRay Driver to getting CC clock correction values.
      boolean FrIfGetGetChannelStatusSupport: set at pre-compile  # Configuration parameter to enable/disable FrIf support to enable/disable of polling the FlexRay Driver to getting error information about the FlexRay communications bus.
      boolean FrIfGetNmVectorSupport: set at pre-compile  # Configuration parameter to enable/disable FrIf support to request the FlexRay hardware NMVector.
      boolean FrIfGetNumOfStartupFramesSupport: set at pre-compile  # Configuration parameter to enable/disable FrIf support to enable/disable of polling the FlexRay Driver for the actual number of received startup frames on the bus.
      boolean FrIfGetSyncFrameListSupport: set at pre-compile  # Configuration parameter to enable/disable FrIf support to enable/disable of polling the FlexRay Driver to getting a list of actual received sync frames.
      boolean FrIfGetTransceiverErrorSupport [0..0]: set at pre-compile  # Configuration parameter to enable/disable FrIf support to get the FlexRay Transceiver errors by calling the FlexRay Transceiver module. The current software does not support this parameter. The multiplicity is made 0 to remove BCT warnings.
      boolean FrIfGetWakeupRxStatusSupport: set at pre-compile  # Configuration parameter to enable/disable FrIf support to get the wakeup received information from the FlexRay controller.
      integer FrIfMaxBufferSize [0..1]: 1..*, origin=BOSCH, set at pre-compile  # Maximum size of the single buffer that is used in case of postbuild loadable configuration. The value should be configured in bytes. FrIf stores the frame data which is aligned to 4 bytes alignment. Because of this, user has to provide the size as per 4 bytes alignment. For ex : if the frame size is configured as 32, then FrIf will need only 8 bytes of uint32. if the frame size is configured as 2, then FrIf will need only 1 bytes of uint32. If this is considered properly, the RAM wastage can be avoided.
      integer FrIfMaxFramesCnt [0..1]: 1..*, origin=BOSCH, set at pre-compile  # Maximum number of Frames. This parameter is needed only in case of post-build loadable implementation using static memory allocation.
      integer FrIfMaxPduCnt [0..1]: 1..*, origin=BOSCH, set at pre-compile  # Maximum number of Pdus. This parameter is needed only in case of post-build loadable implementation using static memory allocation.
      integer FrIfNumClstSupported: 1..15, set at pre-compile  # Maximum number of FlexRay Clusters that the FlexRay Interface supports.
      integer FrIfNumCtrlSupported: 1..15, set at pre-compile  # Maximum number of FlexRay CCs that the FlexRay Interface supports
      integer FrIfPduDefaultByteValue [0..1]: -1..255, origin=BOSCH, set at pre-compile, default-value=-1  # Defines the byte value in decimal, for padding of unused bytes in a LPdu. Default value -1
      string FrIfPublicCddHeaderFile [0..*]: multiplicity set at pre-compile, set at pre-compile  # Defines header files for callback functions which shall be included in case of CDDs. Range of characters is 1.. 32.
      boolean FrIfReadCCConfigApi [0..0]: set at pre-compile  # Configuration parameter to enable/disable the optional FrIf_ReadCCConfig API. The current software does not support this parameter. The multiplicity is made 0 to remove BCT warnings.
      boolean FrIfReconfigLPduSupport: set at pre-compile  # Configuration parameter to enable/disable FrIf support to enable/disable the reconfiguration of a given LPdu according to the parameters (FrameId, Channel, CycleRepetition, CycleOffset, PayloadLength, HeaderCRC) at runtime. Note:Currently only reconfiguration of Frame ID for static frames is supported.
      boolean FrIfTransceiverSharing: origin=BOSCH, set at pre-compile, default-value=0  # True: A single transceiver is shared by two controllers with same channel, False: The transceiver is not shared by two controllers.
      integer FrIfUnusedBitValue [0..1]: 0..1, multiplicity set at pre-compile, set at pre-compile  # Set unused bits to a defined value.
      boolean FrIfVendor6Driver: origin=BOSCH, set at pre-compile, default-value=true  # Parameter to suppress the dependency between FrIf and Fr is BOSCH Fr is not used.
      boolean FrIfVersionInfoApi: set at pre-compile  # Enables/disables the existence of the FrIf_GetVersionInfo() API service | true: FrIf_GetVersionInfo() API service exists false: FrIf_GetVersionInfo() API service does not exist
      boolean FrIfZeroPayloadTx: origin=BOSCH, set at pre-compile, default-value=0  # Switch to Transmit Zero payload when there is no IPdu transmit request

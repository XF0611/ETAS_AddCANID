AUTOSAR XML (schema 4-2-2)
package /AUTOSAR_SomeIpTp/EcucModuleDefs
  module definition SomeIpTp [0..1]: post-build-variant-support=true, refined-module-def=SomeIpTp, variants link-time/post-build/pre-compile  # Configuration of the SomeIpTp module.
    container SomeIpTpChannel [1..*]: multiplicity set at link in variant link-time / post-build in variant post-build / pre-compile in variant pre-compile, post-build-variant-multiplicity=true  # This container contains the configuration parameters of the SomeIpTp channel.
      float SomeIpTpNPduSeparationTime: 0..Inf, post-build-variant-value=true, set at link in variant link-time / post-build in variant post-build / pre-compile in variant pre-compile  # Sets the duration of the minimum time in seconds the SomeIpTp module shall wait between the transmissions of N-PDUs.
      float SomeIpTpRxTimeoutTime: 0..Inf, post-build-variant-value=true, set at link in variant link-time / post-build in variant post-build / pre-compile in variant pre-compile  # Timer to monitor the successful reception. It is started when the first NPdu is received, restarted after reception of intermediate NPdus, and is stopped when the last NPdu has been received. The value shall be calculated as follows: (SomeIpTpRxTimeoutTime = SomeIpTpNPduSeparationTime + budget), where the time budget compensates intermediary hops and jitters within the ECU implementation.
      container SomeIpTpRxNSdu [0..*]: multiplicity set at link in variant link-time / post-build in variant post-build / pre-compile in variant pre-compile, post-build-variant-multiplicity=true  # The following parameters needs to be configured for each N-SDU which has to be passed as one assembled RxPdu to the upper layer.
        reference SomeIpTpRxSduRef: post-build-variant-value=true, set at link in variant link-time / post-build in variant post-build / pre-compile in variant pre-compile, destination=Pdu  # Reference to a Pdu in the COM-Stack that represents the assembled RxPdu which is passed via the PduR to the upper layer.
        container SomeIpTpRxNPdu  # This container contains the configuration parameters of the NPdu that is received from a lower layer
          integer SomeIpTpRxNPduHandleId: 0..65535, set at pre-compile, symbolic-name-value=true, with-auto=true  # This parameter defines the handle ID that is used by the PduR when calling SomeIpTp_RxIndication.
          reference SomeIpTpRxNPduRef: post-build-variant-value=true, set at link in variant link-time / post-build in variant post-build / pre-compile in variant pre-compile, destination=Pdu  # Reference to a global Pdu that is used to harmonize HandleIDs in the COM-Stack.
      container SomeIpTpTxNSdu [0..*]: multiplicity set at link in variant link-time / post-build in variant post-build / pre-compile in variant pre-compile, post-build-variant-multiplicity=true  # The following parameters needs to be configured for each N-SDU that the SomeIpTp module transmits via the SomeIpTpChannel.
        integer SomeIpTpTxNSduHandleId [0..1]: 0..65535, set at pre-compile, symbolic-name-value=true, with-auto=true  # This parameter defines the handle ID of the NSdu that represents the original TxSdu which is segmented and passed via the PduR to the lower layer. This handle ID is used by PduR when calling SomeIpTp_Transmit.
        reference SomeIpTpTxNSduRef: post-build-variant-value=true, set at link in variant link-time / post-build in variant post-build / pre-compile in variant pre-compile, destination=Pdu  # Reference to a global Pdu in the COM-Stack that represents the original TxSdu which is segmented and passed via the PduR to the lower layer.
        container SomeIpTpTxNPdu  # This container contains the configuration parameters of the segmented Tx NPdus that are transmitted to a lower layer.
          integer SomeIpTpTxNPduHandleId: 0..65535, set at pre-compile, symbolic-name-value=true, with-auto=true  # This parameter defines the handle ID that is used by PduR when calling SomeIpTp_TriggerTransmit.
          reference SomeIpTpTxNPduRef: post-build-variant-value=true, set at link in variant link-time / post-build in variant post-build / pre-compile in variant pre-compile, destination=Pdu  # Reference to a global Pdu that is used to harmonize HandleIDs in the COM-Stack.
    container SomeIpTpGeneral  # This container contains the general configuration parameters of the SomeIpTp module.
      boolean SomeIpTpDevErrorDetect: set at pre-compile  # Switches the Development Error Detection and Notification ON or OFF.
      boolean SomeIpTpSupportTxIfConfirmation4_2_2: origin=RB:AR4.3.1.0:2019-11-22, set at pre-compile, default-value=false  # This parameter enables the support of the Autor 4.2.2 signature of the TxIfConfirmation.
      boolean SomeIpTpRbFastTransmission: origin=RB:AR4.3.1.0:2019-11-22, set at pre-compile, default-value=false  # This parameter enable the fast transmission. This supports the transmitting of more than one segment in one SomeIpTp_MainfunctionTx. Additionally the SomeIpTp_TxConfirmation from lower layer will be ignored. Instead SomeIpTp sends the bad case a PduR_SomeIpTpTxConfirmation immediately after a failed PduR_SomeIpTpTransmit() or PduR_SomeIpTpCopyTxData() with a result set to E_NOT_OK . In good case SomeIpTp sends immediately a PduR_SomeIpTpTxConfirmation() with the result E_OK.
      boolean someIpTpRbMetaDataSupport: origin=RB:AR4.3.1.0:2019-11-22, set at pre-compile, default-value=false  # This parameter enable the meta data handling. This functionality is not backward compatible and works only with AR 4.3.1.
      float SomeIpTpRxMainFunctionPeriod: 0..Inf, set at pre-compile  # This parameter defines the cycle time in seconds of the periodic call of the SomeIpTp_MainFunctionRx.
      float SomeIpTpTxMainFunctionPeriod: 0..Inf, set at pre-compile  # This parameter defines the cycle time in seconds of the periodic call of the SomeIpTp_MainFunctionTx.
      integer SomeIpTpRbFastTransNumberOfSegments: set at pre-compile  # This parameter defines the number of segments to be transmitted in one SomeIpTp_MainFunctionTx cycle.
      boolean SomeIpTpVersionInfoApi: set at pre-compile, default-value=false  # Activates the SomeIpTp_GetVersionInfo() API. | TRUE: Enables the SomeIpTp_GetVersionInfo() API. FALSE: SomeIpTp_GetVersionInfo() API is not included.

AUTOSAR XML (schema 00047)
package /TpConfigs
  can tp config CanTpConfig: communication-cluster=Can_Network_ETAS, can-tp-ecu{cycle-time-main-function=0.001, ecu-instance=ETAS}
    can tp address TA_0x0000: tp-address=0
    can tp address TA_0x0001: tp-address=1
    can tp address TA_0x00E0: tp-address=224
    can tp channel CanTpChannel: channel-id=0, channel-mode=FULL-DUPLEX-MODE
    can-tp-connection addressing-format=STANDARD, can-tp-channel=CanTpChannel, data-pdu=NPdu_UdsRxFnc, max-block-size=8, multicast=TA_0x0000, padding-activation=true, receiver=TN_MyECU, ta-type=FUNCTIONAL, timeout-br=0.0, timeout-cr=1.0, tp-sdu=UdsRxFnc, transmitter=TN_0x00E0_Tester:
      ident UdsRxFnc_oTN_0x00E0_Tester
    can-tp-connection addressing-format=STANDARD, can-tp-channel=CanTpChannel, data-pdu=NPdu_UdsRxPhy, flow-control-pdu=NPdu_UdsTxPhy, max-block-size=8, padding-activation=true, receiver=TN_0x0001_MyECU, ta-type=PHYSICAL, timeout-br=0.0, timeout-cr=1.0, tp-sdu=UdsRxPhy, transmitter=TN_0x00E0_Tester:
      ident UdsRxPhy_MyECU_oTN_0x0001_MyECU
    can-tp-connection addressing-format=STANDARD, can-tp-channel=CanTpChannel, cancellation=true, data-pdu=NPdu_UdsTxPhy, flow-control-pdu=NPdu_UdsRxPhy, padding-activation=true, receiver=TN_0x00E0_Tester, ta-type=PHYSICAL, timeout-bs=1.0, timeout-cs=0.002, tp-sdu=UdsTxPhy, transmit-cancellation=true, transmitter=TN_0x0001_MyECU:
      ident UdsTxPhy_0x748_MyECU_oTN_0x0001_MyECU
    can tp node TN_0x0001_MyECU: connector=Conn_ETAS_CAN_ETAS, st-min=0.002, timeout-ar=1.0, timeout-as=1.0, tp-address=TA_0x0001
    can tp node TN_0x00E0_Tester: st-min=0.002, tp-address=TA_0x00E0
    can tp node TN_MyECU: connector=Conn_ETAS_CAN_ETAS, st-min=0.002, timeout-ar=1.0

AUTOSAR XML (schema 00047)
package /Composition
  composition sw component type TopLevelComposition
    component CPT_Composition_SysCluster: type=Composition_SysCluster
    component CPT_Composition_ComCluster: type=Composition_ComCluster
    component CPT_Composition_AppCluster: type=Composition_AppCluster

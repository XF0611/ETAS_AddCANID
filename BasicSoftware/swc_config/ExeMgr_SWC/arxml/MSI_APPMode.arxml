AUTOSAR XML (schema 4-2-2)
package /Pkg_ModeSwitchInterface
  mode switch interface MSI_APPMode
    mode group MDGP_APPMode: type=MDG_ECUM_STATE

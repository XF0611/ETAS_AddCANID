AUTOSAR XML (schema 00047)
package /COM_Interface
  44 x sender receiver interface:
    SR_Interface_ETAS04_Sig21_ComTx_0x98
      data ETAS04_Sig21_ComTx_0x98: type=uint8
    SR_Interface_ETAS04_Sig24_ComTx_0x98
      data ETAS04_Sig24_ComTx_0x98: type=uint8
    SR_Interface_ETAS04_Sig25_ComTx_0x98
      data ETAS04_Sig25_ComTx_0x98: type=uint16
    SR_Interface_ETAS04_Sig20_ComTx_0x98
      data ETAS04_Sig20_ComTx_0x98: type=uint16
    SR_Interface_ETAS04_Sig23_ComTx_0x98
      data ETAS04_Sig23_ComTx_0x98: type=uint16
    SR_Interface_ETAS04_Sig22_ComTx_0x98
      data ETAS04_Sig22_ComTx_0x98: type=uint16
    SR_Interface_ETAS03_Sig18_ComTx_0x55
      data ETAS03_Sig18_ComTx_0x55: type=boolean
    SR_Interface_ETAS03_Sig16_ComTx_0x55
      data ETAS03_Sig16_ComTx_0x55: type=boolean
    SR_Interface_ETAS03_Sig14_ComTx_0x55
      data ETAS03_Sig14_ComTx_0x55: type=boolean
    SR_Interface_ETAS03_Sig19_ComTx_0x55
      data ETAS03_Sig19_ComTx_0x55: type=uint8
    SR_Interface_ETAS03_Sig12_ComTx_0x55
      data ETAS03_Sig12_ComTx_0x55: type=uint8
    SR_Interface_ETAS03_Sig17_ComTx_0x55
      data ETAS03_Sig17_ComTx_0x55: type=uint8
    SR_Interface_ETAS03_Sig11_ComTx_0x55
      data ETAS03_Sig11_ComTx_0x55: type=uint8
    SR_Interface_ETAS03_Sig13_ComTx_0x55
      data ETAS03_Sig13_ComTx_0x55: type=uint16
    SR_Interface_ETAS03_Sig15_ComTx_0x55
      data ETAS03_Sig15_ComTx_0x55: type=uint16
    SR_Interface_ETAS03_Sig10_ComTx_0x55
      data ETAS03_Sig10_ComTx_0x55: type=boolean
    SR_Interface_ETAS02_Sig09_ComRx_0x261
      data ETAS02_Sig09_ComRx_0x261: type=boolean
    SR_Interface_ETAS01_Sig04_ComRx_0x81
      data ETAS01_Sig04_ComRx_0x81: type=boolean
    SR_Interface_ETAS01_Sig02_ComRx_0x81
      data ETAS01_Sig02_ComRx_0x81: type=uint8
    SR_Interface_ETAS01_Sig03_ComRx_0x81
      data ETAS01_Sig03_ComRx_0x81: type=uint8
    SR_Interface_ETAS01_Sig01_ComRx_0x81
      data ETAS01_Sig01_ComRx_0x81: type=boolean
    SR_Interface_ETAS01_Sig06_ComRx_0x81
      data ETAS01_Sig06_ComRx_0x81: type=uint8
    SR_Interface_ETAS01_Sig05_ComRx_0x81
      data ETAS01_Sig05_ComRx_0x81: type=boolean
    SR_Interface_ETAS01_Sig07_ComRx_0x81
      data ETAS01_Sig07_ComRx_0x81: type=uint16
    SR_Interface_ETAS01_Sig00_ComRx_0x81
      data ETAS01_Sig00_ComRx_0x81: type=uint8
    SR_Interface_ETAS01_Sig08_ComRx_0x81
      data ETAS01_Sig08_ComRx_0x81: type=uint16
    SR_Interface_NM_Rx_Sig_NM_Rx_0x677
      data NM_Rx_Sig_NM_Rx_0x677: type=uint8
    SR_Interface_NM_Tx_Sig_NM_Tx_0x600
      data NM_Tx_Sig_NM_Tx_0x600: type=uint8
    SR_Interface_ETAS06_Sig34_ComRx_0x456
      data ETAS06_Sig34_ComRx_0x456: type=uint8
    SR_Interface_ETAS06_Sig35_ComRx_0x456
      data ETAS06_Sig35_ComRx_0x456: type=uint8
    SR_Interface_ETAS06_Sig36_ComRx_0x456
      data ETAS06_Sig36_ComRx_0x456: type=uint8
    SR_Interface_ETAS06_Sig37_ComRx_0x456
      data ETAS06_Sig37_ComRx_0x456: type=uint8
    SR_Interface_ETAS06_Sig38_ComRx_0x456
      data ETAS06_Sig38_ComRx_0x456: type=uint8
    SR_Interface_ETAS06_Sig39_ComRx_0x456
      data ETAS06_Sig39_ComRx_0x456: type=uint8
    SR_Interface_ETAS06_Sig40_ComRx_0x456
      data ETAS06_Sig40_ComRx_0x456: type=uint8
    SR_Interface_ETAS06_Sig41_ComRx_0x456
      data ETAS06_Sig41_ComRx_0x456: type=uint8
    SR_Interface_ETAS05_Sig26_ComTx_0x123
      data ETAS05_Sig26_ComTx_0x123: type=uint8
    SR_Interface_ETAS05_Sig27_ComTx_0x123
      data ETAS05_Sig27_ComTx_0x123: type=uint8
    SR_Interface_ETAS05_Sig28_ComTx_0x123
      data ETAS05_Sig28_ComTx_0x123: type=uint8
    SR_Interface_ETAS05_Sig29_ComTx_0x123
      data ETAS05_Sig29_ComTx_0x123: type=uint8
    SR_Interface_ETAS05_Sig30_ComTx_0x123
      data ETAS05_Sig30_ComTx_0x123: type=uint8
    SR_Interface_ETAS05_Sig31_ComTx_0x123
      data ETAS05_Sig31_ComTx_0x123: type=uint8
    SR_Interface_ETAS05_Sig32_ComTx_0x123
      data ETAS05_Sig32_ComTx_0x123: type=uint8
    SR_Interface_ETAS05_Sig33_ComTx_0x123
      data ETAS05_Sig33_ComTx_0x123: type=uint8

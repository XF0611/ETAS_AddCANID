AUTOSAR XML (schema 4-2-2)
package /Composition
  composition sw component type Composition_AppCluster
    component CPT_CalUT: type=CalUT
    component CPT_ParameterSWC: type=ParameterSWC
    connect CPT_ParameterSWC.PP_SpeedLimit -> CPT_CalUT.RP_SpeedLimit

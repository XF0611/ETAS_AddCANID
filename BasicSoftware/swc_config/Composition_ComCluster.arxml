AUTOSAR XML (schema 4-2-2)
package /Composition
  composition sw component type Composition_ComCluster
    component CPT_OUTP_SWC: type=OUTP_SWC
    component CPT_INP_SWC: type=INP_SWC

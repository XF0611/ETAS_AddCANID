AUTOSAR XML (schema 00047)
package /System_EcuExtract
  system EXTR_ETAS: category=ECU_EXTRACT, ecu-extract-version=1.0.0, system-version=1.0.0
    system mapping SYSMPG_ETAS
      data-mappings:
        data-element=CPT_ETAS_FlatView.RP_ETAS01_Sig{00..08}_ComRx_0x81.ETAS01_Sig{00..08}_ComRx_0x81, system-signal=ETAS01_Sig{00..08}_ComRx_0x81
        data-element=CPT_ETAS_FlatView.RP_ETAS02_Sig09_ComRx_0x261.ETAS02_Sig09_ComRx_0x261, system-signal=ETAS02_Sig09_ComRx_0x261
        data-element=CPT_ETAS_FlatView.PP_NM_Tx_Sig_NM_Tx_0x600.NM_Tx_Sig_NM_Tx_0x600, system-signal=NM_Tx_Sig_NM_Tx_0x600
        data-element=CPT_ETAS_FlatView.PP_ETAS03_Sig{10..19}_ComTx_0x55.ETAS03_Sig{10..19}_ComTx_0x55, system-signal=ETAS03_Sig{10..19}_ComTx_0x55
        data-element=CPT_ETAS_FlatView.PP_ETAS04_Sig{20..25}_ComTx_0x98.ETAS04_Sig{20..25}_ComTx_0x98, system-signal=ETAS04_Sig{20..25}_ComTx_0x98
        data-element=CPT_ETAS_FlatView.PP_ETAS05_Sig{26..33}_ComTx_0x123.ETAS05_Sig{26..33}_ComTx_0x123, system-signal=ETAS05_Sig{26..33}_ComTx_0x123
        data-element=CPT_ETAS_FlatView.RP_ETAS06_Sig{34..41}_ComRx_0x456.ETAS06_Sig{34..41}_ComRx_0x456, system-signal=ETAS06_Sig{34..41}_ComRx_0x456
      sw-mappings:
        swc to ecu mapping SwcToEcuMapping_0: ecu-instance=ETAS
          component:
            CPT_ETAS_FlatView.CPT_BswM
            CPT_ETAS_FlatView.CPT_CalUT
            CPT_ETAS_FlatView.CPT_ComM
            CPT_ETAS_FlatView.CPT_Dcm
            CPT_ETAS_FlatView.CPT_Dem
            CPT_ETAS_FlatView.CPT_Det
            CPT_ETAS_FlatView.CPT_DiagUT
            CPT_ETAS_FlatView.CPT_EcuM
            CPT_ETAS_FlatView.CPT_ExeMgrUT
            CPT_ETAS_FlatView.CPT_FiM
            CPT_ETAS_FlatView.CPT_INP_SWC
            CPT_ETAS_FlatView.CPT_NmUT
            CPT_ETAS_FlatView.CPT_NvBlock
            CPT_ETAS_FlatView.CPT_NvM
            CPT_ETAS_FlatView.CPT_NvMUT
            CPT_ETAS_FlatView.CPT_OUTP_SWC
            CPT_ETAS_FlatView.CPT_ParameterSWC
            CPT_ETAS_FlatView.CPT_Rtm
            CPT_ETAS_FlatView.CPT_StackM
            CPT_ETAS_FlatView.CPT_TstM
            CPT_ETAS_FlatView.CPT_WdgM
            CPT_ETAS_FlatView.CPT_WdgMUT
            CPT_ETAS_FlatView.CPT_rba_DiagLib
    root-software-compositions:
      root sw composition prototype CPT_ETAS_FlatView: flat-map=ETAS_FlatMap, software-composition=ETAS_FlatView

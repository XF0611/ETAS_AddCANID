AUTOSAR XML (schema 00047)
package /System
  system System: category=SYSTEM_EXTRACT
    system mapping SystemMapping
      data-mappings:
        data-element=CPT_Composition_ComCluster.CPT_OUTP_SWC.RootSwCompositionPrototype_0.PP_ETAS04_Sig23_ComTx_0x98.ETAS04_Sig23_ComTx_0x98, system-signal=ETAS04_Sig23_ComTx_0x98
        data-element=CPT_Composition_ComCluster.CPT_INP_SWC.RootSwCompositionPrototype_0.RP_ETAS01_Sig06_ComRx_0x81.ETAS01_Sig06_ComRx_0x81, system-signal=ETAS01_Sig06_ComRx_0x81
        data-element=CPT_Composition_ComCluster.CPT_OUTP_SWC.RootSwCompositionPrototype_0.PP_ETAS03_Sig17_ComTx_0x55.ETAS03_Sig17_ComTx_0x55, system-signal=ETAS03_Sig17_ComTx_0x55
        data-element=CPT_Composition_ComCluster.CPT_OUTP_SWC.RootSwCompositionPrototype_0.PP_ETAS04_Sig25_ComTx_0x98.ETAS04_Sig25_ComTx_0x98, system-signal=ETAS04_Sig25_ComTx_0x98
        data-element=CPT_Composition_ComCluster.CPT_OUTP_SWC.RootSwCompositionPrototype_0.PP_ETAS04_Sig24_ComTx_0x98.ETAS04_Sig24_ComTx_0x98, system-signal=ETAS04_Sig24_ComTx_0x98
        data-element=CPT_Composition_ComCluster.CPT_OUTP_SWC.RootSwCompositionPrototype_0.PP_ETAS03_Sig12_ComTx_0x55.ETAS03_Sig12_ComTx_0x55, system-signal=ETAS03_Sig12_ComTx_0x55
        data-element=CPT_Composition_ComCluster.CPT_OUTP_SWC.RootSwCompositionPrototype_0.PP_ETAS03_Sig10_ComTx_0x55.ETAS03_Sig10_ComTx_0x55, system-signal=ETAS03_Sig10_ComTx_0x55
        data-element=CPT_Composition_ComCluster.CPT_INP_SWC.RootSwCompositionPrototype_0.RP_ETAS01_Sig00_ComRx_0x81.ETAS01_Sig00_ComRx_0x81, system-signal=ETAS01_Sig00_ComRx_0x81
        data-element=CPT_Composition_ComCluster.CPT_INP_SWC.RootSwCompositionPrototype_0.RP_ETAS01_Sig04_ComRx_0x81.ETAS01_Sig04_ComRx_0x81, system-signal=ETAS01_Sig04_ComRx_0x81
        data-element=CPT_Composition_ComCluster.CPT_OUTP_SWC.RootSwCompositionPrototype_0.PP_ETAS04_Sig20_ComTx_0x98.ETAS04_Sig20_ComTx_0x98, system-signal=ETAS04_Sig20_ComTx_0x98
        data-element=CPT_Composition_ComCluster.CPT_OUTP_SWC.RootSwCompositionPrototype_0.PP_ETAS03_Sig15_ComTx_0x55.ETAS03_Sig15_ComTx_0x55, system-signal=ETAS03_Sig15_ComTx_0x55
        data-element=CPT_Composition_ComCluster.CPT_INP_SWC.RootSwCompositionPrototype_0.RP_ETAS01_Sig08_ComRx_0x81.ETAS01_Sig08_ComRx_0x81, system-signal=ETAS01_Sig08_ComRx_0x81
        data-element=CPT_Composition_ComCluster.CPT_OUTP_SWC.RootSwCompositionPrototype_0.PP_ETAS03_Sig16_ComTx_0x55.ETAS03_Sig16_ComTx_0x55, system-signal=ETAS03_Sig16_ComTx_0x55
        data-element=CPT_Composition_ComCluster.CPT_INP_SWC.RootSwCompositionPrototype_0.RP_ETAS01_Sig02_ComRx_0x81.ETAS01_Sig02_ComRx_0x81, system-signal=ETAS01_Sig02_ComRx_0x81
        data-element=CPT_Composition_ComCluster.CPT_INP_SWC.RootSwCompositionPrototype_0.RP_ETAS01_Sig03_ComRx_0x81.ETAS01_Sig03_ComRx_0x81, system-signal=ETAS01_Sig03_ComRx_0x81
        data-element=CPT_Composition_ComCluster.CPT_OUTP_SWC.RootSwCompositionPrototype_0.PP_ETAS03_Sig19_ComTx_0x55.ETAS03_Sig19_ComTx_0x55, system-signal=ETAS03_Sig19_ComTx_0x55
        data-element=CPT_Composition_ComCluster.CPT_OUTP_SWC.RootSwCompositionPrototype_0.PP_ETAS03_Sig18_ComTx_0x55.ETAS03_Sig18_ComTx_0x55, system-signal=ETAS03_Sig18_ComTx_0x55
        data-element=CPT_Composition_ComCluster.CPT_OUTP_SWC.RootSwCompositionPrototype_0.PP_ETAS03_Sig11_ComTx_0x55.ETAS03_Sig11_ComTx_0x55, system-signal=ETAS03_Sig11_ComTx_0x55
        data-element=CPT_Composition_ComCluster.CPT_INP_SWC.RootSwCompositionPrototype_0.RP_ETAS01_Sig01_ComRx_0x81.ETAS01_Sig01_ComRx_0x81, system-signal=ETAS01_Sig01_ComRx_0x81
        data-element=CPT_Composition_ComCluster.CPT_OUTP_SWC.RootSwCompositionPrototype_0.PP_ETAS03_Sig13_ComTx_0x55.ETAS03_Sig13_ComTx_0x55, system-signal=ETAS03_Sig13_ComTx_0x55
        data-element=CPT_Composition_ComCluster.CPT_OUTP_SWC.RootSwCompositionPrototype_0.PP_ETAS04_Sig22_ComTx_0x98.ETAS04_Sig22_ComTx_0x98, system-signal=ETAS04_Sig22_ComTx_0x98
        data-element=CPT_Composition_ComCluster.CPT_OUTP_SWC.RootSwCompositionPrototype_0.PP_ETAS03_Sig14_ComTx_0x55.ETAS03_Sig14_ComTx_0x55, system-signal=ETAS03_Sig14_ComTx_0x55
        data-element=CPT_Composition_ComCluster.CPT_INP_SWC.RootSwCompositionPrototype_0.RP_ETAS01_Sig05_ComRx_0x81.ETAS01_Sig05_ComRx_0x81, system-signal=ETAS01_Sig05_ComRx_0x81
        data-element=CPT_Composition_ComCluster.CPT_INP_SWC.RootSwCompositionPrototype_0.RP_ETAS02_Sig09_ComRx_0x261.ETAS02_Sig09_ComRx_0x261, system-signal=ETAS02_Sig09_ComRx_0x261
        data-element=CPT_Composition_ComCluster.CPT_INP_SWC.RootSwCompositionPrototype_0.RP_ETAS01_Sig07_ComRx_0x81.ETAS01_Sig07_ComRx_0x81, system-signal=ETAS01_Sig07_ComRx_0x81
        data-element=CPT_Composition_ComCluster.CPT_OUTP_SWC.RootSwCompositionPrototype_0.PP_ETAS04_Sig21_ComTx_0x98.ETAS04_Sig21_ComTx_0x98, system-signal=ETAS04_Sig21_ComTx_0x98
        data-element=CPT_Composition_SysCluster.CPT_NmUT.RootSwCompositionPrototype_0.PP_NM_Tx_Sig_NM_Tx_0x600.NM_Tx_Sig_NM_Tx_0x600, system-signal=NM_Tx_Sig_NM_Tx_0x600
        data-element=CPT_Composition_ComCluster.CPT_OUTP_SWC.RootSwCompositionPrototype_0.PP_ETAS05_Sig{26..33}_ComTx_0x123.ETAS05_Sig{26..33}_ComTx_0x123, system-signal=ETAS05_Sig{26..33}_ComTx_0x123
        data-element=CPT_Composition_ComCluster.CPT_INP_SWC.RootSwCompositionPrototype_0.RP_ETAS06_Sig{34..41}_ComRx_0x456.ETAS06_Sig{34..41}_ComRx_0x456, system-signal=ETAS06_Sig{34..41}_ComRx_0x456
      sw-mappings:
        swc to ecu mapping SwcToEcuMapping_0: ecu-instance=ETAS
          component:
            RootSwCompositionPrototype_0.CPT_Composition_ComCluster
            RootSwCompositionPrototype_0.CPT_Composition_SysCluster
            RootSwCompositionPrototype_0.CPT_Composition_AppCluster
    root-software-compositions:
      root sw composition prototype RootSwCompositionPrototype_0: software-composition=TopLevelComposition

AUTOSAR XML (schema 4-2-2)
package /RB/RBA/Common/CentralElements/SwAddrMethods
  12 x sw addr method:
    SAVED_ZONE: memory-allocation-keyword-policy=ADDR-METHOD-SHORT-NAME-AND-ALIGNMENT, section-initialization-policy=NO_INIT, section-type=VAR  # Addressing method for RAM buffers of variables saved in non volatile memory.
    RESET_SAFE_RAM0: memory-allocation-keyword-policy=ADDR-METHOD-SHORT-NAME-AND-ALIGNMENT, section-initialization-policy=NO_INIT, section-type=VAR
    INTERNAL_VAR_POWER_ON_INIT: memory-allocation-keyword-policy=ADDR-METHOD-SHORT-NAME-AND-ALIGNMENT, section-initialization-policy=POWER-ON-INIT, section-type=CALIBRATION-VARIABLES
    VAR_SLOW_NO_INIT: memory-allocation-keyword-policy=ADDR-METHOD-SHORT-NAME-AND-ALIGNMENT, section-initialization-policy=NO-INIT, section-type=VAR
    VAR_NO_INIT: memory-allocation-keyword-policy=ADDR-METHOD-SHORT-NAME-AND-ALIGNMENT, section-initialization-policy=NO_INIT, section-type=VAR
    VAR_POWER_ON_INIT: memory-allocation-keyword-policy=ADDR-METHOD-SHORT-NAME-AND-ALIGNMENT, section-initialization-policy=POWER-ON-INIT, section-type=VAR
    VECTORS: memory-allocation-keyword-policy=ADDR-METHOD-SHORT-NAME, section-type=CODE
    VAR_FAST_NO_INIT: memory-allocation-keyword-policy=ADDR-METHOD-SHORT-NAME-AND-ALIGNMENT, section-initialization-policy=NO-INIT, section-type=VAR
    VAR_TRACE: memory-allocation-keyword-policy=ADDR-METHOD-SHORT-NAME-AND-ALIGNMENT, section-initialization-policy=NO-INIT, section-type=VAR
    VAR_FAST_POWER_ON_INIT: memory-allocation-keyword-policy=ADDR-METHOD-SHORT-NAME-AND-ALIGNMENT, section-initialization-policy=POWER-ON-INIT, section-type=VAR
    VAR_SLOW_POWER_ON_INIT: memory-allocation-keyword-policy=ADDR-METHOD-SHORT-NAME-AND-ALIGNMENT, section-initialization-policy=POWER-ON-INIT, section-type=VAR
    INTERNAL_VAR_NO_INIT: memory-allocation-keyword-policy=ADDR-METHOD-SHORT-NAME-AND-ALIGNMENT, section-initialization-policy=NO-INIT, section-type=CALIBRATION-VARIABLES

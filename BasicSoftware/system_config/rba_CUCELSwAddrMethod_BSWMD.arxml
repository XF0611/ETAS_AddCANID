AUTOSAR XML (schema 4-2-2)
package /RB/RBA/Common/CentralElements/SwAddrMethods
  31 x sw addr method:
    INTERNAL_VAR_INIT: memory-allocation-keyword-policy=ADDR-METHOD-SHORT-NAME-AND-ALIGNMENT, section-initialization-policy=INIT, section-type=CALIBRATION-VARIABLES  # Addressing method for global or static variables accessible from a calibration tool that are initialized with values after every reset.
    INTERNAL_VAR_CLEARED: memory-allocation-keyword-policy=ADDR-METHOD-SHORT-NAME-AND-ALIGNMENT, section-initialization-policy=CLEARED, section-type=CALIBRATION-VARIABLES  # Addressing method for global or static variables accessible from a calibration tool that are cleared to zero after every reset.
    INTERNAL_VAR_POWER_ON_CLEARED: memory-allocation-keyword-policy=ADDR-METHOD-SHORT-NAME-AND-ALIGNMENT, section-initialization-policy=POWER_ON_CLEARED, section-type=CALIBRATION-VARIABLES  # Addressing method for global or static variables accessible from a calibration tool that are cleared to zero only after power on reset.
    CALIB: memory-allocation-keyword-policy=ADDR-METHOD-SHORT-NAME-AND-ALIGNMENT, section-type=CALPRM  # Addressing method for calibration constants.
    CALIB_FAST: memory-allocation-keyword-policy=ADDR-METHOD-SHORT-NAME-AND-ALIGNMENT, section-type=CALPRM  # Addressing method for calibration constants. This addressing method is an extension to AUTOSAR.
    CALIB_SLOW: memory-allocation-keyword-policy=ADDR-METHOD-SHORT-NAME-AND-ALIGNMENT, section-type=CALPRM  # Addressing method for calibration constants. This addressing method is an extension to AUTOSAR.
    CODE: memory-allocation-keyword-policy=ADDR-METHOD-SHORT-NAME, section-type=CODE  # Addressing method for code (application code, BSW code, boot code).
    CALLOUT_CODE: memory-allocation-keyword-policy=ADDR-METHOD-SHORT-NAME, section-type=CODE  # Addressing method for mapping callouts of the BSW Modules which shall typically use the global linker settings for callouts.
    CODE_FAST: memory-allocation-keyword-policy=ADDR-METHOD-SHORT-NAME, section-type=CODE  # Addressing method for code (application code, BSW code, boot code) which are high frequently accessed.
    CODE_SLOW: memory-allocation-keyword-policy=ADDR-METHOD-SHORT-NAME, section-type=CODE  # Addressing method for code (application code, BSW code, boot code) which are low frequently accessed.
    CONFIG_DATA: memory-allocation-keyword-policy=ADDR-METHOD-SHORT-NAME-AND-ALIGNMENT, section-type=CONFIG-DATA  # Addressing method for constants with attributes that show that they reside in one segment for link-time module configuration.
    CONFIG_DATA_FAST: memory-allocation-keyword-policy=ADDR-METHOD-SHORT-NAME-AND-ALIGNMENT, section-type=CONFIG-DATA  # Addressing method for constants with attributes that show that they reside in one segment for link-time module configuration. This addressing method is an extension to AUTOSAR.
    CONFIG_DATA_SLOW: memory-allocation-keyword-policy=ADDR-METHOD-SHORT-NAME-AND-ALIGNMENT, section-type=CONFIG-DATA  # Addressing method for constants with attributes that show that they reside in one segment for link-time module configuration. This addressing method is an extension to AUTOSAR.
    CONFIG_DATA_POSTBUILD: memory-allocation-keyword-policy=ADDR-METHOD-SHORT-NAME-AND-ALIGNMENT, section-type=CONFIG-DATA  # Addressing method for constants with attributes that show that they reside in one segment for link-time module configuration. This addressing method is an extension to AUTOSAR.
    CONFIG_DATA_POSTBUILD_HEADER: memory-allocation-keyword-policy=ADDR-METHOD-SHORT-NAME-AND-ALIGNMENT, section-type=CONFIG-DATA  # Addressing method for constants with attributes that show that they reside in one segment for link-time module configuration. This addressing method is an extension to AUTOSAR.
    CONST: memory-allocation-keyword-policy=ADDR-METHOD-SHORT-NAME-AND-ALIGNMENT, section-type=CONST  # Addressing method for global or static constants.
    CONST_FAST: memory-allocation-keyword-policy=ADDR-METHOD-SHORT-NAME-AND-ALIGNMENT, section-type=CONST  # Addressing method for global or static constants. This addressing method is an extension to AUTOSAR.
    CONST_SLOW: memory-allocation-keyword-policy=ADDR-METHOD-SHORT-NAME-AND-ALIGNMENT, section-type=CONST  # Addressing method for global or static constants. This addressing method is an extension to AUTOSAR.
    CONST_SAVED_RECOVERY_ZONE: memory-allocation-keyword-policy=ADDR-METHOD-SHORT-NAME-AND-ALIGNMENT, section-type=CONST  # Addressing method for ROM buffers of variables saved in non volatile memory.
    VAR_INIT: memory-allocation-keyword-policy=ADDR-METHOD-SHORT-NAME-AND-ALIGNMENT, section-initialization-policy=INIT, section-type=VAR  # Addressing method for global or static variables that are initialized with values after every reset.
    VAR_CLEARED: memory-allocation-keyword-policy=ADDR-METHOD-SHORT-NAME-AND-ALIGNMENT, section-initialization-policy=CLEARED, section-type=VAR  # Addressing method for global or static variables that are cleared to zero after every reset.
    VAR_CLEARED_POSTBUILD: memory-allocation-keyword-policy=ADDR-METHOD-SHORT-NAME-AND-ALIGNMENT, section-initialization-policy=CLEARED_POSTBUILD, section-type=VAR  # Addressing method for global or static variables that are cleared to zero after every reset.This addressing method is an extension to AUTOSAR
    VAR_POWER_ON_CLEARED: memory-allocation-keyword-policy=ADDR-METHOD-SHORT-NAME-AND-ALIGNMENT, section-initialization-policy=POWER_ON_CLEARED, section-type=VAR  # Addressing method for global or static variables that are cleared to zero only after power on reset.
    VAR_FAST_INIT: memory-allocation-keyword-policy=ADDR-METHOD-SHORT-NAME-AND-ALIGNMENT, section-initialization-policy=INIT, section-type=VAR  # Addressing method for global or static variables which are frequently used and that are initialized with values after every reset.
    VAR_FAST_CLEARED: memory-allocation-keyword-policy=ADDR-METHOD-SHORT-NAME-AND-ALIGNMENT, section-initialization-policy=CLEARED, section-type=VAR  # Addressing method for global or static variables which are frequently used and that are cleared to zero after every reset.
    VAR_FAST_POWER_ON_CLEARED: memory-allocation-keyword-policy=ADDR-METHOD-SHORT-NAME-AND-ALIGNMENT, section-initialization-policy=POWER_ON_CLEARED, section-type=VAR  # Addressing method for global or static variables which are frequently used and that are cleared to zero only after power on reset.
    VAR_SLOW_INIT: memory-allocation-keyword-policy=ADDR-METHOD-SHORT-NAME-AND-ALIGNMENT, section-initialization-policy=INIT, section-type=VAR  # Addressing method for global or static variables that are initialized with values after every reset. This addressing method is an extension to AUTOSAR.
    VAR_SLOW_CLEARED: memory-allocation-keyword-policy=ADDR-METHOD-SHORT-NAME-AND-ALIGNMENT, section-initialization-policy=CLEARED, section-type=VAR  # Addressing method for global or static variables that are cleared to zero after every reset. This addressing method is an extension to AUTOSAR.
    VAR_SLOW_POWER_ON_CLEARED: memory-allocation-keyword-policy=ADDR-METHOD-SHORT-NAME-AND-ALIGNMENT, section-initialization-policy=POWER_ON_CLEARED, section-type=VAR  # Addressing method for global or static variables that are cleared to zero only after power on reset. This addressing method is an extension to AUTOSAR.
    VAR_SAVED_ZONE: memory-allocation-keyword-policy=ADDR-METHOD-SHORT-NAME-AND-ALIGNMENT, section-initialization-policy=NO_INIT, section-type=VAR  # Addressing method for RAM buffers of variables saved in non volatile memory.
    HSM_SHARED_VAR: memory-allocation-keyword-policy=ADDR-METHOD-SHORT-NAME-AND-ALIGNMENT, section-initialization-policy=INIT, section-type=VAR  # Addressing method for exchange of Data with the Hardware Security Module. Restricted to Security

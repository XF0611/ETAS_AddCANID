AUTOSAR XML (schema 00047)
package /Diagnostics/Common
  diagnostic contribution set DcmContributionSet: category=DIAGNOSTICS_ECU_EXTRACT, common-properties={max-number-of-request-correctly-received-response-pending=5, security-delay-time-on-boot=10.0}, ecu-instance=ETAS, service-tables=ETAS_ServiceTable
    elements:
      AP_All
      AP_Comb_{0001..0003}
      AP_Extended
      AP_Programming
      ClearDiagnosticInformationClass
      ClearDiagInfo
      ComControlClass
      DisableRxAndTx
      EnableRxAndTx
      ControlDtcSettingClass
      Disable
      Enable
      DID_0x0100
      DID_0x010B
      DID_0x0112
      DID_0xB950
      DID_0xD001
      DID_0xD901
      DID_0xE101
      DID_0xE900
      DID_0xF100
      DID_0xF{110..119}
      DID_0xF11A
      DID_0xF11B
      DID_0xF11C
      DID_0xF11D
      DID_0xF11E
      DID_0xF11F
      DID_0xF{120..122}
      DID_0xF187
      DID_0xF18A
      DID_0xF18B
      DID_0xF18C
      DID_0xF190
      DID_0xF192
      DID_0xF194
      DID_0xF198
      DID_0xF1A{0..2}
      DID_0xF1A5
      DID_0xF1A8
      DID_0xF1A9
      DID_0xF1AA
      EcuResetClass
      Hard
      Soft
      IoControlClass
      DID_0xD901_IoCtrl
      DID_0xE900_IoCtrl
      ReadDataByIdentifierClass
      DID_0x0100_Read
      DID_0x010B_Read
      DID_0x0112_Read
      DID_0xB950_Read
      DID_0xD001_Read
      DID_0xD901_Read
      DID_0xE101_Read
      DID_0xE900_Read
      DID_0xF100_Read
      DID_0xF{110..119}_Read
      DID_0xF11A_Read
      DID_0xF11B_Read
      DID_0xF11C_Read
      DID_0xF11D_Read
      DID_0xF11E_Read
      DID_0xF11F_Read
      DID_0xF{120..122}_Read
      DID_0xF187_Read
      DID_0xF18A_Read
      DID_0xF18B_Read
      DID_0xF18C_Read
      DID_0xF190_Read
      DID_0xF192_Read
      DID_0xF194_Read
      DID_0xF198_Read
      DID_0xF1A{0..2}_Read
      DID_0xF1A5_Read
      DID_0xF1A8_Read
      DID_0xF1A9_Read
      DID_0xF1AA_Read
      ReadDtcInformationClass
      RDTCBSM
      RDTCEDRBDN
      RDTCSSBDTC
      RNODTCBSM
      RSUPDTC
      RoutineControlClass
      Routine_Control_203
      Routine_Control_ABFF
      X_Routine_Control_ABFE
      Routine_Control_203
      Routine_Control_ABFF
      X_Routine_Control_ABFE
      SecurityAccessClass
      Unlocked_L3_SecurityAccess
      UnlockedL1_SecurityAccess
      Unlocked_L3
      UnlockedL1
      ETAS_ServiceTable
      SessionControlClass
      Default_SessionControl
      Extended_SessionControl
      Programming_SessionControl
      Default
      Extended
      Programming
      WriteDataByIdentifierClass
      DID_0x0100_Write
      DID_0xF110_Write
      DID_0xF115_Write
      DID_0xF121_Write
      DID_0xF187_Write
      DID_0xF18B_Write
      DID_0xF18C_Write
      DID_0xF190_Write
      DID_0xF198_Write
      DID_0xF1A8_Write
      DID_0xF1A9_Write
      DID_0xF1AA_Write
      DiagnosticEcuInstanceProps
      DcmDslProtocolRow
  43 x diagnostic data identifier:
    DID_0x0100: id=256
      diagnostic-parameter bit-offset=0:
        diagnostic data element New_Data_Object: array-size-semantics=FIXED-SIZE, max-number-of-elements=16, base-type=uint8_opaq, compu {identical}
    DID_0x010B: id=267
      diagnostic-parameter bit-offset=0:
        diagnostic data element Year: base-type=uint8_opaq, compu {identical}, range raw 0..255
      diagnostic-parameter bit-offset=8:
        diagnostic data element Month: base-type=uint8_opaq, compu {identical}, range raw 0..255
      diagnostic-parameter bit-offset=16:
        diagnostic data element Day: base-type=uint8_opaq, compu {identical}, range raw 0..255
      diagnostic-parameter bit-offset=24:
        diagnostic data element Hour: base-type=uint8_opaq, compu {identical}, range raw 0..255
      diagnostic-parameter bit-offset=32:
        diagnostic data element Minute: base-type=uint8_opaq, compu {identical}, range raw 0..255
      diagnostic-parameter bit-offset=40:
        diagnostic data element Second: base-type=uint8_opaq, compu {identical}, range raw 0..255
    DID_0x0112: id=274
      diagnostic-parameter bit-offset=0:
        diagnostic data element New_Data_Object: base-type=uint8_opaq, compu {identical}, range raw 0..255
    DID_0xB950: id=47440
      diagnostic-parameter bit-offset=0:
        diagnostic data element New_Data_Object: array-size-semantics=FIXED-SIZE, max-number-of-elements=8, base-type=uint8_opaq, compu {identical}
    DID_0xD001: id=53249
      diagnostic-parameter bit-offset=0:
        diagnostic data element New_Data_Object: base-type=uint8_opaq, compu {identical}, range raw 0..255
    DID_0xD901: id=55553
      diagnostic-parameter bit-offset=0:
        diagnostic data element New_Data_Object: base-type=uint8_opaq, compu {identical}, range raw 0..255
    DID_0xE101: id=57601
      diagnostic-parameter bit-offset=0:
        diagnostic data element New_Data_Object: array-size-semantics=FIXED-SIZE, max-number-of-elements=3, base-type=uint8_opaq, compu {identical}
    DID_0xE900: id=59648
      diagnostic-parameter bit-offset=0:
        diagnostic data element New_Data_Object: base-type=uint8_opaq, compu {identical}, range raw 0..255
    DID_0xF100: id=61696
      diagnostic-parameter bit-offset=0:
        diagnostic data element New_Data_Object: array-size-semantics=FIXED-SIZE, max-number-of-elements=5, base-type=uint8_opaq, compu {identical}
      diagnostic-parameter bit-offset=40:
        diagnostic data element New_Data_Object_1: array-size-semantics=FIXED-SIZE, max-number-of-elements=6, base-type=uint8_opaq, compu {identical}
    DID_0xF110: id=61712
      diagnostic-parameter bit-offset=0:
        diagnostic data element New_Data_Object: array-size-semantics=FIXED-SIZE, max-number-of-elements=16, base-type=uint8_opaq, compu {identical}
    DID_0xF111: id=61713
      diagnostic-parameter bit-offset=0:
        diagnostic data element New_Data_Object: array-size-semantics=FIXED-SIZE, max-number-of-elements=16, base-type=uint8_opaq, compu {identical}
    DID_0xF112: id=61714
      diagnostic-parameter bit-offset=0:
        diagnostic data element New_Data_Object: array-size-semantics=FIXED-SIZE, max-number-of-elements=16, base-type=uint8_opaq, compu {identical}
    DID_0xF113: id=61715
      diagnostic-parameter bit-offset=0:
        diagnostic data element New_Data_Object: array-size-semantics=FIXED-SIZE, max-number-of-elements=16, base-type=uint8_opaq, compu {identical}
    DID_0xF114: id=61716
      diagnostic-parameter bit-offset=0:
        diagnostic data element New_Data_Object: array-size-semantics=FIXED-SIZE, max-number-of-elements=16, base-type=uint8_opaq, compu {identical}
    DID_0xF115: id=61717
      diagnostic-parameter bit-offset=0:
        diagnostic data element New_Data_Object: array-size-semantics=FIXED-SIZE, max-number-of-elements=16, base-type=uint8_opaq, compu {identical}
    DID_0xF116: id=61718
      diagnostic-parameter bit-offset=0:
        diagnostic data element New_Data_Object: array-size-semantics=FIXED-SIZE, max-number-of-elements=16, base-type=uint8_opaq, compu {identical}
    DID_0xF117: id=61719
      diagnostic-parameter bit-offset=0:
        diagnostic data element New_Data_Object: array-size-semantics=FIXED-SIZE, max-number-of-elements=16, base-type=uint8_opaq, compu {identical}
    DID_0xF118: id=61720
      diagnostic-parameter bit-offset=0:
        diagnostic data element New_Data_Object: array-size-semantics=FIXED-SIZE, max-number-of-elements=16, base-type=uint8_opaq, compu {identical}
    DID_0xF119: id=61721
      diagnostic-parameter bit-offset=0:
        diagnostic data element New_Data_Object: array-size-semantics=FIXED-SIZE, max-number-of-elements=16, base-type=uint8_opaq, compu {identical}
    DID_0xF11A: id=61722
      diagnostic-parameter bit-offset=0:
        diagnostic data element New_Data_Object: array-size-semantics=FIXED-SIZE, max-number-of-elements=16, base-type=uint8_opaq, compu {identical}
    DID_0xF11B: id=61723
      diagnostic-parameter bit-offset=0:
        diagnostic data element New_Data_Object: array-size-semantics=FIXED-SIZE, max-number-of-elements=16, base-type=uint8_opaq, compu {identical}
    DID_0xF11C: id=61724
      diagnostic-parameter bit-offset=0:
        diagnostic data element New_Data_Object: array-size-semantics=FIXED-SIZE, max-number-of-elements=16, base-type=uint8_opaq, compu {identical}
    DID_0xF11D: id=61725
      diagnostic-parameter bit-offset=0:
        diagnostic data element New_Data_Object: array-size-semantics=FIXED-SIZE, max-number-of-elements=16, base-type=uint8_opaq, compu {identical}
    DID_0xF11E: id=61726
      diagnostic-parameter bit-offset=0:
        diagnostic data element New_Data_Object: array-size-semantics=FIXED-SIZE, max-number-of-elements=16, base-type=uint8_opaq, compu {identical}
    DID_0xF11F: id=61727
      diagnostic-parameter bit-offset=0:
        diagnostic data element New_Data_Object: array-size-semantics=FIXED-SIZE, max-number-of-elements=16, base-type=uint8_opaq, compu {identical}
    DID_0xF120: id=61728
      diagnostic-parameter bit-offset=0:
        diagnostic data element New_Data_Object: array-size-semantics=FIXED-SIZE, max-number-of-elements=16, base-type=uint8_opaq, compu {identical}
    DID_0xF121: id=61729
      diagnostic-parameter bit-offset=0:
        diagnostic data element New_Data_Object: array-size-semantics=FIXED-SIZE, max-number-of-elements=16, base-type=uint8_opaq, compu {identical}
    DID_0xF122: id=61827
      diagnostic-parameter bit-offset=0:
        diagnostic data element New_Data_Object: array-size-semantics=FIXED-SIZE, max-number-of-elements=5, base-type=uint8_opaq, compu {identical}
      diagnostic-parameter bit-offset=40:
        diagnostic data element New_Data_Object_2: array-size-semantics=FIXED-SIZE, max-number-of-elements=5, base-type=uint8_opaq, compu {identical}
    DID_0xF187: id=61831
      diagnostic-parameter bit-offset=0:
        diagnostic data element New_Data_Object: array-size-semantics=FIXED-SIZE, max-number-of-elements=5, base-type=uint8_opaq, compu {identical}
    DID_0xF18A: id=61834
      diagnostic-parameter bit-offset=0:
        diagnostic data element New_Data_Object: array-size-semantics=FIXED-SIZE, max-number-of-elements=5, base-type=uint8_opaq, compu {identical}
    DID_0xF18B: id=61835
      diagnostic-parameter bit-offset=0:
        diagnostic data element New_Data_Object: array-size-semantics=FIXED-SIZE, max-number-of-elements=3, base-type=uint8_opaq, compu {identical}
    DID_0xF18C: id=61836
      diagnostic-parameter bit-offset=0:
        diagnostic data element New_Data_Object: array-size-semantics=FIXED-SIZE, max-number-of-elements=16, base-type=uint8_opaq, compu {identical}
    DID_0xF190: id=61840
      diagnostic-parameter bit-offset=0:
        diagnostic data element New_Data_Object: array-size-semantics=FIXED-SIZE, max-number-of-elements=17, base-type=uint8_opaq, compu {identical}
    DID_0xF192: id=61842
      diagnostic-parameter bit-offset=0:
        diagnostic data element New_Data_Object: array-size-semantics=FIXED-SIZE, max-number-of-elements=5, base-type=uint8_opaq, compu {identical}
      diagnostic-parameter bit-offset=40:
        diagnostic data element New_Data_Object_3: array-size-semantics=FIXED-SIZE, max-number-of-elements=5, base-type=uint8_opaq, compu {identical}
    DID_0xF194: id=61844
      diagnostic-parameter bit-offset=0:
        diagnostic data element New_Data_Object: array-size-semantics=FIXED-SIZE, max-number-of-elements=5, base-type=uint8_opaq, compu {identical}
      diagnostic-parameter bit-offset=40:
        diagnostic data element New_Data_Object_4: array-size-semantics=FIXED-SIZE, max-number-of-elements=5, base-type=uint8_opaq, compu {identical}
    DID_0xF198: id=61848
      diagnostic-parameter bit-offset=0:
        diagnostic data element New_Data_Object: array-size-semantics=FIXED-SIZE, max-number-of-elements=5, base-type=uint8_opaq, compu {identical}
      diagnostic-parameter bit-offset=40:
        diagnostic data element New_Data_Object_5: array-size-semantics=FIXED-SIZE, max-number-of-elements=6, base-type=uint8_opaq, compu {identical}
    DID_0xF1A0: id=61856
      diagnostic-parameter bit-offset=0:
        diagnostic data element New_Data_Object: array-size-semantics=FIXED-SIZE, max-number-of-elements=5, base-type=uint8_opaq, compu {identical}
    DID_0xF1A1: id=61857
      diagnostic-parameter bit-offset=0:
        diagnostic data element New_Data_Object: array-size-semantics=FIXED-SIZE, max-number-of-elements=5, base-type=uint8_opaq, compu {identical}
    DID_0xF1A2: id=61858
      diagnostic-parameter bit-offset=0:
        diagnostic data element New_Data_Object: array-size-semantics=FIXED-SIZE, max-number-of-elements=8, base-type=uint8_opaq, compu {identical}
    DID_0xF1A5: id=61861
      diagnostic-parameter bit-offset=0:
        diagnostic data element New_Data_Object: array-size-semantics=FIXED-SIZE, max-number-of-elements=3, base-type=uint8_opaq, compu {identical}
    DID_0xF1A8: id=61864
      diagnostic-parameter bit-offset=0:
        diagnostic data element New_Data_Object: array-size-semantics=FIXED-SIZE, max-number-of-elements=20, base-type=uint8_opaq, compu {identical}
    DID_0xF1A9: id=61865
      diagnostic-parameter bit-offset=0:
        diagnostic data element New_Data_Object: array-size-semantics=FIXED-SIZE, max-number-of-elements=5, base-type=uint8_opaq, compu {identical}
    DID_0xF1AA: id=61866
      diagnostic-parameter bit-offset=0:
        diagnostic data element New_Data_Object: array-size-semantics=FIXED-SIZE, max-number-of-elements=5, base-type=uint8_opaq, compu {identical}
package /Diagnostics/Common/BaseTypes
  base type uint8_opaq: category=FIXED_LENGTH, base-type-size=8, base-type-encoding=NONE, byte-order=opaque
package /Diagnostics/Dem
  diagnostic contribution set DemContributionSet: category=DIAGNOSTICS_ECU_EXTRACT, ecu-instance=ETAS
    common-properties aging-requires-tested-cycle=false, clear-dtc-limitation=CLEAR-ALL-DTCS, default-endianness=big-endian, dtc-status-availability-mask=255, environment-data-capture=CAPTURE-SYNCHRONOUSLY-TO-REPORTING, event-displacement-strategy=FULL, max-number-of-event-entries=10, max-number-of-request-correctly-received-response-pending=5, memory-entry-storage-trigger=TEST-FAILED, occurrence-counter-processing=TEST-FAILED-BIT, reset-confirmed-bit-on-overflow=false, response-on-all-request-sids=true, response-on-second-declined-request=true, security-delay-time-on-boot=10.0, status-bit-handling-test-failed-since-last-clear=STATUS-BIT-NORMAL, status-bit-storage-test-failed=true, type-of-dtc-supported=ISO-14229--1, type-of-freeze-frame-record-numeration=CONFIGURED:
      12 x diagnostic debounce algorithm props, all with debounce-counter-storage=false:
        DTC_0x000001_DebounceAlgorithmProperties
          debounce-algorithm:
            diag event debounce counter based DTC_0x000001_CounterBasedAlgorithm: counter-decrement-step-size=1, counter-failed-threshold=1, counter-increment-step-size=1, counter-jump-down=false, counter-jump-up=true, counter-passed-threshold=-1
        DTC_0x0d0400_CAN_Network_ETAS_BusOff_DebounceAlgorithmProperties
          debounce-algorithm:
            diag event debounce counter based DTC_0x0d0400_CAN_Network_ETAS_BusOff_CounterBasedAlgorithm: counter-decrement-step-size=1, counter-failed-threshold=1, counter-increment-step-size=1, counter-jump-down=false, counter-jump-up=true, counter-passed-threshold=-1
        DTC_0xc07388_DebounceAlgorithmProperties
          debounce-algorithm:
            diag event debounce counter based DTC_0xc07388_CounterBasedAlgorithm: counter-decrement-step-size=1, counter-failed-threshold=1, counter-increment-step-size=1, counter-jump-down=false, counter-jump-up=true, counter-passed-threshold=-1
        DTC_0xc12687_DebounceAlgorithmProperties
          debounce-algorithm:
            diag event debounce counter based DTC_0xc12687_CounterBasedAlgorithm: counter-decrement-step-size=1, counter-failed-threshold=1, counter-increment-step-size=1, counter-jump-down=false, counter-jump-up=true, counter-passed-threshold=-1
        DTC_0xc14587_DebounceAlgorithmProperties
          debounce-algorithm:
            diag event debounce counter based DTC_0xc14587_CounterBasedAlgorithm: counter-decrement-step-size=1, counter-failed-threshold=1, counter-increment-step-size=1, counter-jump-down=false, counter-jump-up=true, counter-passed-threshold=-1
        DTC_0xc22a87_DebounceAlgorithmProperties
          debounce-algorithm:
            diag event debounce counter based DTC_0xc22a87_CounterBasedAlgorithm: counter-decrement-step-size=1, counter-failed-threshold=1, counter-increment-step-size=1, counter-jump-down=false, counter-jump-up=true, counter-passed-threshold=-1
        DTC_0xc41487_DebounceAlgorithmProperties
          debounce-algorithm:
            diag event debounce counter based DTC_0xc41487_CounterBasedAlgorithm: counter-decrement-step-size=1, counter-failed-threshold=1, counter-increment-step-size=1, counter-jump-down=false, counter-jump-up=true, counter-passed-threshold=-1
        DTC_0xd56217_DebounceAlgorithmProperties
          debounce-algorithm:
            diag event debounce counter based DTC_0xd56217_CounterBasedAlgorithm: counter-decrement-step-size=1, counter-failed-threshold=1, counter-increment-step-size=1, counter-jump-down=false, counter-jump-up=true, counter-passed-threshold=-1
        DTC_0xd56316_DebounceAlgorithmProperties
          debounce-algorithm:
            diag event debounce counter based DTC_0xd56316_CounterBasedAlgorithm: counter-decrement-step-size=1, counter-failed-threshold=1, counter-increment-step-size=1, counter-jump-down=false, counter-jump-up=true, counter-passed-threshold=-1
        DTC_0xe00141_DebounceAlgorithmProperties
          debounce-algorithm:
            diag event debounce counter based DTC_0xe00141_CounterBasedAlgorithm: counter-decrement-step-size=1, counter-failed-threshold=1, counter-increment-step-size=1, counter-jump-down=false, counter-jump-up=true, counter-passed-threshold=-1
        DTC_0xe00142_DebounceAlgorithmProperties
          debounce-algorithm:
            diag event debounce counter based DTC_0xe00142_CounterBasedAlgorithm: counter-decrement-step-size=1, counter-failed-threshold=1, counter-increment-step-size=1, counter-jump-down=false, counter-jump-up=true, counter-passed-threshold=-1
        DTC_0xe26200_DebounceAlgorithmProperties
          debounce-algorithm:
            diag event debounce counter based DTC_0xe26200_CounterBasedAlgorithm: counter-decrement-step-size=1, counter-failed-threshold=1, counter-increment-step-size=1, counter-jump-down=false, counter-jump-up=true, counter-passed-threshold=-1
    elements:
      DTC_0x000001_Aging
      DTC_0x0d0400_CAN_Network_ETAS_BusOff_Aging
      DTC_0x000001_DidSet
      DTC_0x000001_Event
      DTC_0x0d0400_CAN_Network_ETAS_BusOff_Event
      DTC_0xc07388_Event
      DTC_0xc12687_Event
      DTC_0xc14587_Event
      DTC_0xc22a87_Event
      DTC_0xc41487_Event
      DTC_0xd56217_Event
      DTC_0xd56316_Event
      DTC_0xe00141_Event
      DTC_0xe00142_Event
      DTC_0xe26200_Event
      DTC_0x000001_Event_To_DebounceAlgorithmProperties_Mapping
      DTC_0x0d0400_CAN_Network_ETAS_BusOff_Event_To_DebounceAlgorithmProperties_Mapping
      DTC_0xc07388_Event_To_DebounceAlgorithmProperties_Mapping
      DTC_0xc12687_Event_To_DebounceAlgorithmProperties_Mapping
      DTC_0xc14587_Event_To_DebounceAlgorithmProperties_Mapping
      DTC_0xc22a87_Event_To_DebounceAlgorithmProperties_Mapping
      DTC_0xc41487_Event_To_DebounceAlgorithmProperties_Mapping
      DTC_0xd56217_Event_To_DebounceAlgorithmProperties_Mapping
      DTC_0xd56316_Event_To_DebounceAlgorithmProperties_Mapping
      DTC_0xe00141_Event_To_DebounceAlgorithmProperties_Mapping
      DTC_0xe00142_Event_To_DebounceAlgorithmProperties_Mapping
      DTC_0xe26200_Event_To_DebounceAlgorithmProperties_Mapping
      DTC_0x000001_Event_To_DEM_POWER_Mapping
      DTC_0x0d0400_CAN_Network_ETAS_BusOff_Event_To_DEM_POWER_Mapping
      DTC_0xc07388_Event_To_DEM_POWER_Mapping
      DTC_0xc12687_Event_To_DEM_POWER_Mapping
      DTC_0xc14587_Event_To_DEM_POWER_Mapping
      DTC_0xc22a87_Event_To_DEM_POWER_Mapping
      DTC_0xc41487_Event_To_DEM_POWER_Mapping
      DTC_0xd56217_Event_To_DEM_POWER_Mapping
      DTC_0xd56316_Event_To_DEM_POWER_Mapping
      DTC_0xe00141_Event_To_DEM_POWER_Mapping
      DTC_0xe00142_Event_To_DEM_POWER_Mapping
      DTC_0xe26200_Event_To_DEM_POWER_Mapping
      DTC_0x000001_Event_To_DTC_Mapping
      DTC_0x0d0400_CAN_Network_ETAS_BusOff_Event_To_DTC_Mapping
      DTC_0xc07388_Event_To_DTC_Mapping
      DTC_0xc12687_Event_To_DTC_Mapping
      DTC_0xc14587_Event_To_DTC_Mapping
      DTC_0xc22a87_Event_To_DTC_Mapping
      DTC_0xc41487_Event_To_DTC_Mapping
      DTC_0xd56217_Event_To_DTC_Mapping
      DTC_0xd56316_Event_To_DTC_Mapping
      DTC_0xe00141_Event_To_DTC_Mapping
      DTC_0xe00142_Event_To_DTC_Mapping
      DTC_0xe26200_Event_To_DTC_Mapping
      WarningIndicator
      PrimaryMemory
      DEM_POWER
      DTC_0x000001
      DTC_0x0d0400_CAN_Network_ETAS_BusOff
      DTC_0xc07388
      DTC_0xc12687
      DTC_0xc14587
      DTC_0xc22a87
      DTC_0xc41487
      DTC_0xd56217
      DTC_0xd56316
      DTC_0xe00141
      DTC_0xe00142
      DTC_0xe26200
      DTC_0x000001_Properties
      DTC_0x0d0400_CAN_Network_ETAS_BusOff_Properties
      DTC_0xc22a87_Properties
      ExtendedDataRecord0x01
      SnapshotRec_1
      SnapshotRec_2
      DiagnosticEcuInstanceProps
      DcmDslProtocolRow
  diagnostic memory destination primary PrimaryMemory
package /Diagnostics/Dem/Events
  12 x diagnostic event, all with aging-allowed=true, clear-event-behavior=NO-STATUS-BYTE-CHANGE, event-failure-cycle-counter-threshold=1:
    DTC_0x000001_Event: event-kind=SWC
    DTC_0x0d0400_CAN_Network_ETAS_BusOff_Event: event-kind=BSW
    DTC_0xc07388_Event: event-kind=SWC
    DTC_0xc12687_Event: event-kind=SWC
    DTC_0xc14587_Event: event-kind=SWC
    DTC_0xc22a87_Event: event-kind=SWC
    DTC_0xc41487_Event: event-kind=SWC
    DTC_0xd56217_Event: event-kind=SWC
    DTC_0xd56316_Event: event-kind=SWC
    DTC_0xe00141_Event: event-kind=SWC
    DTC_0xe00142_Event: event-kind=SWC
    DTC_0xe26200_Event: event-kind=SWC
package /Diagnostics/Dem/Dtcs
  12 x diagnostic trouble code uds, all with severity=NO-SEVERITY:
    DTC_0x000001: dtc-props=DTC_0x000001_Properties, uds-dtc-value=1
    DTC_0x0d0400_CAN_Network_ETAS_BusOff: dtc-props=DTC_0x0d0400_CAN_Network_ETAS_BusOff_Properties, uds-dtc-value=852992
    DTC_0xc07388: dtc-props=DTC_0x000001_Properties, uds-dtc-value=12612488
    DTC_0xc12687: dtc-props=DTC_0x000001_Properties, uds-dtc-value=12658311
    DTC_0xc14587: dtc-props=DTC_0x000001_Properties, uds-dtc-value=12666247
    DTC_0xc22a87: dtc-props=DTC_0xc22a87_Properties, uds-dtc-value=12724871
    DTC_0xc41487: dtc-props=DTC_0xc22a87_Properties, uds-dtc-value=12850311
    DTC_0xd56217: dtc-props=DTC_0xc22a87_Properties, uds-dtc-value=13984279
    DTC_0xd56316: dtc-props=DTC_0xc22a87_Properties, uds-dtc-value=13984534
    DTC_0xe00141: dtc-props=DTC_0xc22a87_Properties, uds-dtc-value=14680385
    DTC_0xe00142: dtc-props=DTC_0xc22a87_Properties, uds-dtc-value=14680386
    DTC_0xe26200: dtc-props=DTC_0xc22a87_Properties, uds-dtc-value=14836224
package /Diagnostics/Dem/Mappings
  12 x diagnostic event to debounce algorithm mapping:
    DTC_0x000001_Event_To_DebounceAlgorithmProperties_Mapping: debounce-algorithm=DTC_0x000001_DebounceAlgorithmProperties, diagnostic-event=DTC_0x000001_Event
    DTC_0x0d0400_CAN_Network_ETAS_BusOff_Event_To_DebounceAlgorithmProperties_Mapping: debounce-algorithm=DTC_0x0d0400_CAN_Network_ETAS_BusOff_DebounceAlgorithmProperties, diagnostic-event=DTC_0x0d0400_CAN_Network_ETAS_BusOff_Event
    DTC_0xc07388_Event_To_DebounceAlgorithmProperties_Mapping: debounce-algorithm=DTC_0xc07388_DebounceAlgorithmProperties, diagnostic-event=DTC_0xc07388_Event
    DTC_0xc12687_Event_To_DebounceAlgorithmProperties_Mapping: debounce-algorithm=DTC_0xc12687_DebounceAlgorithmProperties, diagnostic-event=DTC_0xc12687_Event
    DTC_0xc14587_Event_To_DebounceAlgorithmProperties_Mapping: debounce-algorithm=DTC_0xc14587_DebounceAlgorithmProperties, diagnostic-event=DTC_0xc14587_Event
    DTC_0xc22a87_Event_To_DebounceAlgorithmProperties_Mapping: debounce-algorithm=DTC_0xc22a87_DebounceAlgorithmProperties, diagnostic-event=DTC_0xc22a87_Event
    DTC_0xc41487_Event_To_DebounceAlgorithmProperties_Mapping: debounce-algorithm=DTC_0xc41487_DebounceAlgorithmProperties, diagnostic-event=DTC_0xc41487_Event
    DTC_0xd56217_Event_To_DebounceAlgorithmProperties_Mapping: debounce-algorithm=DTC_0xd56217_DebounceAlgorithmProperties, diagnostic-event=DTC_0xd56217_Event
    DTC_0xd56316_Event_To_DebounceAlgorithmProperties_Mapping: debounce-algorithm=DTC_0xd56316_DebounceAlgorithmProperties, diagnostic-event=DTC_0xd56316_Event
    DTC_0xe00141_Event_To_DebounceAlgorithmProperties_Mapping: debounce-algorithm=DTC_0xe00141_DebounceAlgorithmProperties, diagnostic-event=DTC_0xe00141_Event
    DTC_0xe00142_Event_To_DebounceAlgorithmProperties_Mapping: debounce-algorithm=DTC_0xe00142_DebounceAlgorithmProperties, diagnostic-event=DTC_0xe00142_Event
    DTC_0xe26200_Event_To_DebounceAlgorithmProperties_Mapping: debounce-algorithm=DTC_0xe26200_DebounceAlgorithmProperties, diagnostic-event=DTC_0xe26200_Event
  12 x diagnostic event to operation cycle mapping, all with operation-cycle=DEM_POWER:
    DTC_0x000001_Event_To_DEM_POWER_Mapping: diagnostic-event=DTC_0x000001_Event
    DTC_0x0d0400_CAN_Network_ETAS_BusOff_Event_To_DEM_POWER_Mapping: diagnostic-event=DTC_0x0d0400_CAN_Network_ETAS_BusOff_Event
    DTC_0xc07388_Event_To_DEM_POWER_Mapping: diagnostic-event=DTC_0xc07388_Event
    DTC_0xc12687_Event_To_DEM_POWER_Mapping: diagnostic-event=DTC_0xc12687_Event
    DTC_0xc14587_Event_To_DEM_POWER_Mapping: diagnostic-event=DTC_0xc14587_Event
    DTC_0xc22a87_Event_To_DEM_POWER_Mapping: diagnostic-event=DTC_0xc22a87_Event
    DTC_0xc41487_Event_To_DEM_POWER_Mapping: diagnostic-event=DTC_0xc41487_Event
    DTC_0xd56217_Event_To_DEM_POWER_Mapping: diagnostic-event=DTC_0xd56217_Event
    DTC_0xd56316_Event_To_DEM_POWER_Mapping: diagnostic-event=DTC_0xd56316_Event
    DTC_0xe00141_Event_To_DEM_POWER_Mapping: diagnostic-event=DTC_0xe00141_Event
    DTC_0xe00142_Event_To_DEM_POWER_Mapping: diagnostic-event=DTC_0xe00142_Event
    DTC_0xe26200_Event_To_DEM_POWER_Mapping: diagnostic-event=DTC_0xe26200_Event
  12 x diagnostic event to trouble code uds mapping:
    DTC_0x000001_Event_To_DTC_Mapping: diagnostic-event=DTC_0x000001_Event, trouble-code-uds=DTC_0x000001
    DTC_0x0d0400_CAN_Network_ETAS_BusOff_Event_To_DTC_Mapping: diagnostic-event=DTC_0x0d0400_CAN_Network_ETAS_BusOff_Event, trouble-code-uds=DTC_0x0d0400_CAN_Network_ETAS_BusOff
    DTC_0xc07388_Event_To_DTC_Mapping: diagnostic-event=DTC_0xc07388_Event, trouble-code-uds=DTC_0xc07388
    DTC_0xc12687_Event_To_DTC_Mapping: diagnostic-event=DTC_0xc12687_Event, trouble-code-uds=DTC_0xc12687
    DTC_0xc14587_Event_To_DTC_Mapping: diagnostic-event=DTC_0xc14587_Event, trouble-code-uds=DTC_0xc14587
    DTC_0xc22a87_Event_To_DTC_Mapping: diagnostic-event=DTC_0xc22a87_Event, trouble-code-uds=DTC_0xc22a87
    DTC_0xc41487_Event_To_DTC_Mapping: diagnostic-event=DTC_0xc41487_Event, trouble-code-uds=DTC_0xc41487
    DTC_0xd56217_Event_To_DTC_Mapping: diagnostic-event=DTC_0xd56217_Event, trouble-code-uds=DTC_0xd56217
    DTC_0xd56316_Event_To_DTC_Mapping: diagnostic-event=DTC_0xd56316_Event, trouble-code-uds=DTC_0xd56316
    DTC_0xe00141_Event_To_DTC_Mapping: diagnostic-event=DTC_0xe00141_Event, trouble-code-uds=DTC_0xe00141
    DTC_0xe00142_Event_To_DTC_Mapping: diagnostic-event=DTC_0xe00142_Event, trouble-code-uds=DTC_0xe00142
    DTC_0xe26200_Event_To_DTC_Mapping: diagnostic-event=DTC_0xe26200_Event, trouble-code-uds=DTC_0xe26200
package /Diagnostics/Dem/DtcProperties
  diagnostic trouble code props DTC_0x000001_Properties: aging=DTC_0x000001_Aging, extended-data-records=ExtendedDataRecord0x01, freeze-frames=[SnapshotRec_1, SnapshotRec_2], freeze-frame-content=DTC_0x000001_DidSet, immediate-nv-data-storage=true, max-number-freeze-frame-records=2, memory-destination=PrimaryMemory, priority=2, significance=FAULT
  diagnostic trouble code props DTC_0x0d0400_CAN_Network_ETAS_BusOff_Properties: aging=DTC_0x0d0400_CAN_Network_ETAS_BusOff_Aging, extended-data-records=ExtendedDataRecord0x01, freeze-frames=[SnapshotRec_1, SnapshotRec_2], freeze-frame-content=DTC_0x000001_DidSet, immediate-nv-data-storage=true, max-number-freeze-frame-records=2, memory-destination=PrimaryMemory, priority=4, significance=FAULT
  diagnostic trouble code props DTC_0xc22a87_Properties: aging=DTC_0x000001_Aging, extended-data-records=ExtendedDataRecord0x01, freeze-frames=[SnapshotRec_1, SnapshotRec_2], freeze-frame-content=DTC_0x000001_DidSet, immediate-nv-data-storage=true, max-number-freeze-frame-records=2, memory-destination=PrimaryMemory, priority=1, significance=FAULT
package /Diagnostics/Dem/DtcProperties/Agings
  diagnostic aging DTC_0x000001_Aging: aging-cycles=DEM_POWER, threshold=3
  diagnostic aging DTC_0x0d0400_CAN_Network_ETAS_BusOff_Aging: aging-cycles=DEM_POWER, threshold=40
package /Diagnostics/Dem/ExtendedDataRecords
  diagnostic extended data record ExtendedDataRecord0x01: record-number=1, trigger=CONFIRMED, update=true
    diagnostic-parameter bit-offset=0:
      diagnostic data element Fault_occurrence_counter: base-type=uint8_opaq, compu {identical}, range raw 0..255
    diagnostic-parameter bit-offset=8:
      diagnostic data element Fault_pending_counter: base-type=uint8_opaq, compu {identical}, range raw 0..255
    diagnostic-parameter bit-offset=16:
      diagnostic data element Aged_counter: base-type=uint8_opaq, compu {identical}, range raw 0..255
    diagnostic-parameter bit-offset=24:
      diagnostic data element Ageing_counter: base-type=uint8_opaq, compu {identical}, range raw 0..255
package /Diagnostics/Dem/FreezeFrames
  diagnostic freeze frame SnapshotRec_1: record-number=1, trigger=CONFIRMED, update=true
  diagnostic freeze frame SnapshotRec_2: record-number=2, trigger=CONFIRMED, update=true
package /Diagnostics/Dem/DidSets
  diagnostic data identifier set DTC_0x000001_DidSet: data-identifier=[DID_0x010B, DID_0x0112, DID_0xD001, DID_0xD901, DID_0xE101]
package /Diagnostics/Dem/OperationCycles
  diagnostic operation cycle DEM_POWER: cycle-autostart=true, cycle-status-storage=true, type=POWER
package /Diagnostics/Dem/Indicators
  diagnostic indicator WarningIndicator: type=WARNING
package /Diagnostics/Dcm
  diagnostic routine Routine_Control_203: id=515
    start Routine_Control_203_Start
      diagnostic-parameter bit-offset=0:
        diagnostic data element Out_New_Data_Object: base-type=uint8_opaq, compu {identical}, range raw 0..255
  diagnostic routine Routine_Control_ABFF: id=44031
    request result Routine_Control_ABFF_Results
      diagnostic-parameter bit-offset=0:
        diagnostic data element Out_New_Data_Object: base-type=uint8_opaq, compu {identical}, range raw 0..255
    start Routine_Control_ABFF_Start
  diagnostic routine X_Routine_Control_ABFE: id=44030
    start X_Routine_Control_ABFE_Start
  diagnostic service table ETAS_ServiceTable:
    diagnostic-connections=DcmDslConnection
    ecu-instance=ETAS
    protocol-kind=DCM_UDS_ON_CAN
    service-instance=[RDTCBSM, RNODTCBSM, RDTCSSBDTC, RDTCEDRBDN, RSUPDTC, Default_SessionControl, Programming_SessionControl, Extended_SessionControl, Hard, Soft, ClearDiagInfo, DID_0x0100_Read, DID_0x010B_Read, DID_0x0112_Read, DID_0xB950_Read, DID_0xD001_Read, DID_0xD901_Read, DID_0xE101_Read, DID_0xE900_Read, DID_0xF100_Read, DID_0xF110_Read, DID_0xF111_Read, DID_0xF112_Read, DID_0xF113_Read, DID_0xF114_Read, DID_0xF115_Read, DID_0xF116_Read, DID_0xF117_Read, DID_0xF118_Read, DID_0xF119_Read, DID_0xF11A_Read, DID_0xF11B_Read, DID_0xF11C_Read, DID_0xF11D_Read, DID_0xF11E_Read, DID_0xF11F_Read, DID_0xF120_Read, DID_0xF121_Read, DID_0xF122_Read, DID_0xF187_Read, DID_0xF18A_Read, DID_0xF18B_Read, DID_0xF18C_Read, DID_0xF190_Read, DID_0xF192_Read, DID_0xF194_Read, DID_0xF198_Read, DID_0xF1A0_Read, DID_0xF1A1_Read, DID_0xF1A2_Read, DID_0xF1A5_Read, DID_0xF1A8_Read, DID_0xF1A9_Read, DID_0xF1AA_Read, UnlockedL1_SecurityAccess, Unlocked_L3_SecurityAccess, EnableRxAndTx, DisableRxAndTx, DID_0x0100_Write, DID_0xF110_Write, DID_0xF115_Write, DID_0xF121_Write, DID_0xF187_Write, DID_0xF18B_Write, DID_0xF18C_Write, DID_0xF190_Write, DID_0xF198_Write, DID_0xF1A8_Write, DID_0xF1A9_Write, DID_0xF1AA_Write, DID_0xD901_IoCtrl, DID_0xE900_IoCtrl, Routine_Control_203, X_Routine_Control_ABFE, Routine_Control_ABFF, Enable, Disable]
  6 x diagnostic access permission:
    AP_All
    AP_Comb_0001: diagnostic-session=[Default, Extended]
    AP_Comb_0002: diagnostic-session=[Extended, Programming]
    AP_Comb_0003: diagnostic-session=Extended, security-level=UnlockedL1
    AP_Extended: diagnostic-session=Extended
    AP_Programming: diagnostic-session=Programming
package /Diagnostics/Dcm/DiagnosticSessions
  diagnostic session Default: id=1, jump-to-boot-loader=NO-BOOT, p-2-server-max=0.05, p-2-star-server-max=5.0
  diagnostic session Extended: id=3, jump-to-boot-loader=NO-BOOT, p-2-server-max=0.05, p-2-star-server-max=5.0
  diagnostic session Programming: id=2, jump-to-boot-loader=OEM-BOOT, p-2-server-max=0.05, p-2-star-server-max=5.0
package /Diagnostics/Dcm/SecurityLevels
  diagnostic security level Unlocked_L3: key-size=4, num-failed-security-access=3, security-delay-time=10.0, seed-size=4
  diagnostic security level UnlockedL1: key-size=4, num-failed-security-access=3, security-delay-time=10.0, seed-size=4
package /Diagnostics/Dcm/ServiceClasses
  diagnostic clear diagnostic information class ClearDiagnosticInformationClass: access-permission-validity=ACCESS-PERMISSION-SERVICE-INSTANCE  # ;FaultMemory_Clear
  diagnostic com control class ComControlClass: access-permission-validity=ACCESS-PERMISSION-SERVICE-INSTANCE, all-channels=Can_Network_ETAS  # ;EnableRxAndEnableTx_Control;DisableRxAndDisableTx_Control
  diagnostic control dtc setting class ControlDtcSettingClass: access-permission-validity=ACCESS-PERMISSION-SERVICE-INSTANCE, control-option-record-present=false  # ;ControlDTCSetting_On;ControlDTCSetting_Off
  diagnostic ecu reset class EcuResetClass: access-permission-validity=ACCESS-PERMISSION-SERVICE-INSTANCE  # ;Hard_Reset_Reset;Soft_Reset_Reset
  diagnostic io control class IoControlClass: access-permission-validity=ACCESS-PERMISSION-SERVICE-INSTANCE  # ;DID_0xD901_ReturnControl;DID_0xD901_Freeze;DID_0xD901_Control;DID_0xE900_ReturnControl;DID_0xE900_Freeze;DID_0xE900_Control
  diagnostic read data by identifier class ReadDataByIdentifierClass: access-permission-validity=ACCESS-PERMISSION-SERVICE-INSTANCE, max-did-to-read=5  # ;DID_0x0100_Read;DID_0x010B_Read;DID_0x0112_Read;DID_0xB950_Read;DID_0xD001_Read;DID_0xD901_Read;DID_0xE101_Read;DID_0xE900_Read;DID_0xF100_Read;DID_0xF110_Read;DID_0xF111_Read;DID_0xF112_Read;DID_0xF113_Read;DID_0xF114_Read;DID_0xF115_Read;DID_0xF116_Read;DID_0xF117_Read;DID_0xF118_Read;DID_0xF119_Read;DID_0xF11A_Read;DID_0xF11B_Read;DID_0xF11C_Read;DID_0xF11D_Read;DID_0xF11E_Read;DID_0xF11F_Read;DID_0xF120_Read;DID_0xF121_Read;DID_0xF122_Read;DID_0xF187_Read;DID_0xF18A_Read;DID_0xF18B_Read;DID_0xF18C_Read;DID_0xF190_Read;DID_0xF192_Read;DID_0xF194_Read;DID_0xF198_Read;DID_0xF1A0_Read;DID_0xF1A1_Read;DID_0xF1A2_Read;DID_0xF1A5_Read;DID_0xF1A8_Read;DID_0xF1A9_Read;DID_0xF1AA_Read
  diagnostic read dtc information class ReadDtcInformationClass: access-permission-validity=ACCESS-PERMISSION-SERVICE-INSTANCE  # ;FaultMemory_ReadAllIdentified
  diagnostic routine control class RoutineControlClass: access-permission-validity=ACCESS-PERMISSION-SERVICE-INSTANCE  # ;Routine_Control_203_Start;_Routine_Control_ABFE_Start;Routine_Control_ABFF_Start;Routine_Control_ABFF_Results
  diagnostic security access class SecurityAccessClass: access-permission-validity=ACCESS-PERMISSION-SERVICE-INSTANCE  # ;SeedLevel1_Request;KeyLevel1_Send;RequestSeed_L3_Request;requestSeed_L3_1_Send
  diagnostic session control class SessionControlClass: access-permission-validity=ACCESS-PERMISSION-SERVICE-INSTANCE  # ;DefaultSession_Start;ProgrammingSession_Start;ExtendedDiagnosticSession_Start
  diagnostic write data by identifier class WriteDataByIdentifierClass: access-permission-validity=ACCESS-PERMISSION-SERVICE-INSTANCE  # ;DID_0x0100_Write;DID_0xF110_Write;DID_0xF115_Write;DID_0xF121_Write;DID_0xF187_Write;DID_0xF18B_Write;DID_0xF18C_Write;DID_0xF190_Write;DID_0xF198_Write;DID_0xF1A8_Write;DID_0xF1A9_Write;DID_0xF1AA_Write
package /Diagnostics/Dcm/ServiceInstances
  diagnostic clear diagnostic information ClearDiagInfo: access-permission=AP_Comb_0001, clear-diagnostic-information-class=ClearDiagnosticInformationClass
  diagnostic com control DisableRxAndTx: category=DISABLE_RX_AND_TX, access-permission=AP_Comb_0002, com-control-class=ComControlClass
  diagnostic com control EnableRxAndTx: category=ENABLE_RX_AND_TX, access-permission=AP_Comb_0002, com-control-class=ComControlClass
  diagnostic control dtc setting Disable: access-permission=AP_Comb_0001, dtc-setting-class=ControlDtcSettingClass, dtc-setting-parameter=2
  diagnostic control dtc setting Enable: access-permission=AP_Comb_0001, dtc-setting-class=ControlDtcSettingClass, dtc-setting-parameter=1
  diagnostic ecu reset Hard: category=HARD_RESET, access-permission=AP_All, ecu-reset-class=EcuResetClass
  diagnostic ecu reset Soft: category=SOFT_RESET, access-permission=AP_All, ecu-reset-class=EcuResetClass
  diagnostic io control DID_0xD901_IoCtrl: access-permission=AP_Extended, data-identifier=DID_0xD901, freeze-current-state=true, io-control-class=IoControlClass, reset-to-default=false, short-term-adjustment=true
  diagnostic io control DID_0xE900_IoCtrl: access-permission=AP_Extended, data-identifier=DID_0xE900, freeze-current-state=true, io-control-class=IoControlClass, reset-to-default=false, short-term-adjustment=true
  43 x diagnostic read data by identifier, all with access-permission=AP_All, read-class=ReadDataByIdentifierClass:
    DID_0x0100_Read: data-identifier=DID_0x0100
    DID_0x010B_Read: data-identifier=DID_0x010B
    DID_0x0112_Read: data-identifier=DID_0x0112
    DID_0xB950_Read: data-identifier=DID_0xB950
    DID_0xD001_Read: data-identifier=DID_0xD001
    DID_0xD901_Read: data-identifier=DID_0xD901
    DID_0xE101_Read: data-identifier=DID_0xE101
    DID_0xE900_Read: data-identifier=DID_0xE900
    DID_0xF100_Read: data-identifier=DID_0xF100
    DID_0xF{110..119}_Read: data-identifier=DID_0xF{110..119}
    DID_0xF11A_Read: data-identifier=DID_0xF11A
    DID_0xF11B_Read: data-identifier=DID_0xF11B
    DID_0xF11C_Read: data-identifier=DID_0xF11C
    DID_0xF11D_Read: data-identifier=DID_0xF11D
    DID_0xF11E_Read: data-identifier=DID_0xF11E
    DID_0xF11F_Read: data-identifier=DID_0xF11F
    DID_0xF{120..122}_Read: data-identifier=DID_0xF{120..122}
    DID_0xF187_Read: data-identifier=DID_0xF187
    DID_0xF18A_Read: data-identifier=DID_0xF18A
    DID_0xF18B_Read: data-identifier=DID_0xF18B
    DID_0xF18C_Read: data-identifier=DID_0xF18C
    DID_0xF190_Read: data-identifier=DID_0xF190
    DID_0xF192_Read: data-identifier=DID_0xF192
    DID_0xF194_Read: data-identifier=DID_0xF194
    DID_0xF198_Read: data-identifier=DID_0xF198
    DID_0xF1A{0..2}_Read: data-identifier=DID_0xF1A{0..2}
    DID_0xF1A5_Read: data-identifier=DID_0xF1A5
    DID_0xF1A8_Read: data-identifier=DID_0xF1A8
    DID_0xF1A9_Read: data-identifier=DID_0xF1A9
    DID_0xF1AA_Read: data-identifier=DID_0xF1AA
  5 x diagnostic read dtc information, all with access-permission=AP_Comb_0001, read-dtc-information-class=ReadDtcInformationClass:
    RDTCBSM: category=REPORT_DTC_BY_STATUS_MASK
    RDTCEDRBDN: category=REPORT_DTC_EXT_DATA_RECORD_BY_DTC_NUMBER
    RDTCSSBDTC: category=REPORT_DTC_SNAPSHOT_RECORD_BY_DTC_NUMBER
    RNODTCBSM: category=REPORT_NUMBER_OF_DTC_BY_STATUS_MASK
    RSUPDTC: category=REPORT_SUPPORTED_DTC
  diagnostic routine control Routine_Control_203: access-permission=AP_Extended, routine-control-class=RoutineControlClass, routine=Routine_Control_203
  diagnostic routine control Routine_Control_ABFF: access-permission=AP_Extended, routine-control-class=RoutineControlClass, routine=Routine_Control_ABFF
  diagnostic routine control X_Routine_Control_ABFE: access-permission=AP_Extended, routine-control-class=RoutineControlClass, routine=X_Routine_Control_ABFE
  diagnostic security access Unlocked_L3_SecurityAccess: access-permission=AP_Programming, request-seed-id=5, security-access-class=SecurityAccessClass, security-level=Unlocked_L3
  diagnostic security access UnlockedL1_SecurityAccess: access-permission=AP_Extended, request-seed-id=1, security-access-class=SecurityAccessClass, security-level=UnlockedL1
  diagnostic session control Default_SessionControl: access-permission=AP_All, diagnostic-session=Default, session-control-class=SessionControlClass
  diagnostic session control Extended_SessionControl: access-permission=AP_All, diagnostic-session=Extended, session-control-class=SessionControlClass
  diagnostic session control Programming_SessionControl: access-permission=AP_Comb_0002, diagnostic-session=Programming, session-control-class=SessionControlClass
  12 x diagnostic write data by identifier, all with access-permission=AP_Comb_0003, write-class=WriteDataByIdentifierClass:
    DID_0x0100_Write: data-identifier=DID_0x0100
    DID_0xF110_Write: data-identifier=DID_0xF110
    DID_0xF115_Write: data-identifier=DID_0xF115
    DID_0xF121_Write: data-identifier=DID_0xF121
    DID_0xF187_Write: data-identifier=DID_0xF187
    DID_0xF18B_Write: data-identifier=DID_0xF18B
    DID_0xF18C_Write: data-identifier=DID_0xF18C
    DID_0xF190_Write: data-identifier=DID_0xF190
    DID_0xF198_Write: data-identifier=DID_0xF198
    DID_0xF1A8_Write: data-identifier=DID_0xF1A8
    DID_0xF1A9_Write: data-identifier=DID_0xF1A9
    DID_0xF1AA_Write: data-identifier=DID_0xF1AA
package /DiagnosticEcuInstancePropss
  diagnostic ecu instance props DiagnosticEcuInstanceProps: ecu-instance=ETAS, obd-support=MASTER-ECU, send-resp-pend-on-trans-to-boot=true
package /DiagnosticConnections
  diagnostic connection DcmDslConnection: functional-request=UdsRxFnc_0x7df_oTN_0x00E0_Tester, physical-request=UdsRxPhy_0x740_MyECU_oTN_0x0001_MyECU, response=UdsTxPhy_0x748_MyECU_oTN_0x0001_MyECU
package /DiagnosticProtocols
  diagnostic protocol DcmDslProtocolRow: diagnostic-connections=DcmDslConnection, priority=0, protocol-kind=DCM_UDS_ON_CAN, send-resp-pend-on-trans-to-boot=true, service-tables=ETAS_ServiceTable
